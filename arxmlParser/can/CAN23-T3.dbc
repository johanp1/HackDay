VERSION ""

NS_ :

BS_:

BU_: SR_RR SR_RF SR_LR SR_LF DACU

BO_ 2671798514 PhysDiagReqMsg_68_F2_Vic4: 8 DACU
 SG_ PhysDiagReqSig_68_F2 : 0|64@1+ (1,0) [0|0] ""  SR_LR

BO_ 796 LRSideSensorTrlrObj: 32 SR_LR
 SG_ LRSideSensorTrlrObj_SegTrlrType3 : 196|4@1+ (1,0) [0|0] ""  VCM
 SG_ LRSideSensorTrlrObj_TrlAnglConf : 174|7@1+ (1,0) [0|0] ""  VCM
 SG_ LRSideSensorTrlrObj_TrlrTypeConf : 208|7@1+ (1,0) [0|127] "Percent"  VCM
 SG_ LRSideSensorTrlrObj_Seg1Length : 36|9@1+ (0.05,0) [0|25.55] "m"  VCM
 SG_ LRSideSensorTrlrObj_SegTrlrType5 : 204|4@1+ (1,0) [0|0] ""  VCM
 SG_ LRSideSensorTrlrObj_SegAngle1 : 45|12@1+ (0.001745,-2.4) [-2.4|4.745775] "rad"  VCM
 SG_ LRSideSensorTrlrObj_Seg4Length : 18|9@1+ (0.05,0) [0|25.55] "m"  VCM
 SG_ LRSideSensorTrlrObj_WheelBased1 : 119|11@1+ (0.1,0) [0|204.7] "m"  VCM
 SG_ LRSideSensorTrlrObj_SegTrlrType1 : 188|4@1+ (1,0) [0|0] ""  VCM
 SG_ LRSideSensorTrlrObj_Seg5Length : 27|9@1+ (0.05,0) [0|25.55] "m"  VCM
 SG_ LRSideSensorTrlrObj_WheelBased2 : 130|11@1+ (0.1,0) [0|204.7] "m"  VCM
 SG_ LRSideSensorTrlrObj_WheelBased3 : 141|11@1+ (0.1,0) [0|204.7] "m"  VCM
 SG_ LRSideSensorTrlrObj_WheelBased5 : 163|11@1+ (0.1,0) [0|204.7] "m"  VCM
 SG_ LRSideSensorTrlrObj_SegTrlrType4 : 200|4@1+ (1,0) [0|0] ""  VCM
 SG_ LRSideSensorTrlrObj_Seg3Length : 9|9@1+ (0.05,0) [0|25.55] "m"  VCM
 SG_ LRSideSensorTrlrObj_SegTrlrType2 : 192|4@1+ (1,0) [0|0] ""  VCM
 SG_ LRSideSensorTrlrObj_TotLenConf : 116|3@1+ (1,0) [0|0] ""  VCM
 SG_ LRSideSensorTrlrObj_WheelBased4 : 152|11@1+ (0.1,0) [0|204.7] "m"  VCM
 SG_ LRSideSensorTrlrObj_TotalLength : 105|11@1+ (0.1,0) [0|204.7] "m"  VCM
 SG_ LRSideSensorTrlrObj_WhlBasedConf : 181|7@1+ (1,0) [0|127] "Percent"  VCM
 SG_ LRSideSensorTrlrObj_SegAngle5 : 93|12@1+ (0.001745,-2.4) [-2.4|4.745775] "rad"  VCM
 SG_ LRSideSensorTrlrObj_SegAngle3 : 69|12@1+ (0.001745,-2.4) [-2.4|4.745775] "rad"  VCM
 SG_ LRSideSensorTrlrObj_SegAngle2 : 57|12@1+ (0.001745,-2.4) [-2.4|4.745775] "rad"  VCM
 SG_ LRSideSensorTrlrObj_SegAngle4 : 81|12@1+ (0.001745,-2.4) [-2.4|4.745775] "rad"  VCM
 SG_ LRSideSensorTrlrObj_Seg2Length : 0|9@1+ (0.05,0) [0|25.55] "m"  VCM

BO_ 795 LRSideSensorObj11: 48 SR_LR
 SG_ LRSideSensorObj11_LatExtLeftVar : 104|8@1+ (0.1,0) [0|25.5] "NotApplicable"  VCM
 SG_ LRSideSensorObj11_CRC : 0|16@1+ (1,0) [0|65535] "NotApplicable"  VCM
 SG_ LRSideSensorObj11_CoastIndex : 155|5@1+ (1,0) [0|31] "NotApplicable"  VCM
 SG_ LRSideSensorObj11_LatPosVar : 88|8@1+ (0.1,0) [0|25.5] "NotApplicable"  VCM
 SG_ LRSideSensorObj11_LongExtBkVar : 64|8@1+ (0.1,0) [0|25.5] "NotApplicable"  VCM
 SG_ LRSideSensorObj11_LongExtBack : 257|10@1+ (0.05,-50) [-50|1.15000000000001] "m"  VCM
 SG_ LRSideSensorObj11_ObstacleConf : 300|7@1+ (0.01,0) [0|1.27] "NotApplicable"  VCM
 SG_ LRSideSensorObj11_MOISPrio : 307|1@1+ (1,0) [0|0] ""  VCM
 SG_ LRSideSensorObj11_LongAccVar : 72|8@1+ (0.1,0) [0|25.5] "NotApplicable"  VCM
 SG_ LRSideSensorObj11_LifeTime : 128|16@1+ (0.1,0) [0|6553.5] "s"  VCM
 SG_ LRSideSensorObj11_Height : 168|8@1+ (0.02,0) [0|5.1] "m"  VCM
 SG_ LRSideSensorObj11_LongExtFrVar : 56|8@1+ (0.1,0) [0|25.5] "NotApplicable"  VCM
 SG_ LRSideSensorObj11_ObjDynClass : 166|2@1+ (1,0) [0|0] ""  VCM
 SG_ LRSideSensorObj11_Prioritisation : 290|2@1+ (1,0) [0|0] ""  VCM
 SG_ LRSideSensorObj11_LongAcc : 176|9@1+ (0.08,-20) [-20|20.88] "m_per_s_squared"  VCM
 SG_ LRSideSensorObj11_LatVelVar : 80|8@1+ (0.01,0) [0|2.55] "NotApplicable"  VCM
 SG_ LRSideSensorObj11_LongPosVar : 48|8@1+ (0.01,0) [0|2.55] "NotApplicable"  VCM
 SG_ LRSideSensorObj11_LatExtRight : 185|7@1+ (0.05,-5) [-5|1.35] "m"  VCM
 SG_ LRSideSensorObj11_LongPos : 234|13@1+ (0.05,-180) [-180|229.55] "m"  VCM
 SG_ LRSideSensorObj11_HeadingVar : 120|8@1+ (0.001,0) [0|0.255] "NotApplicable"  VCM
 SG_ LRSideSensorObj11_Counter : 16|8@1+ (1,0) [0|255] "Count"  VCM
 SG_ LRSideSensorObj11_LatPos : 221|13@1+ (0.05,-180) [-180|229.55] "m"  VCM
 SG_ LRSideSensorObj11_TimeStamp : 24|16@1+ (0.1,0) [0|6553.5] "ms"  VCM
 SG_ LRSideSensorObj11_ObjClassConf : 296|4@1+ (0.1,0) [0|1.5] "NotApplicable"  VCM
 SG_ LRSideSensorObj11_LatExtRtVar : 96|8@1+ (0.1,0) [0|25.5] "NotApplicable"  VCM
 SG_ LRSideSensorObj11_ExistConf : 283|7@1+ (0.01,0) [0|1.27] "NotApplicable"  VCM
 SG_ LRSideSensorObj11_LatExtLeft : 276|7@1+ (0.05,0) [0|6.35] "m"  VCM
 SG_ LRSideSensorObj11_LatAccVar : 112|8@1+ (0.1,0) [0|25.5] "NotApplicable"  VCM
 SG_ LRSideSensorObj11_ObjID : 160|6@1+ (1,0) [0|63] "NotApplicable"  VCM
 SG_ LRSideSensorObj11_LatVel : 208|13@1+ (0.032,-80) [-80|182.112] "m_per_s"  VCM
 SG_ LRSideSensorObj11_LatAcc : 267|9@1+ (0.08,-20) [-20|20.88] "m_per_s_squared"  VCM
 SG_ LRSideSensorObj11_LongVel : 195|13@1+ (0.032,-80) [-80|182.112] "m_per_s"  VCM
 SG_ LRSideSensorObj11_Heading : 144|11@1+ (0.005818,-4.71) [-4.71|7.199446] "rad"  VCM
 SG_ LRSideSensorObj11_LongExtFront : 247|10@1+ (0.05,0) [0|51.15] "m"  VCM
 SG_ LRSideSensorObj11_LongVelVar : 40|8@1+ (0.01,0) [0|2.55] "NotApplicable"  VCM
 SG_ LRSideSensorObj11_TrackStatus : 192|3@1+ (1,0) [0|0] ""  VCM
 SG_ LRSideSensorObj11_ObjClass : 292|4@1+ (1,0) [0|0] ""  VCM

BO_ 794 LRSideSensorObj10: 48 SR_LR
 SG_ LRSideSensorObj10_LifeTime : 128|16@1+ (0.1,0) [0|6553.5] "s"  VCM
 SG_ LRSideSensorObj10_LongPos : 234|13@1+ (0.05,-180) [-180|229.55] "m"  VCM
 SG_ LRSideSensorObj10_LatPosVar : 88|8@1+ (0.1,0) [0|25.5] "NotApplicable"  VCM
 SG_ LRSideSensorObj10_LatVel : 208|13@1+ (0.032,-80) [-80|182.112] "m_per_s"  VCM
 SG_ LRSideSensorObj10_LatPos : 221|13@1+ (0.05,-180) [-180|229.55] "m"  VCM
 SG_ LRSideSensorObj10_HeadingVar : 120|8@1+ (0.001,0) [0|0.255] "NotApplicable"  VCM
 SG_ LRSideSensorObj10_LatExtRight : 185|7@1+ (0.05,-5) [-5|1.35] "m"  VCM
 SG_ LRSideSensorObj10_Height : 168|8@1+ (0.02,0) [0|5.1] "m"  VCM
 SG_ LRSideSensorObj10_TrackStatus : 192|3@1+ (1,0) [0|0] ""  VCM
 SG_ LRSideSensorObj10_ExistConf : 283|7@1+ (0.01,0) [0|1.27] "NotApplicable"  VCM
 SG_ LRSideSensorObj10_LatExtRtVar : 96|8@1+ (0.1,0) [0|25.5] "NotApplicable"  VCM
 SG_ LRSideSensorObj10_CRC : 0|16@1+ (1,0) [0|65535] "NotApplicable"  VCM
 SG_ LRSideSensorObj10_LatExtLeft : 276|7@1+ (0.05,0) [0|6.35] "m"  VCM
 SG_ LRSideSensorObj10_LatAccVar : 112|8@1+ (0.1,0) [0|25.5] "NotApplicable"  VCM
 SG_ LRSideSensorObj10_Heading : 144|11@1+ (0.005818,-4.71) [-4.71|7.199446] "rad"  VCM
 SG_ LRSideSensorObj10_LongExtBack : 257|10@1+ (0.05,-50) [-50|1.15000000000001] "m"  VCM
 SG_ LRSideSensorObj10_ObstacleConf : 300|7@1+ (0.01,0) [0|1.27] "NotApplicable"  VCM
 SG_ LRSideSensorObj10_ObjID : 160|6@1+ (1,0) [0|63] "NotApplicable"  VCM
 SG_ LRSideSensorObj10_LongAcc : 176|9@1+ (0.08,-20) [-20|20.88] "m_per_s_squared"  VCM
 SG_ LRSideSensorObj10_LongExtFront : 247|10@1+ (0.05,0) [0|51.15] "m"  VCM
 SG_ LRSideSensorObj10_LatAcc : 267|9@1+ (0.08,-20) [-20|20.88] "m_per_s_squared"  VCM
 SG_ LRSideSensorObj10_LongVelVar : 40|8@1+ (0.01,0) [0|2.55] "NotApplicable"  VCM
 SG_ LRSideSensorObj10_LongVel : 195|13@1+ (0.032,-80) [-80|182.112] "m_per_s"  VCM
 SG_ LRSideSensorObj10_LongExtFrVar : 56|8@1+ (0.1,0) [0|25.5] "NotApplicable"  VCM
 SG_ LRSideSensorObj10_LongExtBkVar : 64|8@1+ (0.1,0) [0|25.5] "NotApplicable"  VCM
 SG_ LRSideSensorObj10_LongPosVar : 48|8@1+ (0.01,0) [0|2.55] "NotApplicable"  VCM
 SG_ LRSideSensorObj10_Prioritisation : 290|2@1+ (1,0) [0|0] ""  VCM
 SG_ LRSideSensorObj10_ObjClassConf : 296|4@1+ (0.1,0) [0|1.5] "NotApplicable"  VCM
 SG_ LRSideSensorObj10_TimeStamp : 24|16@1+ (0.1,0) [0|6553.5] "ms"  VCM
 SG_ LRSideSensorObj10_MOISPrio : 307|1@1+ (1,0) [0|0] ""  VCM
 SG_ LRSideSensorObj10_LatExtLeftVar : 104|8@1+ (0.1,0) [0|25.5] "NotApplicable"  VCM
 SG_ LRSideSensorObj10_LatVelVar : 80|8@1+ (0.01,0) [0|2.55] "NotApplicable"  VCM
 SG_ LRSideSensorObj10_ObjClass : 292|4@1+ (1,0) [0|0] ""  VCM
 SG_ LRSideSensorObj10_Counter : 16|8@1+ (1,0) [0|255] "Count"  VCM
 SG_ LRSideSensorObj10_LongAccVar : 72|8@1+ (0.1,0) [0|25.5] "NotApplicable"  VCM
 SG_ LRSideSensorObj10_CoastIndex : 155|5@1+ (1,0) [0|31] "NotApplicable"  VCM
 SG_ LRSideSensorObj10_ObjDynClass : 166|2@1+ (1,0) [0|0] ""  VCM

BO_ 793 LRSideSensorObj09: 48 SR_LR
 SG_ LRSideSensorObj09_LongExtFrVar : 56|8@1+ (0.1,0) [0|25.5] "NotApplicable"  VCM
 SG_ LRSideSensorObj09_LongExtBack : 257|10@1+ (0.05,-50) [-50|1.15000000000001] "m"  VCM
 SG_ LRSideSensorObj09_LatExtRtVar : 96|8@1+ (0.1,0) [0|25.5] "NotApplicable"  VCM
 SG_ LRSideSensorObj09_CRC : 0|16@1+ (1,0) [0|65535] "NotApplicable"  VCM
 SG_ LRSideSensorObj09_LatExtLeft : 276|7@1+ (0.05,0) [0|6.35] "m"  VCM
 SG_ LRSideSensorObj09_LatExtRight : 185|7@1+ (0.05,-5) [-5|1.35] "m"  VCM
 SG_ LRSideSensorObj09_LatVelVar : 80|8@1+ (0.01,0) [0|2.55] "NotApplicable"  VCM
 SG_ LRSideSensorObj09_ObjID : 160|6@1+ (1,0) [0|63] "NotApplicable"  VCM
 SG_ LRSideSensorObj09_ObjDynClass : 166|2@1+ (1,0) [0|0] ""  VCM
 SG_ LRSideSensorObj09_MOISPrio : 307|1@1+ (1,0) [0|0] ""  VCM
 SG_ LRSideSensorObj09_LongVel : 195|13@1+ (0.032,-80) [-80|182.112] "m_per_s"  VCM
 SG_ LRSideSensorObj09_HeadingVar : 120|8@1+ (0.001,0) [0|0.255] "NotApplicable"  VCM
 SG_ LRSideSensorObj09_LongExtBkVar : 64|8@1+ (0.1,0) [0|25.5] "NotApplicable"  VCM
 SG_ LRSideSensorObj09_LatAccVar : 112|8@1+ (0.1,0) [0|25.5] "NotApplicable"  VCM
 SG_ LRSideSensorObj09_LatPos : 221|13@1+ (0.05,-180) [-180|229.55] "m"  VCM
 SG_ LRSideSensorObj09_TimeStamp : 24|16@1+ (0.1,0) [0|6553.5] "ms"  VCM
 SG_ LRSideSensorObj09_LatAcc : 267|9@1+ (0.08,-20) [-20|20.88] "m_per_s_squared"  VCM
 SG_ LRSideSensorObj09_LatPosVar : 88|8@1+ (0.1,0) [0|25.5] "NotApplicable"  VCM
 SG_ LRSideSensorObj09_LongAcc : 176|9@1+ (0.08,-20) [-20|20.88] "m_per_s_squared"  VCM
 SG_ LRSideSensorObj09_LatVel : 208|13@1+ (0.032,-80) [-80|182.112] "m_per_s"  VCM
 SG_ LRSideSensorObj09_ObstacleConf : 300|7@1+ (0.01,0) [0|1.27] "NotApplicable"  VCM
 SG_ LRSideSensorObj09_TrackStatus : 192|3@1+ (1,0) [0|0] ""  VCM
 SG_ LRSideSensorObj09_LatExtLeftVar : 104|8@1+ (0.1,0) [0|25.5] "NotApplicable"  VCM
 SG_ LRSideSensorObj09_LifeTime : 128|16@1+ (0.1,0) [0|6553.5] "s"  VCM
 SG_ LRSideSensorObj09_LongExtFront : 247|10@1+ (0.05,0) [0|51.15] "m"  VCM
 SG_ LRSideSensorObj09_LongAccVar : 72|8@1+ (0.1,0) [0|25.5] "NotApplicable"  VCM
 SG_ LRSideSensorObj09_LongPos : 234|13@1+ (0.05,-180) [-180|229.55] "m"  VCM
 SG_ LRSideSensorObj09_LongVelVar : 40|8@1+ (0.01,0) [0|2.55] "NotApplicable"  VCM
 SG_ LRSideSensorObj09_ObjClass : 292|4@1+ (1,0) [0|0] ""  VCM
 SG_ LRSideSensorObj09_ExistConf : 283|7@1+ (0.01,0) [0|1.27] "NotApplicable"  VCM
 SG_ LRSideSensorObj09_Prioritisation : 290|2@1+ (1,0) [0|0] ""  VCM
 SG_ LRSideSensorObj09_Heading : 144|11@1+ (0.005818,-4.71) [-4.71|7.199446] "rad"  VCM
 SG_ LRSideSensorObj09_Height : 168|8@1+ (0.02,0) [0|5.1] "m"  VCM
 SG_ LRSideSensorObj09_ObjClassConf : 296|4@1+ (0.1,0) [0|1.5] "NotApplicable"  VCM
 SG_ LRSideSensorObj09_LongPosVar : 48|8@1+ (0.01,0) [0|2.55] "NotApplicable"  VCM
 SG_ LRSideSensorObj09_CoastIndex : 155|5@1+ (1,0) [0|31] "NotApplicable"  VCM
 SG_ LRSideSensorObj09_Counter : 16|8@1+ (1,0) [0|255] "Count"  VCM

BO_ 792 LRSideSensorObj08: 48 SR_LR
 SG_ LRSideSensorObj08_ObjDynClass : 166|2@1+ (1,0) [0|0] ""  VCM
 SG_ LRSideSensorObj08_LatExtRight : 185|7@1+ (0.05,-5) [-5|1.35] "m"  VCM
 SG_ LRSideSensorObj08_CRC : 0|16@1+ (1,0) [0|65535] "NotApplicable"  VCM
 SG_ LRSideSensorObj08_Counter : 16|8@1+ (1,0) [0|255] "Count"  VCM
 SG_ LRSideSensorObj08_LatPos : 221|13@1+ (0.05,-180) [-180|229.55] "m"  VCM
 SG_ LRSideSensorObj08_LongVelVar : 40|8@1+ (0.01,0) [0|2.55] "NotApplicable"  VCM
 SG_ LRSideSensorObj08_LatVel : 208|13@1+ (0.032,-80) [-80|182.112] "m_per_s"  VCM
 SG_ LRSideSensorObj08_LatAccVar : 112|8@1+ (0.1,0) [0|25.5] "NotApplicable"  VCM
 SG_ LRSideSensorObj08_LongAcc : 176|9@1+ (0.08,-20) [-20|20.88] "m_per_s_squared"  VCM
 SG_ LRSideSensorObj08_CoastIndex : 155|5@1+ (1,0) [0|31] "NotApplicable"  VCM
 SG_ LRSideSensorObj08_LatVelVar : 80|8@1+ (0.01,0) [0|2.55] "NotApplicable"  VCM
 SG_ LRSideSensorObj08_ObjClassConf : 296|4@1+ (0.1,0) [0|1.5] "NotApplicable"  VCM
 SG_ LRSideSensorObj08_Prioritisation : 290|2@1+ (1,0) [0|0] ""  VCM
 SG_ LRSideSensorObj08_LongExtFrVar : 56|8@1+ (0.1,0) [0|25.5] "NotApplicable"  VCM
 SG_ LRSideSensorObj08_ObjID : 160|6@1+ (1,0) [0|63] "NotApplicable"  VCM
 SG_ LRSideSensorObj08_HeadingVar : 120|8@1+ (0.001,0) [0|0.255] "NotApplicable"  VCM
 SG_ LRSideSensorObj08_LatAcc : 267|9@1+ (0.08,-20) [-20|20.88] "m_per_s_squared"  VCM
 SG_ LRSideSensorObj08_LongPos : 234|13@1+ (0.05,-180) [-180|229.55] "m"  VCM
 SG_ LRSideSensorObj08_LongPosVar : 48|8@1+ (0.01,0) [0|2.55] "NotApplicable"  VCM
 SG_ LRSideSensorObj08_LatExtLeft : 276|7@1+ (0.05,0) [0|6.35] "m"  VCM
 SG_ LRSideSensorObj08_LongExtBkVar : 64|8@1+ (0.1,0) [0|25.5] "NotApplicable"  VCM
 SG_ LRSideSensorObj08_TrackStatus : 192|3@1+ (1,0) [0|0] ""  VCM
 SG_ LRSideSensorObj08_LongAccVar : 72|8@1+ (0.1,0) [0|25.5] "NotApplicable"  VCM
 SG_ LRSideSensorObj08_LatPosVar : 88|8@1+ (0.1,0) [0|25.5] "NotApplicable"  VCM
 SG_ LRSideSensorObj08_LongVel : 195|13@1+ (0.032,-80) [-80|182.112] "m_per_s"  VCM
 SG_ LRSideSensorObj08_ObstacleConf : 300|7@1+ (0.01,0) [0|1.27] "NotApplicable"  VCM
 SG_ LRSideSensorObj08_LifeTime : 128|16@1+ (0.1,0) [0|6553.5] "s"  VCM
 SG_ LRSideSensorObj08_LongExtFront : 247|10@1+ (0.05,0) [0|51.15] "m"  VCM
 SG_ LRSideSensorObj08_TimeStamp : 24|16@1+ (0.1,0) [0|6553.5] "ms"  VCM
 SG_ LRSideSensorObj08_LongExtBack : 257|10@1+ (0.05,-50) [-50|1.15000000000001] "m"  VCM
 SG_ LRSideSensorObj08_LatExtLeftVar : 104|8@1+ (0.1,0) [0|25.5] "NotApplicable"  VCM
 SG_ LRSideSensorObj08_LatExtRtVar : 96|8@1+ (0.1,0) [0|25.5] "NotApplicable"  VCM
 SG_ LRSideSensorObj08_Heading : 144|11@1+ (0.005818,-4.71) [-4.71|7.199446] "rad"  VCM
 SG_ LRSideSensorObj08_ExistConf : 283|7@1+ (0.01,0) [0|1.27] "NotApplicable"  VCM
 SG_ LRSideSensorObj08_MOISPrio : 307|1@1+ (1,0) [0|0] ""  VCM
 SG_ LRSideSensorObj08_ObjClass : 292|4@1+ (1,0) [0|0] ""  VCM
 SG_ LRSideSensorObj08_Height : 168|8@1+ (0.02,0) [0|5.1] "m"  VCM

BO_ 791 LRSideSensorObj07: 48 SR_LR
 SG_ LRSideSensorObj07_CRC : 0|16@1+ (1,0) [0|65535] "NotApplicable"  VCM
 SG_ LRSideSensorObj07_ObjID : 160|6@1+ (1,0) [0|63] "NotApplicable"  VCM
 SG_ LRSideSensorObj07_ObjClassConf : 296|4@1+ (0.1,0) [0|1.5] "NotApplicable"  VCM
 SG_ LRSideSensorObj07_LongExtFrVar : 56|8@1+ (0.1,0) [0|25.5] "NotApplicable"  VCM
 SG_ LRSideSensorObj07_MOISPrio : 307|1@1+ (1,0) [0|0] ""  VCM
 SG_ LRSideSensorObj07_LatExtRight : 185|7@1+ (0.05,-5) [-5|1.35] "m"  VCM
 SG_ LRSideSensorObj07_Counter : 16|8@1+ (1,0) [0|255] "Count"  VCM
 SG_ LRSideSensorObj07_LongPosVar : 48|8@1+ (0.01,0) [0|2.55] "NotApplicable"  VCM
 SG_ LRSideSensorObj07_CoastIndex : 155|5@1+ (1,0) [0|31] "NotApplicable"  VCM
 SG_ LRSideSensorObj07_Height : 168|8@1+ (0.02,0) [0|5.1] "m"  VCM
 SG_ LRSideSensorObj07_LifeTime : 128|16@1+ (0.1,0) [0|6553.5] "s"  VCM
 SG_ LRSideSensorObj07_Heading : 144|11@1+ (0.005818,-4.71) [-4.71|7.199446] "rad"  VCM
 SG_ LRSideSensorObj07_LatPos : 221|13@1+ (0.05,-180) [-180|229.55] "m"  VCM
 SG_ LRSideSensorObj07_LongVelVar : 40|8@1+ (0.01,0) [0|2.55] "NotApplicable"  VCM
 SG_ LRSideSensorObj07_ObstacleConf : 300|7@1+ (0.01,0) [0|1.27] "NotApplicable"  VCM
 SG_ LRSideSensorObj07_LongPos : 234|13@1+ (0.05,-180) [-180|229.55] "m"  VCM
 SG_ LRSideSensorObj07_LongExtFront : 247|10@1+ (0.05,0) [0|51.15] "m"  VCM
 SG_ LRSideSensorObj07_LongAccVar : 72|8@1+ (0.1,0) [0|25.5] "NotApplicable"  VCM
 SG_ LRSideSensorObj07_LatExtLeft : 276|7@1+ (0.05,0) [0|6.35] "m"  VCM
 SG_ LRSideSensorObj07_LatPosVar : 88|8@1+ (0.1,0) [0|25.5] "NotApplicable"  VCM
 SG_ LRSideSensorObj07_LongVel : 195|13@1+ (0.032,-80) [-80|182.112] "m_per_s"  VCM
 SG_ LRSideSensorObj07_LatVelVar : 80|8@1+ (0.01,0) [0|2.55] "NotApplicable"  VCM
 SG_ LRSideSensorObj07_LatExtLeftVar : 104|8@1+ (0.1,0) [0|25.5] "NotApplicable"  VCM
 SG_ LRSideSensorObj07_TimeStamp : 24|16@1+ (0.1,0) [0|6553.5] "ms"  VCM
 SG_ LRSideSensorObj07_LatVel : 208|13@1+ (0.032,-80) [-80|182.112] "m_per_s"  VCM
 SG_ LRSideSensorObj07_LatAcc : 267|9@1+ (0.08,-20) [-20|20.88] "m_per_s_squared"  VCM
 SG_ LRSideSensorObj07_LongAcc : 176|9@1+ (0.08,-20) [-20|20.88] "m_per_s_squared"  VCM
 SG_ LRSideSensorObj07_LatAccVar : 112|8@1+ (0.1,0) [0|25.5] "NotApplicable"  VCM
 SG_ LRSideSensorObj07_ObjClass : 292|4@1+ (1,0) [0|0] ""  VCM
 SG_ LRSideSensorObj07_TrackStatus : 192|3@1+ (1,0) [0|0] ""  VCM
 SG_ LRSideSensorObj07_LongExtBkVar : 64|8@1+ (0.1,0) [0|25.5] "NotApplicable"  VCM
 SG_ LRSideSensorObj07_HeadingVar : 120|8@1+ (0.001,0) [0|0.255] "NotApplicable"  VCM
 SG_ LRSideSensorObj07_LatExtRtVar : 96|8@1+ (0.1,0) [0|25.5] "NotApplicable"  VCM
 SG_ LRSideSensorObj07_Prioritisation : 290|2@1+ (1,0) [0|0] ""  VCM
 SG_ LRSideSensorObj07_LongExtBack : 257|10@1+ (0.05,-50) [-50|1.15000000000001] "m"  VCM
 SG_ LRSideSensorObj07_ObjDynClass : 166|2@1+ (1,0) [0|0] ""  VCM
 SG_ LRSideSensorObj07_ExistConf : 283|7@1+ (0.01,0) [0|1.27] "NotApplicable"  VCM

BO_ 790 LRSideSensorObj06: 48 SR_LR
 SG_ LRSideSensorObj06_LongExtFrVar : 56|8@1+ (0.1,0) [0|25.5] "NotApplicable"  VCM
 SG_ LRSideSensorObj06_LongExtBack : 257|10@1+ (0.05,-50) [-50|1.15000000000001] "m"  VCM
 SG_ LRSideSensorObj06_Counter : 16|8@1+ (1,0) [0|255] "Count"  VCM
 SG_ LRSideSensorObj06_LongVel : 195|13@1+ (0.032,-80) [-80|182.112] "m_per_s"  VCM
 SG_ LRSideSensorObj06_HeadingVar : 120|8@1+ (0.001,0) [0|0.255] "NotApplicable"  VCM
 SG_ LRSideSensorObj06_LatPosVar : 88|8@1+ (0.1,0) [0|25.5] "NotApplicable"  VCM
 SG_ LRSideSensorObj06_LatExtLeftVar : 104|8@1+ (0.1,0) [0|25.5] "NotApplicable"  VCM
 SG_ LRSideSensorObj06_LatVel : 208|13@1+ (0.032,-80) [-80|182.112] "m_per_s"  VCM
 SG_ LRSideSensorObj06_TrackStatus : 192|3@1+ (1,0) [0|0] ""  VCM
 SG_ LRSideSensorObj06_ObjClass : 292|4@1+ (1,0) [0|0] ""  VCM
 SG_ LRSideSensorObj06_ObstacleConf : 300|7@1+ (0.01,0) [0|1.27] "NotApplicable"  VCM
 SG_ LRSideSensorObj06_LatExtRtVar : 96|8@1+ (0.1,0) [0|25.5] "NotApplicable"  VCM
 SG_ LRSideSensorObj06_LongAccVar : 72|8@1+ (0.1,0) [0|25.5] "NotApplicable"  VCM
 SG_ LRSideSensorObj06_CoastIndex : 155|5@1+ (1,0) [0|31] "NotApplicable"  VCM
 SG_ LRSideSensorObj06_LongAcc : 176|9@1+ (0.08,-20) [-20|20.88] "m_per_s_squared"  VCM
 SG_ LRSideSensorObj06_ObjDynClass : 166|2@1+ (1,0) [0|0] ""  VCM
 SG_ LRSideSensorObj06_LatExtRight : 185|7@1+ (0.05,-5) [-5|1.35] "m"  VCM
 SG_ LRSideSensorObj06_ExistConf : 283|7@1+ (0.01,0) [0|1.27] "NotApplicable"  VCM
 SG_ LRSideSensorObj06_Prioritisation : 290|2@1+ (1,0) [0|0] ""  VCM
 SG_ LRSideSensorObj06_LongExtFront : 247|10@1+ (0.05,0) [0|51.15] "m"  VCM
 SG_ LRSideSensorObj06_LatExtLeft : 276|7@1+ (0.05,0) [0|6.35] "m"  VCM
 SG_ LRSideSensorObj06_ObjClassConf : 296|4@1+ (0.1,0) [0|1.5] "NotApplicable"  VCM
 SG_ LRSideSensorObj06_Height : 168|8@1+ (0.02,0) [0|5.1] "m"  VCM
 SG_ LRSideSensorObj06_TimeStamp : 24|16@1+ (0.1,0) [0|6553.5] "ms"  VCM
 SG_ LRSideSensorObj06_MOISPrio : 307|1@1+ (1,0) [0|0] ""  VCM
 SG_ LRSideSensorObj06_Heading : 144|11@1+ (0.005818,-4.71) [-4.71|7.199446] "rad"  VCM
 SG_ LRSideSensorObj06_LatPos : 221|13@1+ (0.05,-180) [-180|229.55] "m"  VCM
 SG_ LRSideSensorObj06_CRC : 0|16@1+ (1,0) [0|65535] "NotApplicable"  VCM
 SG_ LRSideSensorObj06_LifeTime : 128|16@1+ (0.1,0) [0|6553.5] "s"  VCM
 SG_ LRSideSensorObj06_ObjID : 160|6@1+ (1,0) [0|63] "NotApplicable"  VCM
 SG_ LRSideSensorObj06_LongVelVar : 40|8@1+ (0.01,0) [0|2.55] "NotApplicable"  VCM
 SG_ LRSideSensorObj06_LatAccVar : 112|8@1+ (0.1,0) [0|25.5] "NotApplicable"  VCM
 SG_ LRSideSensorObj06_LongPosVar : 48|8@1+ (0.01,0) [0|2.55] "NotApplicable"  VCM
 SG_ LRSideSensorObj06_LongPos : 234|13@1+ (0.05,-180) [-180|229.55] "m"  VCM
 SG_ LRSideSensorObj06_LongExtBkVar : 64|8@1+ (0.1,0) [0|25.5] "NotApplicable"  VCM
 SG_ LRSideSensorObj06_LatAcc : 267|9@1+ (0.08,-20) [-20|20.88] "m_per_s_squared"  VCM
 SG_ LRSideSensorObj06_LatVelVar : 80|8@1+ (0.01,0) [0|2.55] "NotApplicable"  VCM

BO_ 789 LRSideSensorObj05: 48 SR_LR
 SG_ LRSideSensorObj05_LongAcc : 176|9@1+ (0.08,-20) [-20|20.88] "m_per_s_squared"  VCM
 SG_ LRSideSensorObj05_TrackStatus : 192|3@1+ (1,0) [0|0] ""  VCM
 SG_ LRSideSensorObj05_LatExtLeftVar : 104|8@1+ (0.1,0) [0|25.5] "NotApplicable"  VCM
 SG_ LRSideSensorObj05_LatExtRight : 185|7@1+ (0.05,-5) [-5|1.35] "m"  VCM
 SG_ LRSideSensorObj05_ObjID : 160|6@1+ (1,0) [0|63] "NotApplicable"  VCM
 SG_ LRSideSensorObj05_ObjClass : 292|4@1+ (1,0) [0|0] ""  VCM
 SG_ LRSideSensorObj05_ObjClassConf : 296|4@1+ (0.1,0) [0|1.5] "NotApplicable"  VCM
 SG_ LRSideSensorObj05_LifeTime : 128|16@1+ (0.1,0) [0|6553.5] "s"  VCM
 SG_ LRSideSensorObj05_LatPosVar : 88|8@1+ (0.1,0) [0|25.5] "NotApplicable"  VCM
 SG_ LRSideSensorObj05_LongVel : 195|13@1+ (0.032,-80) [-80|182.112] "m_per_s"  VCM
 SG_ LRSideSensorObj05_LongAccVar : 72|8@1+ (0.1,0) [0|25.5] "NotApplicable"  VCM
 SG_ LRSideSensorObj05_ObjDynClass : 166|2@1+ (1,0) [0|0] ""  VCM
 SG_ LRSideSensorObj05_LatPos : 221|13@1+ (0.05,-180) [-180|229.55] "m"  VCM
 SG_ LRSideSensorObj05_ExistConf : 283|7@1+ (0.01,0) [0|1.27] "NotApplicable"  VCM
 SG_ LRSideSensorObj05_Heading : 144|11@1+ (0.005818,-4.71) [-4.71|7.199446] "rad"  VCM
 SG_ LRSideSensorObj05_MOISPrio : 307|1@1+ (1,0) [0|0] ""  VCM
 SG_ LRSideSensorObj05_ObstacleConf : 300|7@1+ (0.01,0) [0|1.27] "NotApplicable"  VCM
 SG_ LRSideSensorObj05_HeadingVar : 120|8@1+ (0.001,0) [0|0.255] "NotApplicable"  VCM
 SG_ LRSideSensorObj05_LongVelVar : 40|8@1+ (0.01,0) [0|2.55] "NotApplicable"  VCM
 SG_ LRSideSensorObj05_Prioritisation : 290|2@1+ (1,0) [0|0] ""  VCM
 SG_ LRSideSensorObj05_LongPos : 234|13@1+ (0.05,-180) [-180|229.55] "m"  VCM
 SG_ LRSideSensorObj05_Height : 168|8@1+ (0.02,0) [0|5.1] "m"  VCM
 SG_ LRSideSensorObj05_LatExtLeft : 276|7@1+ (0.05,0) [0|6.35] "m"  VCM
 SG_ LRSideSensorObj05_LatAcc : 267|9@1+ (0.08,-20) [-20|20.88] "m_per_s_squared"  VCM
 SG_ LRSideSensorObj05_LongExtFront : 247|10@1+ (0.05,0) [0|51.15] "m"  VCM
 SG_ LRSideSensorObj05_Counter : 16|8@1+ (1,0) [0|255] "Count"  VCM
 SG_ LRSideSensorObj05_LatAccVar : 112|8@1+ (0.1,0) [0|25.5] "NotApplicable"  VCM
 SG_ LRSideSensorObj05_LongPosVar : 48|8@1+ (0.01,0) [0|2.55] "NotApplicable"  VCM
 SG_ LRSideSensorObj05_CRC : 0|16@1+ (1,0) [0|65535] "NotApplicable"  VCM
 SG_ LRSideSensorObj05_LatVel : 208|13@1+ (0.032,-80) [-80|182.112] "m_per_s"  VCM
 SG_ LRSideSensorObj05_TimeStamp : 24|16@1+ (0.1,0) [0|6553.5] "ms"  VCM
 SG_ LRSideSensorObj05_CoastIndex : 155|5@1+ (1,0) [0|31] "NotApplicable"  VCM
 SG_ LRSideSensorObj05_LatVelVar : 80|8@1+ (0.01,0) [0|2.55] "NotApplicable"  VCM
 SG_ LRSideSensorObj05_LatExtRtVar : 96|8@1+ (0.1,0) [0|25.5] "NotApplicable"  VCM
 SG_ LRSideSensorObj05_LongExtBkVar : 64|8@1+ (0.1,0) [0|25.5] "NotApplicable"  VCM
 SG_ LRSideSensorObj05_LongExtBack : 257|10@1+ (0.05,-50) [-50|1.15000000000001] "m"  VCM
 SG_ LRSideSensorObj05_LongExtFrVar : 56|8@1+ (0.1,0) [0|25.5] "NotApplicable"  VCM

BO_ 788 LRSideSensorObj04: 48 SR_LR
 SG_ LRSideSensorObj04_TrackStatus : 192|3@1+ (1,0) [0|0] ""  VCM
 SG_ LRSideSensorObj04_HeadingVar : 120|8@1+ (0.001,0) [0|0.255] "NotApplicable"  VCM
 SG_ LRSideSensorObj04_Prioritisation : 290|2@1+ (1,0) [0|0] ""  VCM
 SG_ LRSideSensorObj04_LongVel : 195|13@1+ (0.032,-80) [-80|182.112] "m_per_s"  VCM
 SG_ LRSideSensorObj04_ObstacleConf : 300|7@1+ (0.01,0) [0|1.27] "NotApplicable"  VCM
 SG_ LRSideSensorObj04_TimeStamp : 24|16@1+ (0.1,0) [0|6553.5] "ms"  VCM
 SG_ LRSideSensorObj04_ObjDynClass : 166|2@1+ (1,0) [0|0] ""  VCM
 SG_ LRSideSensorObj04_Heading : 144|11@1+ (0.005818,-4.71) [-4.71|7.199446] "rad"  VCM
 SG_ LRSideSensorObj04_LatAccVar : 112|8@1+ (0.1,0) [0|25.5] "NotApplicable"  VCM
 SG_ LRSideSensorObj04_LongAcc : 176|9@1+ (0.08,-20) [-20|20.88] "m_per_s_squared"  VCM
 SG_ LRSideSensorObj04_ExistConf : 283|7@1+ (0.01,0) [0|1.27] "NotApplicable"  VCM
 SG_ LRSideSensorObj04_LatAcc : 267|9@1+ (0.08,-20) [-20|20.88] "m_per_s_squared"  VCM
 SG_ LRSideSensorObj04_LongPos : 234|13@1+ (0.05,-180) [-180|229.55] "m"  VCM
 SG_ LRSideSensorObj04_LatPos : 221|13@1+ (0.05,-180) [-180|229.55] "m"  VCM
 SG_ LRSideSensorObj04_LongPosVar : 48|8@1+ (0.01,0) [0|2.55] "NotApplicable"  VCM
 SG_ LRSideSensorObj04_ObjClassConf : 296|4@1+ (0.1,0) [0|1.5] "NotApplicable"  VCM
 SG_ LRSideSensorObj04_LongAccVar : 72|8@1+ (0.1,0) [0|25.5] "NotApplicable"  VCM
 SG_ LRSideSensorObj04_LongExtFrVar : 56|8@1+ (0.1,0) [0|25.5] "NotApplicable"  VCM
 SG_ LRSideSensorObj04_LatExtLeftVar : 104|8@1+ (0.1,0) [0|25.5] "NotApplicable"  VCM
 SG_ LRSideSensorObj04_LatExtRtVar : 96|8@1+ (0.1,0) [0|25.5] "NotApplicable"  VCM
 SG_ LRSideSensorObj04_LatVelVar : 80|8@1+ (0.01,0) [0|2.55] "NotApplicable"  VCM
 SG_ LRSideSensorObj04_CoastIndex : 155|5@1+ (1,0) [0|31] "NotApplicable"  VCM
 SG_ LRSideSensorObj04_LatPosVar : 88|8@1+ (0.1,0) [0|25.5] "NotApplicable"  VCM
 SG_ LRSideSensorObj04_CRC : 0|16@1+ (1,0) [0|65535] "NotApplicable"  VCM
 SG_ LRSideSensorObj04_LatVel : 208|13@1+ (0.032,-80) [-80|182.112] "m_per_s"  VCM
 SG_ LRSideSensorObj04_LongExtBack : 257|10@1+ (0.05,-50) [-50|1.15000000000001] "m"  VCM
 SG_ LRSideSensorObj04_ObjID : 160|6@1+ (1,0) [0|63] "NotApplicable"  VCM
 SG_ LRSideSensorObj04_LifeTime : 128|16@1+ (0.1,0) [0|6553.5] "s"  VCM
 SG_ LRSideSensorObj04_ObjClass : 292|4@1+ (1,0) [0|0] ""  VCM
 SG_ LRSideSensorObj04_LongExtFront : 247|10@1+ (0.05,0) [0|51.15] "m"  VCM
 SG_ LRSideSensorObj04_Counter : 16|8@1+ (1,0) [0|255] "Count"  VCM
 SG_ LRSideSensorObj04_LongExtBkVar : 64|8@1+ (0.1,0) [0|25.5] "NotApplicable"  VCM
 SG_ LRSideSensorObj04_LatExtRight : 185|7@1+ (0.05,-5) [-5|1.35] "m"  VCM
 SG_ LRSideSensorObj04_MOISPrio : 307|1@1+ (1,0) [0|0] ""  VCM
 SG_ LRSideSensorObj04_Height : 168|8@1+ (0.02,0) [0|5.1] "m"  VCM
 SG_ LRSideSensorObj04_LatExtLeft : 276|7@1+ (0.05,0) [0|6.35] "m"  VCM
 SG_ LRSideSensorObj04_LongVelVar : 40|8@1+ (0.01,0) [0|2.55] "NotApplicable"  VCM

BO_ 787 LRSideSensorObj03: 48 SR_LR
 SG_ LRSideSensorObj03_TimeStamp : 24|16@1+ (0.1,0) [0|6553.5] "ms"  VCM
 SG_ LRSideSensorObj03_CRC : 0|16@1+ (1,0) [0|65535] "NotApplicable"  VCM
 SG_ LRSideSensorObj03_LatPos : 221|13@1+ (0.05,-180) [-180|229.55] "m"  VCM
 SG_ LRSideSensorObj03_ExistConf : 283|7@1+ (0.01,0) [0|1.27] "NotApplicable"  VCM
 SG_ LRSideSensorObj03_Prioritisation : 290|2@1+ (1,0) [0|0] ""  VCM
 SG_ LRSideSensorObj03_LatAccVar : 112|8@1+ (0.1,0) [0|25.5] "NotApplicable"  VCM
 SG_ LRSideSensorObj03_LatVelVar : 80|8@1+ (0.01,0) [0|2.55] "NotApplicable"  VCM
 SG_ LRSideSensorObj03_CoastIndex : 155|5@1+ (1,0) [0|31] "NotApplicable"  VCM
 SG_ LRSideSensorObj03_LongExtBack : 257|10@1+ (0.05,-50) [-50|1.15000000000001] "m"  VCM
 SG_ LRSideSensorObj03_TrackStatus : 192|3@1+ (1,0) [0|0] ""  VCM
 SG_ LRSideSensorObj03_Height : 168|8@1+ (0.02,0) [0|5.1] "m"  VCM
 SG_ LRSideSensorObj03_ObjClassConf : 296|4@1+ (0.1,0) [0|1.5] "NotApplicable"  VCM
 SG_ LRSideSensorObj03_ObjClass : 292|4@1+ (1,0) [0|0] ""  VCM
 SG_ LRSideSensorObj03_LongExtFrVar : 56|8@1+ (0.1,0) [0|25.5] "NotApplicable"  VCM
 SG_ LRSideSensorObj03_HeadingVar : 120|8@1+ (0.001,0) [0|0.255] "NotApplicable"  VCM
 SG_ LRSideSensorObj03_Heading : 144|11@1+ (0.005818,-4.71) [-4.71|7.199446] "rad"  VCM
 SG_ LRSideSensorObj03_LongAccVar : 72|8@1+ (0.1,0) [0|25.5] "NotApplicable"  VCM
 SG_ LRSideSensorObj03_LongAcc : 176|9@1+ (0.08,-20) [-20|20.88] "m_per_s_squared"  VCM
 SG_ LRSideSensorObj03_LatExtRight : 185|7@1+ (0.05,-5) [-5|1.35] "m"  VCM
 SG_ LRSideSensorObj03_LongPosVar : 48|8@1+ (0.01,0) [0|2.55] "NotApplicable"  VCM
 SG_ LRSideSensorObj03_ObstacleConf : 300|7@1+ (0.01,0) [0|1.27] "NotApplicable"  VCM
 SG_ LRSideSensorObj03_ObjID : 160|6@1+ (1,0) [0|63] "NotApplicable"  VCM
 SG_ LRSideSensorObj03_LatExtLeft : 276|7@1+ (0.05,0) [0|6.35] "m"  VCM
 SG_ LRSideSensorObj03_LatExtLeftVar : 104|8@1+ (0.1,0) [0|25.5] "NotApplicable"  VCM
 SG_ LRSideSensorObj03_LongVelVar : 40|8@1+ (0.01,0) [0|2.55] "NotApplicable"  VCM
 SG_ LRSideSensorObj03_LongExtFront : 247|10@1+ (0.05,0) [0|51.15] "m"  VCM
 SG_ LRSideSensorObj03_LatPosVar : 88|8@1+ (0.1,0) [0|25.5] "NotApplicable"  VCM
 SG_ LRSideSensorObj03_ObjDynClass : 166|2@1+ (1,0) [0|0] ""  VCM
 SG_ LRSideSensorObj03_LongExtBkVar : 64|8@1+ (0.1,0) [0|25.5] "NotApplicable"  VCM
 SG_ LRSideSensorObj03_LatVel : 208|13@1+ (0.032,-80) [-80|182.112] "m_per_s"  VCM
 SG_ LRSideSensorObj03_Counter : 16|8@1+ (1,0) [0|255] "Count"  VCM
 SG_ LRSideSensorObj03_LatExtRtVar : 96|8@1+ (0.1,0) [0|25.5] "NotApplicable"  VCM
 SG_ LRSideSensorObj03_MOISPrio : 307|1@1+ (1,0) [0|0] ""  VCM
 SG_ LRSideSensorObj03_LongPos : 234|13@1+ (0.05,-180) [-180|229.55] "m"  VCM
 SG_ LRSideSensorObj03_LatAcc : 267|9@1+ (0.08,-20) [-20|20.88] "m_per_s_squared"  VCM
 SG_ LRSideSensorObj03_LifeTime : 128|16@1+ (0.1,0) [0|6553.5] "s"  VCM
 SG_ LRSideSensorObj03_LongVel : 195|13@1+ (0.032,-80) [-80|182.112] "m_per_s"  VCM

BO_ 786 LRSideSensorObj02: 48 SR_LR
 SG_ LRSideSensorObj02_Heading : 144|11@1+ (0.005818,-4.71) [-4.71|7.199446] "rad"  VCM
 SG_ LRSideSensorObj02_LatExtLeftVar : 104|8@1+ (0.1,0) [0|25.5] "NotApplicable"  VCM
 SG_ LRSideSensorObj02_LatPosVar : 88|8@1+ (0.1,0) [0|25.5] "NotApplicable"  VCM
 SG_ LRSideSensorObj02_LongVel : 195|13@1+ (0.032,-80) [-80|182.112] "m_per_s"  VCM
 SG_ LRSideSensorObj02_LongExtFrVar : 56|8@1+ (0.1,0) [0|25.5] "NotApplicable"  VCM
 SG_ LRSideSensorObj02_MOISPrio : 307|1@1+ (1,0) [0|0] ""  VCM
 SG_ LRSideSensorObj02_LatVel : 208|13@1+ (0.032,-80) [-80|182.112] "m_per_s"  VCM
 SG_ LRSideSensorObj02_CoastIndex : 155|5@1+ (1,0) [0|31] "NotApplicable"  VCM
 SG_ LRSideSensorObj02_LongVelVar : 40|8@1+ (0.01,0) [0|2.55] "NotApplicable"  VCM
 SG_ LRSideSensorObj02_TrackStatus : 192|3@1+ (1,0) [0|0] ""  VCM
 SG_ LRSideSensorObj02_LongExtBkVar : 64|8@1+ (0.1,0) [0|25.5] "NotApplicable"  VCM
 SG_ LRSideSensorObj02_LongExtFront : 247|10@1+ (0.05,0) [0|51.15] "m"  VCM
 SG_ LRSideSensorObj02_LongPosVar : 48|8@1+ (0.01,0) [0|2.55] "NotApplicable"  VCM
 SG_ LRSideSensorObj02_LongPos : 234|13@1+ (0.05,-180) [-180|229.55] "m"  VCM
 SG_ LRSideSensorObj02_LatExtRtVar : 96|8@1+ (0.1,0) [0|25.5] "NotApplicable"  VCM
 SG_ LRSideSensorObj02_LatExtRight : 185|7@1+ (0.05,-5) [-5|1.35] "m"  VCM
 SG_ LRSideSensorObj02_LongAccVar : 72|8@1+ (0.1,0) [0|25.5] "NotApplicable"  VCM
 SG_ LRSideSensorObj02_CRC : 0|16@1+ (1,0) [0|65535] "NotApplicable"  VCM
 SG_ LRSideSensorObj02_ObstacleConf : 300|7@1+ (0.01,0) [0|1.27] "NotApplicable"  VCM
 SG_ LRSideSensorObj02_ObjID : 160|6@1+ (1,0) [0|63] "NotApplicable"  VCM
 SG_ LRSideSensorObj02_ObjDynClass : 166|2@1+ (1,0) [0|0] ""  VCM
 SG_ LRSideSensorObj02_LongAcc : 176|9@1+ (0.08,-20) [-20|20.88] "m_per_s_squared"  VCM
 SG_ LRSideSensorObj02_Counter : 16|8@1+ (1,0) [0|255] "Count"  VCM
 SG_ LRSideSensorObj02_LatVelVar : 80|8@1+ (0.01,0) [0|2.55] "NotApplicable"  VCM
 SG_ LRSideSensorObj02_LatExtLeft : 276|7@1+ (0.05,0) [0|6.35] "m"  VCM
 SG_ LRSideSensorObj02_LatPos : 221|13@1+ (0.05,-180) [-180|229.55] "m"  VCM
 SG_ LRSideSensorObj02_ObjClassConf : 296|4@1+ (0.1,0) [0|1.5] "NotApplicable"  VCM
 SG_ LRSideSensorObj02_TimeStamp : 24|16@1+ (0.1,0) [0|6553.5] "ms"  VCM
 SG_ LRSideSensorObj02_LongExtBack : 257|10@1+ (0.05,-50) [-50|1.15000000000001] "m"  VCM
 SG_ LRSideSensorObj02_LatAcc : 267|9@1+ (0.08,-20) [-20|20.88] "m_per_s_squared"  VCM
 SG_ LRSideSensorObj02_ObjClass : 292|4@1+ (1,0) [0|0] ""  VCM
 SG_ LRSideSensorObj02_Prioritisation : 290|2@1+ (1,0) [0|0] ""  VCM
 SG_ LRSideSensorObj02_HeadingVar : 120|8@1+ (0.001,0) [0|0.255] "NotApplicable"  VCM
 SG_ LRSideSensorObj02_LatAccVar : 112|8@1+ (0.1,0) [0|25.5] "NotApplicable"  VCM
 SG_ LRSideSensorObj02_LifeTime : 128|16@1+ (0.1,0) [0|6553.5] "s"  VCM
 SG_ LRSideSensorObj02_Height : 168|8@1+ (0.02,0) [0|5.1] "m"  VCM
 SG_ LRSideSensorObj02_ExistConf : 283|7@1+ (0.01,0) [0|1.27] "NotApplicable"  VCM

BO_ 785 LRSideSensorObj01: 48 SR_LR
 SG_ LRSideSensorObj01_LongExtFrVar : 56|8@1+ (0.1,0) [0|25.5] "NotApplicable"  VCM
 SG_ LRSideSensorObj01_MOISPrio : 307|1@1+ (1,0) [0|0] ""  VCM
 SG_ LRSideSensorObj01_LongExtBkVar : 64|8@1+ (0.1,0) [0|25.5] "NotApplicable"  VCM
 SG_ LRSideSensorObj01_LatPosVar : 88|8@1+ (0.1,0) [0|25.5] "NotApplicable"  VCM
 SG_ LRSideSensorObj01_Counter : 16|8@1+ (1,0) [0|255] "Count"  VCM
 SG_ LRSideSensorObj01_ObjClassConf : 296|4@1+ (0.1,0) [0|1.5] "NotApplicable"  VCM
 SG_ LRSideSensorObj01_ExistConf : 283|7@1+ (0.01,0) [0|1.27] "NotApplicable"  VCM
 SG_ LRSideSensorObj01_ObjDynClass : 166|2@1+ (1,0) [0|0] ""  VCM
 SG_ LRSideSensorObj01_CRC : 0|16@1+ (1,0) [0|65535] "NotApplicable"  VCM
 SG_ LRSideSensorObj01_LongExtFront : 247|10@1+ (0.05,0) [0|51.15] "m"  VCM
 SG_ LRSideSensorObj01_LongPosVar : 48|8@1+ (0.01,0) [0|2.55] "NotApplicable"  VCM
 SG_ LRSideSensorObj01_Heading : 144|11@1+ (0.005818,-4.71) [-4.71|7.199446] "rad"  VCM
 SG_ LRSideSensorObj01_ObjID : 160|6@1+ (1,0) [0|63] "NotApplicable"  VCM
 SG_ LRSideSensorObj01_CoastIndex : 155|5@1+ (1,0) [0|31] "NotApplicable"  VCM
 SG_ LRSideSensorObj01_LatExtLeftVar : 104|8@1+ (0.1,0) [0|25.5] "NotApplicable"  VCM
 SG_ LRSideSensorObj01_LongPos : 234|13@1+ (0.05,-180) [-180|229.55] "m"  VCM
 SG_ LRSideSensorObj01_TrackStatus : 192|3@1+ (1,0) [0|0] ""  VCM
 SG_ LRSideSensorObj01_LatExtRight : 185|7@1+ (0.05,-5) [-5|1.35] "m"  VCM
 SG_ LRSideSensorObj01_LatPos : 221|13@1+ (0.05,-180) [-180|229.55] "m"  VCM
 SG_ LRSideSensorObj01_TimeStamp : 24|16@1+ (0.1,0) [0|6553.5] "ms"  VCM
 SG_ LRSideSensorObj01_LatVel : 208|13@1+ (0.032,-80) [-80|182.112] "m_per_s"  VCM
 SG_ LRSideSensorObj01_LongExtBack : 257|10@1+ (0.05,-50) [-50|1.15000000000001] "m"  VCM
 SG_ LRSideSensorObj01_LatExtLeft : 276|7@1+ (0.05,0) [0|6.35] "m"  VCM
 SG_ LRSideSensorObj01_Height : 168|8@1+ (0.02,0) [0|5.1] "m"  VCM
 SG_ LRSideSensorObj01_HeadingVar : 120|8@1+ (0.001,0) [0|0.255] "NotApplicable"  VCM
 SG_ LRSideSensorObj01_LongVelVar : 40|8@1+ (0.01,0) [0|2.55] "NotApplicable"  VCM
 SG_ LRSideSensorObj01_ObjClass : 292|4@1+ (1,0) [0|0] ""  VCM
 SG_ LRSideSensorObj01_LifeTime : 128|16@1+ (0.1,0) [0|6553.5] "s"  VCM
 SG_ LRSideSensorObj01_LongAcc : 176|9@1+ (0.08,-20) [-20|20.88] "m_per_s_squared"  VCM
 SG_ LRSideSensorObj01_LongVel : 195|13@1+ (0.032,-80) [-80|182.112] "m_per_s"  VCM
 SG_ LRSideSensorObj01_LatVelVar : 80|8@1+ (0.01,0) [0|2.55] "NotApplicable"  VCM
 SG_ LRSideSensorObj01_Prioritisation : 290|2@1+ (1,0) [0|0] ""  VCM
 SG_ LRSideSensorObj01_LatExtRtVar : 96|8@1+ (0.1,0) [0|25.5] "NotApplicable"  VCM
 SG_ LRSideSensorObj01_LatAccVar : 112|8@1+ (0.1,0) [0|25.5] "NotApplicable"  VCM
 SG_ LRSideSensorObj01_LongAccVar : 72|8@1+ (0.1,0) [0|25.5] "NotApplicable"  VCM
 SG_ LRSideSensorObj01_LatAcc : 267|9@1+ (0.08,-20) [-20|20.88] "m_per_s_squared"  VCM
 SG_ LRSideSensorObj01_ObstacleConf : 300|7@1+ (0.01,0) [0|1.27] "NotApplicable"  VCM

BO_ 784 LRSideSensorObj00: 48 SR_LR
 SG_ LRSideSensorObj00_TimeStamp : 24|16@1+ (0.1,0) [0|6553.5] "ms"  VCM
 SG_ LRSideSensorObj00_LatPos : 221|13@1+ (0.05,-180) [-180|229.55] "m"  VCM
 SG_ LRSideSensorObj00_ObjClass : 292|4@1+ (1,0) [0|0] ""  VCM
 SG_ LRSideSensorObj00_LongPosVar : 48|8@1+ (0.01,0) [0|2.55] "NotApplicable"  VCM
 SG_ LRSideSensorObj00_LongVel : 195|13@1+ (0.032,-80) [-80|182.112] "m_per_s"  VCM
 SG_ LRSideSensorObj00_ExistConf : 283|7@1+ (0.01,0) [0|1.27] "NotApplicable"  VCM
 SG_ LRSideSensorObj00_LatVelVar : 80|8@1+ (0.01,0) [0|2.55] "NotApplicable"  VCM
 SG_ LRSideSensorObj00_LongAcc : 176|9@1+ (0.08,-20) [-20|20.88] "m_per_s_squared"  VCM
 SG_ LRSideSensorObj00_LatVel : 208|13@1+ (0.032,-80) [-80|182.112] "m_per_s"  VCM
 SG_ LRSideSensorObj00_ObstacleConf : 300|7@1+ (0.01,0) [0|1.27] "NotApplicable"  VCM
 SG_ LRSideSensorObj00_HeadingVar : 120|8@1+ (0.001,0) [0|0.255] "NotApplicable"  VCM
 SG_ LRSideSensorObj00_LatExtLeft : 276|7@1+ (0.05,0) [0|6.35] "m"  VCM
 SG_ LRSideSensorObj00_LongPos : 234|13@1+ (0.05,-180) [-180|229.55] "m"  VCM
 SG_ LRSideSensorObj00_LatAcc : 267|9@1+ (0.08,-20) [-20|20.88] "m_per_s_squared"  VCM
 SG_ LRSideSensorObj00_ObjID : 160|6@1+ (1,0) [0|63] "NotApplicable"  VCM
 SG_ LRSideSensorObj00_LatExtLeftVar : 104|8@1+ (0.1,0) [0|25.5] "NotApplicable"  VCM
 SG_ LRSideSensorObj00_TrackStatus : 192|3@1+ (1,0) [0|0] ""  VCM
 SG_ LRSideSensorObj00_CoastIndex : 155|5@1+ (1,0) [0|31] "NotApplicable"  VCM
 SG_ LRSideSensorObj00_Prioritisation : 290|2@1+ (1,0) [0|0] ""  VCM
 SG_ LRSideSensorObj00_LifeTime : 128|16@1+ (0.1,0) [0|6553.5] "s"  VCM
 SG_ LRSideSensorObj00_ObjDynClass : 166|2@1+ (1,0) [0|0] ""  VCM
 SG_ LRSideSensorObj00_LongVelVar : 40|8@1+ (0.01,0) [0|2.55] "NotApplicable"  VCM
 SG_ LRSideSensorObj00_LongExtFrVar : 56|8@1+ (0.1,0) [0|25.5] "NotApplicable"  VCM
 SG_ LRSideSensorObj00_Heading : 144|11@1+ (0.005818,-4.71) [-4.71|7.199446] "rad"  VCM
 SG_ LRSideSensorObj00_LongExtFront : 247|10@1+ (0.05,0) [0|51.15] "m"  VCM
 SG_ LRSideSensorObj00_ObjClassConf : 296|4@1+ (0.1,0) [0|1.5] "NotApplicable"  VCM
 SG_ LRSideSensorObj00_LatPosVar : 88|8@1+ (0.1,0) [0|25.5] "NotApplicable"  VCM
 SG_ LRSideSensorObj00_Height : 168|8@1+ (0.02,0) [0|5.1] "m"  VCM
 SG_ LRSideSensorObj00_LatAccVar : 112|8@1+ (0.1,0) [0|25.5] "NotApplicable"  VCM
 SG_ LRSideSensorObj00_Counter : 16|8@1+ (1,0) [0|255] "Count"  VCM
 SG_ LRSideSensorObj00_LongAccVar : 72|8@1+ (0.1,0) [0|25.5] "NotApplicable"  VCM
 SG_ LRSideSensorObj00_MOISPrio : 307|1@1+ (1,0) [0|0] ""  VCM
 SG_ LRSideSensorObj00_LongExtBack : 257|10@1+ (0.05,-50) [-50|1.15000000000001] "m"  VCM
 SG_ LRSideSensorObj00_LongExtBkVar : 64|8@1+ (0.1,0) [0|25.5] "NotApplicable"  VCM
 SG_ LRSideSensorObj00_LatExtRtVar : 96|8@1+ (0.1,0) [0|25.5] "NotApplicable"  VCM
 SG_ LRSideSensorObj00_LatExtRight : 185|7@1+ (0.05,-5) [-5|1.35] "m"  VCM
 SG_ LRSideSensorObj00_CRC : 0|16@1+ (1,0) [0|65535] "NotApplicable"  VCM

BO_ 1553 LRSRSwVersion_Vic4: 64 SR_LR
 SG_ LRSRSwVersion_Substring1 : 64|64@1+ (1,0) [0|0] ""  VCM
 SG_ LRSRSwVersion_Substring2 : 128|64@1+ (1,0) [0|0] ""  VCM
 SG_ LRSRSwVersion_Substring3 : 192|64@1+ (1,0) [0|0] ""  VCM
 SG_ LRSRSwVersion_Substring7 : 448|64@1+ (1,0) [0|0] ""  VCM
 SG_ LRSRSwVersion_Substring6 : 384|64@1+ (1,0) [0|0] ""  VCM
 SG_ LRSRSwVersion_Substring4 : 256|64@1+ (1,0) [0|0] ""  VCM
 SG_ LRSRSwVersion_Substring5 : 320|64@1+ (1,0) [0|0] ""  VCM
 SG_ LRSRSwVersion_Substring0 : 0|64@1+ (1,0) [0|0] ""  VCM

BO_ 799 LRSRRaisedEdge_Vic4: 20 SR_LR
 SG_ LRSRRaisedEdge_Type : 133|3@1+ (1,0) [0|0] ""  VCM
 SG_ LRSRRaisedEdge_TrackStatus : 93|3@1+ (1,0) [0|0] ""  VCM
 SG_ LRSRRaisedEdge_DxEnd : 56|8@1+ (1,0) [0|255] "m"  VCM
 SG_ LRSRRaisedEdge_Curvature : 96|18@1+ (1E-006,-0.1310705) [-0.1310705|0.1310725] "per_meter"  VCM
 SG_ LRSRRaisedEdge_Confidence : 126|7@1+ (0.01,0) [0|1.27] "NotApplicable"  VCM
 SG_ LRSRRaisedEdge_Counter : 16|8@1+ (1,0) [0|255] "Count"  VCM
 SG_ LRSRRaisedEdge_LatDistVar : 48|8@1+ (0.001,0) [0|0.255] "NotApplicable"  VCM
 SG_ LRSRRaisedEdge_LifeTime : 136|16@1+ (0.1,0) [0|6553.5] "s"  VCM
 SG_ LRSRRaisedEdge_LatDist : 114|12@1+ (0.005,-10) [-10|10.475] "m"  VCM
 SG_ LRSRRaisedEdge_CRC : 0|16@1+ (1,0) [0|65535] "NotApplicable"  VCM
 SG_ LRSRRaisedEdge_CurvatureRate : 64|11@1+ (5.1E-007,-0.000516) [-0.000516|0.00052797] "per_meter_squared"  VCM
 SG_ LRSRRaisedEdge_DxStart : 40|8@1+ (1,0) [0|255] "m"  VCM
 SG_ LRSRRaisedEdge_HeadingAngle : 80|13@1+ (0.0005,-1.57) [-1.57|2.5255] "rad"  VCM
 SG_ LRSRRaisedEdge_TimeStamp : 24|16@1+ (0.1,0) [0|6553.5] "ms"  VCM
 SG_ LRSRRaisedEdge_CoastIndex : 75|5@1+ (1,0) [0|31] "NotApplicable"  VCM

BO_ 798 LRSREgoAssumpt_Vic4: 16 SR_LR
 SG_ LRSREgoAssumpt_EgoLongVel : 0|16@1+ (0.00108507,0) [0|71.11006245] "m_per_s"  VCM
 SG_ LRSREgoAssumpt_EgoRoadHeading : 80|13@1+ (0.0005,-1.57) [-1.57|2.5255] "rad"  VCM
 SG_ LRSREgoAssumpt_EgoRoadCurvature : 104|18@1+ (1E-006,-0.1310705) [-0.1310705|0.1310725] "per_meter"  VCM
 SG_ LRSREgoAssumpt_EgoLongAcc : 16|16@1+ (0.00048828125,-15.6875) [-15.6875|16.31201171875] "m_per_s_squared"  VCM
 SG_ LRSREgoAssumpt_EgoRoadCurvRate : 93|11@1+ (5.1E-007,-0.000516) [-0.000516|0.00052797] "per_meter_squared"  VCM
 SG_ LRSREgoAssumpt_VelCorrFactor : 64|8@1+ (0.002,0.75) [0.75|1.26] "NotApplicable"  VCM
 SG_ LRSREgoAssumpt_EgoRoadEnd : 72|8@1+ (1,0) [0|255] "m"  VCM
 SG_ LRSREgoAssumpt_EgoYawRate : 32|16@1+ (0.000122,-3.92) [-3.92|4.07527] "Rad_per_s"  VCM
 SG_ LRSREgoAssumpt_TimeStamp : 48|16@1+ (0.1,0) [0|6553.5] "ms"  VCM

BO_ 844 LFSideSensorTrlrObj: 32 SR_LF
 SG_ LFSideSensorTrlrObj_SegTrlrType1 : 188|4@1+ (1,0) [0|0] ""  VCM
 SG_ LFSideSensorTrlrObj_SegAngle3 : 69|12@1+ (0.001745,-2.4) [-2.4|4.745775] "rad"  VCM
 SG_ LFSideSensorTrlrObj_Seg1Length : 36|9@1+ (0.05,0) [0|25.55] "m"  VCM
 SG_ LFSideSensorTrlrObj_TotalLength : 105|11@1+ (0.1,0) [0|204.7] "m"  VCM
 SG_ LFSideSensorTrlrObj_Seg5Length : 27|9@1+ (0.05,0) [0|25.55] "m"  VCM
 SG_ LFSideSensorTrlrObj_SegAngle5 : 93|12@1+ (0.001745,-2.4) [-2.4|4.745775] "rad"  VCM
 SG_ LFSideSensorTrlrObj_SegAngle1 : 45|12@1+ (0.001745,-2.4) [-2.4|4.745775] "rad"  VCM
 SG_ LFSideSensorTrlrObj_Seg4Length : 18|9@1+ (0.05,0) [0|25.55] "m"  VCM
 SG_ LFSideSensorTrlrObj_SegAngle4 : 81|12@1+ (0.001745,-2.4) [-2.4|4.745775] "rad"  VCM
 SG_ LFSideSensorTrlrObj_WhlBasedConf : 181|7@1+ (1,0) [0|127] "Percent"  VCM
 SG_ LFSideSensorTrlrObj_TotLenConf : 116|3@1+ (1,0) [0|0] ""  VCM
 SG_ LFSideSensorTrlrObj_TrlAnglConf : 174|7@1+ (1,0) [0|0] ""  VCM
 SG_ LFSideSensorTrlrObj_WheelBased1 : 119|11@1+ (0.1,0) [0|204.7] "m"  VCM
 SG_ LFSideSensorTrlrObj_SegTrlrType2 : 192|4@1+ (1,0) [0|0] ""  VCM
 SG_ LFSideSensorTrlrObj_WheelBased5 : 163|11@1+ (0.1,0) [0|204.7] "m"  VCM
 SG_ LFSideSensorTrlrObj_SegTrlrType5 : 204|4@1+ (1,0) [0|0] ""  VCM
 SG_ LFSideSensorTrlrObj_TrlrTypeConf : 208|7@1+ (1,0) [0|127] "Percent"  VCM
 SG_ LFSideSensorTrlrObj_WheelBased2 : 130|11@1+ (0.1,0) [0|204.7] "m"  VCM
 SG_ LFSideSensorTrlrObj_Seg2Length : 0|9@1+ (0.05,0) [0|25.55] "m"  VCM
 SG_ LFSideSensorTrlrObj_WheelBased4 : 152|11@1+ (0.1,0) [0|204.7] "m"  VCM
 SG_ LFSideSensorTrlrObj_WheelBased3 : 141|11@1+ (0.1,0) [0|204.7] "m"  VCM
 SG_ LFSideSensorTrlrObj_SegTrlrType3 : 196|4@1+ (1,0) [0|0] ""  VCM
 SG_ LFSideSensorTrlrObj_SegAngle2 : 57|12@1+ (0.001745,-2.4) [-2.4|4.745775] "rad"  VCM
 SG_ LFSideSensorTrlrObj_Seg3Length : 9|9@1+ (0.05,0) [0|25.55] "m"  VCM
 SG_ LFSideSensorTrlrObj_SegTrlrType4 : 200|4@1+ (1,0) [0|0] ""  VCM

BO_ 843 LFSideSensorObj11: 48 SR_LF
 SG_ LFSideSensorObj11_ExistConf : 283|7@1+ (0.01,0) [0|1.27] "NotApplicable"  VCM
 SG_ LFSideSensorObj11_LifeTime : 128|16@1+ (0.1,0) [0|6553.5] "s"  VCM
 SG_ LFSideSensorObj11_ObjClassConf : 296|4@1+ (0.1,0) [0|1.5] "NotApplicable"  VCM
 SG_ LFSideSensorObj11_Prioritisation : 290|2@1+ (1,0) [0|0] ""  VCM
 SG_ LFSideSensorObj11_LatVel : 208|13@1+ (0.032,-80) [-80|182.112] "m_per_s"  VCM
 SG_ LFSideSensorObj11_ObjDynClass : 166|2@1+ (1,0) [0|0] ""  VCM
 SG_ LFSideSensorObj11_LongPos : 234|13@1+ (0.05,-180) [-180|229.55] "m"  VCM
 SG_ LFSideSensorObj11_MOISPrio : 307|1@1+ (1,0) [0|0] ""  VCM
 SG_ LFSideSensorObj11_Heading : 144|11@1+ (0.005818,-4.71) [-4.71|7.199446] "rad"  VCM
 SG_ LFSideSensorObj11_Height : 168|8@1+ (0.02,0) [0|5.1] "m"  VCM
 SG_ LFSideSensorObj11_LatExtLeft : 276|7@1+ (0.05,0) [0|6.35] "m"  VCM
 SG_ LFSideSensorObj11_LongVel : 195|13@1+ (0.032,-80) [-80|182.112] "m_per_s"  VCM
 SG_ LFSideSensorObj11_LongVelVar : 40|8@1+ (0.01,0) [0|2.55] "NotApplicable"  VCM
 SG_ LFSideSensorObj11_LatPos : 221|13@1+ (0.05,-180) [-180|229.55] "m"  VCM
 SG_ LFSideSensorObj11_LatPosVar : 88|8@1+ (0.1,0) [0|25.5] "NotApplicable"  VCM
 SG_ LFSideSensorObj11_ObjClass : 292|4@1+ (1,0) [0|0] ""  VCM
 SG_ LFSideSensorObj11_LongExtBkVar : 64|8@1+ (0.1,0) [0|25.5] "NotApplicable"  VCM
 SG_ LFSideSensorObj11_ObjID : 160|6@1+ (1,0) [0|63] "NotApplicable"  VCM
 SG_ LFSideSensorObj11_LatAccVar : 112|8@1+ (0.1,0) [0|25.5] "NotApplicable"  VCM
 SG_ LFSideSensorObj11_LatExtRtVar : 96|8@1+ (0.1,0) [0|25.5] "NotApplicable"  VCM
 SG_ LFSideSensorObj11_LongAcc : 176|9@1+ (0.08,-20) [-20|20.88] "m_per_s_squared"  VCM
 SG_ LFSideSensorObj11_Counter : 16|8@1+ (1,0) [0|255] "Count"  VCM
 SG_ LFSideSensorObj11_ObstacleConf : 300|7@1+ (0.01,0) [0|1.27] "NotApplicable"  VCM
 SG_ LFSideSensorObj11_CRC : 0|16@1+ (1,0) [0|65535] "NotApplicable"  VCM
 SG_ LFSideSensorObj11_LatExtRight : 185|7@1+ (0.05,-5) [-5|1.35] "m"  VCM
 SG_ LFSideSensorObj11_LongExtFrVar : 56|8@1+ (0.1,0) [0|25.5] "NotApplicable"  VCM
 SG_ LFSideSensorObj11_LongExtBack : 257|10@1+ (0.05,-50) [-50|1.15000000000001] "m"  VCM
 SG_ LFSideSensorObj11_LongPosVar : 48|8@1+ (0.01,0) [0|2.55] "NotApplicable"  VCM
 SG_ LFSideSensorObj11_LatExtLeftVar : 104|8@1+ (0.1,0) [0|25.5] "NotApplicable"  VCM
 SG_ LFSideSensorObj11_HeadingVar : 120|8@1+ (0.001,0) [0|0.255] "NotApplicable"  VCM
 SG_ LFSideSensorObj11_LatAcc : 267|9@1+ (0.08,-20) [-20|20.88] "m_per_s_squared"  VCM
 SG_ LFSideSensorObj11_TimeStamp : 24|16@1+ (0.1,0) [0|6553.5] "ms"  VCM
 SG_ LFSideSensorObj11_LongExtFront : 247|10@1+ (0.05,0) [0|51.15] "m"  VCM
 SG_ LFSideSensorObj11_CoastIndex : 155|5@1+ (1,0) [0|31] "NotApplicable"  VCM
 SG_ LFSideSensorObj11_LatVelVar : 80|8@1+ (0.01,0) [0|2.55] "NotApplicable"  VCM
 SG_ LFSideSensorObj11_LongAccVar : 72|8@1+ (0.1,0) [0|25.5] "NotApplicable"  VCM
 SG_ LFSideSensorObj11_TrackStatus : 192|3@1+ (1,0) [0|0] ""  VCM

BA_DEF_ BO_  "GenMsgStartDelayTime" INT 0 0;
BA_DEF_ BO_  "GenMsgDelayTime" INT 0 0;
BA_DEF_ BO_  "GenMsgCycleTime" INT 0 0;
BA_DEF_ BO_  "GenMsgSendType" ENUM  "Cyclic","NotUsed","NotUsed","NotUsed","NotUsed","NotUsed","NotUsed","IfActive","NoMsgSendType","NotUsed";
BA_DEF_ SG_  "GenSigStartValue" INT 0 0;
BA_DEF_ SG_  "GenSigCycleTimeActive" INT 0 0;
BA_DEF_ SG_  "GenSigCycleTime" INT 0 0;
BA_DEF_ SG_  "GenSigSendType" ENUM  "Cyclic","OnWrite","OnWriteWithRepetition","OnChange","OnChangeWithRepetition","IfActive","IfActiveWithRepetition","NoSigSendType","NotUsed","NotUsed","NotUsed","NotUsed","NotUsed";
BA_DEF_ BO_  "VFrameFormat" ENUM  "StandardCAN","ExtendedCAN","reserved","J1939PG","reserved","reserved","reserved","reserved","reserved","reserved","reserved","reserved","reserved","reserved","StandardCAN_FD","ExtendedCAN_FD";
BA_DEF_ SG_  "SigType" ENUM  "Default","Range","RangeSigned","ASCII","Discrete","Control","ReferencePGN","DTC","StringDelimiter","StringLength","StringLengthControl";
BA_DEF_ SG_  "SeToolVersion_SIGNAL" STRING ;
BA_DEF_ SG_  "SeToolUniqueID_SIGNAL" STRING ;
BA_DEF_ SG_  "SeToolName_SIGNAL" STRING ;
BA_DEF_ SG_  "SeToolItemID_SIGNAL" STRING ;
BA_DEF_ SG_  "SeToolAncestorID_SIGNAL" STRING ;
BA_DEF_ SG_  "Platform_VMCU1_Sig" ENUM  "No","Yes";
BA_DEF_ SG_  "NeedsUpdateBit" ENUM  "No","Yes";
BA_DEF_ SG_  "GenSigMaxLatency" INT 0 65535;
BA_DEF_ SG_  "GenSigILSupport" ENUM  "Yes","No";
BA_DEF_ BO_  "GenMsgILSupport" ENUM  "No","Yes";
BA_DEF_ SG_  "E2EProfile" STRING ;
BA_DEF_ SG_  "E2EDataLength" INT 0 65535;
BA_DEF_ SG_  "E2EDataId" INT 0 65535;
BA_DEF_ BO_  "DiagUUDTResponse" ENUM  "No","Yes";
BA_DEF_ BO_  "DiagState" ENUM  "No","Yes";
BA_DEF_ BO_  "DiagResponse" ENUM  "No","Yes";
BA_DEF_ BO_  "DiagRequest" ENUM  "No","Yes";
BA_DEF_ BO_  "DiagConnection" HEX 0 65535;
BA_DEF_ BO_  "CanTpFcFrameId" HEX 0 2147483647;
BA_DEF_ BO_  "CanTpBs" INT 0 255;
BA_DEF_ BO_  "CANFD_BRS" ENUM  "0","1";
BA_DEF_REL_ BU_SG_REL_  "GenSigTimeoutTime" INT 0 65535;
BA_DEF_REL_ BU_SG_REL_  "GenSigFirstTimeoutTime" INT 0 65535;
BA_DEF_DEF_  "GenMsgStartDelayTime" 0;
BA_DEF_DEF_  "GenMsgDelayTime" 0;
BA_DEF_DEF_  "GenMsgCycleTime" 0;
BA_DEF_DEF_  "GenMsgSendType" "Cyclic";
BA_DEF_DEF_  "GenSigStartValue" 0;
BA_DEF_DEF_  "GenSigCycleTimeActive" 0;
BA_DEF_DEF_  "GenSigCycleTime" 0;
BA_DEF_DEF_  "GenSigSendType" "Cyclic";
BA_DEF_DEF_  "VFrameFormat" "ExtendedCAN";
BA_DEF_DEF_  "SigType" "Default";
BA_DEF_DEF_  "SeToolVersion_SIGNAL" "";
BA_DEF_DEF_  "SeToolUniqueID_SIGNAL" "";
BA_DEF_DEF_  "SeToolName_SIGNAL" "";
BA_DEF_DEF_  "SeToolItemID_SIGNAL" "";
BA_DEF_DEF_  "SeToolAncestorID_SIGNAL" "";
BA_DEF_DEF_  "Platform_VMCU1_Sig" "No";
BA_DEF_DEF_  "NeedsUpdateBit" "No";
BA_DEF_DEF_  "GenSigMaxLatency" 0;
BA_DEF_DEF_  "GenSigILSupport" "Yes";
BA_DEF_DEF_  "GenMsgILSupport" "Yes";
BA_DEF_DEF_  "E2EProfile" "none";
BA_DEF_DEF_  "E2EDataLength" 0;
BA_DEF_DEF_  "E2EDataId" 0;
BA_DEF_DEF_  "DiagUUDTResponse" "No";
BA_DEF_DEF_  "DiagState" "No";
BA_DEF_DEF_  "DiagResponse" "No";
BA_DEF_DEF_  "DiagRequest" "No";
BA_DEF_DEF_  "DiagConnection" 0;
BA_DEF_DEF_  "CanTpFcFrameId" 2147483647;
BA_DEF_DEF_  "CanTpBs" 255;
BA_DEF_DEF_  "CANFD_BRS" "0";
BA_DEF_DEF_REL_ "GenSigTimeoutTime" 0;
BA_DEF_DEF_REL_ "GenSigFirstTimeoutTime" 0;
BA_ "DiagConnection" BO_ 2671798514 62056;
BA_ "DiagRequest" BO_ 2671798514 1;
BA_ "GenMsgILSupport" BO_ 2671798514 0;
BA_ "GenMsgSendType" BO_ 2671798514 8;
BA_ "CANFD_BRS" BO_ 796 1;
BA_ "GenMsgSendType" BO_ 796 8;
BA_ "GenMsgDelayTime" BO_ 796 10;
BA_ "VFrameFormat" BO_ 796 14;
BA_ "CANFD_BRS" BO_ 795 1;
BA_ "GenMsgSendType" BO_ 795 8;
BA_ "GenMsgDelayTime" BO_ 795 10;
BA_ "VFrameFormat" BO_ 795 14;
BA_ "CANFD_BRS" BO_ 794 1;
BA_ "GenMsgSendType" BO_ 794 8;
BA_ "GenMsgDelayTime" BO_ 794 10;
BA_ "VFrameFormat" BO_ 794 14;
BA_ "CANFD_BRS" BO_ 793 1;
BA_ "GenMsgSendType" BO_ 793 8;
BA_ "GenMsgDelayTime" BO_ 793 10;
BA_ "VFrameFormat" BO_ 793 14;
BA_ "CANFD_BRS" BO_ 792 1;
BA_ "GenMsgSendType" BO_ 792 8;
BA_ "GenMsgDelayTime" BO_ 792 10;
BA_ "VFrameFormat" BO_ 792 14;
BA_ "CANFD_BRS" BO_ 791 1;
BA_ "GenMsgSendType" BO_ 791 8;
BA_ "GenMsgDelayTime" BO_ 791 10;
BA_ "VFrameFormat" BO_ 791 14;
BA_ "CANFD_BRS" BO_ 790 1;
BA_ "GenMsgSendType" BO_ 790 8;
BA_ "GenMsgDelayTime" BO_ 790 10;
BA_ "VFrameFormat" BO_ 790 14;
BA_ "CANFD_BRS" BO_ 789 1;
BA_ "GenMsgSendType" BO_ 789 8;
BA_ "GenMsgDelayTime" BO_ 789 10;
BA_ "VFrameFormat" BO_ 789 14;
BA_ "CANFD_BRS" BO_ 788 1;
BA_ "GenMsgSendType" BO_ 788 8;
BA_ "GenMsgDelayTime" BO_ 788 10;
BA_ "VFrameFormat" BO_ 788 14;
BA_ "CANFD_BRS" BO_ 787 1;
BA_ "GenMsgSendType" BO_ 787 8;
BA_ "GenMsgDelayTime" BO_ 787 10;
BA_ "VFrameFormat" BO_ 787 14;
BA_ "CANFD_BRS" BO_ 786 1;
BA_ "GenMsgSendType" BO_ 786 8;
BA_ "GenMsgDelayTime" BO_ 786 10;
BA_ "VFrameFormat" BO_ 786 14;
BA_ "CANFD_BRS" BO_ 785 1;
BA_ "GenMsgSendType" BO_ 785 8;
BA_ "GenMsgDelayTime" BO_ 785 10;
BA_ "VFrameFormat" BO_ 785 14;
BA_ "CANFD_BRS" BO_ 784 1;
BA_ "GenMsgSendType" BO_ 784 8;
BA_ "GenMsgDelayTime" BO_ 784 10;
BA_ "VFrameFormat" BO_ 784 14;
BA_ "CANFD_BRS" BO_ 1553 1;
BA_ "GenMsgCycleTime" BO_ 1553 10000;
BA_ "GenMsgStartDelayTime" BO_ 1553 125;
BA_ "VFrameFormat" BO_ 1553 14;
BA_ "CANFD_BRS" BO_ 799 1;
BA_ "GenMsgSendType" BO_ 799 8;
BA_ "VFrameFormat" BO_ 799 14;
BA_ "CANFD_BRS" BO_ 798 1;
BA_ "GenMsgSendType" BO_ 798 8;
BA_ "VFrameFormat" BO_ 798 14;
BA_ "CANFD_BRS" BO_ 844 1;
BA_ "GenMsgSendType" BO_ 844 8;
BA_ "GenMsgDelayTime" BO_ 844 10;
BA_ "VFrameFormat" BO_ 844 14;
BA_ "CANFD_BRS" BO_ 843 1;
BA_ "GenMsgSendType" BO_ 843 8;
BA_ "GenMsgDelayTime" BO_ 843 10;
BA_ "VFrameFormat" BO_ 843 14;
BA_ "GenSigSendType" SG_ 2671798514 PhysDiagReqSig_68_F2 7;
BA_ "GenSigSendType" SG_ 796 LRSideSensorTrlrObj_SegTrlrType3 1;
BA_ "GenSigStartValue" SG_ 796 LRSideSensorTrlrObj_SegTrlrType3 15;
BA_ "GenSigSendType" SG_ 796 LRSideSensorTrlrObj_TrlAnglConf 1;
BA_ "GenSigStartValue" SG_ 796 LRSideSensorTrlrObj_TrlAnglConf 127;
BA_ "GenSigSendType" SG_ 796 LRSideSensorTrlrObj_TrlrTypeConf 1;
BA_ "GenSigStartValue" SG_ 796 LRSideSensorTrlrObj_TrlrTypeConf 127;
BA_ "GenSigSendType" SG_ 796 LRSideSensorTrlrObj_Seg1Length 1;
BA_ "GenSigStartValue" SG_ 796 LRSideSensorTrlrObj_Seg1Length 511;
BA_ "GenSigSendType" SG_ 796 LRSideSensorTrlrObj_SegTrlrType5 1;
BA_ "GenSigStartValue" SG_ 796 LRSideSensorTrlrObj_SegTrlrType5 15;
BA_ "GenSigSendType" SG_ 796 LRSideSensorTrlrObj_SegAngle1 1;
BA_ "GenSigStartValue" SG_ 796 LRSideSensorTrlrObj_SegAngle1 4095;
BA_ "GenSigSendType" SG_ 796 LRSideSensorTrlrObj_Seg4Length 1;
BA_ "GenSigStartValue" SG_ 796 LRSideSensorTrlrObj_Seg4Length 511;
BA_ "GenSigSendType" SG_ 796 LRSideSensorTrlrObj_WheelBased1 1;
BA_ "GenSigStartValue" SG_ 796 LRSideSensorTrlrObj_WheelBased1 2047;
BA_ "GenSigSendType" SG_ 796 LRSideSensorTrlrObj_SegTrlrType1 1;
BA_ "GenSigStartValue" SG_ 796 LRSideSensorTrlrObj_SegTrlrType1 15;
BA_ "GenSigSendType" SG_ 796 LRSideSensorTrlrObj_Seg5Length 1;
BA_ "GenSigStartValue" SG_ 796 LRSideSensorTrlrObj_Seg5Length 511;
BA_ "GenSigSendType" SG_ 796 LRSideSensorTrlrObj_WheelBased2 1;
BA_ "GenSigStartValue" SG_ 796 LRSideSensorTrlrObj_WheelBased2 2047;
BA_ "GenSigSendType" SG_ 796 LRSideSensorTrlrObj_WheelBased3 1;
BA_ "GenSigStartValue" SG_ 796 LRSideSensorTrlrObj_WheelBased3 2047;
BA_ "GenSigSendType" SG_ 796 LRSideSensorTrlrObj_WheelBased5 1;
BA_ "GenSigStartValue" SG_ 796 LRSideSensorTrlrObj_WheelBased5 2047;
BA_ "GenSigSendType" SG_ 796 LRSideSensorTrlrObj_SegTrlrType4 1;
BA_ "GenSigStartValue" SG_ 796 LRSideSensorTrlrObj_SegTrlrType4 15;
BA_ "GenSigSendType" SG_ 796 LRSideSensorTrlrObj_Seg3Length 1;
BA_ "GenSigStartValue" SG_ 796 LRSideSensorTrlrObj_Seg3Length 511;
BA_ "GenSigSendType" SG_ 796 LRSideSensorTrlrObj_SegTrlrType2 1;
BA_ "GenSigStartValue" SG_ 796 LRSideSensorTrlrObj_SegTrlrType2 15;
BA_ "GenSigSendType" SG_ 796 LRSideSensorTrlrObj_TotLenConf 1;
BA_ "GenSigStartValue" SG_ 796 LRSideSensorTrlrObj_TotLenConf 7;
BA_ "GenSigSendType" SG_ 796 LRSideSensorTrlrObj_WheelBased4 1;
BA_ "GenSigStartValue" SG_ 796 LRSideSensorTrlrObj_WheelBased4 2047;
BA_ "GenSigSendType" SG_ 796 LRSideSensorTrlrObj_TotalLength 1;
BA_ "GenSigStartValue" SG_ 796 LRSideSensorTrlrObj_TotalLength 2047;
BA_ "GenSigSendType" SG_ 796 LRSideSensorTrlrObj_WhlBasedConf 1;
BA_ "GenSigStartValue" SG_ 796 LRSideSensorTrlrObj_WhlBasedConf 127;
BA_ "GenSigSendType" SG_ 796 LRSideSensorTrlrObj_SegAngle5 1;
BA_ "GenSigStartValue" SG_ 796 LRSideSensorTrlrObj_SegAngle5 4095;
BA_ "GenSigSendType" SG_ 796 LRSideSensorTrlrObj_SegAngle3 1;
BA_ "GenSigStartValue" SG_ 796 LRSideSensorTrlrObj_SegAngle3 4095;
BA_ "GenSigSendType" SG_ 796 LRSideSensorTrlrObj_SegAngle2 1;
BA_ "GenSigStartValue" SG_ 796 LRSideSensorTrlrObj_SegAngle2 4095;
BA_ "GenSigSendType" SG_ 796 LRSideSensorTrlrObj_SegAngle4 1;
BA_ "GenSigStartValue" SG_ 796 LRSideSensorTrlrObj_SegAngle4 4095;
BA_ "GenSigSendType" SG_ 796 LRSideSensorTrlrObj_Seg2Length 1;
BA_ "GenSigStartValue" SG_ 796 LRSideSensorTrlrObj_Seg2Length 511;
BA_ "GenSigSendType" SG_ 795 LRSideSensorObj11_LatExtLeftVar 1;
BA_ "GenSigStartValue" SG_ 795 LRSideSensorObj11_LatExtLeftVar 255;
BA_ "GenSigSendType" SG_ 795 LRSideSensorObj11_CRC 1;
BA_ "GenSigStartValue" SG_ 795 LRSideSensorObj11_CRC 65535;
BA_ "E2EDataId" SG_ 795 LRSideSensorObj11_CRC 41;
BA_ "E2EDataLength" SG_ 795 LRSideSensorObj11_CRC 312;
BA_ "E2EProfile" SG_ 795 LRSideSensorObj11_CRC "P05";
BA_ "GenSigSendType" SG_ 795 LRSideSensorObj11_CoastIndex 1;
BA_ "GenSigStartValue" SG_ 795 LRSideSensorObj11_CoastIndex 31;
BA_ "GenSigSendType" SG_ 795 LRSideSensorObj11_LatPosVar 1;
BA_ "GenSigStartValue" SG_ 795 LRSideSensorObj11_LatPosVar 255;
BA_ "GenSigSendType" SG_ 795 LRSideSensorObj11_LongExtBkVar 1;
BA_ "GenSigStartValue" SG_ 795 LRSideSensorObj11_LongExtBkVar 255;
BA_ "GenSigSendType" SG_ 795 LRSideSensorObj11_LongExtBack 1;
BA_ "GenSigStartValue" SG_ 795 LRSideSensorObj11_LongExtBack 1023;
BA_ "GenSigSendType" SG_ 795 LRSideSensorObj11_ObstacleConf 1;
BA_ "GenSigStartValue" SG_ 795 LRSideSensorObj11_ObstacleConf 127;
BA_ "GenSigSendType" SG_ 795 LRSideSensorObj11_MOISPrio 1;
BA_ "GenSigSendType" SG_ 795 LRSideSensorObj11_LongAccVar 1;
BA_ "GenSigStartValue" SG_ 795 LRSideSensorObj11_LongAccVar 255;
BA_ "GenSigSendType" SG_ 795 LRSideSensorObj11_LifeTime 1;
BA_ "GenSigStartValue" SG_ 795 LRSideSensorObj11_LifeTime 65535;
BA_ "GenSigSendType" SG_ 795 LRSideSensorObj11_Height 1;
BA_ "GenSigStartValue" SG_ 795 LRSideSensorObj11_Height 255;
BA_ "GenSigSendType" SG_ 795 LRSideSensorObj11_LongExtFrVar 1;
BA_ "GenSigStartValue" SG_ 795 LRSideSensorObj11_LongExtFrVar 255;
BA_ "GenSigSendType" SG_ 795 LRSideSensorObj11_ObjDynClass 1;
BA_ "GenSigStartValue" SG_ 795 LRSideSensorObj11_ObjDynClass 3;
BA_ "GenSigSendType" SG_ 795 LRSideSensorObj11_Prioritisation 1;
BA_ "GenSigStartValue" SG_ 795 LRSideSensorObj11_Prioritisation 3;
BA_ "GenSigSendType" SG_ 795 LRSideSensorObj11_LongAcc 1;
BA_ "GenSigStartValue" SG_ 795 LRSideSensorObj11_LongAcc 511;
BA_ "GenSigSendType" SG_ 795 LRSideSensorObj11_LatVelVar 1;
BA_ "GenSigStartValue" SG_ 795 LRSideSensorObj11_LatVelVar 255;
BA_ "GenSigSendType" SG_ 795 LRSideSensorObj11_LongPosVar 1;
BA_ "GenSigStartValue" SG_ 795 LRSideSensorObj11_LongPosVar 255;
BA_ "GenSigSendType" SG_ 795 LRSideSensorObj11_LatExtRight 1;
BA_ "GenSigStartValue" SG_ 795 LRSideSensorObj11_LatExtRight 127;
BA_ "GenSigSendType" SG_ 795 LRSideSensorObj11_LongPos 1;
BA_ "GenSigStartValue" SG_ 795 LRSideSensorObj11_LongPos 8191;
BA_ "GenSigSendType" SG_ 795 LRSideSensorObj11_HeadingVar 1;
BA_ "GenSigStartValue" SG_ 795 LRSideSensorObj11_HeadingVar 255;
BA_ "GenSigSendType" SG_ 795 LRSideSensorObj11_Counter 1;
BA_ "GenSigStartValue" SG_ 795 LRSideSensorObj11_Counter 255;
BA_ "GenSigSendType" SG_ 795 LRSideSensorObj11_LatPos 1;
BA_ "GenSigStartValue" SG_ 795 LRSideSensorObj11_LatPos 8191;
BA_ "GenSigSendType" SG_ 795 LRSideSensorObj11_TimeStamp 1;
BA_ "GenSigStartValue" SG_ 795 LRSideSensorObj11_TimeStamp 65535;
BA_ "GenSigSendType" SG_ 795 LRSideSensorObj11_ObjClassConf 1;
BA_ "GenSigStartValue" SG_ 795 LRSideSensorObj11_ObjClassConf 15;
BA_ "GenSigSendType" SG_ 795 LRSideSensorObj11_LatExtRtVar 1;
BA_ "GenSigStartValue" SG_ 795 LRSideSensorObj11_LatExtRtVar 255;
BA_ "GenSigSendType" SG_ 795 LRSideSensorObj11_ExistConf 1;
BA_ "GenSigStartValue" SG_ 795 LRSideSensorObj11_ExistConf 127;
BA_ "GenSigSendType" SG_ 795 LRSideSensorObj11_LatExtLeft 1;
BA_ "GenSigStartValue" SG_ 795 LRSideSensorObj11_LatExtLeft 127;
BA_ "GenSigSendType" SG_ 795 LRSideSensorObj11_LatAccVar 1;
BA_ "GenSigStartValue" SG_ 795 LRSideSensorObj11_LatAccVar 255;
BA_ "GenSigSendType" SG_ 795 LRSideSensorObj11_ObjID 1;
BA_ "GenSigStartValue" SG_ 795 LRSideSensorObj11_ObjID 63;
BA_ "GenSigSendType" SG_ 795 LRSideSensorObj11_LatVel 1;
BA_ "GenSigStartValue" SG_ 795 LRSideSensorObj11_LatVel 8191;
BA_ "GenSigSendType" SG_ 795 LRSideSensorObj11_LatAcc 1;
BA_ "GenSigStartValue" SG_ 795 LRSideSensorObj11_LatAcc 511;
BA_ "GenSigSendType" SG_ 795 LRSideSensorObj11_LongVel 1;
BA_ "GenSigStartValue" SG_ 795 LRSideSensorObj11_LongVel 8191;
BA_ "GenSigSendType" SG_ 795 LRSideSensorObj11_Heading 1;
BA_ "GenSigStartValue" SG_ 795 LRSideSensorObj11_Heading 2047;
BA_ "GenSigSendType" SG_ 795 LRSideSensorObj11_LongExtFront 1;
BA_ "GenSigStartValue" SG_ 795 LRSideSensorObj11_LongExtFront 1023;
BA_ "GenSigSendType" SG_ 795 LRSideSensorObj11_LongVelVar 1;
BA_ "GenSigStartValue" SG_ 795 LRSideSensorObj11_LongVelVar 255;
BA_ "GenSigSendType" SG_ 795 LRSideSensorObj11_TrackStatus 1;
BA_ "GenSigStartValue" SG_ 795 LRSideSensorObj11_TrackStatus 7;
BA_ "GenSigSendType" SG_ 795 LRSideSensorObj11_ObjClass 1;
BA_ "GenSigStartValue" SG_ 795 LRSideSensorObj11_ObjClass 15;
BA_ "GenSigSendType" SG_ 794 LRSideSensorObj10_LifeTime 1;
BA_ "GenSigStartValue" SG_ 794 LRSideSensorObj10_LifeTime 65535;
BA_ "GenSigSendType" SG_ 794 LRSideSensorObj10_LongPos 1;
BA_ "GenSigStartValue" SG_ 794 LRSideSensorObj10_LongPos 8191;
BA_ "GenSigSendType" SG_ 794 LRSideSensorObj10_LatPosVar 1;
BA_ "GenSigStartValue" SG_ 794 LRSideSensorObj10_LatPosVar 255;
BA_ "GenSigSendType" SG_ 794 LRSideSensorObj10_LatVel 1;
BA_ "GenSigStartValue" SG_ 794 LRSideSensorObj10_LatVel 8191;
BA_ "GenSigSendType" SG_ 794 LRSideSensorObj10_LatPos 1;
BA_ "GenSigStartValue" SG_ 794 LRSideSensorObj10_LatPos 8191;
BA_ "GenSigSendType" SG_ 794 LRSideSensorObj10_HeadingVar 1;
BA_ "GenSigStartValue" SG_ 794 LRSideSensorObj10_HeadingVar 255;
BA_ "GenSigSendType" SG_ 794 LRSideSensorObj10_LatExtRight 1;
BA_ "GenSigStartValue" SG_ 794 LRSideSensorObj10_LatExtRight 127;
BA_ "GenSigSendType" SG_ 794 LRSideSensorObj10_Height 1;
BA_ "GenSigStartValue" SG_ 794 LRSideSensorObj10_Height 255;
BA_ "GenSigSendType" SG_ 794 LRSideSensorObj10_TrackStatus 1;
BA_ "GenSigStartValue" SG_ 794 LRSideSensorObj10_TrackStatus 7;
BA_ "GenSigSendType" SG_ 794 LRSideSensorObj10_ExistConf 1;
BA_ "GenSigStartValue" SG_ 794 LRSideSensorObj10_ExistConf 127;
BA_ "GenSigSendType" SG_ 794 LRSideSensorObj10_LatExtRtVar 1;
BA_ "GenSigStartValue" SG_ 794 LRSideSensorObj10_LatExtRtVar 255;
BA_ "GenSigSendType" SG_ 794 LRSideSensorObj10_CRC 1;
BA_ "GenSigStartValue" SG_ 794 LRSideSensorObj10_CRC 65535;
BA_ "E2EDataId" SG_ 794 LRSideSensorObj10_CRC 40;
BA_ "E2EDataLength" SG_ 794 LRSideSensorObj10_CRC 312;
BA_ "E2EProfile" SG_ 794 LRSideSensorObj10_CRC "P05";
BA_ "GenSigSendType" SG_ 794 LRSideSensorObj10_LatExtLeft 1;
BA_ "GenSigStartValue" SG_ 794 LRSideSensorObj10_LatExtLeft 127;
BA_ "GenSigSendType" SG_ 794 LRSideSensorObj10_LatAccVar 1;
BA_ "GenSigStartValue" SG_ 794 LRSideSensorObj10_LatAccVar 255;
BA_ "GenSigSendType" SG_ 794 LRSideSensorObj10_Heading 1;
BA_ "GenSigStartValue" SG_ 794 LRSideSensorObj10_Heading 2047;
BA_ "GenSigSendType" SG_ 794 LRSideSensorObj10_LongExtBack 1;
BA_ "GenSigStartValue" SG_ 794 LRSideSensorObj10_LongExtBack 1023;
BA_ "GenSigSendType" SG_ 794 LRSideSensorObj10_ObstacleConf 1;
BA_ "GenSigStartValue" SG_ 794 LRSideSensorObj10_ObstacleConf 127;
BA_ "GenSigSendType" SG_ 794 LRSideSensorObj10_ObjID 1;
BA_ "GenSigStartValue" SG_ 794 LRSideSensorObj10_ObjID 63;
BA_ "GenSigSendType" SG_ 794 LRSideSensorObj10_LongAcc 1;
BA_ "GenSigStartValue" SG_ 794 LRSideSensorObj10_LongAcc 511;
BA_ "GenSigSendType" SG_ 794 LRSideSensorObj10_LongExtFront 1;
BA_ "GenSigStartValue" SG_ 794 LRSideSensorObj10_LongExtFront 1023;
BA_ "GenSigSendType" SG_ 794 LRSideSensorObj10_LatAcc 1;
BA_ "GenSigStartValue" SG_ 794 LRSideSensorObj10_LatAcc 511;
BA_ "GenSigSendType" SG_ 794 LRSideSensorObj10_LongVelVar 1;
BA_ "GenSigStartValue" SG_ 794 LRSideSensorObj10_LongVelVar 255;
BA_ "GenSigSendType" SG_ 794 LRSideSensorObj10_LongVel 1;
BA_ "GenSigStartValue" SG_ 794 LRSideSensorObj10_LongVel 8191;
BA_ "GenSigSendType" SG_ 794 LRSideSensorObj10_LongExtFrVar 1;
BA_ "GenSigStartValue" SG_ 794 LRSideSensorObj10_LongExtFrVar 255;
BA_ "GenSigSendType" SG_ 794 LRSideSensorObj10_LongExtBkVar 1;
BA_ "GenSigStartValue" SG_ 794 LRSideSensorObj10_LongExtBkVar 255;
BA_ "GenSigSendType" SG_ 794 LRSideSensorObj10_LongPosVar 1;
BA_ "GenSigStartValue" SG_ 794 LRSideSensorObj10_LongPosVar 255;
BA_ "GenSigSendType" SG_ 794 LRSideSensorObj10_Prioritisation 1;
BA_ "GenSigStartValue" SG_ 794 LRSideSensorObj10_Prioritisation 3;
BA_ "GenSigSendType" SG_ 794 LRSideSensorObj10_ObjClassConf 1;
BA_ "GenSigStartValue" SG_ 794 LRSideSensorObj10_ObjClassConf 15;
BA_ "GenSigSendType" SG_ 794 LRSideSensorObj10_TimeStamp 1;
BA_ "GenSigStartValue" SG_ 794 LRSideSensorObj10_TimeStamp 65535;
BA_ "GenSigSendType" SG_ 794 LRSideSensorObj10_MOISPrio 1;
BA_ "GenSigSendType" SG_ 794 LRSideSensorObj10_LatExtLeftVar 1;
BA_ "GenSigStartValue" SG_ 794 LRSideSensorObj10_LatExtLeftVar 255;
BA_ "GenSigSendType" SG_ 794 LRSideSensorObj10_LatVelVar 1;
BA_ "GenSigStartValue" SG_ 794 LRSideSensorObj10_LatVelVar 255;
BA_ "GenSigSendType" SG_ 794 LRSideSensorObj10_ObjClass 1;
BA_ "GenSigStartValue" SG_ 794 LRSideSensorObj10_ObjClass 15;
BA_ "GenSigSendType" SG_ 794 LRSideSensorObj10_Counter 1;
BA_ "GenSigStartValue" SG_ 794 LRSideSensorObj10_Counter 255;
BA_ "GenSigSendType" SG_ 794 LRSideSensorObj10_LongAccVar 1;
BA_ "GenSigStartValue" SG_ 794 LRSideSensorObj10_LongAccVar 255;
BA_ "GenSigSendType" SG_ 794 LRSideSensorObj10_CoastIndex 1;
BA_ "GenSigStartValue" SG_ 794 LRSideSensorObj10_CoastIndex 31;
BA_ "GenSigSendType" SG_ 794 LRSideSensorObj10_ObjDynClass 1;
BA_ "GenSigStartValue" SG_ 794 LRSideSensorObj10_ObjDynClass 3;
BA_ "GenSigSendType" SG_ 793 LRSideSensorObj09_LongExtFrVar 1;
BA_ "GenSigStartValue" SG_ 793 LRSideSensorObj09_LongExtFrVar 255;
BA_ "GenSigSendType" SG_ 793 LRSideSensorObj09_LongExtBack 1;
BA_ "GenSigStartValue" SG_ 793 LRSideSensorObj09_LongExtBack 1023;
BA_ "GenSigSendType" SG_ 793 LRSideSensorObj09_LatExtRtVar 1;
BA_ "GenSigStartValue" SG_ 793 LRSideSensorObj09_LatExtRtVar 255;
BA_ "GenSigSendType" SG_ 793 LRSideSensorObj09_CRC 1;
BA_ "GenSigStartValue" SG_ 793 LRSideSensorObj09_CRC 65535;
BA_ "E2EDataId" SG_ 793 LRSideSensorObj09_CRC 39;
BA_ "E2EDataLength" SG_ 793 LRSideSensorObj09_CRC 312;
BA_ "E2EProfile" SG_ 793 LRSideSensorObj09_CRC "P05";
BA_ "GenSigSendType" SG_ 793 LRSideSensorObj09_LatExtLeft 1;
BA_ "GenSigStartValue" SG_ 793 LRSideSensorObj09_LatExtLeft 127;
BA_ "GenSigSendType" SG_ 793 LRSideSensorObj09_LatExtRight 1;
BA_ "GenSigStartValue" SG_ 793 LRSideSensorObj09_LatExtRight 127;
BA_ "GenSigSendType" SG_ 793 LRSideSensorObj09_LatVelVar 1;
BA_ "GenSigStartValue" SG_ 793 LRSideSensorObj09_LatVelVar 255;
BA_ "GenSigSendType" SG_ 793 LRSideSensorObj09_ObjID 1;
BA_ "GenSigStartValue" SG_ 793 LRSideSensorObj09_ObjID 63;
BA_ "GenSigSendType" SG_ 793 LRSideSensorObj09_ObjDynClass 1;
BA_ "GenSigStartValue" SG_ 793 LRSideSensorObj09_ObjDynClass 3;
BA_ "GenSigSendType" SG_ 793 LRSideSensorObj09_MOISPrio 1;
BA_ "GenSigSendType" SG_ 793 LRSideSensorObj09_LongVel 1;
BA_ "GenSigStartValue" SG_ 793 LRSideSensorObj09_LongVel 8191;
BA_ "GenSigSendType" SG_ 793 LRSideSensorObj09_HeadingVar 1;
BA_ "GenSigStartValue" SG_ 793 LRSideSensorObj09_HeadingVar 255;
BA_ "GenSigSendType" SG_ 793 LRSideSensorObj09_LongExtBkVar 1;
BA_ "GenSigStartValue" SG_ 793 LRSideSensorObj09_LongExtBkVar 255;
BA_ "GenSigSendType" SG_ 793 LRSideSensorObj09_LatAccVar 1;
BA_ "GenSigStartValue" SG_ 793 LRSideSensorObj09_LatAccVar 255;
BA_ "GenSigSendType" SG_ 793 LRSideSensorObj09_LatPos 1;
BA_ "GenSigStartValue" SG_ 793 LRSideSensorObj09_LatPos 8191;
BA_ "GenSigSendType" SG_ 793 LRSideSensorObj09_TimeStamp 1;
BA_ "GenSigStartValue" SG_ 793 LRSideSensorObj09_TimeStamp 65535;
BA_ "GenSigSendType" SG_ 793 LRSideSensorObj09_LatAcc 1;
BA_ "GenSigStartValue" SG_ 793 LRSideSensorObj09_LatAcc 511;
BA_ "GenSigSendType" SG_ 793 LRSideSensorObj09_LatPosVar 1;
BA_ "GenSigStartValue" SG_ 793 LRSideSensorObj09_LatPosVar 255;
BA_ "GenSigSendType" SG_ 793 LRSideSensorObj09_LongAcc 1;
BA_ "GenSigStartValue" SG_ 793 LRSideSensorObj09_LongAcc 511;
BA_ "GenSigSendType" SG_ 793 LRSideSensorObj09_LatVel 1;
BA_ "GenSigStartValue" SG_ 793 LRSideSensorObj09_LatVel 8191;
BA_ "GenSigSendType" SG_ 793 LRSideSensorObj09_ObstacleConf 1;
BA_ "GenSigStartValue" SG_ 793 LRSideSensorObj09_ObstacleConf 127;
BA_ "GenSigSendType" SG_ 793 LRSideSensorObj09_TrackStatus 1;
BA_ "GenSigStartValue" SG_ 793 LRSideSensorObj09_TrackStatus 7;
BA_ "GenSigSendType" SG_ 793 LRSideSensorObj09_LatExtLeftVar 1;
BA_ "GenSigStartValue" SG_ 793 LRSideSensorObj09_LatExtLeftVar 255;
BA_ "GenSigSendType" SG_ 793 LRSideSensorObj09_LifeTime 1;
BA_ "GenSigStartValue" SG_ 793 LRSideSensorObj09_LifeTime 65535;
BA_ "GenSigSendType" SG_ 793 LRSideSensorObj09_LongExtFront 1;
BA_ "GenSigStartValue" SG_ 793 LRSideSensorObj09_LongExtFront 1023;
BA_ "GenSigSendType" SG_ 793 LRSideSensorObj09_LongAccVar 1;
BA_ "GenSigStartValue" SG_ 793 LRSideSensorObj09_LongAccVar 255;
BA_ "GenSigSendType" SG_ 793 LRSideSensorObj09_LongPos 1;
BA_ "GenSigStartValue" SG_ 793 LRSideSensorObj09_LongPos 8191;
BA_ "GenSigSendType" SG_ 793 LRSideSensorObj09_LongVelVar 1;
BA_ "GenSigStartValue" SG_ 793 LRSideSensorObj09_LongVelVar 255;
BA_ "GenSigSendType" SG_ 793 LRSideSensorObj09_ObjClass 1;
BA_ "GenSigStartValue" SG_ 793 LRSideSensorObj09_ObjClass 15;
BA_ "GenSigSendType" SG_ 793 LRSideSensorObj09_ExistConf 1;
BA_ "GenSigStartValue" SG_ 793 LRSideSensorObj09_ExistConf 127;
BA_ "GenSigSendType" SG_ 793 LRSideSensorObj09_Prioritisation 1;
BA_ "GenSigStartValue" SG_ 793 LRSideSensorObj09_Prioritisation 3;
BA_ "GenSigSendType" SG_ 793 LRSideSensorObj09_Heading 1;
BA_ "GenSigStartValue" SG_ 793 LRSideSensorObj09_Heading 2047;
BA_ "GenSigSendType" SG_ 793 LRSideSensorObj09_Height 1;
BA_ "GenSigStartValue" SG_ 793 LRSideSensorObj09_Height 255;
BA_ "GenSigSendType" SG_ 793 LRSideSensorObj09_ObjClassConf 1;
BA_ "GenSigStartValue" SG_ 793 LRSideSensorObj09_ObjClassConf 15;
BA_ "GenSigSendType" SG_ 793 LRSideSensorObj09_LongPosVar 1;
BA_ "GenSigStartValue" SG_ 793 LRSideSensorObj09_LongPosVar 255;
BA_ "GenSigSendType" SG_ 793 LRSideSensorObj09_CoastIndex 1;
BA_ "GenSigStartValue" SG_ 793 LRSideSensorObj09_CoastIndex 31;
BA_ "GenSigSendType" SG_ 793 LRSideSensorObj09_Counter 1;
BA_ "GenSigStartValue" SG_ 793 LRSideSensorObj09_Counter 255;
BA_ "GenSigSendType" SG_ 792 LRSideSensorObj08_ObjDynClass 1;
BA_ "GenSigStartValue" SG_ 792 LRSideSensorObj08_ObjDynClass 3;
BA_ "GenSigSendType" SG_ 792 LRSideSensorObj08_LatExtRight 1;
BA_ "GenSigStartValue" SG_ 792 LRSideSensorObj08_LatExtRight 127;
BA_ "GenSigSendType" SG_ 792 LRSideSensorObj08_CRC 1;
BA_ "GenSigStartValue" SG_ 792 LRSideSensorObj08_CRC 65535;
BA_ "E2EDataId" SG_ 792 LRSideSensorObj08_CRC 38;
BA_ "E2EDataLength" SG_ 792 LRSideSensorObj08_CRC 312;
BA_ "E2EProfile" SG_ 792 LRSideSensorObj08_CRC "P05";
BA_ "GenSigSendType" SG_ 792 LRSideSensorObj08_Counter 1;
BA_ "GenSigStartValue" SG_ 792 LRSideSensorObj08_Counter 255;
BA_ "GenSigSendType" SG_ 792 LRSideSensorObj08_LatPos 1;
BA_ "GenSigStartValue" SG_ 792 LRSideSensorObj08_LatPos 8191;
BA_ "GenSigSendType" SG_ 792 LRSideSensorObj08_LongVelVar 1;
BA_ "GenSigStartValue" SG_ 792 LRSideSensorObj08_LongVelVar 255;
BA_ "GenSigSendType" SG_ 792 LRSideSensorObj08_LatVel 1;
BA_ "GenSigStartValue" SG_ 792 LRSideSensorObj08_LatVel 8191;
BA_ "GenSigSendType" SG_ 792 LRSideSensorObj08_LatAccVar 1;
BA_ "GenSigStartValue" SG_ 792 LRSideSensorObj08_LatAccVar 255;
BA_ "GenSigSendType" SG_ 792 LRSideSensorObj08_LongAcc 1;
BA_ "GenSigStartValue" SG_ 792 LRSideSensorObj08_LongAcc 511;
BA_ "GenSigSendType" SG_ 792 LRSideSensorObj08_CoastIndex 1;
BA_ "GenSigStartValue" SG_ 792 LRSideSensorObj08_CoastIndex 31;
BA_ "GenSigSendType" SG_ 792 LRSideSensorObj08_LatVelVar 1;
BA_ "GenSigStartValue" SG_ 792 LRSideSensorObj08_LatVelVar 255;
BA_ "GenSigSendType" SG_ 792 LRSideSensorObj08_ObjClassConf 1;
BA_ "GenSigStartValue" SG_ 792 LRSideSensorObj08_ObjClassConf 15;
BA_ "GenSigSendType" SG_ 792 LRSideSensorObj08_Prioritisation 1;
BA_ "GenSigStartValue" SG_ 792 LRSideSensorObj08_Prioritisation 3;
BA_ "GenSigSendType" SG_ 792 LRSideSensorObj08_LongExtFrVar 1;
BA_ "GenSigStartValue" SG_ 792 LRSideSensorObj08_LongExtFrVar 255;
BA_ "GenSigSendType" SG_ 792 LRSideSensorObj08_ObjID 1;
BA_ "GenSigStartValue" SG_ 792 LRSideSensorObj08_ObjID 63;
BA_ "GenSigSendType" SG_ 792 LRSideSensorObj08_HeadingVar 1;
BA_ "GenSigStartValue" SG_ 792 LRSideSensorObj08_HeadingVar 255;
BA_ "GenSigSendType" SG_ 792 LRSideSensorObj08_LatAcc 1;
BA_ "GenSigStartValue" SG_ 792 LRSideSensorObj08_LatAcc 511;
BA_ "GenSigSendType" SG_ 792 LRSideSensorObj08_LongPos 1;
BA_ "GenSigStartValue" SG_ 792 LRSideSensorObj08_LongPos 8191;
BA_ "GenSigSendType" SG_ 792 LRSideSensorObj08_LongPosVar 1;
BA_ "GenSigStartValue" SG_ 792 LRSideSensorObj08_LongPosVar 255;
BA_ "GenSigSendType" SG_ 792 LRSideSensorObj08_LatExtLeft 1;
BA_ "GenSigStartValue" SG_ 792 LRSideSensorObj08_LatExtLeft 127;
BA_ "GenSigSendType" SG_ 792 LRSideSensorObj08_LongExtBkVar 1;
BA_ "GenSigStartValue" SG_ 792 LRSideSensorObj08_LongExtBkVar 255;
BA_ "GenSigSendType" SG_ 792 LRSideSensorObj08_TrackStatus 1;
BA_ "GenSigStartValue" SG_ 792 LRSideSensorObj08_TrackStatus 7;
BA_ "GenSigSendType" SG_ 792 LRSideSensorObj08_LongAccVar 1;
BA_ "GenSigStartValue" SG_ 792 LRSideSensorObj08_LongAccVar 255;
BA_ "GenSigSendType" SG_ 792 LRSideSensorObj08_LatPosVar 1;
BA_ "GenSigStartValue" SG_ 792 LRSideSensorObj08_LatPosVar 255;
BA_ "GenSigSendType" SG_ 792 LRSideSensorObj08_LongVel 1;
BA_ "GenSigStartValue" SG_ 792 LRSideSensorObj08_LongVel 8191;
BA_ "GenSigSendType" SG_ 792 LRSideSensorObj08_ObstacleConf 1;
BA_ "GenSigStartValue" SG_ 792 LRSideSensorObj08_ObstacleConf 127;
BA_ "GenSigSendType" SG_ 792 LRSideSensorObj08_LifeTime 1;
BA_ "GenSigStartValue" SG_ 792 LRSideSensorObj08_LifeTime 65535;
BA_ "GenSigSendType" SG_ 792 LRSideSensorObj08_LongExtFront 1;
BA_ "GenSigStartValue" SG_ 792 LRSideSensorObj08_LongExtFront 1023;
BA_ "GenSigSendType" SG_ 792 LRSideSensorObj08_TimeStamp 1;
BA_ "GenSigStartValue" SG_ 792 LRSideSensorObj08_TimeStamp 65535;
BA_ "GenSigSendType" SG_ 792 LRSideSensorObj08_LongExtBack 1;
BA_ "GenSigStartValue" SG_ 792 LRSideSensorObj08_LongExtBack 1023;
BA_ "GenSigSendType" SG_ 792 LRSideSensorObj08_LatExtLeftVar 1;
BA_ "GenSigStartValue" SG_ 792 LRSideSensorObj08_LatExtLeftVar 255;
BA_ "GenSigSendType" SG_ 792 LRSideSensorObj08_LatExtRtVar 1;
BA_ "GenSigStartValue" SG_ 792 LRSideSensorObj08_LatExtRtVar 255;
BA_ "GenSigSendType" SG_ 792 LRSideSensorObj08_Heading 1;
BA_ "GenSigStartValue" SG_ 792 LRSideSensorObj08_Heading 2047;
BA_ "GenSigSendType" SG_ 792 LRSideSensorObj08_ExistConf 1;
BA_ "GenSigStartValue" SG_ 792 LRSideSensorObj08_ExistConf 127;
BA_ "GenSigSendType" SG_ 792 LRSideSensorObj08_MOISPrio 1;
BA_ "GenSigSendType" SG_ 792 LRSideSensorObj08_ObjClass 1;
BA_ "GenSigStartValue" SG_ 792 LRSideSensorObj08_ObjClass 15;
BA_ "GenSigSendType" SG_ 792 LRSideSensorObj08_Height 1;
BA_ "GenSigStartValue" SG_ 792 LRSideSensorObj08_Height 255;
BA_ "GenSigSendType" SG_ 791 LRSideSensorObj07_CRC 1;
BA_ "GenSigStartValue" SG_ 791 LRSideSensorObj07_CRC 65535;
BA_ "E2EDataId" SG_ 791 LRSideSensorObj07_CRC 37;
BA_ "E2EDataLength" SG_ 791 LRSideSensorObj07_CRC 312;
BA_ "E2EProfile" SG_ 791 LRSideSensorObj07_CRC "P05";
BA_ "GenSigSendType" SG_ 791 LRSideSensorObj07_ObjID 1;
BA_ "GenSigStartValue" SG_ 791 LRSideSensorObj07_ObjID 63;
BA_ "GenSigSendType" SG_ 791 LRSideSensorObj07_ObjClassConf 1;
BA_ "GenSigStartValue" SG_ 791 LRSideSensorObj07_ObjClassConf 15;
BA_ "GenSigSendType" SG_ 791 LRSideSensorObj07_LongExtFrVar 1;
BA_ "GenSigStartValue" SG_ 791 LRSideSensorObj07_LongExtFrVar 255;
BA_ "GenSigSendType" SG_ 791 LRSideSensorObj07_MOISPrio 1;
BA_ "GenSigSendType" SG_ 791 LRSideSensorObj07_LatExtRight 1;
BA_ "GenSigStartValue" SG_ 791 LRSideSensorObj07_LatExtRight 127;
BA_ "GenSigSendType" SG_ 791 LRSideSensorObj07_Counter 1;
BA_ "GenSigStartValue" SG_ 791 LRSideSensorObj07_Counter 255;
BA_ "GenSigSendType" SG_ 791 LRSideSensorObj07_LongPosVar 1;
BA_ "GenSigStartValue" SG_ 791 LRSideSensorObj07_LongPosVar 255;
BA_ "GenSigSendType" SG_ 791 LRSideSensorObj07_CoastIndex 1;
BA_ "GenSigStartValue" SG_ 791 LRSideSensorObj07_CoastIndex 31;
BA_ "GenSigSendType" SG_ 791 LRSideSensorObj07_Height 1;
BA_ "GenSigStartValue" SG_ 791 LRSideSensorObj07_Height 255;
BA_ "GenSigSendType" SG_ 791 LRSideSensorObj07_LifeTime 1;
BA_ "GenSigStartValue" SG_ 791 LRSideSensorObj07_LifeTime 65535;
BA_ "GenSigSendType" SG_ 791 LRSideSensorObj07_Heading 1;
BA_ "GenSigStartValue" SG_ 791 LRSideSensorObj07_Heading 2047;
BA_ "GenSigSendType" SG_ 791 LRSideSensorObj07_LatPos 1;
BA_ "GenSigStartValue" SG_ 791 LRSideSensorObj07_LatPos 8191;
BA_ "GenSigSendType" SG_ 791 LRSideSensorObj07_LongVelVar 1;
BA_ "GenSigStartValue" SG_ 791 LRSideSensorObj07_LongVelVar 255;
BA_ "GenSigSendType" SG_ 791 LRSideSensorObj07_ObstacleConf 1;
BA_ "GenSigStartValue" SG_ 791 LRSideSensorObj07_ObstacleConf 127;
BA_ "GenSigSendType" SG_ 791 LRSideSensorObj07_LongPos 1;
BA_ "GenSigStartValue" SG_ 791 LRSideSensorObj07_LongPos 8191;
BA_ "GenSigSendType" SG_ 791 LRSideSensorObj07_LongExtFront 1;
BA_ "GenSigStartValue" SG_ 791 LRSideSensorObj07_LongExtFront 1023;
BA_ "GenSigSendType" SG_ 791 LRSideSensorObj07_LongAccVar 1;
BA_ "GenSigStartValue" SG_ 791 LRSideSensorObj07_LongAccVar 255;
BA_ "GenSigSendType" SG_ 791 LRSideSensorObj07_LatExtLeft 1;
BA_ "GenSigStartValue" SG_ 791 LRSideSensorObj07_LatExtLeft 127;
BA_ "GenSigSendType" SG_ 791 LRSideSensorObj07_LatPosVar 1;
BA_ "GenSigStartValue" SG_ 791 LRSideSensorObj07_LatPosVar 255;
BA_ "GenSigSendType" SG_ 791 LRSideSensorObj07_LongVel 1;
BA_ "GenSigStartValue" SG_ 791 LRSideSensorObj07_LongVel 8191;
BA_ "GenSigSendType" SG_ 791 LRSideSensorObj07_LatVelVar 1;
BA_ "GenSigStartValue" SG_ 791 LRSideSensorObj07_LatVelVar 255;
BA_ "GenSigSendType" SG_ 791 LRSideSensorObj07_LatExtLeftVar 1;
BA_ "GenSigStartValue" SG_ 791 LRSideSensorObj07_LatExtLeftVar 255;
BA_ "GenSigSendType" SG_ 791 LRSideSensorObj07_TimeStamp 1;
BA_ "GenSigStartValue" SG_ 791 LRSideSensorObj07_TimeStamp 65535;
BA_ "GenSigSendType" SG_ 791 LRSideSensorObj07_LatVel 1;
BA_ "GenSigStartValue" SG_ 791 LRSideSensorObj07_LatVel 8191;
BA_ "GenSigSendType" SG_ 791 LRSideSensorObj07_LatAcc 1;
BA_ "GenSigStartValue" SG_ 791 LRSideSensorObj07_LatAcc 511;
BA_ "GenSigSendType" SG_ 791 LRSideSensorObj07_LongAcc 1;
BA_ "GenSigStartValue" SG_ 791 LRSideSensorObj07_LongAcc 511;
BA_ "GenSigSendType" SG_ 791 LRSideSensorObj07_LatAccVar 1;
BA_ "GenSigStartValue" SG_ 791 LRSideSensorObj07_LatAccVar 255;
BA_ "GenSigSendType" SG_ 791 LRSideSensorObj07_ObjClass 1;
BA_ "GenSigStartValue" SG_ 791 LRSideSensorObj07_ObjClass 15;
BA_ "GenSigSendType" SG_ 791 LRSideSensorObj07_TrackStatus 1;
BA_ "GenSigStartValue" SG_ 791 LRSideSensorObj07_TrackStatus 7;
BA_ "GenSigSendType" SG_ 791 LRSideSensorObj07_LongExtBkVar 1;
BA_ "GenSigStartValue" SG_ 791 LRSideSensorObj07_LongExtBkVar 255;
BA_ "GenSigSendType" SG_ 791 LRSideSensorObj07_HeadingVar 1;
BA_ "GenSigStartValue" SG_ 791 LRSideSensorObj07_HeadingVar 255;
BA_ "GenSigSendType" SG_ 791 LRSideSensorObj07_LatExtRtVar 1;
BA_ "GenSigStartValue" SG_ 791 LRSideSensorObj07_LatExtRtVar 255;
BA_ "GenSigSendType" SG_ 791 LRSideSensorObj07_Prioritisation 1;
BA_ "GenSigStartValue" SG_ 791 LRSideSensorObj07_Prioritisation 3;
BA_ "GenSigSendType" SG_ 791 LRSideSensorObj07_LongExtBack 1;
BA_ "GenSigStartValue" SG_ 791 LRSideSensorObj07_LongExtBack 1023;
BA_ "GenSigSendType" SG_ 791 LRSideSensorObj07_ObjDynClass 1;
BA_ "GenSigStartValue" SG_ 791 LRSideSensorObj07_ObjDynClass 3;
BA_ "GenSigSendType" SG_ 791 LRSideSensorObj07_ExistConf 1;
BA_ "GenSigStartValue" SG_ 791 LRSideSensorObj07_ExistConf 127;
BA_ "GenSigSendType" SG_ 790 LRSideSensorObj06_LongExtFrVar 1;
BA_ "GenSigStartValue" SG_ 790 LRSideSensorObj06_LongExtFrVar 255;
BA_ "GenSigSendType" SG_ 790 LRSideSensorObj06_LongExtBack 1;
BA_ "GenSigStartValue" SG_ 790 LRSideSensorObj06_LongExtBack 1023;
BA_ "GenSigSendType" SG_ 790 LRSideSensorObj06_Counter 1;
BA_ "GenSigStartValue" SG_ 790 LRSideSensorObj06_Counter 255;
BA_ "GenSigSendType" SG_ 790 LRSideSensorObj06_LongVel 1;
BA_ "GenSigStartValue" SG_ 790 LRSideSensorObj06_LongVel 8191;
BA_ "GenSigSendType" SG_ 790 LRSideSensorObj06_HeadingVar 1;
BA_ "GenSigStartValue" SG_ 790 LRSideSensorObj06_HeadingVar 255;
BA_ "GenSigSendType" SG_ 790 LRSideSensorObj06_LatPosVar 1;
BA_ "GenSigStartValue" SG_ 790 LRSideSensorObj06_LatPosVar 255;
BA_ "GenSigSendType" SG_ 790 LRSideSensorObj06_LatExtLeftVar 1;
BA_ "GenSigStartValue" SG_ 790 LRSideSensorObj06_LatExtLeftVar 255;
BA_ "GenSigSendType" SG_ 790 LRSideSensorObj06_LatVel 1;
BA_ "GenSigStartValue" SG_ 790 LRSideSensorObj06_LatVel 8191;
BA_ "GenSigSendType" SG_ 790 LRSideSensorObj06_TrackStatus 1;
BA_ "GenSigStartValue" SG_ 790 LRSideSensorObj06_TrackStatus 7;
BA_ "GenSigSendType" SG_ 790 LRSideSensorObj06_ObjClass 1;
BA_ "GenSigStartValue" SG_ 790 LRSideSensorObj06_ObjClass 15;
BA_ "GenSigSendType" SG_ 790 LRSideSensorObj06_ObstacleConf 1;
BA_ "GenSigStartValue" SG_ 790 LRSideSensorObj06_ObstacleConf 127;
BA_ "GenSigSendType" SG_ 790 LRSideSensorObj06_LatExtRtVar 1;
BA_ "GenSigStartValue" SG_ 790 LRSideSensorObj06_LatExtRtVar 255;
BA_ "GenSigSendType" SG_ 790 LRSideSensorObj06_LongAccVar 1;
BA_ "GenSigStartValue" SG_ 790 LRSideSensorObj06_LongAccVar 255;
BA_ "GenSigSendType" SG_ 790 LRSideSensorObj06_CoastIndex 1;
BA_ "GenSigStartValue" SG_ 790 LRSideSensorObj06_CoastIndex 31;
BA_ "GenSigSendType" SG_ 790 LRSideSensorObj06_LongAcc 1;
BA_ "GenSigStartValue" SG_ 790 LRSideSensorObj06_LongAcc 511;
BA_ "GenSigSendType" SG_ 790 LRSideSensorObj06_ObjDynClass 1;
BA_ "GenSigStartValue" SG_ 790 LRSideSensorObj06_ObjDynClass 3;
BA_ "GenSigSendType" SG_ 790 LRSideSensorObj06_LatExtRight 1;
BA_ "GenSigStartValue" SG_ 790 LRSideSensorObj06_LatExtRight 127;
BA_ "GenSigSendType" SG_ 790 LRSideSensorObj06_ExistConf 1;
BA_ "GenSigStartValue" SG_ 790 LRSideSensorObj06_ExistConf 127;
BA_ "GenSigSendType" SG_ 790 LRSideSensorObj06_Prioritisation 1;
BA_ "GenSigStartValue" SG_ 790 LRSideSensorObj06_Prioritisation 3;
BA_ "GenSigSendType" SG_ 790 LRSideSensorObj06_LongExtFront 1;
BA_ "GenSigStartValue" SG_ 790 LRSideSensorObj06_LongExtFront 1023;
BA_ "GenSigSendType" SG_ 790 LRSideSensorObj06_LatExtLeft 1;
BA_ "GenSigStartValue" SG_ 790 LRSideSensorObj06_LatExtLeft 127;
BA_ "GenSigSendType" SG_ 790 LRSideSensorObj06_ObjClassConf 1;
BA_ "GenSigStartValue" SG_ 790 LRSideSensorObj06_ObjClassConf 15;
BA_ "GenSigSendType" SG_ 790 LRSideSensorObj06_Height 1;
BA_ "GenSigStartValue" SG_ 790 LRSideSensorObj06_Height 255;
BA_ "GenSigSendType" SG_ 790 LRSideSensorObj06_TimeStamp 1;
BA_ "GenSigStartValue" SG_ 790 LRSideSensorObj06_TimeStamp 65535;
BA_ "GenSigSendType" SG_ 790 LRSideSensorObj06_MOISPrio 1;
BA_ "GenSigSendType" SG_ 790 LRSideSensorObj06_Heading 1;
BA_ "GenSigStartValue" SG_ 790 LRSideSensorObj06_Heading 2047;
BA_ "GenSigSendType" SG_ 790 LRSideSensorObj06_LatPos 1;
BA_ "GenSigStartValue" SG_ 790 LRSideSensorObj06_LatPos 8191;
BA_ "GenSigSendType" SG_ 790 LRSideSensorObj06_CRC 1;
BA_ "GenSigStartValue" SG_ 790 LRSideSensorObj06_CRC 65535;
BA_ "E2EDataId" SG_ 790 LRSideSensorObj06_CRC 36;
BA_ "E2EDataLength" SG_ 790 LRSideSensorObj06_CRC 312;
BA_ "E2EProfile" SG_ 790 LRSideSensorObj06_CRC "P05";
BA_ "GenSigSendType" SG_ 790 LRSideSensorObj06_LifeTime 1;
BA_ "GenSigStartValue" SG_ 790 LRSideSensorObj06_LifeTime 65535;
BA_ "GenSigSendType" SG_ 790 LRSideSensorObj06_ObjID 1;
BA_ "GenSigStartValue" SG_ 790 LRSideSensorObj06_ObjID 63;
BA_ "GenSigSendType" SG_ 790 LRSideSensorObj06_LongVelVar 1;
BA_ "GenSigStartValue" SG_ 790 LRSideSensorObj06_LongVelVar 255;
BA_ "GenSigSendType" SG_ 790 LRSideSensorObj06_LatAccVar 1;
BA_ "GenSigStartValue" SG_ 790 LRSideSensorObj06_LatAccVar 255;
BA_ "GenSigSendType" SG_ 790 LRSideSensorObj06_LongPosVar 1;
BA_ "GenSigStartValue" SG_ 790 LRSideSensorObj06_LongPosVar 255;
BA_ "GenSigSendType" SG_ 790 LRSideSensorObj06_LongPos 1;
BA_ "GenSigStartValue" SG_ 790 LRSideSensorObj06_LongPos 8191;
BA_ "GenSigSendType" SG_ 790 LRSideSensorObj06_LongExtBkVar 1;
BA_ "GenSigStartValue" SG_ 790 LRSideSensorObj06_LongExtBkVar 255;
BA_ "GenSigSendType" SG_ 790 LRSideSensorObj06_LatAcc 1;
BA_ "GenSigStartValue" SG_ 790 LRSideSensorObj06_LatAcc 511;
BA_ "GenSigSendType" SG_ 790 LRSideSensorObj06_LatVelVar 1;
BA_ "GenSigStartValue" SG_ 790 LRSideSensorObj06_LatVelVar 255;
BA_ "GenSigSendType" SG_ 789 LRSideSensorObj05_LongAcc 1;
BA_ "GenSigStartValue" SG_ 789 LRSideSensorObj05_LongAcc 511;
BA_ "GenSigSendType" SG_ 789 LRSideSensorObj05_TrackStatus 1;
BA_ "GenSigStartValue" SG_ 789 LRSideSensorObj05_TrackStatus 7;
BA_ "GenSigSendType" SG_ 789 LRSideSensorObj05_LatExtLeftVar 1;
BA_ "GenSigStartValue" SG_ 789 LRSideSensorObj05_LatExtLeftVar 255;
BA_ "GenSigSendType" SG_ 789 LRSideSensorObj05_LatExtRight 1;
BA_ "GenSigStartValue" SG_ 789 LRSideSensorObj05_LatExtRight 127;
BA_ "GenSigSendType" SG_ 789 LRSideSensorObj05_ObjID 1;
BA_ "GenSigStartValue" SG_ 789 LRSideSensorObj05_ObjID 63;
BA_ "GenSigSendType" SG_ 789 LRSideSensorObj05_ObjClass 1;
BA_ "GenSigStartValue" SG_ 789 LRSideSensorObj05_ObjClass 15;
BA_ "GenSigSendType" SG_ 789 LRSideSensorObj05_ObjClassConf 1;
BA_ "GenSigStartValue" SG_ 789 LRSideSensorObj05_ObjClassConf 15;
BA_ "GenSigSendType" SG_ 789 LRSideSensorObj05_LifeTime 1;
BA_ "GenSigStartValue" SG_ 789 LRSideSensorObj05_LifeTime 65535;
BA_ "GenSigSendType" SG_ 789 LRSideSensorObj05_LatPosVar 1;
BA_ "GenSigStartValue" SG_ 789 LRSideSensorObj05_LatPosVar 255;
BA_ "GenSigSendType" SG_ 789 LRSideSensorObj05_LongVel 1;
BA_ "GenSigStartValue" SG_ 789 LRSideSensorObj05_LongVel 8191;
BA_ "GenSigSendType" SG_ 789 LRSideSensorObj05_LongAccVar 1;
BA_ "GenSigStartValue" SG_ 789 LRSideSensorObj05_LongAccVar 255;
BA_ "GenSigSendType" SG_ 789 LRSideSensorObj05_ObjDynClass 1;
BA_ "GenSigStartValue" SG_ 789 LRSideSensorObj05_ObjDynClass 3;
BA_ "GenSigSendType" SG_ 789 LRSideSensorObj05_LatPos 1;
BA_ "GenSigStartValue" SG_ 789 LRSideSensorObj05_LatPos 8191;
BA_ "GenSigSendType" SG_ 789 LRSideSensorObj05_ExistConf 1;
BA_ "GenSigStartValue" SG_ 789 LRSideSensorObj05_ExistConf 127;
BA_ "GenSigSendType" SG_ 789 LRSideSensorObj05_Heading 1;
BA_ "GenSigStartValue" SG_ 789 LRSideSensorObj05_Heading 2047;
BA_ "GenSigSendType" SG_ 789 LRSideSensorObj05_MOISPrio 1;
BA_ "GenSigSendType" SG_ 789 LRSideSensorObj05_ObstacleConf 1;
BA_ "GenSigStartValue" SG_ 789 LRSideSensorObj05_ObstacleConf 127;
BA_ "GenSigSendType" SG_ 789 LRSideSensorObj05_HeadingVar 1;
BA_ "GenSigStartValue" SG_ 789 LRSideSensorObj05_HeadingVar 255;
BA_ "GenSigSendType" SG_ 789 LRSideSensorObj05_LongVelVar 1;
BA_ "GenSigStartValue" SG_ 789 LRSideSensorObj05_LongVelVar 255;
BA_ "GenSigSendType" SG_ 789 LRSideSensorObj05_Prioritisation 1;
BA_ "GenSigStartValue" SG_ 789 LRSideSensorObj05_Prioritisation 3;
BA_ "GenSigSendType" SG_ 789 LRSideSensorObj05_LongPos 1;
BA_ "GenSigStartValue" SG_ 789 LRSideSensorObj05_LongPos 8191;
BA_ "GenSigSendType" SG_ 789 LRSideSensorObj05_Height 1;
BA_ "GenSigStartValue" SG_ 789 LRSideSensorObj05_Height 255;
BA_ "GenSigSendType" SG_ 789 LRSideSensorObj05_LatExtLeft 1;
BA_ "GenSigStartValue" SG_ 789 LRSideSensorObj05_LatExtLeft 127;
BA_ "GenSigSendType" SG_ 789 LRSideSensorObj05_LatAcc 1;
BA_ "GenSigStartValue" SG_ 789 LRSideSensorObj05_LatAcc 511;
BA_ "GenSigSendType" SG_ 789 LRSideSensorObj05_LongExtFront 1;
BA_ "GenSigStartValue" SG_ 789 LRSideSensorObj05_LongExtFront 1023;
BA_ "GenSigSendType" SG_ 789 LRSideSensorObj05_Counter 1;
BA_ "GenSigStartValue" SG_ 789 LRSideSensorObj05_Counter 255;
BA_ "GenSigSendType" SG_ 789 LRSideSensorObj05_LatAccVar 1;
BA_ "GenSigStartValue" SG_ 789 LRSideSensorObj05_LatAccVar 255;
BA_ "GenSigSendType" SG_ 789 LRSideSensorObj05_LongPosVar 1;
BA_ "GenSigStartValue" SG_ 789 LRSideSensorObj05_LongPosVar 255;
BA_ "GenSigSendType" SG_ 789 LRSideSensorObj05_CRC 1;
BA_ "GenSigStartValue" SG_ 789 LRSideSensorObj05_CRC 65535;
BA_ "E2EDataId" SG_ 789 LRSideSensorObj05_CRC 35;
BA_ "E2EDataLength" SG_ 789 LRSideSensorObj05_CRC 312;
BA_ "E2EProfile" SG_ 789 LRSideSensorObj05_CRC "P05";
BA_ "GenSigSendType" SG_ 789 LRSideSensorObj05_LatVel 1;
BA_ "GenSigStartValue" SG_ 789 LRSideSensorObj05_LatVel 8191;
BA_ "GenSigSendType" SG_ 789 LRSideSensorObj05_TimeStamp 1;
BA_ "GenSigStartValue" SG_ 789 LRSideSensorObj05_TimeStamp 65535;
BA_ "GenSigSendType" SG_ 789 LRSideSensorObj05_CoastIndex 1;
BA_ "GenSigStartValue" SG_ 789 LRSideSensorObj05_CoastIndex 31;
BA_ "GenSigSendType" SG_ 789 LRSideSensorObj05_LatVelVar 1;
BA_ "GenSigStartValue" SG_ 789 LRSideSensorObj05_LatVelVar 255;
BA_ "GenSigSendType" SG_ 789 LRSideSensorObj05_LatExtRtVar 1;
BA_ "GenSigStartValue" SG_ 789 LRSideSensorObj05_LatExtRtVar 255;
BA_ "GenSigSendType" SG_ 789 LRSideSensorObj05_LongExtBkVar 1;
BA_ "GenSigStartValue" SG_ 789 LRSideSensorObj05_LongExtBkVar 255;
BA_ "GenSigSendType" SG_ 789 LRSideSensorObj05_LongExtBack 1;
BA_ "GenSigStartValue" SG_ 789 LRSideSensorObj05_LongExtBack 1023;
BA_ "GenSigSendType" SG_ 789 LRSideSensorObj05_LongExtFrVar 1;
BA_ "GenSigStartValue" SG_ 789 LRSideSensorObj05_LongExtFrVar 255;
BA_ "GenSigSendType" SG_ 788 LRSideSensorObj04_TrackStatus 1;
BA_ "GenSigStartValue" SG_ 788 LRSideSensorObj04_TrackStatus 7;
BA_ "GenSigSendType" SG_ 788 LRSideSensorObj04_HeadingVar 1;
BA_ "GenSigStartValue" SG_ 788 LRSideSensorObj04_HeadingVar 255;
BA_ "GenSigSendType" SG_ 788 LRSideSensorObj04_Prioritisation 1;
BA_ "GenSigStartValue" SG_ 788 LRSideSensorObj04_Prioritisation 3;
BA_ "GenSigSendType" SG_ 788 LRSideSensorObj04_LongVel 1;
BA_ "GenSigStartValue" SG_ 788 LRSideSensorObj04_LongVel 8191;
BA_ "GenSigSendType" SG_ 788 LRSideSensorObj04_ObstacleConf 1;
BA_ "GenSigStartValue" SG_ 788 LRSideSensorObj04_ObstacleConf 127;
BA_ "GenSigSendType" SG_ 788 LRSideSensorObj04_TimeStamp 1;
BA_ "GenSigStartValue" SG_ 788 LRSideSensorObj04_TimeStamp 65535;
BA_ "GenSigSendType" SG_ 788 LRSideSensorObj04_ObjDynClass 1;
BA_ "GenSigStartValue" SG_ 788 LRSideSensorObj04_ObjDynClass 3;
BA_ "GenSigSendType" SG_ 788 LRSideSensorObj04_Heading 1;
BA_ "GenSigStartValue" SG_ 788 LRSideSensorObj04_Heading 2047;
BA_ "GenSigSendType" SG_ 788 LRSideSensorObj04_LatAccVar 1;
BA_ "GenSigStartValue" SG_ 788 LRSideSensorObj04_LatAccVar 255;
BA_ "GenSigSendType" SG_ 788 LRSideSensorObj04_LongAcc 1;
BA_ "GenSigStartValue" SG_ 788 LRSideSensorObj04_LongAcc 511;
BA_ "GenSigSendType" SG_ 788 LRSideSensorObj04_ExistConf 1;
BA_ "GenSigStartValue" SG_ 788 LRSideSensorObj04_ExistConf 127;
BA_ "GenSigSendType" SG_ 788 LRSideSensorObj04_LatAcc 1;
BA_ "GenSigStartValue" SG_ 788 LRSideSensorObj04_LatAcc 511;
BA_ "GenSigSendType" SG_ 788 LRSideSensorObj04_LongPos 1;
BA_ "GenSigStartValue" SG_ 788 LRSideSensorObj04_LongPos 8191;
BA_ "GenSigSendType" SG_ 788 LRSideSensorObj04_LatPos 1;
BA_ "GenSigStartValue" SG_ 788 LRSideSensorObj04_LatPos 8191;
BA_ "GenSigSendType" SG_ 788 LRSideSensorObj04_LongPosVar 1;
BA_ "GenSigStartValue" SG_ 788 LRSideSensorObj04_LongPosVar 255;
BA_ "GenSigSendType" SG_ 788 LRSideSensorObj04_ObjClassConf 1;
BA_ "GenSigStartValue" SG_ 788 LRSideSensorObj04_ObjClassConf 15;
BA_ "GenSigSendType" SG_ 788 LRSideSensorObj04_LongAccVar 1;
BA_ "GenSigStartValue" SG_ 788 LRSideSensorObj04_LongAccVar 255;
BA_ "GenSigSendType" SG_ 788 LRSideSensorObj04_LongExtFrVar 1;
BA_ "GenSigStartValue" SG_ 788 LRSideSensorObj04_LongExtFrVar 255;
BA_ "GenSigSendType" SG_ 788 LRSideSensorObj04_LatExtLeftVar 1;
BA_ "GenSigStartValue" SG_ 788 LRSideSensorObj04_LatExtLeftVar 255;
BA_ "GenSigSendType" SG_ 788 LRSideSensorObj04_LatExtRtVar 1;
BA_ "GenSigStartValue" SG_ 788 LRSideSensorObj04_LatExtRtVar 255;
BA_ "GenSigSendType" SG_ 788 LRSideSensorObj04_LatVelVar 1;
BA_ "GenSigStartValue" SG_ 788 LRSideSensorObj04_LatVelVar 255;
BA_ "GenSigSendType" SG_ 788 LRSideSensorObj04_CoastIndex 1;
BA_ "GenSigStartValue" SG_ 788 LRSideSensorObj04_CoastIndex 31;
BA_ "GenSigSendType" SG_ 788 LRSideSensorObj04_LatPosVar 1;
BA_ "GenSigStartValue" SG_ 788 LRSideSensorObj04_LatPosVar 255;
BA_ "GenSigSendType" SG_ 788 LRSideSensorObj04_CRC 1;
BA_ "GenSigStartValue" SG_ 788 LRSideSensorObj04_CRC 65535;
BA_ "E2EDataId" SG_ 788 LRSideSensorObj04_CRC 34;
BA_ "E2EDataLength" SG_ 788 LRSideSensorObj04_CRC 312;
BA_ "E2EProfile" SG_ 788 LRSideSensorObj04_CRC "P05";
BA_ "GenSigSendType" SG_ 788 LRSideSensorObj04_LatVel 1;
BA_ "GenSigStartValue" SG_ 788 LRSideSensorObj04_LatVel 8191;
BA_ "GenSigSendType" SG_ 788 LRSideSensorObj04_LongExtBack 1;
BA_ "GenSigStartValue" SG_ 788 LRSideSensorObj04_LongExtBack 1023;
BA_ "GenSigSendType" SG_ 788 LRSideSensorObj04_ObjID 1;
BA_ "GenSigStartValue" SG_ 788 LRSideSensorObj04_ObjID 63;
BA_ "GenSigSendType" SG_ 788 LRSideSensorObj04_LifeTime 1;
BA_ "GenSigStartValue" SG_ 788 LRSideSensorObj04_LifeTime 65535;
BA_ "GenSigSendType" SG_ 788 LRSideSensorObj04_ObjClass 1;
BA_ "GenSigStartValue" SG_ 788 LRSideSensorObj04_ObjClass 15;
BA_ "GenSigSendType" SG_ 788 LRSideSensorObj04_LongExtFront 1;
BA_ "GenSigStartValue" SG_ 788 LRSideSensorObj04_LongExtFront 1023;
BA_ "GenSigSendType" SG_ 788 LRSideSensorObj04_Counter 1;
BA_ "GenSigStartValue" SG_ 788 LRSideSensorObj04_Counter 255;
BA_ "GenSigSendType" SG_ 788 LRSideSensorObj04_LongExtBkVar 1;
BA_ "GenSigStartValue" SG_ 788 LRSideSensorObj04_LongExtBkVar 255;
BA_ "GenSigSendType" SG_ 788 LRSideSensorObj04_LatExtRight 1;
BA_ "GenSigStartValue" SG_ 788 LRSideSensorObj04_LatExtRight 127;
BA_ "GenSigSendType" SG_ 788 LRSideSensorObj04_MOISPrio 1;
BA_ "GenSigSendType" SG_ 788 LRSideSensorObj04_Height 1;
BA_ "GenSigStartValue" SG_ 788 LRSideSensorObj04_Height 255;
BA_ "GenSigSendType" SG_ 788 LRSideSensorObj04_LatExtLeft 1;
BA_ "GenSigStartValue" SG_ 788 LRSideSensorObj04_LatExtLeft 127;
BA_ "GenSigSendType" SG_ 788 LRSideSensorObj04_LongVelVar 1;
BA_ "GenSigStartValue" SG_ 788 LRSideSensorObj04_LongVelVar 255;
BA_ "GenSigSendType" SG_ 787 LRSideSensorObj03_TimeStamp 1;
BA_ "GenSigStartValue" SG_ 787 LRSideSensorObj03_TimeStamp 65535;
BA_ "GenSigSendType" SG_ 787 LRSideSensorObj03_CRC 1;
BA_ "GenSigStartValue" SG_ 787 LRSideSensorObj03_CRC 65535;
BA_ "E2EDataId" SG_ 787 LRSideSensorObj03_CRC 33;
BA_ "E2EDataLength" SG_ 787 LRSideSensorObj03_CRC 312;
BA_ "E2EProfile" SG_ 787 LRSideSensorObj03_CRC "P05";
BA_ "GenSigSendType" SG_ 787 LRSideSensorObj03_LatPos 1;
BA_ "GenSigStartValue" SG_ 787 LRSideSensorObj03_LatPos 8191;
BA_ "GenSigSendType" SG_ 787 LRSideSensorObj03_ExistConf 1;
BA_ "GenSigStartValue" SG_ 787 LRSideSensorObj03_ExistConf 127;
BA_ "GenSigSendType" SG_ 787 LRSideSensorObj03_Prioritisation 1;
BA_ "GenSigStartValue" SG_ 787 LRSideSensorObj03_Prioritisation 3;
BA_ "GenSigSendType" SG_ 787 LRSideSensorObj03_LatAccVar 1;
BA_ "GenSigStartValue" SG_ 787 LRSideSensorObj03_LatAccVar 255;
BA_ "GenSigSendType" SG_ 787 LRSideSensorObj03_LatVelVar 1;
BA_ "GenSigStartValue" SG_ 787 LRSideSensorObj03_LatVelVar 255;
BA_ "GenSigSendType" SG_ 787 LRSideSensorObj03_CoastIndex 1;
BA_ "GenSigStartValue" SG_ 787 LRSideSensorObj03_CoastIndex 31;
BA_ "GenSigSendType" SG_ 787 LRSideSensorObj03_LongExtBack 1;
BA_ "GenSigStartValue" SG_ 787 LRSideSensorObj03_LongExtBack 1023;
BA_ "GenSigSendType" SG_ 787 LRSideSensorObj03_TrackStatus 1;
BA_ "GenSigStartValue" SG_ 787 LRSideSensorObj03_TrackStatus 7;
BA_ "GenSigSendType" SG_ 787 LRSideSensorObj03_Height 1;
BA_ "GenSigStartValue" SG_ 787 LRSideSensorObj03_Height 255;
BA_ "GenSigSendType" SG_ 787 LRSideSensorObj03_ObjClassConf 1;
BA_ "GenSigStartValue" SG_ 787 LRSideSensorObj03_ObjClassConf 15;
BA_ "GenSigSendType" SG_ 787 LRSideSensorObj03_ObjClass 1;
BA_ "GenSigStartValue" SG_ 787 LRSideSensorObj03_ObjClass 15;
BA_ "GenSigSendType" SG_ 787 LRSideSensorObj03_LongExtFrVar 1;
BA_ "GenSigStartValue" SG_ 787 LRSideSensorObj03_LongExtFrVar 255;
BA_ "GenSigSendType" SG_ 787 LRSideSensorObj03_HeadingVar 1;
BA_ "GenSigStartValue" SG_ 787 LRSideSensorObj03_HeadingVar 255;
BA_ "GenSigSendType" SG_ 787 LRSideSensorObj03_Heading 1;
BA_ "GenSigStartValue" SG_ 787 LRSideSensorObj03_Heading 2047;
BA_ "GenSigSendType" SG_ 787 LRSideSensorObj03_LongAccVar 1;
BA_ "GenSigStartValue" SG_ 787 LRSideSensorObj03_LongAccVar 255;
BA_ "GenSigSendType" SG_ 787 LRSideSensorObj03_LongAcc 1;
BA_ "GenSigStartValue" SG_ 787 LRSideSensorObj03_LongAcc 511;
BA_ "GenSigSendType" SG_ 787 LRSideSensorObj03_LatExtRight 1;
BA_ "GenSigStartValue" SG_ 787 LRSideSensorObj03_LatExtRight 127;
BA_ "GenSigSendType" SG_ 787 LRSideSensorObj03_LongPosVar 1;
BA_ "GenSigStartValue" SG_ 787 LRSideSensorObj03_LongPosVar 255;
BA_ "GenSigSendType" SG_ 787 LRSideSensorObj03_ObstacleConf 1;
BA_ "GenSigStartValue" SG_ 787 LRSideSensorObj03_ObstacleConf 127;
BA_ "GenSigSendType" SG_ 787 LRSideSensorObj03_ObjID 1;
BA_ "GenSigStartValue" SG_ 787 LRSideSensorObj03_ObjID 63;
BA_ "GenSigSendType" SG_ 787 LRSideSensorObj03_LatExtLeft 1;
BA_ "GenSigStartValue" SG_ 787 LRSideSensorObj03_LatExtLeft 127;
BA_ "GenSigSendType" SG_ 787 LRSideSensorObj03_LatExtLeftVar 1;
BA_ "GenSigStartValue" SG_ 787 LRSideSensorObj03_LatExtLeftVar 255;
BA_ "GenSigSendType" SG_ 787 LRSideSensorObj03_LongVelVar 1;
BA_ "GenSigStartValue" SG_ 787 LRSideSensorObj03_LongVelVar 255;
BA_ "GenSigSendType" SG_ 787 LRSideSensorObj03_LongExtFront 1;
BA_ "GenSigStartValue" SG_ 787 LRSideSensorObj03_LongExtFront 1023;
BA_ "GenSigSendType" SG_ 787 LRSideSensorObj03_LatPosVar 1;
BA_ "GenSigStartValue" SG_ 787 LRSideSensorObj03_LatPosVar 255;
BA_ "GenSigSendType" SG_ 787 LRSideSensorObj03_ObjDynClass 1;
BA_ "GenSigStartValue" SG_ 787 LRSideSensorObj03_ObjDynClass 3;
BA_ "GenSigSendType" SG_ 787 LRSideSensorObj03_LongExtBkVar 1;
BA_ "GenSigStartValue" SG_ 787 LRSideSensorObj03_LongExtBkVar 255;
BA_ "GenSigSendType" SG_ 787 LRSideSensorObj03_LatVel 1;
BA_ "GenSigStartValue" SG_ 787 LRSideSensorObj03_LatVel 8191;
BA_ "GenSigSendType" SG_ 787 LRSideSensorObj03_Counter 1;
BA_ "GenSigStartValue" SG_ 787 LRSideSensorObj03_Counter 255;
BA_ "GenSigSendType" SG_ 787 LRSideSensorObj03_LatExtRtVar 1;
BA_ "GenSigStartValue" SG_ 787 LRSideSensorObj03_LatExtRtVar 255;
BA_ "GenSigSendType" SG_ 787 LRSideSensorObj03_MOISPrio 1;
BA_ "GenSigSendType" SG_ 787 LRSideSensorObj03_LongPos 1;
BA_ "GenSigStartValue" SG_ 787 LRSideSensorObj03_LongPos 8191;
BA_ "GenSigSendType" SG_ 787 LRSideSensorObj03_LatAcc 1;
BA_ "GenSigStartValue" SG_ 787 LRSideSensorObj03_LatAcc 511;
BA_ "GenSigSendType" SG_ 787 LRSideSensorObj03_LifeTime 1;
BA_ "GenSigStartValue" SG_ 787 LRSideSensorObj03_LifeTime 65535;
BA_ "GenSigSendType" SG_ 787 LRSideSensorObj03_LongVel 1;
BA_ "GenSigStartValue" SG_ 787 LRSideSensorObj03_LongVel 8191;
BA_ "GenSigSendType" SG_ 786 LRSideSensorObj02_Heading 1;
BA_ "GenSigStartValue" SG_ 786 LRSideSensorObj02_Heading 2047;
BA_ "GenSigSendType" SG_ 786 LRSideSensorObj02_LatExtLeftVar 1;
BA_ "GenSigStartValue" SG_ 786 LRSideSensorObj02_LatExtLeftVar 255;
BA_ "GenSigSendType" SG_ 786 LRSideSensorObj02_LatPosVar 1;
BA_ "GenSigStartValue" SG_ 786 LRSideSensorObj02_LatPosVar 255;
BA_ "GenSigSendType" SG_ 786 LRSideSensorObj02_LongVel 1;
BA_ "GenSigStartValue" SG_ 786 LRSideSensorObj02_LongVel 8191;
BA_ "GenSigSendType" SG_ 786 LRSideSensorObj02_LongExtFrVar 1;
BA_ "GenSigStartValue" SG_ 786 LRSideSensorObj02_LongExtFrVar 255;
BA_ "GenSigSendType" SG_ 786 LRSideSensorObj02_MOISPrio 1;
BA_ "GenSigSendType" SG_ 786 LRSideSensorObj02_LatVel 1;
BA_ "GenSigStartValue" SG_ 786 LRSideSensorObj02_LatVel 8191;
BA_ "GenSigSendType" SG_ 786 LRSideSensorObj02_CoastIndex 1;
BA_ "GenSigStartValue" SG_ 786 LRSideSensorObj02_CoastIndex 31;
BA_ "GenSigSendType" SG_ 786 LRSideSensorObj02_LongVelVar 1;
BA_ "GenSigStartValue" SG_ 786 LRSideSensorObj02_LongVelVar 255;
BA_ "GenSigSendType" SG_ 786 LRSideSensorObj02_TrackStatus 1;
BA_ "GenSigStartValue" SG_ 786 LRSideSensorObj02_TrackStatus 7;
BA_ "GenSigSendType" SG_ 786 LRSideSensorObj02_LongExtBkVar 1;
BA_ "GenSigStartValue" SG_ 786 LRSideSensorObj02_LongExtBkVar 255;
BA_ "GenSigSendType" SG_ 786 LRSideSensorObj02_LongExtFront 1;
BA_ "GenSigStartValue" SG_ 786 LRSideSensorObj02_LongExtFront 1023;
BA_ "GenSigSendType" SG_ 786 LRSideSensorObj02_LongPosVar 1;
BA_ "GenSigStartValue" SG_ 786 LRSideSensorObj02_LongPosVar 255;
BA_ "GenSigSendType" SG_ 786 LRSideSensorObj02_LongPos 1;
BA_ "GenSigStartValue" SG_ 786 LRSideSensorObj02_LongPos 8191;
BA_ "GenSigSendType" SG_ 786 LRSideSensorObj02_LatExtRtVar 1;
BA_ "GenSigStartValue" SG_ 786 LRSideSensorObj02_LatExtRtVar 255;
BA_ "GenSigSendType" SG_ 786 LRSideSensorObj02_LatExtRight 1;
BA_ "GenSigStartValue" SG_ 786 LRSideSensorObj02_LatExtRight 127;
BA_ "GenSigSendType" SG_ 786 LRSideSensorObj02_LongAccVar 1;
BA_ "GenSigStartValue" SG_ 786 LRSideSensorObj02_LongAccVar 255;
BA_ "GenSigSendType" SG_ 786 LRSideSensorObj02_CRC 1;
BA_ "GenSigStartValue" SG_ 786 LRSideSensorObj02_CRC 65535;
BA_ "E2EDataId" SG_ 786 LRSideSensorObj02_CRC 32;
BA_ "E2EDataLength" SG_ 786 LRSideSensorObj02_CRC 312;
BA_ "E2EProfile" SG_ 786 LRSideSensorObj02_CRC "P05";
BA_ "GenSigSendType" SG_ 786 LRSideSensorObj02_ObstacleConf 1;
BA_ "GenSigStartValue" SG_ 786 LRSideSensorObj02_ObstacleConf 127;
BA_ "GenSigSendType" SG_ 786 LRSideSensorObj02_ObjID 1;
BA_ "GenSigStartValue" SG_ 786 LRSideSensorObj02_ObjID 63;
BA_ "GenSigSendType" SG_ 786 LRSideSensorObj02_ObjDynClass 1;
BA_ "GenSigStartValue" SG_ 786 LRSideSensorObj02_ObjDynClass 3;
BA_ "GenSigSendType" SG_ 786 LRSideSensorObj02_LongAcc 1;
BA_ "GenSigStartValue" SG_ 786 LRSideSensorObj02_LongAcc 511;
BA_ "GenSigSendType" SG_ 786 LRSideSensorObj02_Counter 1;
BA_ "GenSigStartValue" SG_ 786 LRSideSensorObj02_Counter 255;
BA_ "GenSigSendType" SG_ 786 LRSideSensorObj02_LatVelVar 1;
BA_ "GenSigStartValue" SG_ 786 LRSideSensorObj02_LatVelVar 255;
BA_ "GenSigSendType" SG_ 786 LRSideSensorObj02_LatExtLeft 1;
BA_ "GenSigStartValue" SG_ 786 LRSideSensorObj02_LatExtLeft 127;
BA_ "GenSigSendType" SG_ 786 LRSideSensorObj02_LatPos 1;
BA_ "GenSigStartValue" SG_ 786 LRSideSensorObj02_LatPos 8191;
BA_ "GenSigSendType" SG_ 786 LRSideSensorObj02_ObjClassConf 1;
BA_ "GenSigStartValue" SG_ 786 LRSideSensorObj02_ObjClassConf 15;
BA_ "GenSigSendType" SG_ 786 LRSideSensorObj02_TimeStamp 1;
BA_ "GenSigStartValue" SG_ 786 LRSideSensorObj02_TimeStamp 65535;
BA_ "GenSigSendType" SG_ 786 LRSideSensorObj02_LongExtBack 1;
BA_ "GenSigStartValue" SG_ 786 LRSideSensorObj02_LongExtBack 1023;
BA_ "GenSigSendType" SG_ 786 LRSideSensorObj02_LatAcc 1;
BA_ "GenSigStartValue" SG_ 786 LRSideSensorObj02_LatAcc 511;
BA_ "GenSigSendType" SG_ 786 LRSideSensorObj02_ObjClass 1;
BA_ "GenSigStartValue" SG_ 786 LRSideSensorObj02_ObjClass 15;
BA_ "GenSigSendType" SG_ 786 LRSideSensorObj02_Prioritisation 1;
BA_ "GenSigStartValue" SG_ 786 LRSideSensorObj02_Prioritisation 3;
BA_ "GenSigSendType" SG_ 786 LRSideSensorObj02_HeadingVar 1;
BA_ "GenSigStartValue" SG_ 786 LRSideSensorObj02_HeadingVar 255;
BA_ "GenSigSendType" SG_ 786 LRSideSensorObj02_LatAccVar 1;
BA_ "GenSigStartValue" SG_ 786 LRSideSensorObj02_LatAccVar 255;
BA_ "GenSigSendType" SG_ 786 LRSideSensorObj02_LifeTime 1;
BA_ "GenSigStartValue" SG_ 786 LRSideSensorObj02_LifeTime 65535;
BA_ "GenSigSendType" SG_ 786 LRSideSensorObj02_Height 1;
BA_ "GenSigStartValue" SG_ 786 LRSideSensorObj02_Height 255;
BA_ "GenSigSendType" SG_ 786 LRSideSensorObj02_ExistConf 1;
BA_ "GenSigStartValue" SG_ 786 LRSideSensorObj02_ExistConf 127;
BA_ "GenSigSendType" SG_ 785 LRSideSensorObj01_LongExtFrVar 1;
BA_ "GenSigStartValue" SG_ 785 LRSideSensorObj01_LongExtFrVar 255;
BA_ "GenSigSendType" SG_ 785 LRSideSensorObj01_MOISPrio 1;
BA_ "GenSigSendType" SG_ 785 LRSideSensorObj01_LongExtBkVar 1;
BA_ "GenSigStartValue" SG_ 785 LRSideSensorObj01_LongExtBkVar 255;
BA_ "GenSigSendType" SG_ 785 LRSideSensorObj01_LatPosVar 1;
BA_ "GenSigStartValue" SG_ 785 LRSideSensorObj01_LatPosVar 255;
BA_ "GenSigSendType" SG_ 785 LRSideSensorObj01_Counter 1;
BA_ "GenSigStartValue" SG_ 785 LRSideSensorObj01_Counter 255;
BA_ "GenSigSendType" SG_ 785 LRSideSensorObj01_ObjClassConf 1;
BA_ "GenSigStartValue" SG_ 785 LRSideSensorObj01_ObjClassConf 15;
BA_ "GenSigSendType" SG_ 785 LRSideSensorObj01_ExistConf 1;
BA_ "GenSigStartValue" SG_ 785 LRSideSensorObj01_ExistConf 127;
BA_ "GenSigSendType" SG_ 785 LRSideSensorObj01_ObjDynClass 1;
BA_ "GenSigStartValue" SG_ 785 LRSideSensorObj01_ObjDynClass 3;
BA_ "GenSigSendType" SG_ 785 LRSideSensorObj01_CRC 1;
BA_ "GenSigStartValue" SG_ 785 LRSideSensorObj01_CRC 65535;
BA_ "E2EDataId" SG_ 785 LRSideSensorObj01_CRC 31;
BA_ "E2EDataLength" SG_ 785 LRSideSensorObj01_CRC 312;
BA_ "E2EProfile" SG_ 785 LRSideSensorObj01_CRC "P05";
BA_ "GenSigSendType" SG_ 785 LRSideSensorObj01_LongExtFront 1;
BA_ "GenSigStartValue" SG_ 785 LRSideSensorObj01_LongExtFront 1023;
BA_ "GenSigSendType" SG_ 785 LRSideSensorObj01_LongPosVar 1;
BA_ "GenSigStartValue" SG_ 785 LRSideSensorObj01_LongPosVar 255;
BA_ "GenSigSendType" SG_ 785 LRSideSensorObj01_Heading 1;
BA_ "GenSigStartValue" SG_ 785 LRSideSensorObj01_Heading 2047;
BA_ "GenSigSendType" SG_ 785 LRSideSensorObj01_ObjID 1;
BA_ "GenSigStartValue" SG_ 785 LRSideSensorObj01_ObjID 63;
BA_ "GenSigSendType" SG_ 785 LRSideSensorObj01_CoastIndex 1;
BA_ "GenSigStartValue" SG_ 785 LRSideSensorObj01_CoastIndex 31;
BA_ "GenSigSendType" SG_ 785 LRSideSensorObj01_LatExtLeftVar 1;
BA_ "GenSigStartValue" SG_ 785 LRSideSensorObj01_LatExtLeftVar 255;
BA_ "GenSigSendType" SG_ 785 LRSideSensorObj01_LongPos 1;
BA_ "GenSigStartValue" SG_ 785 LRSideSensorObj01_LongPos 8191;
BA_ "GenSigSendType" SG_ 785 LRSideSensorObj01_TrackStatus 1;
BA_ "GenSigStartValue" SG_ 785 LRSideSensorObj01_TrackStatus 7;
BA_ "GenSigSendType" SG_ 785 LRSideSensorObj01_LatExtRight 1;
BA_ "GenSigStartValue" SG_ 785 LRSideSensorObj01_LatExtRight 127;
BA_ "GenSigSendType" SG_ 785 LRSideSensorObj01_LatPos 1;
BA_ "GenSigStartValue" SG_ 785 LRSideSensorObj01_LatPos 8191;
BA_ "GenSigSendType" SG_ 785 LRSideSensorObj01_TimeStamp 1;
BA_ "GenSigStartValue" SG_ 785 LRSideSensorObj01_TimeStamp 65535;
BA_ "GenSigSendType" SG_ 785 LRSideSensorObj01_LatVel 1;
BA_ "GenSigStartValue" SG_ 785 LRSideSensorObj01_LatVel 8191;
BA_ "GenSigSendType" SG_ 785 LRSideSensorObj01_LongExtBack 1;
BA_ "GenSigStartValue" SG_ 785 LRSideSensorObj01_LongExtBack 1023;
BA_ "GenSigSendType" SG_ 785 LRSideSensorObj01_LatExtLeft 1;
BA_ "GenSigStartValue" SG_ 785 LRSideSensorObj01_LatExtLeft 127;
BA_ "GenSigSendType" SG_ 785 LRSideSensorObj01_Height 1;
BA_ "GenSigStartValue" SG_ 785 LRSideSensorObj01_Height 255;
BA_ "GenSigSendType" SG_ 785 LRSideSensorObj01_HeadingVar 1;
BA_ "GenSigStartValue" SG_ 785 LRSideSensorObj01_HeadingVar 255;
BA_ "GenSigSendType" SG_ 785 LRSideSensorObj01_LongVelVar 1;
BA_ "GenSigStartValue" SG_ 785 LRSideSensorObj01_LongVelVar 255;
BA_ "GenSigSendType" SG_ 785 LRSideSensorObj01_ObjClass 1;
BA_ "GenSigStartValue" SG_ 785 LRSideSensorObj01_ObjClass 15;
BA_ "GenSigSendType" SG_ 785 LRSideSensorObj01_LifeTime 1;
BA_ "GenSigStartValue" SG_ 785 LRSideSensorObj01_LifeTime 65535;
BA_ "GenSigSendType" SG_ 785 LRSideSensorObj01_LongAcc 1;
BA_ "GenSigStartValue" SG_ 785 LRSideSensorObj01_LongAcc 511;
BA_ "GenSigSendType" SG_ 785 LRSideSensorObj01_LongVel 1;
BA_ "GenSigStartValue" SG_ 785 LRSideSensorObj01_LongVel 8191;
BA_ "GenSigSendType" SG_ 785 LRSideSensorObj01_LatVelVar 1;
BA_ "GenSigStartValue" SG_ 785 LRSideSensorObj01_LatVelVar 255;
BA_ "GenSigSendType" SG_ 785 LRSideSensorObj01_Prioritisation 1;
BA_ "GenSigStartValue" SG_ 785 LRSideSensorObj01_Prioritisation 3;
BA_ "GenSigSendType" SG_ 785 LRSideSensorObj01_LatExtRtVar 1;
BA_ "GenSigStartValue" SG_ 785 LRSideSensorObj01_LatExtRtVar 255;
BA_ "GenSigSendType" SG_ 785 LRSideSensorObj01_LatAccVar 1;
BA_ "GenSigStartValue" SG_ 785 LRSideSensorObj01_LatAccVar 255;
BA_ "GenSigSendType" SG_ 785 LRSideSensorObj01_LongAccVar 1;
BA_ "GenSigStartValue" SG_ 785 LRSideSensorObj01_LongAccVar 255;
BA_ "GenSigSendType" SG_ 785 LRSideSensorObj01_LatAcc 1;
BA_ "GenSigStartValue" SG_ 785 LRSideSensorObj01_LatAcc 511;
BA_ "GenSigSendType" SG_ 785 LRSideSensorObj01_ObstacleConf 1;
BA_ "GenSigStartValue" SG_ 785 LRSideSensorObj01_ObstacleConf 127;
BA_ "GenSigSendType" SG_ 784 LRSideSensorObj00_TimeStamp 1;
BA_ "GenSigStartValue" SG_ 784 LRSideSensorObj00_TimeStamp 65535;
BA_ "GenSigSendType" SG_ 784 LRSideSensorObj00_LatPos 1;
BA_ "GenSigStartValue" SG_ 784 LRSideSensorObj00_LatPos 8191;
BA_ "GenSigSendType" SG_ 784 LRSideSensorObj00_ObjClass 1;
BA_ "GenSigStartValue" SG_ 784 LRSideSensorObj00_ObjClass 15;
BA_ "GenSigSendType" SG_ 784 LRSideSensorObj00_LongPosVar 1;
BA_ "GenSigStartValue" SG_ 784 LRSideSensorObj00_LongPosVar 255;
BA_ "GenSigSendType" SG_ 784 LRSideSensorObj00_LongVel 1;
BA_ "GenSigStartValue" SG_ 784 LRSideSensorObj00_LongVel 8191;
BA_ "GenSigSendType" SG_ 784 LRSideSensorObj00_ExistConf 1;
BA_ "GenSigStartValue" SG_ 784 LRSideSensorObj00_ExistConf 127;
BA_ "GenSigSendType" SG_ 784 LRSideSensorObj00_LatVelVar 1;
BA_ "GenSigStartValue" SG_ 784 LRSideSensorObj00_LatVelVar 255;
BA_ "GenSigSendType" SG_ 784 LRSideSensorObj00_LongAcc 1;
BA_ "GenSigStartValue" SG_ 784 LRSideSensorObj00_LongAcc 511;
BA_ "GenSigSendType" SG_ 784 LRSideSensorObj00_LatVel 1;
BA_ "GenSigStartValue" SG_ 784 LRSideSensorObj00_LatVel 8191;
BA_ "GenSigSendType" SG_ 784 LRSideSensorObj00_ObstacleConf 1;
BA_ "GenSigStartValue" SG_ 784 LRSideSensorObj00_ObstacleConf 127;
BA_ "GenSigSendType" SG_ 784 LRSideSensorObj00_HeadingVar 1;
BA_ "GenSigStartValue" SG_ 784 LRSideSensorObj00_HeadingVar 255;
BA_ "GenSigSendType" SG_ 784 LRSideSensorObj00_LatExtLeft 1;
BA_ "GenSigStartValue" SG_ 784 LRSideSensorObj00_LatExtLeft 127;
BA_ "GenSigSendType" SG_ 784 LRSideSensorObj00_LongPos 1;
BA_ "GenSigStartValue" SG_ 784 LRSideSensorObj00_LongPos 8191;
BA_ "GenSigSendType" SG_ 784 LRSideSensorObj00_LatAcc 1;
BA_ "GenSigStartValue" SG_ 784 LRSideSensorObj00_LatAcc 511;
BA_ "GenSigSendType" SG_ 784 LRSideSensorObj00_ObjID 1;
BA_ "GenSigStartValue" SG_ 784 LRSideSensorObj00_ObjID 63;
BA_ "GenSigSendType" SG_ 784 LRSideSensorObj00_LatExtLeftVar 1;
BA_ "GenSigStartValue" SG_ 784 LRSideSensorObj00_LatExtLeftVar 255;
BA_ "GenSigSendType" SG_ 784 LRSideSensorObj00_TrackStatus 1;
BA_ "GenSigStartValue" SG_ 784 LRSideSensorObj00_TrackStatus 7;
BA_ "GenSigSendType" SG_ 784 LRSideSensorObj00_CoastIndex 1;
BA_ "GenSigStartValue" SG_ 784 LRSideSensorObj00_CoastIndex 31;
BA_ "GenSigSendType" SG_ 784 LRSideSensorObj00_Prioritisation 1;
BA_ "GenSigStartValue" SG_ 784 LRSideSensorObj00_Prioritisation 3;
BA_ "GenSigSendType" SG_ 784 LRSideSensorObj00_LifeTime 1;
BA_ "GenSigStartValue" SG_ 784 LRSideSensorObj00_LifeTime 65535;
BA_ "GenSigSendType" SG_ 784 LRSideSensorObj00_ObjDynClass 1;
BA_ "GenSigStartValue" SG_ 784 LRSideSensorObj00_ObjDynClass 3;
BA_ "GenSigSendType" SG_ 784 LRSideSensorObj00_LongVelVar 1;
BA_ "GenSigStartValue" SG_ 784 LRSideSensorObj00_LongVelVar 255;
BA_ "GenSigSendType" SG_ 784 LRSideSensorObj00_LongExtFrVar 1;
BA_ "GenSigStartValue" SG_ 784 LRSideSensorObj00_LongExtFrVar 255;
BA_ "GenSigSendType" SG_ 784 LRSideSensorObj00_Heading 1;
BA_ "GenSigStartValue" SG_ 784 LRSideSensorObj00_Heading 2047;
BA_ "GenSigSendType" SG_ 784 LRSideSensorObj00_LongExtFront 1;
BA_ "GenSigStartValue" SG_ 784 LRSideSensorObj00_LongExtFront 1023;
BA_ "GenSigSendType" SG_ 784 LRSideSensorObj00_ObjClassConf 1;
BA_ "GenSigStartValue" SG_ 784 LRSideSensorObj00_ObjClassConf 15;
BA_ "GenSigSendType" SG_ 784 LRSideSensorObj00_LatPosVar 1;
BA_ "GenSigStartValue" SG_ 784 LRSideSensorObj00_LatPosVar 255;
BA_ "GenSigSendType" SG_ 784 LRSideSensorObj00_Height 1;
BA_ "GenSigStartValue" SG_ 784 LRSideSensorObj00_Height 255;
BA_ "GenSigSendType" SG_ 784 LRSideSensorObj00_LatAccVar 1;
BA_ "GenSigStartValue" SG_ 784 LRSideSensorObj00_LatAccVar 255;
BA_ "GenSigSendType" SG_ 784 LRSideSensorObj00_Counter 1;
BA_ "GenSigStartValue" SG_ 784 LRSideSensorObj00_Counter 255;
BA_ "GenSigSendType" SG_ 784 LRSideSensorObj00_LongAccVar 1;
BA_ "GenSigStartValue" SG_ 784 LRSideSensorObj00_LongAccVar 255;
BA_ "GenSigSendType" SG_ 784 LRSideSensorObj00_MOISPrio 1;
BA_ "GenSigSendType" SG_ 784 LRSideSensorObj00_LongExtBack 1;
BA_ "GenSigStartValue" SG_ 784 LRSideSensorObj00_LongExtBack 1023;
BA_ "GenSigSendType" SG_ 784 LRSideSensorObj00_LongExtBkVar 1;
BA_ "GenSigStartValue" SG_ 784 LRSideSensorObj00_LongExtBkVar 255;
BA_ "GenSigSendType" SG_ 784 LRSideSensorObj00_LatExtRtVar 1;
BA_ "GenSigStartValue" SG_ 784 LRSideSensorObj00_LatExtRtVar 255;
BA_ "GenSigSendType" SG_ 784 LRSideSensorObj00_LatExtRight 1;
BA_ "GenSigStartValue" SG_ 784 LRSideSensorObj00_LatExtRight 127;
BA_ "GenSigSendType" SG_ 784 LRSideSensorObj00_CRC 1;
BA_ "GenSigStartValue" SG_ 784 LRSideSensorObj00_CRC 65535;
BA_ "E2EDataId" SG_ 784 LRSideSensorObj00_CRC 30;
BA_ "E2EDataLength" SG_ 784 LRSideSensorObj00_CRC 312;
BA_ "E2EProfile" SG_ 784 LRSideSensorObj00_CRC "P05";
BA_ "GenSigCycleTime" SG_ 1553 LRSRSwVersion_Substring1 100;
BA_ "GenSigCycleTimeActive" SG_ 1553 LRSRSwVersion_Substring1 100;
BA_ "GenSigCycleTime" SG_ 1553 LRSRSwVersion_Substring2 100;
BA_ "GenSigCycleTimeActive" SG_ 1553 LRSRSwVersion_Substring2 100;
BA_ "GenSigCycleTime" SG_ 1553 LRSRSwVersion_Substring3 100;
BA_ "GenSigCycleTimeActive" SG_ 1553 LRSRSwVersion_Substring3 100;
BA_ "GenSigCycleTime" SG_ 1553 LRSRSwVersion_Substring7 100;
BA_ "GenSigCycleTimeActive" SG_ 1553 LRSRSwVersion_Substring7 100;
BA_ "GenSigCycleTime" SG_ 1553 LRSRSwVersion_Substring6 100;
BA_ "GenSigCycleTimeActive" SG_ 1553 LRSRSwVersion_Substring6 100;
BA_ "GenSigCycleTime" SG_ 1553 LRSRSwVersion_Substring4 100;
BA_ "GenSigCycleTimeActive" SG_ 1553 LRSRSwVersion_Substring4 100;
BA_ "GenSigCycleTime" SG_ 1553 LRSRSwVersion_Substring5 100;
BA_ "GenSigCycleTimeActive" SG_ 1553 LRSRSwVersion_Substring5 100;
BA_ "GenSigCycleTime" SG_ 1553 LRSRSwVersion_Substring0 100;
BA_ "GenSigCycleTimeActive" SG_ 1553 LRSRSwVersion_Substring0 100;
BA_ "GenSigSendType" SG_ 799 LRSRRaisedEdge_Type 1;
BA_ "GenSigStartValue" SG_ 799 LRSRRaisedEdge_Type 7;
BA_ "GenSigSendType" SG_ 799 LRSRRaisedEdge_TrackStatus 1;
BA_ "GenSigStartValue" SG_ 799 LRSRRaisedEdge_TrackStatus 7;
BA_ "GenSigSendType" SG_ 799 LRSRRaisedEdge_DxEnd 1;
BA_ "GenSigStartValue" SG_ 799 LRSRRaisedEdge_DxEnd 255;
BA_ "GenSigSendType" SG_ 799 LRSRRaisedEdge_Curvature 1;
BA_ "GenSigStartValue" SG_ 799 LRSRRaisedEdge_Curvature 262143;
BA_ "GenSigSendType" SG_ 799 LRSRRaisedEdge_Confidence 1;
BA_ "GenSigStartValue" SG_ 799 LRSRRaisedEdge_Confidence 127;
BA_ "GenSigSendType" SG_ 799 LRSRRaisedEdge_Counter 1;
BA_ "GenSigStartValue" SG_ 799 LRSRRaisedEdge_Counter 255;
BA_ "GenSigSendType" SG_ 799 LRSRRaisedEdge_LatDistVar 1;
BA_ "GenSigStartValue" SG_ 799 LRSRRaisedEdge_LatDistVar 255;
BA_ "GenSigSendType" SG_ 799 LRSRRaisedEdge_LifeTime 1;
BA_ "GenSigStartValue" SG_ 799 LRSRRaisedEdge_LifeTime 65535;
BA_ "GenSigSendType" SG_ 799 LRSRRaisedEdge_LatDist 1;
BA_ "GenSigStartValue" SG_ 799 LRSRRaisedEdge_LatDist 4095;
BA_ "GenSigSendType" SG_ 799 LRSRRaisedEdge_CRC 1;
BA_ "GenSigStartValue" SG_ 799 LRSRRaisedEdge_CRC 65535;
BA_ "E2EDataId" SG_ 799 LRSRRaisedEdge_CRC 112;
BA_ "E2EDataLength" SG_ 799 LRSRRaisedEdge_CRC 152;
BA_ "E2EProfile" SG_ 799 LRSRRaisedEdge_CRC "P05";
BA_ "GenSigSendType" SG_ 799 LRSRRaisedEdge_CurvatureRate 1;
BA_ "GenSigStartValue" SG_ 799 LRSRRaisedEdge_CurvatureRate 2047;
BA_ "GenSigSendType" SG_ 799 LRSRRaisedEdge_DxStart 1;
BA_ "GenSigStartValue" SG_ 799 LRSRRaisedEdge_DxStart 255;
BA_ "GenSigSendType" SG_ 799 LRSRRaisedEdge_HeadingAngle 1;
BA_ "GenSigStartValue" SG_ 799 LRSRRaisedEdge_HeadingAngle 8191;
BA_ "GenSigSendType" SG_ 799 LRSRRaisedEdge_TimeStamp 1;
BA_ "GenSigStartValue" SG_ 799 LRSRRaisedEdge_TimeStamp 65535;
BA_ "GenSigSendType" SG_ 799 LRSRRaisedEdge_CoastIndex 1;
BA_ "GenSigStartValue" SG_ 799 LRSRRaisedEdge_CoastIndex 31;
BA_ "GenSigSendType" SG_ 798 LRSREgoAssumpt_EgoLongVel 1;
BA_ "GenSigStartValue" SG_ 798 LRSREgoAssumpt_EgoLongVel 65535;
BA_ "GenSigSendType" SG_ 798 LRSREgoAssumpt_EgoRoadHeading 1;
BA_ "GenSigStartValue" SG_ 798 LRSREgoAssumpt_EgoRoadHeading 8191;
BA_ "GenSigSendType" SG_ 798 LRSREgoAssumpt_EgoRoadCurvature 1;
BA_ "GenSigStartValue" SG_ 798 LRSREgoAssumpt_EgoRoadCurvature 262143;
BA_ "GenSigSendType" SG_ 798 LRSREgoAssumpt_EgoLongAcc 1;
BA_ "GenSigStartValue" SG_ 798 LRSREgoAssumpt_EgoLongAcc 65535;
BA_ "GenSigSendType" SG_ 798 LRSREgoAssumpt_EgoRoadCurvRate 1;
BA_ "GenSigStartValue" SG_ 798 LRSREgoAssumpt_EgoRoadCurvRate 2047;
BA_ "GenSigSendType" SG_ 798 LRSREgoAssumpt_VelCorrFactor 1;
BA_ "GenSigStartValue" SG_ 798 LRSREgoAssumpt_VelCorrFactor 255;
BA_ "GenSigSendType" SG_ 798 LRSREgoAssumpt_EgoRoadEnd 1;
BA_ "GenSigStartValue" SG_ 798 LRSREgoAssumpt_EgoRoadEnd 255;
BA_ "GenSigSendType" SG_ 798 LRSREgoAssumpt_EgoYawRate 1;
BA_ "GenSigStartValue" SG_ 798 LRSREgoAssumpt_EgoYawRate 65535;
BA_ "GenSigSendType" SG_ 798 LRSREgoAssumpt_TimeStamp 1;
BA_ "GenSigStartValue" SG_ 798 LRSREgoAssumpt_TimeStamp 65535;
BA_ "GenSigSendType" SG_ 844 LFSideSensorTrlrObj_SegTrlrType1 1;
BA_ "GenSigStartValue" SG_ 844 LFSideSensorTrlrObj_SegTrlrType1 15;
BA_ "GenSigSendType" SG_ 844 LFSideSensorTrlrObj_SegAngle3 1;
BA_ "GenSigStartValue" SG_ 844 LFSideSensorTrlrObj_SegAngle3 4095;
BA_ "GenSigSendType" SG_ 844 LFSideSensorTrlrObj_Seg1Length 1;
BA_ "GenSigStartValue" SG_ 844 LFSideSensorTrlrObj_Seg1Length 511;
BA_ "GenSigSendType" SG_ 844 LFSideSensorTrlrObj_TotalLength 1;
BA_ "GenSigStartValue" SG_ 844 LFSideSensorTrlrObj_TotalLength 2047;
BA_ "GenSigSendType" SG_ 844 LFSideSensorTrlrObj_Seg5Length 1;
BA_ "GenSigStartValue" SG_ 844 LFSideSensorTrlrObj_Seg5Length 511;
BA_ "GenSigSendType" SG_ 844 LFSideSensorTrlrObj_SegAngle5 1;
BA_ "GenSigStartValue" SG_ 844 LFSideSensorTrlrObj_SegAngle5 4095;
BA_ "GenSigSendType" SG_ 844 LFSideSensorTrlrObj_SegAngle1 1;
BA_ "GenSigStartValue" SG_ 844 LFSideSensorTrlrObj_SegAngle1 4095;
BA_ "GenSigSendType" SG_ 844 LFSideSensorTrlrObj_Seg4Length 1;
BA_ "GenSigStartValue" SG_ 844 LFSideSensorTrlrObj_Seg4Length 511;
BA_ "GenSigSendType" SG_ 844 LFSideSensorTrlrObj_SegAngle4 1;
BA_ "GenSigStartValue" SG_ 844 LFSideSensorTrlrObj_SegAngle4 4095;
BA_ "GenSigSendType" SG_ 844 LFSideSensorTrlrObj_WhlBasedConf 1;
BA_ "GenSigStartValue" SG_ 844 LFSideSensorTrlrObj_WhlBasedConf 127;
BA_ "GenSigSendType" SG_ 844 LFSideSensorTrlrObj_TotLenConf 1;
BA_ "GenSigStartValue" SG_ 844 LFSideSensorTrlrObj_TotLenConf 7;
BA_ "GenSigSendType" SG_ 844 LFSideSensorTrlrObj_TrlAnglConf 1;
BA_ "GenSigStartValue" SG_ 844 LFSideSensorTrlrObj_TrlAnglConf 127;
BA_ "GenSigSendType" SG_ 844 LFSideSensorTrlrObj_WheelBased1 1;
BA_ "GenSigStartValue" SG_ 844 LFSideSensorTrlrObj_WheelBased1 2047;
BA_ "GenSigSendType" SG_ 844 LFSideSensorTrlrObj_SegTrlrType2 1;
BA_ "GenSigStartValue" SG_ 844 LFSideSensorTrlrObj_SegTrlrType2 15;
BA_ "GenSigSendType" SG_ 844 LFSideSensorTrlrObj_WheelBased5 1;
BA_ "GenSigStartValue" SG_ 844 LFSideSensorTrlrObj_WheelBased5 2047;
BA_ "GenSigSendType" SG_ 844 LFSideSensorTrlrObj_SegTrlrType5 1;
BA_ "GenSigStartValue" SG_ 844 LFSideSensorTrlrObj_SegTrlrType5 15;
BA_ "GenSigSendType" SG_ 844 LFSideSensorTrlrObj_TrlrTypeConf 1;
BA_ "GenSigStartValue" SG_ 844 LFSideSensorTrlrObj_TrlrTypeConf 127;
BA_ "GenSigSendType" SG_ 844 LFSideSensorTrlrObj_WheelBased2 1;
BA_ "GenSigStartValue" SG_ 844 LFSideSensorTrlrObj_WheelBased2 2047;
BA_ "GenSigSendType" SG_ 844 LFSideSensorTrlrObj_Seg2Length 1;
BA_ "GenSigStartValue" SG_ 844 LFSideSensorTrlrObj_Seg2Length 511;
BA_ "GenSigSendType" SG_ 844 LFSideSensorTrlrObj_WheelBased4 1;
BA_ "GenSigStartValue" SG_ 844 LFSideSensorTrlrObj_WheelBased4 2047;
BA_ "GenSigSendType" SG_ 844 LFSideSensorTrlrObj_WheelBased3 1;
BA_ "GenSigStartValue" SG_ 844 LFSideSensorTrlrObj_WheelBased3 2047;
BA_ "GenSigSendType" SG_ 844 LFSideSensorTrlrObj_SegTrlrType3 1;
BA_ "GenSigStartValue" SG_ 844 LFSideSensorTrlrObj_SegTrlrType3 15;
BA_ "GenSigSendType" SG_ 844 LFSideSensorTrlrObj_SegAngle2 1;
BA_ "GenSigStartValue" SG_ 844 LFSideSensorTrlrObj_SegAngle2 4095;
BA_ "GenSigSendType" SG_ 844 LFSideSensorTrlrObj_Seg3Length 1;
BA_ "GenSigStartValue" SG_ 844 LFSideSensorTrlrObj_Seg3Length 511;
BA_ "GenSigSendType" SG_ 844 LFSideSensorTrlrObj_SegTrlrType4 1;
BA_ "GenSigStartValue" SG_ 844 LFSideSensorTrlrObj_SegTrlrType4 15;
BA_ "GenSigSendType" SG_ 843 LFSideSensorObj11_ExistConf 1;
BA_ "GenSigStartValue" SG_ 843 LFSideSensorObj11_ExistConf 127;
BA_ "GenSigSendType" SG_ 843 LFSideSensorObj11_LifeTime 1;
BA_ "GenSigStartValue" SG_ 843 LFSideSensorObj11_LifeTime 65535;
BA_ "GenSigSendType" SG_ 843 LFSideSensorObj11_ObjClassConf 1;
BA_ "GenSigStartValue" SG_ 843 LFSideSensorObj11_ObjClassConf 15;
BA_ "GenSigSendType" SG_ 843 LFSideSensorObj11_Prioritisation 1;
BA_ "GenSigStartValue" SG_ 843 LFSideSensorObj11_Prioritisation 3;
BA_ "GenSigSendType" SG_ 843 LFSideSensorObj11_LatVel 1;
BA_ "GenSigStartValue" SG_ 843 LFSideSensorObj11_LatVel 8191;
BA_ "GenSigSendType" SG_ 843 LFSideSensorObj11_ObjDynClass 1;
BA_ "GenSigStartValue" SG_ 843 LFSideSensorObj11_ObjDynClass 3;
BA_ "GenSigSendType" SG_ 843 LFSideSensorObj11_LongPos 1;
BA_ "GenSigStartValue" SG_ 843 LFSideSensorObj11_LongPos 8191;
BA_ "GenSigSendType" SG_ 843 LFSideSensorObj11_MOISPrio 1;
BA_ "GenSigSendType" SG_ 843 LFSideSensorObj11_Heading 1;
BA_ "GenSigStartValue" SG_ 843 LFSideSensorObj11_Heading 2047;
BA_ "GenSigSendType" SG_ 843 LFSideSensorObj11_Height 1;
BA_ "GenSigStartValue" SG_ 843 LFSideSensorObj11_Height 255;
BA_ "GenSigSendType" SG_ 843 LFSideSensorObj11_LatExtLeft 1;
BA_ "GenSigStartValue" SG_ 843 LFSideSensorObj11_LatExtLeft 127;
BA_ "GenSigSendType" SG_ 843 LFSideSensorObj11_LongVel 1;
BA_ "GenSigStartValue" SG_ 843 LFSideSensorObj11_LongVel 8191;
BA_ "GenSigSendType" SG_ 843 LFSideSensorObj11_LongVelVar 1;
BA_ "GenSigStartValue" SG_ 843 LFSideSensorObj11_LongVelVar 255;
BA_ "GenSigSendType" SG_ 843 LFSideSensorObj11_LatPos 1;
BA_ "GenSigStartValue" SG_ 843 LFSideSensorObj11_LatPos 8191;
BA_ "GenSigSendType" SG_ 843 LFSideSensorObj11_LatPosVar 1;
BA_ "GenSigStartValue" SG_ 843 LFSideSensorObj11_LatPosVar 255;
BA_ "GenSigSendType" SG_ 843 LFSideSensorObj11_ObjClass 1;
BA_ "GenSigStartValue" SG_ 843 LFSideSensorObj11_ObjClass 15;
BA_ "GenSigSendType" SG_ 843 LFSideSensorObj11_LongExtBkVar 1;
BA_ "GenSigStartValue" SG_ 843 LFSideSensorObj11_LongExtBkVar 255;
BA_ "GenSigSendType" SG_ 843 LFSideSensorObj11_ObjID 1;
BA_ "GenSigStartValue" SG_ 843 LFSideSensorObj11_ObjID 63;
BA_ "GenSigSendType" SG_ 843 LFSideSensorObj11_LatAccVar 1;
BA_ "GenSigStartValue" SG_ 843 LFSideSensorObj11_LatAccVar 255;
BA_ "GenSigSendType" SG_ 843 LFSideSensorObj11_LatExtRtVar 1;
BA_ "GenSigStartValue" SG_ 843 LFSideSensorObj11_LatExtRtVar 255;
BA_ "GenSigSendType" SG_ 843 LFSideSensorObj11_LongAcc 1;
BA_ "GenSigStartValue" SG_ 843 LFSideSensorObj11_LongAcc 511;
BA_ "GenSigSendType" SG_ 843 LFSideSensorObj11_Counter 1;
BA_ "GenSigStartValue" SG_ 843 LFSideSensorObj11_Counter 255;
BA_ "GenSigSendType" SG_ 843 LFSideSensorObj11_ObstacleConf 1;
BA_ "GenSigStartValue" SG_ 843 LFSideSensorObj11_ObstacleConf 127;
BA_ "GenSigSendType" SG_ 843 LFSideSensorObj11_CRC 1;
BA_ "GenSigStartValue" SG_ 843 LFSideSensorObj11_CRC 65535;
BA_ "E2EDataId" SG_ 843 LFSideSensorObj11_CRC 29;
BA_ "E2EDataLength" SG_ 843 LFSideSensorObj11_CRC 312;
BA_ "E2EProfile" SG_ 843 LFSideSensorObj11_CRC "P05";
BA_ "GenSigSendType" SG_ 843 LFSideSensorObj11_LatExtRight 1;
BA_ "GenSigStartValue" SG_ 843 LFSideSensorObj11_LatExtRight 127;
BA_ "GenSigSendType" SG_ 843 LFSideSensorObj11_LongExtFrVar 1;
BA_ "GenSigStartValue" SG_ 843 LFSideSensorObj11_LongExtFrVar 255;
BA_ "GenSigSendType" SG_ 843 LFSideSensorObj11_LongExtBack 1;
BA_ "GenSigStartValue" SG_ 843 LFSideSensorObj11_LongExtBack 1023;
BA_ "GenSigSendType" SG_ 843 LFSideSensorObj11_LongPosVar 1;
BA_ "GenSigStartValue" SG_ 843 LFSideSensorObj11_LongPosVar 255;
BA_ "GenSigSendType" SG_ 843 LFSideSensorObj11_LatExtLeftVar 1;
BA_ "GenSigStartValue" SG_ 843 LFSideSensorObj11_LatExtLeftVar 255;
BA_ "GenSigSendType" SG_ 843 LFSideSensorObj11_HeadingVar 1;
BA_ "GenSigStartValue" SG_ 843 LFSideSensorObj11_HeadingVar 255;
BA_ "GenSigSendType" SG_ 843 LFSideSensorObj11_LatAcc 1;
BA_ "GenSigStartValue" SG_ 843 LFSideSensorObj11_LatAcc 511;
BA_ "GenSigSendType" SG_ 843 LFSideSensorObj11_TimeStamp 1;
BA_ "GenSigStartValue" SG_ 843 LFSideSensorObj11_TimeStamp 65535;
BA_ "GenSigSendType" SG_ 843 LFSideSensorObj11_LongExtFront 1;
BA_ "GenSigStartValue" SG_ 843 LFSideSensorObj11_LongExtFront 1023;
BA_ "GenSigSendType" SG_ 843 LFSideSensorObj11_CoastIndex 1;
BA_ "GenSigStartValue" SG_ 843 LFSideSensorObj11_CoastIndex 31;
BA_ "GenSigSendType" SG_ 843 LFSideSensorObj11_LatVelVar 1;
BA_ "GenSigStartValue" SG_ 843 LFSideSensorObj11_LatVelVar 255;
BA_ "GenSigSendType" SG_ 843 LFSideSensorObj11_LongAccVar 1;
BA_ "GenSigStartValue" SG_ 843 LFSideSensorObj11_LongAccVar 255;
BA_ "GenSigSendType" SG_ 843 LFSideSensorObj11_TrackStatus 1;
BA_ "GenSigStartValue" SG_ 843 LFSideSensorObj11_TrackStatus 7;
BA_REL_ "GenSigFirstTimeoutTime" BU_SG_REL_ DACU SG_ 796 LRSideSensorTrlrObj_SegTrlrType3 3000;
BA_REL_ "GenSigTimeoutTime" BU_SG_REL_ DACU SG_ 796 LRSideSensorTrlrObj_SegTrlrType3 300;
BA_REL_ "GenSigFirstTimeoutTime" BU_SG_REL_ DACU SG_ 796 LRSideSensorTrlrObj_TrlAnglConf 3000;
BA_REL_ "GenSigTimeoutTime" BU_SG_REL_ DACU SG_ 796 LRSideSensorTrlrObj_TrlAnglConf 300;
BA_REL_ "GenSigFirstTimeoutTime" BU_SG_REL_ DACU SG_ 796 LRSideSensorTrlrObj_TrlrTypeConf 3000;
BA_REL_ "GenSigTimeoutTime" BU_SG_REL_ DACU SG_ 796 LRSideSensorTrlrObj_TrlrTypeConf 300;
BA_REL_ "GenSigFirstTimeoutTime" BU_SG_REL_ DACU SG_ 796 LRSideSensorTrlrObj_Seg1Length 3000;
BA_REL_ "GenSigTimeoutTime" BU_SG_REL_ DACU SG_ 796 LRSideSensorTrlrObj_Seg1Length 300;
BA_REL_ "GenSigFirstTimeoutTime" BU_SG_REL_ DACU SG_ 796 LRSideSensorTrlrObj_SegTrlrType5 3000;
BA_REL_ "GenSigTimeoutTime" BU_SG_REL_ DACU SG_ 796 LRSideSensorTrlrObj_SegTrlrType5 300;
BA_REL_ "GenSigFirstTimeoutTime" BU_SG_REL_ DACU SG_ 796 LRSideSensorTrlrObj_SegAngle1 3000;
BA_REL_ "GenSigTimeoutTime" BU_SG_REL_ DACU SG_ 796 LRSideSensorTrlrObj_SegAngle1 300;
BA_REL_ "GenSigFirstTimeoutTime" BU_SG_REL_ DACU SG_ 796 LRSideSensorTrlrObj_Seg4Length 3000;
BA_REL_ "GenSigTimeoutTime" BU_SG_REL_ DACU SG_ 796 LRSideSensorTrlrObj_Seg4Length 300;
BA_REL_ "GenSigFirstTimeoutTime" BU_SG_REL_ DACU SG_ 796 LRSideSensorTrlrObj_WheelBased1 3000;
BA_REL_ "GenSigTimeoutTime" BU_SG_REL_ DACU SG_ 796 LRSideSensorTrlrObj_WheelBased1 300;
BA_REL_ "GenSigFirstTimeoutTime" BU_SG_REL_ DACU SG_ 796 LRSideSensorTrlrObj_SegTrlrType1 3000;
BA_REL_ "GenSigTimeoutTime" BU_SG_REL_ DACU SG_ 796 LRSideSensorTrlrObj_SegTrlrType1 300;
BA_REL_ "GenSigFirstTimeoutTime" BU_SG_REL_ DACU SG_ 796 LRSideSensorTrlrObj_Seg5Length 3000;
BA_REL_ "GenSigTimeoutTime" BU_SG_REL_ DACU SG_ 796 LRSideSensorTrlrObj_Seg5Length 300;
BA_REL_ "GenSigFirstTimeoutTime" BU_SG_REL_ DACU SG_ 796 LRSideSensorTrlrObj_WheelBased2 3000;
BA_REL_ "GenSigTimeoutTime" BU_SG_REL_ DACU SG_ 796 LRSideSensorTrlrObj_WheelBased2 300;
BA_REL_ "GenSigFirstTimeoutTime" BU_SG_REL_ DACU SG_ 796 LRSideSensorTrlrObj_WheelBased3 3000;
BA_REL_ "GenSigTimeoutTime" BU_SG_REL_ DACU SG_ 796 LRSideSensorTrlrObj_WheelBased3 300;
BA_REL_ "GenSigFirstTimeoutTime" BU_SG_REL_ DACU SG_ 796 LRSideSensorTrlrObj_WheelBased5 3000;
BA_REL_ "GenSigTimeoutTime" BU_SG_REL_ DACU SG_ 796 LRSideSensorTrlrObj_WheelBased5 300;
BA_REL_ "GenSigFirstTimeoutTime" BU_SG_REL_ DACU SG_ 796 LRSideSensorTrlrObj_SegTrlrType4 3000;
BA_REL_ "GenSigTimeoutTime" BU_SG_REL_ DACU SG_ 796 LRSideSensorTrlrObj_SegTrlrType4 300;
BA_REL_ "GenSigFirstTimeoutTime" BU_SG_REL_ DACU SG_ 796 LRSideSensorTrlrObj_Seg3Length 3000;
BA_REL_ "GenSigTimeoutTime" BU_SG_REL_ DACU SG_ 796 LRSideSensorTrlrObj_Seg3Length 300;
BA_REL_ "GenSigFirstTimeoutTime" BU_SG_REL_ DACU SG_ 796 LRSideSensorTrlrObj_SegTrlrType2 3000;
BA_REL_ "GenSigTimeoutTime" BU_SG_REL_ DACU SG_ 796 LRSideSensorTrlrObj_SegTrlrType2 300;
BA_REL_ "GenSigFirstTimeoutTime" BU_SG_REL_ DACU SG_ 796 LRSideSensorTrlrObj_TotLenConf 3000;
BA_REL_ "GenSigTimeoutTime" BU_SG_REL_ DACU SG_ 796 LRSideSensorTrlrObj_TotLenConf 300;
BA_REL_ "GenSigFirstTimeoutTime" BU_SG_REL_ DACU SG_ 796 LRSideSensorTrlrObj_WheelBased4 3000;
BA_REL_ "GenSigTimeoutTime" BU_SG_REL_ DACU SG_ 796 LRSideSensorTrlrObj_WheelBased4 300;
BA_REL_ "GenSigFirstTimeoutTime" BU_SG_REL_ DACU SG_ 796 LRSideSensorTrlrObj_TotalLength 3000;
BA_REL_ "GenSigTimeoutTime" BU_SG_REL_ DACU SG_ 796 LRSideSensorTrlrObj_TotalLength 300;
BA_REL_ "GenSigFirstTimeoutTime" BU_SG_REL_ DACU SG_ 796 LRSideSensorTrlrObj_WhlBasedConf 3000;
BA_REL_ "GenSigTimeoutTime" BU_SG_REL_ DACU SG_ 796 LRSideSensorTrlrObj_WhlBasedConf 300;
BA_REL_ "GenSigFirstTimeoutTime" BU_SG_REL_ DACU SG_ 796 LRSideSensorTrlrObj_SegAngle5 3000;
BA_REL_ "GenSigTimeoutTime" BU_SG_REL_ DACU SG_ 796 LRSideSensorTrlrObj_SegAngle5 300;
BA_REL_ "GenSigFirstTimeoutTime" BU_SG_REL_ DACU SG_ 796 LRSideSensorTrlrObj_SegAngle3 3000;
BA_REL_ "GenSigTimeoutTime" BU_SG_REL_ DACU SG_ 796 LRSideSensorTrlrObj_SegAngle3 300;
BA_REL_ "GenSigFirstTimeoutTime" BU_SG_REL_ DACU SG_ 796 LRSideSensorTrlrObj_SegAngle2 3000;
BA_REL_ "GenSigTimeoutTime" BU_SG_REL_ DACU SG_ 796 LRSideSensorTrlrObj_SegAngle2 300;
BA_REL_ "GenSigFirstTimeoutTime" BU_SG_REL_ DACU SG_ 796 LRSideSensorTrlrObj_SegAngle4 3000;
BA_REL_ "GenSigTimeoutTime" BU_SG_REL_ DACU SG_ 796 LRSideSensorTrlrObj_SegAngle4 300;
BA_REL_ "GenSigFirstTimeoutTime" BU_SG_REL_ DACU SG_ 796 LRSideSensorTrlrObj_Seg2Length 3000;
BA_REL_ "GenSigTimeoutTime" BU_SG_REL_ DACU SG_ 796 LRSideSensorTrlrObj_Seg2Length 300;
BA_REL_ "GenSigFirstTimeoutTime" BU_SG_REL_ DACU SG_ 1553 LRSRSwVersion_Substring1 60000;
BA_REL_ "GenSigTimeoutTime" BU_SG_REL_ DACU SG_ 1553 LRSRSwVersion_Substring1 60000;
BA_REL_ "GenSigFirstTimeoutTime" BU_SG_REL_ DACU SG_ 1553 LRSRSwVersion_Substring2 60000;
BA_REL_ "GenSigTimeoutTime" BU_SG_REL_ DACU SG_ 1553 LRSRSwVersion_Substring2 60000;
BA_REL_ "GenSigFirstTimeoutTime" BU_SG_REL_ DACU SG_ 1553 LRSRSwVersion_Substring3 60000;
BA_REL_ "GenSigTimeoutTime" BU_SG_REL_ DACU SG_ 1553 LRSRSwVersion_Substring3 60000;
BA_REL_ "GenSigFirstTimeoutTime" BU_SG_REL_ DACU SG_ 1553 LRSRSwVersion_Substring7 60000;
BA_REL_ "GenSigTimeoutTime" BU_SG_REL_ DACU SG_ 1553 LRSRSwVersion_Substring7 60000;
BA_REL_ "GenSigFirstTimeoutTime" BU_SG_REL_ DACU SG_ 1553 LRSRSwVersion_Substring6 60000;
BA_REL_ "GenSigTimeoutTime" BU_SG_REL_ DACU SG_ 1553 LRSRSwVersion_Substring6 60000;
BA_REL_ "GenSigFirstTimeoutTime" BU_SG_REL_ DACU SG_ 1553 LRSRSwVersion_Substring4 60000;
BA_REL_ "GenSigTimeoutTime" BU_SG_REL_ DACU SG_ 1553 LRSRSwVersion_Substring4 60000;
BA_REL_ "GenSigFirstTimeoutTime" BU_SG_REL_ DACU SG_ 1553 LRSRSwVersion_Substring5 60000;
BA_REL_ "GenSigTimeoutTime" BU_SG_REL_ DACU SG_ 1553 LRSRSwVersion_Substring5 60000;
BA_REL_ "GenSigFirstTimeoutTime" BU_SG_REL_ DACU SG_ 1553 LRSRSwVersion_Substring0 60000;
BA_REL_ "GenSigTimeoutTime" BU_SG_REL_ DACU SG_ 1553 LRSRSwVersion_Substring0 60000;
BA_REL_ "GenSigFirstTimeoutTime" BU_SG_REL_ DACU SG_ 799 LRSRRaisedEdge_Type 3000;
BA_REL_ "GenSigTimeoutTime" BU_SG_REL_ DACU SG_ 799 LRSRRaisedEdge_Type 300;
BA_REL_ "GenSigFirstTimeoutTime" BU_SG_REL_ DACU SG_ 799 LRSRRaisedEdge_TrackStatus 3000;
BA_REL_ "GenSigTimeoutTime" BU_SG_REL_ DACU SG_ 799 LRSRRaisedEdge_TrackStatus 300;
BA_REL_ "GenSigFirstTimeoutTime" BU_SG_REL_ DACU SG_ 799 LRSRRaisedEdge_DxEnd 3000;
BA_REL_ "GenSigTimeoutTime" BU_SG_REL_ DACU SG_ 799 LRSRRaisedEdge_DxEnd 300;
BA_REL_ "GenSigFirstTimeoutTime" BU_SG_REL_ DACU SG_ 799 LRSRRaisedEdge_Curvature 3000;
BA_REL_ "GenSigTimeoutTime" BU_SG_REL_ DACU SG_ 799 LRSRRaisedEdge_Curvature 300;
BA_REL_ "GenSigFirstTimeoutTime" BU_SG_REL_ DACU SG_ 799 LRSRRaisedEdge_Confidence 3000;
BA_REL_ "GenSigTimeoutTime" BU_SG_REL_ DACU SG_ 799 LRSRRaisedEdge_Confidence 300;
BA_REL_ "GenSigFirstTimeoutTime" BU_SG_REL_ DACU SG_ 799 LRSRRaisedEdge_Counter 3000;
BA_REL_ "GenSigTimeoutTime" BU_SG_REL_ DACU SG_ 799 LRSRRaisedEdge_Counter 300;
BA_REL_ "GenSigFirstTimeoutTime" BU_SG_REL_ DACU SG_ 799 LRSRRaisedEdge_LatDistVar 3000;
BA_REL_ "GenSigTimeoutTime" BU_SG_REL_ DACU SG_ 799 LRSRRaisedEdge_LatDistVar 300;
BA_REL_ "GenSigFirstTimeoutTime" BU_SG_REL_ DACU SG_ 799 LRSRRaisedEdge_LifeTime 3000;
BA_REL_ "GenSigTimeoutTime" BU_SG_REL_ DACU SG_ 799 LRSRRaisedEdge_LifeTime 300;
BA_REL_ "GenSigFirstTimeoutTime" BU_SG_REL_ DACU SG_ 799 LRSRRaisedEdge_LatDist 3000;
BA_REL_ "GenSigTimeoutTime" BU_SG_REL_ DACU SG_ 799 LRSRRaisedEdge_LatDist 300;
BA_REL_ "GenSigFirstTimeoutTime" BU_SG_REL_ DACU SG_ 799 LRSRRaisedEdge_CRC 3000;
BA_REL_ "GenSigTimeoutTime" BU_SG_REL_ DACU SG_ 799 LRSRRaisedEdge_CRC 300;
BA_REL_ "GenSigFirstTimeoutTime" BU_SG_REL_ DACU SG_ 799 LRSRRaisedEdge_CurvatureRate 3000;
BA_REL_ "GenSigTimeoutTime" BU_SG_REL_ DACU SG_ 799 LRSRRaisedEdge_CurvatureRate 300;
BA_REL_ "GenSigFirstTimeoutTime" BU_SG_REL_ DACU SG_ 799 LRSRRaisedEdge_DxStart 3000;
BA_REL_ "GenSigTimeoutTime" BU_SG_REL_ DACU SG_ 799 LRSRRaisedEdge_DxStart 300;
BA_REL_ "GenSigFirstTimeoutTime" BU_SG_REL_ DACU SG_ 799 LRSRRaisedEdge_HeadingAngle 3000;
BA_REL_ "GenSigTimeoutTime" BU_SG_REL_ DACU SG_ 799 LRSRRaisedEdge_HeadingAngle 300;
BA_REL_ "GenSigFirstTimeoutTime" BU_SG_REL_ DACU SG_ 799 LRSRRaisedEdge_TimeStamp 3000;
BA_REL_ "GenSigTimeoutTime" BU_SG_REL_ DACU SG_ 799 LRSRRaisedEdge_TimeStamp 300;
BA_REL_ "GenSigFirstTimeoutTime" BU_SG_REL_ DACU SG_ 799 LRSRRaisedEdge_CoastIndex 3000;
BA_REL_ "GenSigTimeoutTime" BU_SG_REL_ DACU SG_ 799 LRSRRaisedEdge_CoastIndex 300;
BA_REL_ "GenSigFirstTimeoutTime" BU_SG_REL_ DACU SG_ 798 LRSREgoAssumpt_EgoLongVel 3000;
BA_REL_ "GenSigTimeoutTime" BU_SG_REL_ DACU SG_ 798 LRSREgoAssumpt_EgoLongVel 300;
BA_REL_ "GenSigFirstTimeoutTime" BU_SG_REL_ DACU SG_ 798 LRSREgoAssumpt_EgoRoadHeading 3000;
BA_REL_ "GenSigTimeoutTime" BU_SG_REL_ DACU SG_ 798 LRSREgoAssumpt_EgoRoadHeading 300;
BA_REL_ "GenSigFirstTimeoutTime" BU_SG_REL_ DACU SG_ 798 LRSREgoAssumpt_EgoRoadCurvature 3000;
BA_REL_ "GenSigTimeoutTime" BU_SG_REL_ DACU SG_ 798 LRSREgoAssumpt_EgoRoadCurvature 300;
BA_REL_ "GenSigFirstTimeoutTime" BU_SG_REL_ DACU SG_ 798 LRSREgoAssumpt_EgoLongAcc 3000;
BA_REL_ "GenSigTimeoutTime" BU_SG_REL_ DACU SG_ 798 LRSREgoAssumpt_EgoLongAcc 300;
BA_REL_ "GenSigFirstTimeoutTime" BU_SG_REL_ DACU SG_ 798 LRSREgoAssumpt_EgoRoadCurvRate 3000;
BA_REL_ "GenSigTimeoutTime" BU_SG_REL_ DACU SG_ 798 LRSREgoAssumpt_EgoRoadCurvRate 300;
BA_REL_ "GenSigFirstTimeoutTime" BU_SG_REL_ DACU SG_ 798 LRSREgoAssumpt_VelCorrFactor 3000;
BA_REL_ "GenSigTimeoutTime" BU_SG_REL_ DACU SG_ 798 LRSREgoAssumpt_VelCorrFactor 300;
BA_REL_ "GenSigFirstTimeoutTime" BU_SG_REL_ DACU SG_ 798 LRSREgoAssumpt_EgoRoadEnd 3000;
BA_REL_ "GenSigTimeoutTime" BU_SG_REL_ DACU SG_ 798 LRSREgoAssumpt_EgoRoadEnd 300;
BA_REL_ "GenSigFirstTimeoutTime" BU_SG_REL_ DACU SG_ 798 LRSREgoAssumpt_EgoYawRate 3000;
BA_REL_ "GenSigTimeoutTime" BU_SG_REL_ DACU SG_ 798 LRSREgoAssumpt_EgoYawRate 300;
BA_REL_ "GenSigFirstTimeoutTime" BU_SG_REL_ DACU SG_ 798 LRSREgoAssumpt_TimeStamp 3000;
BA_REL_ "GenSigTimeoutTime" BU_SG_REL_ DACU SG_ 798 LRSREgoAssumpt_TimeStamp 300;
BA_REL_ "GenSigFirstTimeoutTime" BU_SG_REL_ DACU SG_ 844 LFSideSensorTrlrObj_SegTrlrType1 3000;
BA_REL_ "GenSigTimeoutTime" BU_SG_REL_ DACU SG_ 844 LFSideSensorTrlrObj_SegTrlrType1 300;
BA_REL_ "GenSigFirstTimeoutTime" BU_SG_REL_ DACU SG_ 844 LFSideSensorTrlrObj_SegAngle3 3000;
BA_REL_ "GenSigTimeoutTime" BU_SG_REL_ DACU SG_ 844 LFSideSensorTrlrObj_SegAngle3 300;
BA_REL_ "GenSigFirstTimeoutTime" BU_SG_REL_ DACU SG_ 844 LFSideSensorTrlrObj_Seg1Length 3000;
BA_REL_ "GenSigTimeoutTime" BU_SG_REL_ DACU SG_ 844 LFSideSensorTrlrObj_Seg1Length 300;
BA_REL_ "GenSigFirstTimeoutTime" BU_SG_REL_ DACU SG_ 844 LFSideSensorTrlrObj_TotalLength 3000;
BA_REL_ "GenSigTimeoutTime" BU_SG_REL_ DACU SG_ 844 LFSideSensorTrlrObj_TotalLength 300;
BA_REL_ "GenSigFirstTimeoutTime" BU_SG_REL_ DACU SG_ 844 LFSideSensorTrlrObj_Seg5Length 3000;
BA_REL_ "GenSigTimeoutTime" BU_SG_REL_ DACU SG_ 844 LFSideSensorTrlrObj_Seg5Length 300;
BA_REL_ "GenSigFirstTimeoutTime" BU_SG_REL_ DACU SG_ 844 LFSideSensorTrlrObj_SegAngle5 3000;
BA_REL_ "GenSigTimeoutTime" BU_SG_REL_ DACU SG_ 844 LFSideSensorTrlrObj_SegAngle5 300;
BA_REL_ "GenSigFirstTimeoutTime" BU_SG_REL_ DACU SG_ 844 LFSideSensorTrlrObj_SegAngle1 3000;
BA_REL_ "GenSigTimeoutTime" BU_SG_REL_ DACU SG_ 844 LFSideSensorTrlrObj_SegAngle1 300;
BA_REL_ "GenSigFirstTimeoutTime" BU_SG_REL_ DACU SG_ 844 LFSideSensorTrlrObj_Seg4Length 3000;
BA_REL_ "GenSigTimeoutTime" BU_SG_REL_ DACU SG_ 844 LFSideSensorTrlrObj_Seg4Length 300;
BA_REL_ "GenSigFirstTimeoutTime" BU_SG_REL_ DACU SG_ 844 LFSideSensorTrlrObj_SegAngle4 3000;
BA_REL_ "GenSigTimeoutTime" BU_SG_REL_ DACU SG_ 844 LFSideSensorTrlrObj_SegAngle4 300;
BA_REL_ "GenSigFirstTimeoutTime" BU_SG_REL_ DACU SG_ 844 LFSideSensorTrlrObj_WhlBasedConf 3000;
BA_REL_ "GenSigTimeoutTime" BU_SG_REL_ DACU SG_ 844 LFSideSensorTrlrObj_WhlBasedConf 300;
BA_REL_ "GenSigFirstTimeoutTime" BU_SG_REL_ DACU SG_ 844 LFSideSensorTrlrObj_TotLenConf 3000;
BA_REL_ "GenSigTimeoutTime" BU_SG_REL_ DACU SG_ 844 LFSideSensorTrlrObj_TotLenConf 300;
BA_REL_ "GenSigFirstTimeoutTime" BU_SG_REL_ DACU SG_ 844 LFSideSensorTrlrObj_TrlAnglConf 3000;
BA_REL_ "GenSigTimeoutTime" BU_SG_REL_ DACU SG_ 844 LFSideSensorTrlrObj_TrlAnglConf 300;
BA_REL_ "GenSigFirstTimeoutTime" BU_SG_REL_ DACU SG_ 844 LFSideSensorTrlrObj_WheelBased1 3000;
BA_REL_ "GenSigTimeoutTime" BU_SG_REL_ DACU SG_ 844 LFSideSensorTrlrObj_WheelBased1 300;
BA_REL_ "GenSigFirstTimeoutTime" BU_SG_REL_ DACU SG_ 844 LFSideSensorTrlrObj_SegTrlrType2 3000;
BA_REL_ "GenSigTimeoutTime" BU_SG_REL_ DACU SG_ 844 LFSideSensorTrlrObj_SegTrlrType2 300;
BA_REL_ "GenSigFirstTimeoutTime" BU_SG_REL_ DACU SG_ 844 LFSideSensorTrlrObj_WheelBased5 3000;
BA_REL_ "GenSigTimeoutTime" BU_SG_REL_ DACU SG_ 844 LFSideSensorTrlrObj_WheelBased5 300;
BA_REL_ "GenSigFirstTimeoutTime" BU_SG_REL_ DACU SG_ 844 LFSideSensorTrlrObj_SegTrlrType5 3000;
BA_REL_ "GenSigTimeoutTime" BU_SG_REL_ DACU SG_ 844 LFSideSensorTrlrObj_SegTrlrType5 300;
BA_REL_ "GenSigFirstTimeoutTime" BU_SG_REL_ DACU SG_ 844 LFSideSensorTrlrObj_TrlrTypeConf 3000;
BA_REL_ "GenSigTimeoutTime" BU_SG_REL_ DACU SG_ 844 LFSideSensorTrlrObj_TrlrTypeConf 300;
BA_REL_ "GenSigFirstTimeoutTime" BU_SG_REL_ DACU SG_ 844 LFSideSensorTrlrObj_WheelBased2 3000;
BA_REL_ "GenSigTimeoutTime" BU_SG_REL_ DACU SG_ 844 LFSideSensorTrlrObj_WheelBased2 300;
BA_REL_ "GenSigFirstTimeoutTime" BU_SG_REL_ DACU SG_ 844 LFSideSensorTrlrObj_Seg2Length 3000;
BA_REL_ "GenSigTimeoutTime" BU_SG_REL_ DACU SG_ 844 LFSideSensorTrlrObj_Seg2Length 300;
BA_REL_ "GenSigFirstTimeoutTime" BU_SG_REL_ DACU SG_ 844 LFSideSensorTrlrObj_WheelBased4 3000;
BA_REL_ "GenSigTimeoutTime" BU_SG_REL_ DACU SG_ 844 LFSideSensorTrlrObj_WheelBased4 300;
BA_REL_ "GenSigFirstTimeoutTime" BU_SG_REL_ DACU SG_ 844 LFSideSensorTrlrObj_WheelBased3 3000;
BA_REL_ "GenSigTimeoutTime" BU_SG_REL_ DACU SG_ 844 LFSideSensorTrlrObj_WheelBased3 300;
BA_REL_ "GenSigFirstTimeoutTime" BU_SG_REL_ DACU SG_ 844 LFSideSensorTrlrObj_SegTrlrType3 3000;
BA_REL_ "GenSigTimeoutTime" BU_SG_REL_ DACU SG_ 844 LFSideSensorTrlrObj_SegTrlrType3 300;
BA_REL_ "GenSigFirstTimeoutTime" BU_SG_REL_ DACU SG_ 844 LFSideSensorTrlrObj_SegAngle2 3000;
BA_REL_ "GenSigTimeoutTime" BU_SG_REL_ DACU SG_ 844 LFSideSensorTrlrObj_SegAngle2 300;
BA_REL_ "GenSigFirstTimeoutTime" BU_SG_REL_ DACU SG_ 844 LFSideSensorTrlrObj_Seg3Length 3000;
BA_REL_ "GenSigTimeoutTime" BU_SG_REL_ DACU SG_ 844 LFSideSensorTrlrObj_Seg3Length 300;
BA_REL_ "GenSigFirstTimeoutTime" BU_SG_REL_ DACU SG_ 844 LFSideSensorTrlrObj_SegTrlrType4 3000;
BA_REL_ "GenSigTimeoutTime" BU_SG_REL_ DACU SG_ 844 LFSideSensorTrlrObj_SegTrlrType4 300;
VAL_ 796 LRSideSensorTrlrObj_SegTrlrType3 15 "SegTrailerType_NotAvailable" 14 "SegTrailerType_Error" 13 "SegTrailerType_Spare6" 12 "SegTrailerType_Spare5" 11 "SegTrailerType_Spare4" 10 "SegTrailerType_Spare3" 9 "SegTrailerType_Spare2" 8 "SegTrailerType_Spare1" 7 "SegTrailerType_TowingFullTrailer" 6 "SegTrailerType_TowingCentreAxleTrailer" 5 "SegTrailerType_TowingSemiTrailer" 4 "SegTrailerType_LinkTrailer" 3 "SegTrailerType_ConverterDolly" 2 "SegTrailerType_FullTrailer" 1 "SegTrailerType_CentreAxleTrailer" 0 "SegTrailerType_SemiTrailer" ;
VAL_ 796 LRSideSensorTrlrObj_SegTrlrType5 15 "SegTrailerType_NotAvailable" 14 "SegTrailerType_Error" 13 "SegTrailerType_Spare6" 12 "SegTrailerType_Spare5" 11 "SegTrailerType_Spare4" 10 "SegTrailerType_Spare3" 9 "SegTrailerType_Spare2" 8 "SegTrailerType_Spare1" 7 "SegTrailerType_TowingFullTrailer" 6 "SegTrailerType_TowingCentreAxleTrailer" 5 "SegTrailerType_TowingSemiTrailer" 4 "SegTrailerType_LinkTrailer" 3 "SegTrailerType_ConverterDolly" 2 "SegTrailerType_FullTrailer" 1 "SegTrailerType_CentreAxleTrailer" 0 "SegTrailerType_SemiTrailer" ;
VAL_ 796 LRSideSensorTrlrObj_SegTrlrType1 15 "SegTrailerType_NotAvailable" 14 "SegTrailerType_Error" 13 "SegTrailerType_Spare6" 12 "SegTrailerType_Spare5" 11 "SegTrailerType_Spare4" 10 "SegTrailerType_Spare3" 9 "SegTrailerType_Spare2" 8 "SegTrailerType_Spare1" 7 "SegTrailerType_TowingFullTrailer" 6 "SegTrailerType_TowingCentreAxleTrailer" 5 "SegTrailerType_TowingSemiTrailer" 4 "SegTrailerType_LinkTrailer" 3 "SegTrailerType_ConverterDolly" 2 "SegTrailerType_FullTrailer" 1 "SegTrailerType_CentreAxleTrailer" 0 "SegTrailerType_SemiTrailer" ;
VAL_ 796 LRSideSensorTrlrObj_SegTrlrType4 15 "SegTrailerType_NotAvailable" 14 "SegTrailerType_Error" 13 "SegTrailerType_Spare6" 12 "SegTrailerType_Spare5" 11 "SegTrailerType_Spare4" 10 "SegTrailerType_Spare3" 9 "SegTrailerType_Spare2" 8 "SegTrailerType_Spare1" 7 "SegTrailerType_TowingFullTrailer" 6 "SegTrailerType_TowingCentreAxleTrailer" 5 "SegTrailerType_TowingSemiTrailer" 4 "SegTrailerType_LinkTrailer" 3 "SegTrailerType_ConverterDolly" 2 "SegTrailerType_FullTrailer" 1 "SegTrailerType_CentreAxleTrailer" 0 "SegTrailerType_SemiTrailer" ;
VAL_ 796 LRSideSensorTrlrObj_SegTrlrType2 15 "SegTrailerType_NotAvailable" 14 "SegTrailerType_Error" 13 "SegTrailerType_Spare6" 12 "SegTrailerType_Spare5" 11 "SegTrailerType_Spare4" 10 "SegTrailerType_Spare3" 9 "SegTrailerType_Spare2" 8 "SegTrailerType_Spare1" 7 "SegTrailerType_TowingFullTrailer" 6 "SegTrailerType_TowingCentreAxleTrailer" 5 "SegTrailerType_TowingSemiTrailer" 4 "SegTrailerType_LinkTrailer" 3 "SegTrailerType_ConverterDolly" 2 "SegTrailerType_FullTrailer" 1 "SegTrailerType_CentreAxleTrailer" 0 "SegTrailerType_SemiTrailer" ;
VAL_ 796 LRSideSensorTrlrObj_TotLenConf 7 "TotLenConf_NotAvailable" 6 "TotLenConf_Error" 5 "TotLenConf_Spare" 4 "TotLenConf_LessThanPoint1m" 3 "TotLenConf_LessThanPoint5m" 2 "TotLenConf_LessThan1m" 1 "TotLenConf_LessThan3m" 0 "TotLenConf_GreaterThan3m" ;
VAL_ 795 LRSideSensorObj11_ObjDynClass 3 "ObjDynClass_Error" 2 "ObjDynClass_Movable" 1 "ObjDynClass_Stationary" 0 "ObjDynClass_Reserved" ;
VAL_ 795 LRSideSensorObj11_Prioritisation 3 "Prioritisation_NotAvailable" 2 "Prioritisation_StaticPrioritisation" 1 "Prioritisation_VolvoPrioritisation" 0 "Prioritisation_BoschPrioritisation" ;
VAL_ 795 LRSideSensorObj11_TrackStatus 7 "TrackStatus_NotAvailable" 6 "TrackStatus_Error" 5 "TrackStatus_Spare3" 4 "TrackStatus_Spare2" 3 "TrackStatus_Spare1" 2 "TrackStatus_Invalid" 1 "TrackStatus_Predicted" 0 "TrackStatus_Tracked" ;
VAL_ 795 LRSideSensorObj11_ObjClass 15 "ObjClassSideS_NotAvailable" 14 "ObjClassSideS_Error" 13 "ObjClassSideS_Spare4" 12 "ObjClassSideS_Spare3" 11 "ObjClassSideS_Motorcycle" 10 "ObjClassSideS_Bicycle" 9 "ObjClassSideS_UnidentifiedMovableObject" 8 "ObjClassSideS_UnidentifiedVRU" 7 "ObjClassSideS_UnidentifiedVehicle" 6 "ObjClassSideS_StaticObject" 5 "ObjClassSideS_Pedestrian" 4 "ObjClassSideS_2Wheeler" 3 "ObjClassSideS_HeavyVehicle" 2 "ObjClassSideS_Car" 1 "ObjClassSideS_Obstacle" 0 "ObjClassSideS_Undetermined" ;
VAL_ 794 LRSideSensorObj10_TrackStatus 7 "TrackStatus_NotAvailable" 6 "TrackStatus_Error" 5 "TrackStatus_Spare3" 4 "TrackStatus_Spare2" 3 "TrackStatus_Spare1" 2 "TrackStatus_Invalid" 1 "TrackStatus_Predicted" 0 "TrackStatus_Tracked" ;
VAL_ 794 LRSideSensorObj10_Prioritisation 3 "Prioritisation_NotAvailable" 2 "Prioritisation_StaticPrioritisation" 1 "Prioritisation_VolvoPrioritisation" 0 "Prioritisation_BoschPrioritisation" ;
VAL_ 794 LRSideSensorObj10_ObjClass 15 "ObjClassSideS_NotAvailable" 14 "ObjClassSideS_Error" 13 "ObjClassSideS_Spare4" 12 "ObjClassSideS_Spare3" 11 "ObjClassSideS_Motorcycle" 10 "ObjClassSideS_Bicycle" 9 "ObjClassSideS_UnidentifiedMovableObject" 8 "ObjClassSideS_UnidentifiedVRU" 7 "ObjClassSideS_UnidentifiedVehicle" 6 "ObjClassSideS_StaticObject" 5 "ObjClassSideS_Pedestrian" 4 "ObjClassSideS_2Wheeler" 3 "ObjClassSideS_HeavyVehicle" 2 "ObjClassSideS_Car" 1 "ObjClassSideS_Obstacle" 0 "ObjClassSideS_Undetermined" ;
VAL_ 794 LRSideSensorObj10_ObjDynClass 3 "ObjDynClass_Error" 2 "ObjDynClass_Movable" 1 "ObjDynClass_Stationary" 0 "ObjDynClass_Reserved" ;
VAL_ 793 LRSideSensorObj09_ObjDynClass 3 "ObjDynClass_Error" 2 "ObjDynClass_Movable" 1 "ObjDynClass_Stationary" 0 "ObjDynClass_Reserved" ;
VAL_ 793 LRSideSensorObj09_TrackStatus 7 "TrackStatus_NotAvailable" 6 "TrackStatus_Error" 5 "TrackStatus_Spare3" 4 "TrackStatus_Spare2" 3 "TrackStatus_Spare1" 2 "TrackStatus_Invalid" 1 "TrackStatus_Predicted" 0 "TrackStatus_Tracked" ;
VAL_ 793 LRSideSensorObj09_ObjClass 15 "ObjClassSideS_NotAvailable" 14 "ObjClassSideS_Error" 13 "ObjClassSideS_Spare4" 12 "ObjClassSideS_Spare3" 11 "ObjClassSideS_Motorcycle" 10 "ObjClassSideS_Bicycle" 9 "ObjClassSideS_UnidentifiedMovableObject" 8 "ObjClassSideS_UnidentifiedVRU" 7 "ObjClassSideS_UnidentifiedVehicle" 6 "ObjClassSideS_StaticObject" 5 "ObjClassSideS_Pedestrian" 4 "ObjClassSideS_2Wheeler" 3 "ObjClassSideS_HeavyVehicle" 2 "ObjClassSideS_Car" 1 "ObjClassSideS_Obstacle" 0 "ObjClassSideS_Undetermined" ;
VAL_ 793 LRSideSensorObj09_Prioritisation 3 "Prioritisation_NotAvailable" 2 "Prioritisation_StaticPrioritisation" 1 "Prioritisation_VolvoPrioritisation" 0 "Prioritisation_BoschPrioritisation" ;
VAL_ 792 LRSideSensorObj08_ObjDynClass 3 "ObjDynClass_Error" 2 "ObjDynClass_Movable" 1 "ObjDynClass_Stationary" 0 "ObjDynClass_Reserved" ;
VAL_ 792 LRSideSensorObj08_Prioritisation 3 "Prioritisation_NotAvailable" 2 "Prioritisation_StaticPrioritisation" 1 "Prioritisation_VolvoPrioritisation" 0 "Prioritisation_BoschPrioritisation" ;
VAL_ 792 LRSideSensorObj08_TrackStatus 7 "TrackStatus_NotAvailable" 6 "TrackStatus_Error" 5 "TrackStatus_Spare3" 4 "TrackStatus_Spare2" 3 "TrackStatus_Spare1" 2 "TrackStatus_Invalid" 1 "TrackStatus_Predicted" 0 "TrackStatus_Tracked" ;
VAL_ 792 LRSideSensorObj08_ObjClass 15 "ObjClassSideS_NotAvailable" 14 "ObjClassSideS_Error" 13 "ObjClassSideS_Spare4" 12 "ObjClassSideS_Spare3" 11 "ObjClassSideS_Motorcycle" 10 "ObjClassSideS_Bicycle" 9 "ObjClassSideS_UnidentifiedMovableObject" 8 "ObjClassSideS_UnidentifiedVRU" 7 "ObjClassSideS_UnidentifiedVehicle" 6 "ObjClassSideS_StaticObject" 5 "ObjClassSideS_Pedestrian" 4 "ObjClassSideS_2Wheeler" 3 "ObjClassSideS_HeavyVehicle" 2 "ObjClassSideS_Car" 1 "ObjClassSideS_Obstacle" 0 "ObjClassSideS_Undetermined" ;
VAL_ 791 LRSideSensorObj07_ObjClass 15 "ObjClassSideS_NotAvailable" 14 "ObjClassSideS_Error" 13 "ObjClassSideS_Spare4" 12 "ObjClassSideS_Spare3" 11 "ObjClassSideS_Motorcycle" 10 "ObjClassSideS_Bicycle" 9 "ObjClassSideS_UnidentifiedMovableObject" 8 "ObjClassSideS_UnidentifiedVRU" 7 "ObjClassSideS_UnidentifiedVehicle" 6 "ObjClassSideS_StaticObject" 5 "ObjClassSideS_Pedestrian" 4 "ObjClassSideS_2Wheeler" 3 "ObjClassSideS_HeavyVehicle" 2 "ObjClassSideS_Car" 1 "ObjClassSideS_Obstacle" 0 "ObjClassSideS_Undetermined" ;
VAL_ 791 LRSideSensorObj07_TrackStatus 7 "TrackStatus_NotAvailable" 6 "TrackStatus_Error" 5 "TrackStatus_Spare3" 4 "TrackStatus_Spare2" 3 "TrackStatus_Spare1" 2 "TrackStatus_Invalid" 1 "TrackStatus_Predicted" 0 "TrackStatus_Tracked" ;
VAL_ 791 LRSideSensorObj07_Prioritisation 3 "Prioritisation_NotAvailable" 2 "Prioritisation_StaticPrioritisation" 1 "Prioritisation_VolvoPrioritisation" 0 "Prioritisation_BoschPrioritisation" ;
VAL_ 791 LRSideSensorObj07_ObjDynClass 3 "ObjDynClass_Error" 2 "ObjDynClass_Movable" 1 "ObjDynClass_Stationary" 0 "ObjDynClass_Reserved" ;
VAL_ 790 LRSideSensorObj06_TrackStatus 7 "TrackStatus_NotAvailable" 6 "TrackStatus_Error" 5 "TrackStatus_Spare3" 4 "TrackStatus_Spare2" 3 "TrackStatus_Spare1" 2 "TrackStatus_Invalid" 1 "TrackStatus_Predicted" 0 "TrackStatus_Tracked" ;
VAL_ 790 LRSideSensorObj06_ObjClass 15 "ObjClassSideS_NotAvailable" 14 "ObjClassSideS_Error" 13 "ObjClassSideS_Spare4" 12 "ObjClassSideS_Spare3" 11 "ObjClassSideS_Motorcycle" 10 "ObjClassSideS_Bicycle" 9 "ObjClassSideS_UnidentifiedMovableObject" 8 "ObjClassSideS_UnidentifiedVRU" 7 "ObjClassSideS_UnidentifiedVehicle" 6 "ObjClassSideS_StaticObject" 5 "ObjClassSideS_Pedestrian" 4 "ObjClassSideS_2Wheeler" 3 "ObjClassSideS_HeavyVehicle" 2 "ObjClassSideS_Car" 1 "ObjClassSideS_Obstacle" 0 "ObjClassSideS_Undetermined" ;
VAL_ 790 LRSideSensorObj06_ObjDynClass 3 "ObjDynClass_Error" 2 "ObjDynClass_Movable" 1 "ObjDynClass_Stationary" 0 "ObjDynClass_Reserved" ;
VAL_ 790 LRSideSensorObj06_Prioritisation 3 "Prioritisation_NotAvailable" 2 "Prioritisation_StaticPrioritisation" 1 "Prioritisation_VolvoPrioritisation" 0 "Prioritisation_BoschPrioritisation" ;
VAL_ 789 LRSideSensorObj05_TrackStatus 7 "TrackStatus_NotAvailable" 6 "TrackStatus_Error" 5 "TrackStatus_Spare3" 4 "TrackStatus_Spare2" 3 "TrackStatus_Spare1" 2 "TrackStatus_Invalid" 1 "TrackStatus_Predicted" 0 "TrackStatus_Tracked" ;
VAL_ 789 LRSideSensorObj05_ObjClass 15 "ObjClassSideS_NotAvailable" 14 "ObjClassSideS_Error" 13 "ObjClassSideS_Spare4" 12 "ObjClassSideS_Spare3" 11 "ObjClassSideS_Motorcycle" 10 "ObjClassSideS_Bicycle" 9 "ObjClassSideS_UnidentifiedMovableObject" 8 "ObjClassSideS_UnidentifiedVRU" 7 "ObjClassSideS_UnidentifiedVehicle" 6 "ObjClassSideS_StaticObject" 5 "ObjClassSideS_Pedestrian" 4 "ObjClassSideS_2Wheeler" 3 "ObjClassSideS_HeavyVehicle" 2 "ObjClassSideS_Car" 1 "ObjClassSideS_Obstacle" 0 "ObjClassSideS_Undetermined" ;
VAL_ 789 LRSideSensorObj05_ObjDynClass 3 "ObjDynClass_Error" 2 "ObjDynClass_Movable" 1 "ObjDynClass_Stationary" 0 "ObjDynClass_Reserved" ;
VAL_ 789 LRSideSensorObj05_Prioritisation 3 "Prioritisation_NotAvailable" 2 "Prioritisation_StaticPrioritisation" 1 "Prioritisation_VolvoPrioritisation" 0 "Prioritisation_BoschPrioritisation" ;
VAL_ 788 LRSideSensorObj04_TrackStatus 7 "TrackStatus_NotAvailable" 6 "TrackStatus_Error" 5 "TrackStatus_Spare3" 4 "TrackStatus_Spare2" 3 "TrackStatus_Spare1" 2 "TrackStatus_Invalid" 1 "TrackStatus_Predicted" 0 "TrackStatus_Tracked" ;
VAL_ 788 LRSideSensorObj04_Prioritisation 3 "Prioritisation_NotAvailable" 2 "Prioritisation_StaticPrioritisation" 1 "Prioritisation_VolvoPrioritisation" 0 "Prioritisation_BoschPrioritisation" ;
VAL_ 788 LRSideSensorObj04_ObjDynClass 3 "ObjDynClass_Error" 2 "ObjDynClass_Movable" 1 "ObjDynClass_Stationary" 0 "ObjDynClass_Reserved" ;
VAL_ 788 LRSideSensorObj04_ObjClass 15 "ObjClassSideS_NotAvailable" 14 "ObjClassSideS_Error" 13 "ObjClassSideS_Spare4" 12 "ObjClassSideS_Spare3" 11 "ObjClassSideS_Motorcycle" 10 "ObjClassSideS_Bicycle" 9 "ObjClassSideS_UnidentifiedMovableObject" 8 "ObjClassSideS_UnidentifiedVRU" 7 "ObjClassSideS_UnidentifiedVehicle" 6 "ObjClassSideS_StaticObject" 5 "ObjClassSideS_Pedestrian" 4 "ObjClassSideS_2Wheeler" 3 "ObjClassSideS_HeavyVehicle" 2 "ObjClassSideS_Car" 1 "ObjClassSideS_Obstacle" 0 "ObjClassSideS_Undetermined" ;
VAL_ 787 LRSideSensorObj03_Prioritisation 3 "Prioritisation_NotAvailable" 2 "Prioritisation_StaticPrioritisation" 1 "Prioritisation_VolvoPrioritisation" 0 "Prioritisation_BoschPrioritisation" ;
VAL_ 787 LRSideSensorObj03_TrackStatus 7 "TrackStatus_NotAvailable" 6 "TrackStatus_Error" 5 "TrackStatus_Spare3" 4 "TrackStatus_Spare2" 3 "TrackStatus_Spare1" 2 "TrackStatus_Invalid" 1 "TrackStatus_Predicted" 0 "TrackStatus_Tracked" ;
VAL_ 787 LRSideSensorObj03_ObjClass 15 "ObjClassSideS_NotAvailable" 14 "ObjClassSideS_Error" 13 "ObjClassSideS_Spare4" 12 "ObjClassSideS_Spare3" 11 "ObjClassSideS_Motorcycle" 10 "ObjClassSideS_Bicycle" 9 "ObjClassSideS_UnidentifiedMovableObject" 8 "ObjClassSideS_UnidentifiedVRU" 7 "ObjClassSideS_UnidentifiedVehicle" 6 "ObjClassSideS_StaticObject" 5 "ObjClassSideS_Pedestrian" 4 "ObjClassSideS_2Wheeler" 3 "ObjClassSideS_HeavyVehicle" 2 "ObjClassSideS_Car" 1 "ObjClassSideS_Obstacle" 0 "ObjClassSideS_Undetermined" ;
VAL_ 787 LRSideSensorObj03_ObjDynClass 3 "ObjDynClass_Error" 2 "ObjDynClass_Movable" 1 "ObjDynClass_Stationary" 0 "ObjDynClass_Reserved" ;
VAL_ 786 LRSideSensorObj02_TrackStatus 7 "TrackStatus_NotAvailable" 6 "TrackStatus_Error" 5 "TrackStatus_Spare3" 4 "TrackStatus_Spare2" 3 "TrackStatus_Spare1" 2 "TrackStatus_Invalid" 1 "TrackStatus_Predicted" 0 "TrackStatus_Tracked" ;
VAL_ 786 LRSideSensorObj02_ObjDynClass 3 "ObjDynClass_Error" 2 "ObjDynClass_Movable" 1 "ObjDynClass_Stationary" 0 "ObjDynClass_Reserved" ;
VAL_ 786 LRSideSensorObj02_ObjClass 15 "ObjClassSideS_NotAvailable" 14 "ObjClassSideS_Error" 13 "ObjClassSideS_Spare4" 12 "ObjClassSideS_Spare3" 11 "ObjClassSideS_Motorcycle" 10 "ObjClassSideS_Bicycle" 9 "ObjClassSideS_UnidentifiedMovableObject" 8 "ObjClassSideS_UnidentifiedVRU" 7 "ObjClassSideS_UnidentifiedVehicle" 6 "ObjClassSideS_StaticObject" 5 "ObjClassSideS_Pedestrian" 4 "ObjClassSideS_2Wheeler" 3 "ObjClassSideS_HeavyVehicle" 2 "ObjClassSideS_Car" 1 "ObjClassSideS_Obstacle" 0 "ObjClassSideS_Undetermined" ;
VAL_ 786 LRSideSensorObj02_Prioritisation 3 "Prioritisation_NotAvailable" 2 "Prioritisation_StaticPrioritisation" 1 "Prioritisation_VolvoPrioritisation" 0 "Prioritisation_BoschPrioritisation" ;
VAL_ 785 LRSideSensorObj01_ObjDynClass 3 "ObjDynClass_Error" 2 "ObjDynClass_Movable" 1 "ObjDynClass_Stationary" 0 "ObjDynClass_Reserved" ;
VAL_ 785 LRSideSensorObj01_TrackStatus 7 "TrackStatus_NotAvailable" 6 "TrackStatus_Error" 5 "TrackStatus_Spare3" 4 "TrackStatus_Spare2" 3 "TrackStatus_Spare1" 2 "TrackStatus_Invalid" 1 "TrackStatus_Predicted" 0 "TrackStatus_Tracked" ;
VAL_ 785 LRSideSensorObj01_ObjClass 15 "ObjClassSideS_NotAvailable" 14 "ObjClassSideS_Error" 13 "ObjClassSideS_Spare4" 12 "ObjClassSideS_Spare3" 11 "ObjClassSideS_Motorcycle" 10 "ObjClassSideS_Bicycle" 9 "ObjClassSideS_UnidentifiedMovableObject" 8 "ObjClassSideS_UnidentifiedVRU" 7 "ObjClassSideS_UnidentifiedVehicle" 6 "ObjClassSideS_StaticObject" 5 "ObjClassSideS_Pedestrian" 4 "ObjClassSideS_2Wheeler" 3 "ObjClassSideS_HeavyVehicle" 2 "ObjClassSideS_Car" 1 "ObjClassSideS_Obstacle" 0 "ObjClassSideS_Undetermined" ;
VAL_ 785 LRSideSensorObj01_Prioritisation 3 "Prioritisation_NotAvailable" 2 "Prioritisation_StaticPrioritisation" 1 "Prioritisation_VolvoPrioritisation" 0 "Prioritisation_BoschPrioritisation" ;
VAL_ 784 LRSideSensorObj00_ObjClass 15 "ObjClassSideS_NotAvailable" 14 "ObjClassSideS_Error" 13 "ObjClassSideS_Spare4" 12 "ObjClassSideS_Spare3" 11 "ObjClassSideS_Motorcycle" 10 "ObjClassSideS_Bicycle" 9 "ObjClassSideS_UnidentifiedMovableObject" 8 "ObjClassSideS_UnidentifiedVRU" 7 "ObjClassSideS_UnidentifiedVehicle" 6 "ObjClassSideS_StaticObject" 5 "ObjClassSideS_Pedestrian" 4 "ObjClassSideS_2Wheeler" 3 "ObjClassSideS_HeavyVehicle" 2 "ObjClassSideS_Car" 1 "ObjClassSideS_Obstacle" 0 "ObjClassSideS_Undetermined" ;
VAL_ 784 LRSideSensorObj00_TrackStatus 7 "TrackStatus_NotAvailable" 6 "TrackStatus_Error" 5 "TrackStatus_Spare3" 4 "TrackStatus_Spare2" 3 "TrackStatus_Spare1" 2 "TrackStatus_Invalid" 1 "TrackStatus_Predicted" 0 "TrackStatus_Tracked" ;
VAL_ 784 LRSideSensorObj00_Prioritisation 3 "Prioritisation_NotAvailable" 2 "Prioritisation_StaticPrioritisation" 1 "Prioritisation_VolvoPrioritisation" 0 "Prioritisation_BoschPrioritisation" ;
VAL_ 784 LRSideSensorObj00_ObjDynClass 3 "ObjDynClass_Error" 2 "ObjDynClass_Movable" 1 "ObjDynClass_Stationary" 0 "ObjDynClass_Reserved" ;
VAL_ 799 LRSRRaisedEdge_Type 7 "RaisedEdgeType_NotAvailable" 6 "RaisedEdgeType_Error" 5 "RaisedEdgeType_Spare2" 4 "RaisedEdgeType_Spare1" 3 "RaisedEdgeType_Barrier" 2 "RaisedEdgeType_NonElevatedBoundary" 1 "RaisedEdgeType_ElevatedBoundary" 0 "RaisedEdgeType_Unknown" ;
VAL_ 799 LRSRRaisedEdge_TrackStatus 7 "TrackStatus_NotAvailable" 6 "TrackStatus_Error" 5 "TrackStatus_Spare3" 4 "TrackStatus_Spare2" 3 "TrackStatus_Spare1" 2 "TrackStatus_Invalid" 1 "TrackStatus_Predicted" 0 "TrackStatus_Tracked" ;
VAL_ 844 LFSideSensorTrlrObj_SegTrlrType1 15 "SegTrailerType_NotAvailable" 14 "SegTrailerType_Error" 13 "SegTrailerType_Spare6" 12 "SegTrailerType_Spare5" 11 "SegTrailerType_Spare4" 10 "SegTrailerType_Spare3" 9 "SegTrailerType_Spare2" 8 "SegTrailerType_Spare1" 7 "SegTrailerType_TowingFullTrailer" 6 "SegTrailerType_TowingCentreAxleTrailer" 5 "SegTrailerType_TowingSemiTrailer" 4 "SegTrailerType_LinkTrailer" 3 "SegTrailerType_ConverterDolly" 2 "SegTrailerType_FullTrailer" 1 "SegTrailerType_CentreAxleTrailer" 0 "SegTrailerType_SemiTrailer" ;
VAL_ 844 LFSideSensorTrlrObj_TotLenConf 7 "TotLenConf_NotAvailable" 6 "TotLenConf_Error" 5 "TotLenConf_Spare" 4 "TotLenConf_LessThanPoint1m" 3 "TotLenConf_LessThanPoint5m" 2 "TotLenConf_LessThan1m" 1 "TotLenConf_LessThan3m" 0 "TotLenConf_GreaterThan3m" ;
VAL_ 844 LFSideSensorTrlrObj_SegTrlrType2 15 "SegTrailerType_NotAvailable" 14 "SegTrailerType_Error" 13 "SegTrailerType_Spare6" 12 "SegTrailerType_Spare5" 11 "SegTrailerType_Spare4" 10 "SegTrailerType_Spare3" 9 "SegTrailerType_Spare2" 8 "SegTrailerType_Spare1" 7 "SegTrailerType_TowingFullTrailer" 6 "SegTrailerType_TowingCentreAxleTrailer" 5 "SegTrailerType_TowingSemiTrailer" 4 "SegTrailerType_LinkTrailer" 3 "SegTrailerType_ConverterDolly" 2 "SegTrailerType_FullTrailer" 1 "SegTrailerType_CentreAxleTrailer" 0 "SegTrailerType_SemiTrailer" ;
VAL_ 844 LFSideSensorTrlrObj_SegTrlrType5 15 "SegTrailerType_NotAvailable" 14 "SegTrailerType_Error" 13 "SegTrailerType_Spare6" 12 "SegTrailerType_Spare5" 11 "SegTrailerType_Spare4" 10 "SegTrailerType_Spare3" 9 "SegTrailerType_Spare2" 8 "SegTrailerType_Spare1" 7 "SegTrailerType_TowingFullTrailer" 6 "SegTrailerType_TowingCentreAxleTrailer" 5 "SegTrailerType_TowingSemiTrailer" 4 "SegTrailerType_LinkTrailer" 3 "SegTrailerType_ConverterDolly" 2 "SegTrailerType_FullTrailer" 1 "SegTrailerType_CentreAxleTrailer" 0 "SegTrailerType_SemiTrailer" ;
VAL_ 844 LFSideSensorTrlrObj_SegTrlrType3 15 "SegTrailerType_NotAvailable" 14 "SegTrailerType_Error" 13 "SegTrailerType_Spare6" 12 "SegTrailerType_Spare5" 11 "SegTrailerType_Spare4" 10 "SegTrailerType_Spare3" 9 "SegTrailerType_Spare2" 8 "SegTrailerType_Spare1" 7 "SegTrailerType_TowingFullTrailer" 6 "SegTrailerType_TowingCentreAxleTrailer" 5 "SegTrailerType_TowingSemiTrailer" 4 "SegTrailerType_LinkTrailer" 3 "SegTrailerType_ConverterDolly" 2 "SegTrailerType_FullTrailer" 1 "SegTrailerType_CentreAxleTrailer" 0 "SegTrailerType_SemiTrailer" ;
VAL_ 844 LFSideSensorTrlrObj_SegTrlrType4 15 "SegTrailerType_NotAvailable" 14 "SegTrailerType_Error" 13 "SegTrailerType_Spare6" 12 "SegTrailerType_Spare5" 11 "SegTrailerType_Spare4" 10 "SegTrailerType_Spare3" 9 "SegTrailerType_Spare2" 8 "SegTrailerType_Spare1" 7 "SegTrailerType_TowingFullTrailer" 6 "SegTrailerType_TowingCentreAxleTrailer" 5 "SegTrailerType_TowingSemiTrailer" 4 "SegTrailerType_LinkTrailer" 3 "SegTrailerType_ConverterDolly" 2 "SegTrailerType_FullTrailer" 1 "SegTrailerType_CentreAxleTrailer" 0 "SegTrailerType_SemiTrailer" ;
VAL_ 843 LFSideSensorObj11_Prioritisation 3 "Prioritisation_NotAvailable" 2 "Prioritisation_StaticPrioritisation" 1 "Prioritisation_VolvoPrioritisation" 0 "Prioritisation_BoschPrioritisation" ;
VAL_ 843 LFSideSensorObj11_ObjDynClass 3 "ObjDynClass_Error" 2 "ObjDynClass_Movable" 1 "ObjDynClass_Stationary" 0 "ObjDynClass_Reserved" ;
VAL_ 843 LFSideSensorObj11_ObjClass 15 "ObjClassSideS_NotAvailable" 14 "ObjClassSideS_Error" 13 "ObjClassSideS_Spare4" 12 "ObjClassSideS_Spare3" 11 "ObjClassSideS_Motorcycle" 10 "ObjClassSideS_Bicycle" 9 "ObjClassSideS_UnidentifiedMovableObject" 8 "ObjClassSideS_UnidentifiedVRU" 7 "ObjClassSideS_UnidentifiedVehicle" 6 "ObjClassSideS_StaticObject" 5 "ObjClassSideS_Pedestrian" 4 "ObjClassSideS_2Wheeler" 3 "ObjClassSideS_HeavyVehicle" 2 "ObjClassSideS_Car" 1 "ObjClassSideS_Obstacle" 0 "ObjClassSideS_Undetermined" ;
VAL_ 843 LFSideSensorObj11_TrackStatus 7 "TrackStatus_NotAvailable" 6 "TrackStatus_Error" 5 "TrackStatus_Spare3" 4 "TrackStatus_Spare2" 3 "TrackStatus_Spare1" 2 "TrackStatus_Invalid" 1 "TrackStatus_Predicted" 0 "TrackStatus_Tracked" ;
SIG_GROUP_ 796 LRSideSensorTrlrObj_sg 1 : LRSideSensorTrlrObj_SegTrlrType3 LRSideSensorTrlrObj_TrlAnglConf LRSideSensorTrlrObj_TrlrTypeConf LRSideSensorTrlrObj_Seg1Length LRSideSensorTrlrObj_SegTrlrType5 LRSideSensorTrlrObj_SegAngle1 LRSideSensorTrlrObj_Seg4Length LRSideSensorTrlrObj_WheelBased1 LRSideSensorTrlrObj_SegTrlrType1 LRSideSensorTrlrObj_Seg5Length LRSideSensorTrlrObj_WheelBased2 LRSideSensorTrlrObj_WheelBased3 LRSideSensorTrlrObj_WheelBased5 LRSideSensorTrlrObj_SegTrlrType4 LRSideSensorTrlrObj_Seg3Length LRSideSensorTrlrObj_SegTrlrType2 LRSideSensorTrlrObj_TotLenConf LRSideSensorTrlrObj_WheelBased4 LRSideSensorTrlrObj_TotalLength LRSideSensorTrlrObj_WhlBasedConf LRSideSensorTrlrObj_SegAngle5 LRSideSensorTrlrObj_SegAngle3 LRSideSensorTrlrObj_SegAngle2 LRSideSensorTrlrObj_SegAngle4 LRSideSensorTrlrObj_Seg2Length;
SIG_GROUP_ 795 LRSideSensorObj11_sg 1 : LRSideSensorObj11_LatExtLeftVar LRSideSensorObj11_CRC LRSideSensorObj11_CoastIndex LRSideSensorObj11_LatPosVar LRSideSensorObj11_LongExtBkVar LRSideSensorObj11_LongExtBack LRSideSensorObj11_ObstacleConf LRSideSensorObj11_MOISPrio LRSideSensorObj11_LongAccVar LRSideSensorObj11_LifeTime LRSideSensorObj11_Height LRSideSensorObj11_LongExtFrVar LRSideSensorObj11_ObjDynClass LRSideSensorObj11_Prioritisation LRSideSensorObj11_LongAcc LRSideSensorObj11_LatVelVar LRSideSensorObj11_LongPosVar LRSideSensorObj11_LatExtRight LRSideSensorObj11_LongPos LRSideSensorObj11_HeadingVar LRSideSensorObj11_Counter LRSideSensorObj11_LatPos LRSideSensorObj11_TimeStamp LRSideSensorObj11_ObjClassConf LRSideSensorObj11_LatExtRtVar LRSideSensorObj11_ExistConf LRSideSensorObj11_LatExtLeft LRSideSensorObj11_LatAccVar LRSideSensorObj11_ObjID LRSideSensorObj11_LatVel LRSideSensorObj11_LatAcc LRSideSensorObj11_LongVel LRSideSensorObj11_Heading LRSideSensorObj11_LongExtFront LRSideSensorObj11_LongVelVar LRSideSensorObj11_TrackStatus LRSideSensorObj11_ObjClass;
SIG_GROUP_ 794 LRSideSensorObj10_sg 1 : LRSideSensorObj10_LifeTime LRSideSensorObj10_LongPos LRSideSensorObj10_LatPosVar LRSideSensorObj10_LatVel LRSideSensorObj10_LatPos LRSideSensorObj10_HeadingVar LRSideSensorObj10_LatExtRight LRSideSensorObj10_Height LRSideSensorObj10_TrackStatus LRSideSensorObj10_ExistConf LRSideSensorObj10_LatExtRtVar LRSideSensorObj10_CRC LRSideSensorObj10_LatExtLeft LRSideSensorObj10_LatAccVar LRSideSensorObj10_Heading LRSideSensorObj10_LongExtBack LRSideSensorObj10_ObstacleConf LRSideSensorObj10_ObjID LRSideSensorObj10_LongAcc LRSideSensorObj10_LongExtFront LRSideSensorObj10_LatAcc LRSideSensorObj10_LongVelVar LRSideSensorObj10_LongVel LRSideSensorObj10_LongExtFrVar LRSideSensorObj10_LongExtBkVar LRSideSensorObj10_LongPosVar LRSideSensorObj10_Prioritisation LRSideSensorObj10_ObjClassConf LRSideSensorObj10_TimeStamp LRSideSensorObj10_MOISPrio LRSideSensorObj10_LatExtLeftVar LRSideSensorObj10_LatVelVar LRSideSensorObj10_ObjClass LRSideSensorObj10_Counter LRSideSensorObj10_LongAccVar LRSideSensorObj10_CoastIndex LRSideSensorObj10_ObjDynClass;
SIG_GROUP_ 793 LRSideSensorObj09_sg 1 : LRSideSensorObj09_LongExtFrVar LRSideSensorObj09_LongExtBack LRSideSensorObj09_LatExtRtVar LRSideSensorObj09_CRC LRSideSensorObj09_LatExtLeft LRSideSensorObj09_LatExtRight LRSideSensorObj09_LatVelVar LRSideSensorObj09_ObjID LRSideSensorObj09_ObjDynClass LRSideSensorObj09_MOISPrio LRSideSensorObj09_LongVel LRSideSensorObj09_HeadingVar LRSideSensorObj09_LongExtBkVar LRSideSensorObj09_LatAccVar LRSideSensorObj09_LatPos LRSideSensorObj09_TimeStamp LRSideSensorObj09_LatAcc LRSideSensorObj09_LatPosVar LRSideSensorObj09_LongAcc LRSideSensorObj09_LatVel LRSideSensorObj09_ObstacleConf LRSideSensorObj09_TrackStatus LRSideSensorObj09_LatExtLeftVar LRSideSensorObj09_LifeTime LRSideSensorObj09_LongExtFront LRSideSensorObj09_LongAccVar LRSideSensorObj09_LongPos LRSideSensorObj09_LongVelVar LRSideSensorObj09_ObjClass LRSideSensorObj09_ExistConf LRSideSensorObj09_Prioritisation LRSideSensorObj09_Heading LRSideSensorObj09_Height LRSideSensorObj09_ObjClassConf LRSideSensorObj09_LongPosVar LRSideSensorObj09_CoastIndex LRSideSensorObj09_Counter;
SIG_GROUP_ 792 LRSideSensorObj08_sg 1 : LRSideSensorObj08_ObjDynClass LRSideSensorObj08_LatExtRight LRSideSensorObj08_CRC LRSideSensorObj08_Counter LRSideSensorObj08_LatPos LRSideSensorObj08_LongVelVar LRSideSensorObj08_LatVel LRSideSensorObj08_LatAccVar LRSideSensorObj08_LongAcc LRSideSensorObj08_CoastIndex LRSideSensorObj08_LatVelVar LRSideSensorObj08_ObjClassConf LRSideSensorObj08_Prioritisation LRSideSensorObj08_LongExtFrVar LRSideSensorObj08_ObjID LRSideSensorObj08_HeadingVar LRSideSensorObj08_LatAcc LRSideSensorObj08_LongPos LRSideSensorObj08_LongPosVar LRSideSensorObj08_LatExtLeft LRSideSensorObj08_LongExtBkVar LRSideSensorObj08_TrackStatus LRSideSensorObj08_LongAccVar LRSideSensorObj08_LatPosVar LRSideSensorObj08_LongVel LRSideSensorObj08_ObstacleConf LRSideSensorObj08_LifeTime LRSideSensorObj08_LongExtFront LRSideSensorObj08_TimeStamp LRSideSensorObj08_LongExtBack LRSideSensorObj08_LatExtLeftVar LRSideSensorObj08_LatExtRtVar LRSideSensorObj08_Heading LRSideSensorObj08_ExistConf LRSideSensorObj08_MOISPrio LRSideSensorObj08_ObjClass LRSideSensorObj08_Height;
SIG_GROUP_ 791 LRSideSensorObj07_sg 1 : LRSideSensorObj07_CRC LRSideSensorObj07_ObjID LRSideSensorObj07_ObjClassConf LRSideSensorObj07_LongExtFrVar LRSideSensorObj07_MOISPrio LRSideSensorObj07_LatExtRight LRSideSensorObj07_Counter LRSideSensorObj07_LongPosVar LRSideSensorObj07_CoastIndex LRSideSensorObj07_Height LRSideSensorObj07_LifeTime LRSideSensorObj07_Heading LRSideSensorObj07_LatPos LRSideSensorObj07_LongVelVar LRSideSensorObj07_ObstacleConf LRSideSensorObj07_LongPos LRSideSensorObj07_LongExtFront LRSideSensorObj07_LongAccVar LRSideSensorObj07_LatExtLeft LRSideSensorObj07_LatPosVar LRSideSensorObj07_LongVel LRSideSensorObj07_LatVelVar LRSideSensorObj07_LatExtLeftVar LRSideSensorObj07_TimeStamp LRSideSensorObj07_LatVel LRSideSensorObj07_LatAcc LRSideSensorObj07_LongAcc LRSideSensorObj07_LatAccVar LRSideSensorObj07_ObjClass LRSideSensorObj07_TrackStatus LRSideSensorObj07_LongExtBkVar LRSideSensorObj07_HeadingVar LRSideSensorObj07_LatExtRtVar LRSideSensorObj07_Prioritisation LRSideSensorObj07_LongExtBack LRSideSensorObj07_ObjDynClass LRSideSensorObj07_ExistConf;
SIG_GROUP_ 790 LRSideSensorObj06_sg 1 : LRSideSensorObj06_LongExtFrVar LRSideSensorObj06_LongExtBack LRSideSensorObj06_Counter LRSideSensorObj06_LongVel LRSideSensorObj06_HeadingVar LRSideSensorObj06_LatPosVar LRSideSensorObj06_LatExtLeftVar LRSideSensorObj06_LatVel LRSideSensorObj06_TrackStatus LRSideSensorObj06_ObjClass LRSideSensorObj06_ObstacleConf LRSideSensorObj06_LatExtRtVar LRSideSensorObj06_LongAccVar LRSideSensorObj06_CoastIndex LRSideSensorObj06_LongAcc LRSideSensorObj06_ObjDynClass LRSideSensorObj06_LatExtRight LRSideSensorObj06_ExistConf LRSideSensorObj06_Prioritisation LRSideSensorObj06_LongExtFront LRSideSensorObj06_LatExtLeft LRSideSensorObj06_ObjClassConf LRSideSensorObj06_Height LRSideSensorObj06_TimeStamp LRSideSensorObj06_MOISPrio LRSideSensorObj06_Heading LRSideSensorObj06_LatPos LRSideSensorObj06_CRC LRSideSensorObj06_LifeTime LRSideSensorObj06_ObjID LRSideSensorObj06_LongVelVar LRSideSensorObj06_LatAccVar LRSideSensorObj06_LongPosVar LRSideSensorObj06_LongPos LRSideSensorObj06_LongExtBkVar LRSideSensorObj06_LatAcc LRSideSensorObj06_LatVelVar;
SIG_GROUP_ 789 LRSideSensorObj05_sg 1 : LRSideSensorObj05_LongAcc LRSideSensorObj05_TrackStatus LRSideSensorObj05_LatExtLeftVar LRSideSensorObj05_LatExtRight LRSideSensorObj05_ObjID LRSideSensorObj05_ObjClass LRSideSensorObj05_ObjClassConf LRSideSensorObj05_LifeTime LRSideSensorObj05_LatPosVar LRSideSensorObj05_LongVel LRSideSensorObj05_LongAccVar LRSideSensorObj05_ObjDynClass LRSideSensorObj05_LatPos LRSideSensorObj05_ExistConf LRSideSensorObj05_Heading LRSideSensorObj05_MOISPrio LRSideSensorObj05_ObstacleConf LRSideSensorObj05_HeadingVar LRSideSensorObj05_LongVelVar LRSideSensorObj05_Prioritisation LRSideSensorObj05_LongPos LRSideSensorObj05_Height LRSideSensorObj05_LatExtLeft LRSideSensorObj05_LatAcc LRSideSensorObj05_LongExtFront LRSideSensorObj05_Counter LRSideSensorObj05_LatAccVar LRSideSensorObj05_LongPosVar LRSideSensorObj05_CRC LRSideSensorObj05_LatVel LRSideSensorObj05_TimeStamp LRSideSensorObj05_CoastIndex LRSideSensorObj05_LatVelVar LRSideSensorObj05_LatExtRtVar LRSideSensorObj05_LongExtBkVar LRSideSensorObj05_LongExtBack LRSideSensorObj05_LongExtFrVar;
SIG_GROUP_ 788 LRSideSensorObj04_sg 1 : LRSideSensorObj04_TrackStatus LRSideSensorObj04_HeadingVar LRSideSensorObj04_Prioritisation LRSideSensorObj04_LongVel LRSideSensorObj04_ObstacleConf LRSideSensorObj04_TimeStamp LRSideSensorObj04_ObjDynClass LRSideSensorObj04_Heading LRSideSensorObj04_LatAccVar LRSideSensorObj04_LongAcc LRSideSensorObj04_ExistConf LRSideSensorObj04_LatAcc LRSideSensorObj04_LongPos LRSideSensorObj04_LatPos LRSideSensorObj04_LongPosVar LRSideSensorObj04_ObjClassConf LRSideSensorObj04_LongAccVar LRSideSensorObj04_LongExtFrVar LRSideSensorObj04_LatExtLeftVar LRSideSensorObj04_LatExtRtVar LRSideSensorObj04_LatVelVar LRSideSensorObj04_CoastIndex LRSideSensorObj04_LatPosVar LRSideSensorObj04_CRC LRSideSensorObj04_LatVel LRSideSensorObj04_LongExtBack LRSideSensorObj04_ObjID LRSideSensorObj04_LifeTime LRSideSensorObj04_ObjClass LRSideSensorObj04_LongExtFront LRSideSensorObj04_Counter LRSideSensorObj04_LongExtBkVar LRSideSensorObj04_LatExtRight LRSideSensorObj04_MOISPrio LRSideSensorObj04_Height LRSideSensorObj04_LatExtLeft LRSideSensorObj04_LongVelVar;
SIG_GROUP_ 787 LRSideSensorObj03_sg 1 : LRSideSensorObj03_TimeStamp LRSideSensorObj03_CRC LRSideSensorObj03_LatPos LRSideSensorObj03_ExistConf LRSideSensorObj03_Prioritisation LRSideSensorObj03_LatAccVar LRSideSensorObj03_LatVelVar LRSideSensorObj03_CoastIndex LRSideSensorObj03_LongExtBack LRSideSensorObj03_TrackStatus LRSideSensorObj03_Height LRSideSensorObj03_ObjClassConf LRSideSensorObj03_ObjClass LRSideSensorObj03_LongExtFrVar LRSideSensorObj03_HeadingVar LRSideSensorObj03_Heading LRSideSensorObj03_LongAccVar LRSideSensorObj03_LongAcc LRSideSensorObj03_LatExtRight LRSideSensorObj03_LongPosVar LRSideSensorObj03_ObstacleConf LRSideSensorObj03_ObjID LRSideSensorObj03_LatExtLeft LRSideSensorObj03_LatExtLeftVar LRSideSensorObj03_LongVelVar LRSideSensorObj03_LongExtFront LRSideSensorObj03_LatPosVar LRSideSensorObj03_ObjDynClass LRSideSensorObj03_LongExtBkVar LRSideSensorObj03_LatVel LRSideSensorObj03_Counter LRSideSensorObj03_LatExtRtVar LRSideSensorObj03_MOISPrio LRSideSensorObj03_LongPos LRSideSensorObj03_LatAcc LRSideSensorObj03_LifeTime LRSideSensorObj03_LongVel;
SIG_GROUP_ 786 LRSideSensorObj02_sg 1 : LRSideSensorObj02_Heading LRSideSensorObj02_LatExtLeftVar LRSideSensorObj02_LatPosVar LRSideSensorObj02_LongVel LRSideSensorObj02_LongExtFrVar LRSideSensorObj02_MOISPrio LRSideSensorObj02_LatVel LRSideSensorObj02_CoastIndex LRSideSensorObj02_LongVelVar LRSideSensorObj02_TrackStatus LRSideSensorObj02_LongExtBkVar LRSideSensorObj02_LongExtFront LRSideSensorObj02_LongPosVar LRSideSensorObj02_LongPos LRSideSensorObj02_LatExtRtVar LRSideSensorObj02_LatExtRight LRSideSensorObj02_LongAccVar LRSideSensorObj02_CRC LRSideSensorObj02_ObstacleConf LRSideSensorObj02_ObjID LRSideSensorObj02_ObjDynClass LRSideSensorObj02_LongAcc LRSideSensorObj02_Counter LRSideSensorObj02_LatVelVar LRSideSensorObj02_LatExtLeft LRSideSensorObj02_LatPos LRSideSensorObj02_ObjClassConf LRSideSensorObj02_TimeStamp LRSideSensorObj02_LongExtBack LRSideSensorObj02_LatAcc LRSideSensorObj02_ObjClass LRSideSensorObj02_Prioritisation LRSideSensorObj02_HeadingVar LRSideSensorObj02_LatAccVar LRSideSensorObj02_LifeTime LRSideSensorObj02_Height LRSideSensorObj02_ExistConf;
SIG_GROUP_ 785 LRSideSensorObj01_sg 1 : LRSideSensorObj01_LongExtFrVar LRSideSensorObj01_MOISPrio LRSideSensorObj01_LongExtBkVar LRSideSensorObj01_LatPosVar LRSideSensorObj01_Counter LRSideSensorObj01_ObjClassConf LRSideSensorObj01_ExistConf LRSideSensorObj01_ObjDynClass LRSideSensorObj01_CRC LRSideSensorObj01_LongExtFront LRSideSensorObj01_LongPosVar LRSideSensorObj01_Heading LRSideSensorObj01_ObjID LRSideSensorObj01_CoastIndex LRSideSensorObj01_LatExtLeftVar LRSideSensorObj01_LongPos LRSideSensorObj01_TrackStatus LRSideSensorObj01_LatExtRight LRSideSensorObj01_LatPos LRSideSensorObj01_TimeStamp LRSideSensorObj01_LatVel LRSideSensorObj01_LongExtBack LRSideSensorObj01_LatExtLeft LRSideSensorObj01_Height LRSideSensorObj01_HeadingVar LRSideSensorObj01_LongVelVar LRSideSensorObj01_ObjClass LRSideSensorObj01_LifeTime LRSideSensorObj01_LongAcc LRSideSensorObj01_LongVel LRSideSensorObj01_LatVelVar LRSideSensorObj01_Prioritisation LRSideSensorObj01_LatExtRtVar LRSideSensorObj01_LatAccVar LRSideSensorObj01_LongAccVar LRSideSensorObj01_LatAcc LRSideSensorObj01_ObstacleConf;
SIG_GROUP_ 784 LRSideSensorObj00_sg 1 : LRSideSensorObj00_TimeStamp LRSideSensorObj00_LatPos LRSideSensorObj00_ObjClass LRSideSensorObj00_LongPosVar LRSideSensorObj00_LongVel LRSideSensorObj00_ExistConf LRSideSensorObj00_LatVelVar LRSideSensorObj00_LongAcc LRSideSensorObj00_LatVel LRSideSensorObj00_ObstacleConf LRSideSensorObj00_HeadingVar LRSideSensorObj00_LatExtLeft LRSideSensorObj00_LongPos LRSideSensorObj00_LatAcc LRSideSensorObj00_ObjID LRSideSensorObj00_LatExtLeftVar LRSideSensorObj00_TrackStatus LRSideSensorObj00_CoastIndex LRSideSensorObj00_Prioritisation LRSideSensorObj00_LifeTime LRSideSensorObj00_ObjDynClass LRSideSensorObj00_LongVelVar LRSideSensorObj00_LongExtFrVar LRSideSensorObj00_Heading LRSideSensorObj00_LongExtFront LRSideSensorObj00_ObjClassConf LRSideSensorObj00_LatPosVar LRSideSensorObj00_Height LRSideSensorObj00_LatAccVar LRSideSensorObj00_Counter LRSideSensorObj00_LongAccVar LRSideSensorObj00_MOISPrio LRSideSensorObj00_LongExtBack LRSideSensorObj00_LongExtBkVar LRSideSensorObj00_LatExtRtVar LRSideSensorObj00_LatExtRight LRSideSensorObj00_CRC;
SIG_GROUP_ 1553 LRSRSwVersion_sg 1 : LRSRSwVersion_Substring1 LRSRSwVersion_Substring2 LRSRSwVersion_Substring3 LRSRSwVersion_Substring7 LRSRSwVersion_Substring6 LRSRSwVersion_Substring4 LRSRSwVersion_Substring5 LRSRSwVersion_Substring0;
SIG_GROUP_ 799 LRSRRaisedEdge_sg 1 : LRSRRaisedEdge_Type LRSRRaisedEdge_TrackStatus LRSRRaisedEdge_DxEnd LRSRRaisedEdge_Curvature LRSRRaisedEdge_Confidence LRSRRaisedEdge_Counter LRSRRaisedEdge_LatDistVar LRSRRaisedEdge_LifeTime LRSRRaisedEdge_LatDist LRSRRaisedEdge_CRC LRSRRaisedEdge_CurvatureRate LRSRRaisedEdge_DxStart LRSRRaisedEdge_HeadingAngle LRSRRaisedEdge_TimeStamp LRSRRaisedEdge_CoastIndex;
SIG_GROUP_ 798 LRSREgoAssumpt_sg 1 : LRSREgoAssumpt_EgoLongVel LRSREgoAssumpt_EgoRoadHeading LRSREgoAssumpt_EgoRoadCurvature LRSREgoAssumpt_EgoLongAcc LRSREgoAssumpt_EgoRoadCurvRate LRSREgoAssumpt_VelCorrFactor LRSREgoAssumpt_EgoRoadEnd LRSREgoAssumpt_EgoYawRate LRSREgoAssumpt_TimeStamp;
SIG_GROUP_ 844 LFSideSensorTrlrObj_sg 1 : LFSideSensorTrlrObj_SegTrlrType1 LFSideSensorTrlrObj_SegAngle3 LFSideSensorTrlrObj_Seg1Length LFSideSensorTrlrObj_TotalLength LFSideSensorTrlrObj_Seg5Length LFSideSensorTrlrObj_SegAngle5 LFSideSensorTrlrObj_SegAngle1 LFSideSensorTrlrObj_Seg4Length LFSideSensorTrlrObj_SegAngle4 LFSideSensorTrlrObj_WhlBasedConf LFSideSensorTrlrObj_TotLenConf LFSideSensorTrlrObj_TrlAnglConf LFSideSensorTrlrObj_WheelBased1 LFSideSensorTrlrObj_SegTrlrType2 LFSideSensorTrlrObj_WheelBased5 LFSideSensorTrlrObj_SegTrlrType5 LFSideSensorTrlrObj_TrlrTypeConf LFSideSensorTrlrObj_WheelBased2 LFSideSensorTrlrObj_Seg2Length LFSideSensorTrlrObj_WheelBased4 LFSideSensorTrlrObj_WheelBased3 LFSideSensorTrlrObj_SegTrlrType3 LFSideSensorTrlrObj_SegAngle2 LFSideSensorTrlrObj_Seg3Length LFSideSensorTrlrObj_SegTrlrType4;
SIG_GROUP_ 843 LFSideSensorObj11_sg 1 : LFSideSensorObj11_ExistConf LFSideSensorObj11_LifeTime LFSideSensorObj11_ObjClassConf LFSideSensorObj11_Prioritisation LFSideSensorObj11_LatVel LFSideSensorObj11_ObjDynClass LFSideSensorObj11_LongPos LFSideSensorObj11_MOISPrio LFSideSensorObj11_Heading LFSideSensorObj11_Height LFSideSensorObj11_LatExtLeft LFSideSensorObj11_LongVel LFSideSensorObj11_LongVelVar LFSideSensorObj11_LatPos LFSideSensorObj11_LatPosVar LFSideSensorObj11_ObjClass LFSideSensorObj11_LongExtBkVar LFSideSensorObj11_ObjID LFSideSensorObj11_LatAccVar LFSideSensorObj11_LatExtRtVar LFSideSensorObj11_LongAcc LFSideSensorObj11_Counter LFSideSensorObj11_ObstacleConf LFSideSensorObj11_CRC LFSideSensorObj11_LatExtRight LFSideSensorObj11_LongExtFrVar LFSideSensorObj11_LongExtBack LFSideSensorObj11_LongPosVar LFSideSensorObj11_LatExtLeftVar LFSideSensorObj11_HeadingVar LFSideSensorObj11_LatAcc LFSideSensorObj11_TimeStamp LFSideSensorObj11_LongExtFront LFSideSensorObj11_CoastIndex LFSideSensorObj11_LatVelVar LFSideSensorObj11_LongAccVar LFSideSensorObj11_TrackStatus;
