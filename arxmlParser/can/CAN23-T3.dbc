VERSION ""

NS_ :

BS_:

BU_: SR_RR SR_RF SR_LR SR_LF DACU

BO_ 816 RRSideSensorObj00: 48 SR_RR
 SG_ RRSideSensorObj00_ObjID : 160|6@1+ (1,0) [0|63] "NotApplicable"  VCM
 SG_ RRSideSensorObj00_ObstacleConf : 300|7@1+ (0.01,0) [0|1.27] "NotApplicable"  VCM
 SG_ RRSideSensorObj00_ObjClass : 292|4@1+ (1,0) [0|0] ""  VCM
 SG_ RRSideSensorObj00_TrackStatus : 192|3@1+ (1,0) [0|0] ""  VCM
 SG_ RRSideSensorObj00_LongPosVar : 48|8@1+ (0.01,0) [0|2.55] "NotApplicable"  VCM
 SG_ RRSideSensorObj00_LongExtBack : 257|10@1+ (0.05,-50) [-50|1.15000000000001] "m"  VCM
 SG_ RRSideSensorObj00_LatPos : 221|13@1+ (0.05,-180) [-180|229.55] "m"  VCM
 SG_ RRSideSensorObj00_LongAccVar : 72|8@1+ (0.1,0) [0|25.5] "NotApplicable"  VCM
 SG_ RRSideSensorObj00_LatExtRight : 185|7@1+ (0.05,-5) [-5|1.35] "m"  VCM
 SG_ RRSideSensorObj00_LatVelVar : 80|8@1+ (0.01,0) [0|2.55] "NotApplicable"  VCM
 SG_ RRSideSensorObj00_CRC : 0|16@1+ (1,0) [0|65535] "NotApplicable"  VCM
 SG_ RRSideSensorObj00_MOISPrio : 307|1@1+ (1,0) [0|0] ""  VCM
 SG_ RRSideSensorObj00_ObjClassConf : 296|4@1+ (0.1,0) [0|1.5] "NotApplicable"  VCM
 SG_ RRSideSensorObj00_LatAcc : 267|9@1+ (0.08,-20) [-20|20.88] "m_per_s_squared"  VCM
 SG_ RRSideSensorObj00_LatExtRtVar : 96|8@1+ (0.1,0) [0|25.5] "NotApplicable"  VCM
 SG_ RRSideSensorObj00_LongPos : 234|13@1+ (0.05,-180) [-180|229.55] "m"  VCM
 SG_ RRSideSensorObj00_Height : 168|8@1+ (0.02,0) [0|5.1] "m"  VCM
 SG_ RRSideSensorObj00_TimeStamp : 24|16@1+ (0.1,0) [0|6553.5] "ms"  VCM
 SG_ RRSideSensorObj00_LongExtFrVar : 56|8@1+ (0.1,0) [0|25.5] "NotApplicable"  VCM
 SG_ RRSideSensorObj00_CoastIndex : 155|5@1+ (1,0) [0|31] "NotApplicable"  VCM
 SG_ RRSideSensorObj00_LatExtLeft : 276|7@1+ (0.05,0) [0|6.35] "m"  VCM
 SG_ RRSideSensorObj00_Counter : 16|8@1+ (1,0) [0|255] "Count"  VCM
 SG_ RRSideSensorObj00_ExistConf : 283|7@1+ (0.01,0) [0|1.27] "NotApplicable"  VCM
 SG_ RRSideSensorObj00_LatVel : 208|13@1+ (0.032,-80) [-80|182.112] "m_per_s"  VCM
 SG_ RRSideSensorObj00_LongAcc : 176|9@1+ (0.08,-20) [-20|20.88] "m_per_s_squared"  VCM
 SG_ RRSideSensorObj00_HeadingVar : 120|8@1+ (0.001,0) [0|0.255] "NotApplicable"  VCM
 SG_ RRSideSensorObj00_LatExtLeftVar : 104|8@1+ (0.1,0) [0|25.5] "NotApplicable"  VCM
 SG_ RRSideSensorObj00_LifeTime : 128|16@1+ (0.1,0) [0|6553.5] "s"  VCM
 SG_ RRSideSensorObj00_LatPosVar : 88|8@1+ (0.1,0) [0|25.5] "NotApplicable"  VCM
 SG_ RRSideSensorObj00_LongExtFront : 247|10@1+ (0.05,0) [0|51.15] "m"  VCM
 SG_ RRSideSensorObj00_Heading : 144|11@1+ (0.005818,-4.71) [-4.71|7.199446] "rad"  VCM
 SG_ RRSideSensorObj00_Prioritisation : 290|2@1+ (1,0) [0|0] ""  VCM
 SG_ RRSideSensorObj00_LatAccVar : 112|8@1+ (0.1,0) [0|25.5] "NotApplicable"  VCM
 SG_ RRSideSensorObj00_LongExtBkVar : 64|8@1+ (0.1,0) [0|25.5] "NotApplicable"  VCM
 SG_ RRSideSensorObj00_LongVel : 195|13@1+ (0.032,-80) [-80|182.112] "m_per_s"  VCM
 SG_ RRSideSensorObj00_ObjDynClass : 166|2@1+ (1,0) [0|0] ""  VCM
 SG_ RRSideSensorObj00_LongVelVar : 40|8@1+ (0.01,0) [0|2.55] "NotApplicable"  VCM

BO_ 1555 RRSRSwVersion_Vic4: 64 SR_RR
 SG_ RRSRSwVersion_Substring0 : 0|64@1+ (1,0) [0|0] ""  VCM
 SG_ RRSRSwVersion_Substring4 : 256|64@1+ (1,0) [0|0] ""  VCM
 SG_ RRSRSwVersion_Substring1 : 64|64@1+ (1,0) [0|0] ""  VCM
 SG_ RRSRSwVersion_Substring7 : 448|64@1+ (1,0) [0|0] ""  VCM
 SG_ RRSRSwVersion_Substring2 : 128|64@1+ (1,0) [0|0] ""  VCM
 SG_ RRSRSwVersion_Substring3 : 192|64@1+ (1,0) [0|0] ""  VCM
 SG_ RRSRSwVersion_Substring5 : 320|64@1+ (1,0) [0|0] ""  VCM
 SG_ RRSRSwVersion_Substring6 : 384|64@1+ (1,0) [0|0] ""  VCM

BO_ 831 RRSRRaisedEdge_Vic4: 20 SR_RR
 SG_ RRSRRaisedEdge_LifeTime : 136|16@1+ (0.1,0) [0|6553.5] "s"  VCM
 SG_ RRSRRaisedEdge_CRC : 0|16@1+ (1,0) [0|65535] "NotApplicable"  VCM
 SG_ RRSRRaisedEdge_HeadingAngle : 80|13@1+ (0.0005,-1.57) [-1.57|2.5255] "rad"  VCM
 SG_ RRSRRaisedEdge_Type : 133|3@1+ (1,0) [0|0] ""  VCM
 SG_ RRSRRaisedEdge_DxStart : 40|8@1+ (1,0) [0|255] "m"  VCM
 SG_ RRSRRaisedEdge_TimeStamp : 24|16@1+ (0.1,0) [0|6553.5] "ms"  VCM
 SG_ RRSRRaisedEdge_Confidence : 126|7@1+ (0.01,0) [0|1.27] "NotApplicable"  VCM
 SG_ RRSRRaisedEdge_DxEnd : 56|8@1+ (1,0) [0|255] "m"  VCM
 SG_ RRSRRaisedEdge_LatDistVar : 48|8@1+ (0.001,0) [0|0.255] "NotApplicable"  VCM
 SG_ RRSRRaisedEdge_CoastIndex : 75|5@1+ (1,0) [0|31] "NotApplicable"  VCM
 SG_ RRSRRaisedEdge_LatDist : 114|12@1+ (0.005,-10) [-10|10.475] "m"  VCM
 SG_ RRSRRaisedEdge_Counter : 16|8@1+ (1,0) [0|255] "Count"  VCM
 SG_ RRSRRaisedEdge_CurvatureRate : 64|11@1+ (5.1E-007,-0.000516) [-0.000516|0.00052797] "per_meter_squared"  VCM
 SG_ RRSRRaisedEdge_TrackStatus : 93|3@1+ (1,0) [0|0] ""  VCM
 SG_ RRSRRaisedEdge_Curvature : 96|18@1+ (1E-006,-0.1310705) [-0.1310705|0.1310725] "per_meter"  VCM

BO_ 830 RRSREgoAssumpt_Vic4: 16 SR_RR
 SG_ RRSREgoAssumpt_EgoYawRate : 32|16@1+ (0.000122,-3.92) [-3.92|4.07527] "Rad_per_s"  VCM
 SG_ RRSREgoAssumpt_EgoRoadEnd : 72|8@1+ (1,0) [0|255] "m"  VCM
 SG_ RRSREgoAssumpt_EgoRoadHeading : 80|13@1+ (0.0005,-1.57) [-1.57|2.5255] "rad"  VCM
 SG_ RRSREgoAssumpt_EgoRoadCurvRate : 93|11@1+ (5.1E-007,-0.000516) [-0.000516|0.00052797] "per_meter_squared"  VCM
 SG_ RRSREgoAssumpt_EgoLongVel : 0|16@1+ (0.00108507,0) [0|71.11006245] "m_per_s"  VCM
 SG_ RRSREgoAssumpt_VelCorrFactor : 64|8@1+ (0.002,0.75) [0.75|1.26] "NotApplicable"  VCM
 SG_ RRSREgoAssumpt_EgoRoadCurvature : 104|18@1+ (1E-006,-0.1310705) [-0.1310705|0.1310725] "per_meter"  VCM
 SG_ RRSREgoAssumpt_EgoLongAcc : 16|16@1+ (0.00048828125,-15.6875) [-15.6875|16.31201171875] "m_per_s_squared"  VCM
 SG_ RRSREgoAssumpt_TimeStamp : 48|16@1+ (0.1,0) [0|6553.5] "ms"  VCM

BO_ 812 RFSideSensorTrlrObj: 32 SR_RF
 SG_ RFSideSensorTrlrObj_TrlrTypeConf : 208|7@1+ (1,0) [0|127] "Percent"  VCM
 SG_ RFSideSensorTrlrObj_WheelBased3 : 141|11@1+ (0.1,0) [0|204.7] "m"  VCM
 SG_ RFSideSensorTrlrObj_TrlAnglConf : 174|7@1+ (1,0) [0|0] ""  VCM
 SG_ RFSideSensorTrlrObj_Seg5Length : 27|9@1+ (0.05,0) [0|25.55] "m"  VCM
 SG_ RFSideSensorTrlrObj_SegAngle3 : 69|12@1+ (0.001745,-2.4) [-2.4|4.745775] "rad"  VCM
 SG_ RFSideSensorTrlrObj_SegAngle1 : 45|12@1+ (0.001745,-2.4) [-2.4|4.745775] "rad"  VCM
 SG_ RFSideSensorTrlrObj_SegTrlrType3 : 196|4@1+ (1,0) [0|0] ""  VCM
 SG_ RFSideSensorTrlrObj_Seg1Length : 36|9@1+ (0.05,0) [0|25.55] "m"  VCM
 SG_ RFSideSensorTrlrObj_WheelBased2 : 130|11@1+ (0.1,0) [0|204.7] "m"  VCM
 SG_ RFSideSensorTrlrObj_SegTrlrType1 : 188|4@1+ (1,0) [0|0] ""  VCM
 SG_ RFSideSensorTrlrObj_SegAngle2 : 57|12@1+ (0.001745,-2.4) [-2.4|4.745775] "rad"  VCM
 SG_ RFSideSensorTrlrObj_SegAngle4 : 81|12@1+ (0.001745,-2.4) [-2.4|4.745775] "rad"  VCM
 SG_ RFSideSensorTrlrObj_Seg3Length : 9|9@1+ (0.05,0) [0|25.55] "m"  VCM
 SG_ RFSideSensorTrlrObj_Seg2Length : 0|9@1+ (0.05,0) [0|25.55] "m"  VCM
 SG_ RFSideSensorTrlrObj_WhlBasedConf : 181|7@1+ (1,0) [0|127] "Percent"  VCM
 SG_ RFSideSensorTrlrObj_WheelBased1 : 119|11@1+ (0.1,0) [0|204.7] "m"  VCM
 SG_ RFSideSensorTrlrObj_SegTrlrType5 : 204|4@1+ (1,0) [0|0] ""  VCM
 SG_ RFSideSensorTrlrObj_Seg4Length : 18|9@1+ (0.05,0) [0|25.55] "m"  VCM
 SG_ RFSideSensorTrlrObj_WheelBased4 : 152|11@1+ (0.1,0) [0|204.7] "m"  VCM
 SG_ RFSideSensorTrlrObj_SegAngle5 : 93|12@1+ (0.001745,-2.4) [-2.4|4.745775] "rad"  VCM
 SG_ RFSideSensorTrlrObj_TotLenConf : 116|3@1+ (1,0) [0|0] ""  VCM
 SG_ RFSideSensorTrlrObj_SegTrlrType4 : 200|4@1+ (1,0) [0|0] ""  VCM
 SG_ RFSideSensorTrlrObj_WheelBased5 : 163|11@1+ (0.1,0) [0|204.7] "m"  VCM
 SG_ RFSideSensorTrlrObj_SegTrlrType2 : 192|4@1+ (1,0) [0|0] ""  VCM
 SG_ RFSideSensorTrlrObj_TotalLength : 105|11@1+ (0.1,0) [0|204.7] "m"  VCM

BO_ 811 RFSideSensorObj11: 48 SR_RF
 SG_ RFSideSensorObj11_HeadingVar : 120|8@1+ (0.001,0) [0|0.255] "NotApplicable"  VCM
 SG_ RFSideSensorObj11_LatPosVar : 88|8@1+ (0.1,0) [0|25.5] "NotApplicable"  VCM
 SG_ RFSideSensorObj11_MOISPrio : 307|1@1+ (1,0) [0|0] ""  VCM
 SG_ RFSideSensorObj11_CRC : 0|16@1+ (1,0) [0|65535] "NotApplicable"  VCM
 SG_ RFSideSensorObj11_LatVel : 208|13@1+ (0.032,-80) [-80|182.112] "m_per_s"  VCM
 SG_ RFSideSensorObj11_LatAcc : 267|9@1+ (0.08,-20) [-20|20.88] "m_per_s_squared"  VCM
 SG_ RFSideSensorObj11_LatExtRtVar : 96|8@1+ (0.1,0) [0|25.5] "NotApplicable"  VCM
 SG_ RFSideSensorObj11_LatExtLeftVar : 104|8@1+ (0.1,0) [0|25.5] "NotApplicable"  VCM
 SG_ RFSideSensorObj11_LongPosVar : 48|8@1+ (0.01,0) [0|2.55] "NotApplicable"  VCM
 SG_ RFSideSensorObj11_ObjClassConf : 296|4@1+ (0.1,0) [0|1.5] "NotApplicable"  VCM
 SG_ RFSideSensorObj11_ObstacleConf : 300|7@1+ (0.01,0) [0|1.27] "NotApplicable"  VCM
 SG_ RFSideSensorObj11_LongVelVar : 40|8@1+ (0.01,0) [0|2.55] "NotApplicable"  VCM
 SG_ RFSideSensorObj11_LongAcc : 176|9@1+ (0.08,-20) [-20|20.88] "m_per_s_squared"  VCM
 SG_ RFSideSensorObj11_ObjID : 160|6@1+ (1,0) [0|63] "NotApplicable"  VCM
 SG_ RFSideSensorObj11_LifeTime : 128|16@1+ (0.1,0) [0|6553.5] "s"  VCM
 SG_ RFSideSensorObj11_Counter : 16|8@1+ (1,0) [0|255] "Count"  VCM
 SG_ RFSideSensorObj11_LongExtFront : 247|10@1+ (0.05,0) [0|51.15] "m"  VCM
 SG_ RFSideSensorObj11_ObjDynClass : 166|2@1+ (1,0) [0|0] ""  VCM
 SG_ RFSideSensorObj11_LongPos : 234|13@1+ (0.05,-180) [-180|229.55] "m"  VCM
 SG_ RFSideSensorObj11_LongExtFrVar : 56|8@1+ (0.1,0) [0|25.5] "NotApplicable"  VCM
 SG_ RFSideSensorObj11_LongExtBack : 257|10@1+ (0.05,-50) [-50|1.15000000000001] "m"  VCM
 SG_ RFSideSensorObj11_LongExtBkVar : 64|8@1+ (0.1,0) [0|25.5] "NotApplicable"  VCM
 SG_ RFSideSensorObj11_Prioritisation : 290|2@1+ (1,0) [0|0] ""  VCM
 SG_ RFSideSensorObj11_LatExtRight : 185|7@1+ (0.05,-5) [-5|1.35] "m"  VCM
 SG_ RFSideSensorObj11_LatAccVar : 112|8@1+ (0.1,0) [0|25.5] "NotApplicable"  VCM
 SG_ RFSideSensorObj11_ExistConf : 283|7@1+ (0.01,0) [0|1.27] "NotApplicable"  VCM
 SG_ RFSideSensorObj11_Heading : 144|11@1+ (0.005818,-4.71) [-4.71|7.199446] "rad"  VCM
 SG_ RFSideSensorObj11_LongAccVar : 72|8@1+ (0.1,0) [0|25.5] "NotApplicable"  VCM
 SG_ RFSideSensorObj11_TrackStatus : 192|3@1+ (1,0) [0|0] ""  VCM
 SG_ RFSideSensorObj11_LatPos : 221|13@1+ (0.05,-180) [-180|229.55] "m"  VCM
 SG_ RFSideSensorObj11_TimeStamp : 24|16@1+ (0.1,0) [0|6553.5] "ms"  VCM
 SG_ RFSideSensorObj11_LatVelVar : 80|8@1+ (0.01,0) [0|2.55] "NotApplicable"  VCM
 SG_ RFSideSensorObj11_LatExtLeft : 276|7@1+ (0.05,0) [0|6.35] "m"  VCM
 SG_ RFSideSensorObj11_LongVel : 195|13@1+ (0.032,-80) [-80|182.112] "m_per_s"  VCM
 SG_ RFSideSensorObj11_CoastIndex : 155|5@1+ (1,0) [0|31] "NotApplicable"  VCM
 SG_ RFSideSensorObj11_ObjClass : 292|4@1+ (1,0) [0|0] ""  VCM
 SG_ RFSideSensorObj11_Height : 168|8@1+ (0.02,0) [0|5.1] "m"  VCM

BO_ 810 RFSideSensorObj10: 48 SR_RF
 SG_ RFSideSensorObj10_Prioritisation : 290|2@1+ (1,0) [0|0] ""  VCM
 SG_ RFSideSensorObj10_LatAcc : 267|9@1+ (0.08,-20) [-20|20.88] "m_per_s_squared"  VCM
 SG_ RFSideSensorObj10_LatPosVar : 88|8@1+ (0.1,0) [0|25.5] "NotApplicable"  VCM
 SG_ RFSideSensorObj10_LatExtLeftVar : 104|8@1+ (0.1,0) [0|25.5] "NotApplicable"  VCM
 SG_ RFSideSensorObj10_ObjDynClass : 166|2@1+ (1,0) [0|0] ""  VCM
 SG_ RFSideSensorObj10_CoastIndex : 155|5@1+ (1,0) [0|31] "NotApplicable"  VCM
 SG_ RFSideSensorObj10_LongExtFront : 247|10@1+ (0.05,0) [0|51.15] "m"  VCM
 SG_ RFSideSensorObj10_LatExtLeft : 276|7@1+ (0.05,0) [0|6.35] "m"  VCM
 SG_ RFSideSensorObj10_ExistConf : 283|7@1+ (0.01,0) [0|1.27] "NotApplicable"  VCM
 SG_ RFSideSensorObj10_ObjClass : 292|4@1+ (1,0) [0|0] ""  VCM
 SG_ RFSideSensorObj10_LongExtBack : 257|10@1+ (0.05,-50) [-50|1.15000000000001] "m"  VCM
 SG_ RFSideSensorObj10_HeadingVar : 120|8@1+ (0.001,0) [0|0.255] "NotApplicable"  VCM
 SG_ RFSideSensorObj10_LatExtRight : 185|7@1+ (0.05,-5) [-5|1.35] "m"  VCM
 SG_ RFSideSensorObj10_LatVelVar : 80|8@1+ (0.01,0) [0|2.55] "NotApplicable"  VCM
 SG_ RFSideSensorObj10_LongVelVar : 40|8@1+ (0.01,0) [0|2.55] "NotApplicable"  VCM
 SG_ RFSideSensorObj10_TrackStatus : 192|3@1+ (1,0) [0|0] ""  VCM
 SG_ RFSideSensorObj10_LongPosVar : 48|8@1+ (0.01,0) [0|2.55] "NotApplicable"  VCM
 SG_ RFSideSensorObj10_LatVel : 208|13@1+ (0.032,-80) [-80|182.112] "m_per_s"  VCM
 SG_ RFSideSensorObj10_MOISPrio : 307|1@1+ (1,0) [0|0] ""  VCM
 SG_ RFSideSensorObj10_Height : 168|8@1+ (0.02,0) [0|5.1] "m"  VCM
 SG_ RFSideSensorObj10_LongAccVar : 72|8@1+ (0.1,0) [0|25.5] "NotApplicable"  VCM
 SG_ RFSideSensorObj10_LifeTime : 128|16@1+ (0.1,0) [0|6553.5] "s"  VCM
 SG_ RFSideSensorObj10_ObjID : 160|6@1+ (1,0) [0|63] "NotApplicable"  VCM
 SG_ RFSideSensorObj10_LatExtRtVar : 96|8@1+ (0.1,0) [0|25.5] "NotApplicable"  VCM
 SG_ RFSideSensorObj10_TimeStamp : 24|16@1+ (0.1,0) [0|6553.5] "ms"  VCM
 SG_ RFSideSensorObj10_LongVel : 195|13@1+ (0.032,-80) [-80|182.112] "m_per_s"  VCM
 SG_ RFSideSensorObj10_Heading : 144|11@1+ (0.005818,-4.71) [-4.71|7.199446] "rad"  VCM
 SG_ RFSideSensorObj10_LongPos : 234|13@1+ (0.05,-180) [-180|229.55] "m"  VCM
 SG_ RFSideSensorObj10_LongExtFrVar : 56|8@1+ (0.1,0) [0|25.5] "NotApplicable"  VCM
 SG_ RFSideSensorObj10_LatAccVar : 112|8@1+ (0.1,0) [0|25.5] "NotApplicable"  VCM
 SG_ RFSideSensorObj10_ObjClassConf : 296|4@1+ (0.1,0) [0|1.5] "NotApplicable"  VCM
 SG_ RFSideSensorObj10_ObstacleConf : 300|7@1+ (0.01,0) [0|1.27] "NotApplicable"  VCM
 SG_ RFSideSensorObj10_LongAcc : 176|9@1+ (0.08,-20) [-20|20.88] "m_per_s_squared"  VCM
 SG_ RFSideSensorObj10_LongExtBkVar : 64|8@1+ (0.1,0) [0|25.5] "NotApplicable"  VCM
 SG_ RFSideSensorObj10_LatPos : 221|13@1+ (0.05,-180) [-180|229.55] "m"  VCM
 SG_ RFSideSensorObj10_CRC : 0|16@1+ (1,0) [0|65535] "NotApplicable"  VCM
 SG_ RFSideSensorObj10_Counter : 16|8@1+ (1,0) [0|255] "Count"  VCM

BO_ 809 RFSideSensorObj09: 48 SR_RF
 SG_ RFSideSensorObj09_LongPos : 234|13@1+ (0.05,-180) [-180|229.55] "m"  VCM
 SG_ RFSideSensorObj09_ObjClass : 292|4@1+ (1,0) [0|0] ""  VCM
 SG_ RFSideSensorObj09_LongVelVar : 40|8@1+ (0.01,0) [0|2.55] "NotApplicable"  VCM
 SG_ RFSideSensorObj09_LongPosVar : 48|8@1+ (0.01,0) [0|2.55] "NotApplicable"  VCM
 SG_ RFSideSensorObj09_LatPosVar : 88|8@1+ (0.1,0) [0|25.5] "NotApplicable"  VCM
 SG_ RFSideSensorObj09_Prioritisation : 290|2@1+ (1,0) [0|0] ""  VCM
 SG_ RFSideSensorObj09_LifeTime : 128|16@1+ (0.1,0) [0|6553.5] "s"  VCM
 SG_ RFSideSensorObj09_MOISPrio : 307|1@1+ (1,0) [0|0] ""  VCM
 SG_ RFSideSensorObj09_CoastIndex : 155|5@1+ (1,0) [0|31] "NotApplicable"  VCM
 SG_ RFSideSensorObj09_LatVel : 208|13@1+ (0.032,-80) [-80|182.112] "m_per_s"  VCM
 SG_ RFSideSensorObj09_LongExtBack : 257|10@1+ (0.05,-50) [-50|1.15000000000001] "m"  VCM
 SG_ RFSideSensorObj09_LatExtLeft : 276|7@1+ (0.05,0) [0|6.35] "m"  VCM
 SG_ RFSideSensorObj09_LatVelVar : 80|8@1+ (0.01,0) [0|2.55] "NotApplicable"  VCM
 SG_ RFSideSensorObj09_LongVel : 195|13@1+ (0.032,-80) [-80|182.112] "m_per_s"  VCM
 SG_ RFSideSensorObj09_LatExtRtVar : 96|8@1+ (0.1,0) [0|25.5] "NotApplicable"  VCM
 SG_ RFSideSensorObj09_LatPos : 221|13@1+ (0.05,-180) [-180|229.55] "m"  VCM
 SG_ RFSideSensorObj09_LatExtLeftVar : 104|8@1+ (0.1,0) [0|25.5] "NotApplicable"  VCM
 SG_ RFSideSensorObj09_LongAccVar : 72|8@1+ (0.1,0) [0|25.5] "NotApplicable"  VCM
 SG_ RFSideSensorObj09_ObjID : 160|6@1+ (1,0) [0|63] "NotApplicable"  VCM
 SG_ RFSideSensorObj09_LongExtFrVar : 56|8@1+ (0.1,0) [0|25.5] "NotApplicable"  VCM
 SG_ RFSideSensorObj09_LongExtBkVar : 64|8@1+ (0.1,0) [0|25.5] "NotApplicable"  VCM
 SG_ RFSideSensorObj09_CRC : 0|16@1+ (1,0) [0|65535] "NotApplicable"  VCM
 SG_ RFSideSensorObj09_LongExtFront : 247|10@1+ (0.05,0) [0|51.15] "m"  VCM
 SG_ RFSideSensorObj09_LatExtRight : 185|7@1+ (0.05,-5) [-5|1.35] "m"  VCM
 SG_ RFSideSensorObj09_LatAccVar : 112|8@1+ (0.1,0) [0|25.5] "NotApplicable"  VCM
 SG_ RFSideSensorObj09_LongAcc : 176|9@1+ (0.08,-20) [-20|20.88] "m_per_s_squared"  VCM
 SG_ RFSideSensorObj09_LatAcc : 267|9@1+ (0.08,-20) [-20|20.88] "m_per_s_squared"  VCM
 SG_ RFSideSensorObj09_ObjClassConf : 296|4@1+ (0.1,0) [0|1.5] "NotApplicable"  VCM
 SG_ RFSideSensorObj09_TrackStatus : 192|3@1+ (1,0) [0|0] ""  VCM
 SG_ RFSideSensorObj09_HeadingVar : 120|8@1+ (0.001,0) [0|0.255] "NotApplicable"  VCM
 SG_ RFSideSensorObj09_Height : 168|8@1+ (0.02,0) [0|5.1] "m"  VCM
 SG_ RFSideSensorObj09_ObstacleConf : 300|7@1+ (0.01,0) [0|1.27] "NotApplicable"  VCM
 SG_ RFSideSensorObj09_Counter : 16|8@1+ (1,0) [0|255] "Count"  VCM
 SG_ RFSideSensorObj09_TimeStamp : 24|16@1+ (0.1,0) [0|6553.5] "ms"  VCM
 SG_ RFSideSensorObj09_Heading : 144|11@1+ (0.005818,-4.71) [-4.71|7.199446] "rad"  VCM
 SG_ RFSideSensorObj09_ExistConf : 283|7@1+ (0.01,0) [0|1.27] "NotApplicable"  VCM
 SG_ RFSideSensorObj09_ObjDynClass : 166|2@1+ (1,0) [0|0] ""  VCM

BO_ 808 RFSideSensorObj08: 48 SR_RF
 SG_ RFSideSensorObj08_LongExtBack : 257|10@1+ (0.05,-50) [-50|1.15000000000001] "m"  VCM
 SG_ RFSideSensorObj08_LongPos : 234|13@1+ (0.05,-180) [-180|229.55] "m"  VCM
 SG_ RFSideSensorObj08_LifeTime : 128|16@1+ (0.1,0) [0|6553.5] "s"  VCM
 SG_ RFSideSensorObj08_CRC : 0|16@1+ (1,0) [0|65535] "NotApplicable"  VCM
 SG_ RFSideSensorObj08_LongExtBkVar : 64|8@1+ (0.1,0) [0|25.5] "NotApplicable"  VCM
 SG_ RFSideSensorObj08_Prioritisation : 290|2@1+ (1,0) [0|0] ""  VCM
 SG_ RFSideSensorObj08_LatVel : 208|13@1+ (0.032,-80) [-80|182.112] "m_per_s"  VCM
 SG_ RFSideSensorObj08_ObjClass : 292|4@1+ (1,0) [0|0] ""  VCM
 SG_ RFSideSensorObj08_TrackStatus : 192|3@1+ (1,0) [0|0] ""  VCM
 SG_ RFSideSensorObj08_MOISPrio : 307|1@1+ (1,0) [0|0] ""  VCM
 SG_ RFSideSensorObj08_LatExtLeftVar : 104|8@1+ (0.1,0) [0|25.5] "NotApplicable"  VCM
 SG_ RFSideSensorObj08_ObstacleConf : 300|7@1+ (0.01,0) [0|1.27] "NotApplicable"  VCM
 SG_ RFSideSensorObj08_LongExtFrVar : 56|8@1+ (0.1,0) [0|25.5] "NotApplicable"  VCM
 SG_ RFSideSensorObj08_LongAccVar : 72|8@1+ (0.1,0) [0|25.5] "NotApplicable"  VCM
 SG_ RFSideSensorObj08_TimeStamp : 24|16@1+ (0.1,0) [0|6553.5] "ms"  VCM
 SG_ RFSideSensorObj08_LatPos : 221|13@1+ (0.05,-180) [-180|229.55] "m"  VCM
 SG_ RFSideSensorObj08_LatPosVar : 88|8@1+ (0.1,0) [0|25.5] "NotApplicable"  VCM
 SG_ RFSideSensorObj08_ObjDynClass : 166|2@1+ (1,0) [0|0] ""  VCM
 SG_ RFSideSensorObj08_LongVelVar : 40|8@1+ (0.01,0) [0|2.55] "NotApplicable"  VCM
 SG_ RFSideSensorObj08_LatAcc : 267|9@1+ (0.08,-20) [-20|20.88] "m_per_s_squared"  VCM
 SG_ RFSideSensorObj08_LatVelVar : 80|8@1+ (0.01,0) [0|2.55] "NotApplicable"  VCM
 SG_ RFSideSensorObj08_ObjID : 160|6@1+ (1,0) [0|63] "NotApplicable"  VCM
 SG_ RFSideSensorObj08_Height : 168|8@1+ (0.02,0) [0|5.1] "m"  VCM
 SG_ RFSideSensorObj08_CoastIndex : 155|5@1+ (1,0) [0|31] "NotApplicable"  VCM
 SG_ RFSideSensorObj08_LatExtRtVar : 96|8@1+ (0.1,0) [0|25.5] "NotApplicable"  VCM
 SG_ RFSideSensorObj08_LongExtFront : 247|10@1+ (0.05,0) [0|51.15] "m"  VCM
 SG_ RFSideSensorObj08_LongPosVar : 48|8@1+ (0.01,0) [0|2.55] "NotApplicable"  VCM
 SG_ RFSideSensorObj08_ObjClassConf : 296|4@1+ (0.1,0) [0|1.5] "NotApplicable"  VCM
 SG_ RFSideSensorObj08_HeadingVar : 120|8@1+ (0.001,0) [0|0.255] "NotApplicable"  VCM
 SG_ RFSideSensorObj08_LatExtLeft : 276|7@1+ (0.05,0) [0|6.35] "m"  VCM
 SG_ RFSideSensorObj08_Heading : 144|11@1+ (0.005818,-4.71) [-4.71|7.199446] "rad"  VCM
 SG_ RFSideSensorObj08_LatExtRight : 185|7@1+ (0.05,-5) [-5|1.35] "m"  VCM
 SG_ RFSideSensorObj08_LongAcc : 176|9@1+ (0.08,-20) [-20|20.88] "m_per_s_squared"  VCM
 SG_ RFSideSensorObj08_LatAccVar : 112|8@1+ (0.1,0) [0|25.5] "NotApplicable"  VCM
 SG_ RFSideSensorObj08_Counter : 16|8@1+ (1,0) [0|255] "Count"  VCM
 SG_ RFSideSensorObj08_ExistConf : 283|7@1+ (0.01,0) [0|1.27] "NotApplicable"  VCM
 SG_ RFSideSensorObj08_LongVel : 195|13@1+ (0.032,-80) [-80|182.112] "m_per_s"  VCM

BO_ 807 RFSideSensorObj07: 48 SR_RF
 SG_ RFSideSensorObj07_LatVel : 208|13@1+ (0.032,-80) [-80|182.112] "m_per_s"  VCM
 SG_ RFSideSensorObj07_LatPosVar : 88|8@1+ (0.1,0) [0|25.5] "NotApplicable"  VCM
 SG_ RFSideSensorObj07_ExistConf : 283|7@1+ (0.01,0) [0|1.27] "NotApplicable"  VCM
 SG_ RFSideSensorObj07_MOISPrio : 307|1@1+ (1,0) [0|0] ""  VCM
 SG_ RFSideSensorObj07_LatAcc : 267|9@1+ (0.08,-20) [-20|20.88] "m_per_s_squared"  VCM
 SG_ RFSideSensorObj07_LongExtBack : 257|10@1+ (0.05,-50) [-50|1.15000000000001] "m"  VCM
 SG_ RFSideSensorObj07_LatExtLeft : 276|7@1+ (0.05,0) [0|6.35] "m"  VCM
 SG_ RFSideSensorObj07_Heading : 144|11@1+ (0.005818,-4.71) [-4.71|7.199446] "rad"  VCM
 SG_ RFSideSensorObj07_LongExtFrVar : 56|8@1+ (0.1,0) [0|25.5] "NotApplicable"  VCM
 SG_ RFSideSensorObj07_LongAcc : 176|9@1+ (0.08,-20) [-20|20.88] "m_per_s_squared"  VCM
 SG_ RFSideSensorObj07_Prioritisation : 290|2@1+ (1,0) [0|0] ""  VCM
 SG_ RFSideSensorObj07_CoastIndex : 155|5@1+ (1,0) [0|31] "NotApplicable"  VCM
 SG_ RFSideSensorObj07_LatAccVar : 112|8@1+ (0.1,0) [0|25.5] "NotApplicable"  VCM
 SG_ RFSideSensorObj07_LatPos : 221|13@1+ (0.05,-180) [-180|229.55] "m"  VCM
 SG_ RFSideSensorObj07_Counter : 16|8@1+ (1,0) [0|255] "Count"  VCM
 SG_ RFSideSensorObj07_LifeTime : 128|16@1+ (0.1,0) [0|6553.5] "s"  VCM
 SG_ RFSideSensorObj07_ObjDynClass : 166|2@1+ (1,0) [0|0] ""  VCM
 SG_ RFSideSensorObj07_CRC : 0|16@1+ (1,0) [0|65535] "NotApplicable"  VCM
 SG_ RFSideSensorObj07_LatExtRtVar : 96|8@1+ (0.1,0) [0|25.5] "NotApplicable"  VCM
 SG_ RFSideSensorObj07_ObjID : 160|6@1+ (1,0) [0|63] "NotApplicable"  VCM
 SG_ RFSideSensorObj07_ObjClassConf : 296|4@1+ (0.1,0) [0|1.5] "NotApplicable"  VCM
 SG_ RFSideSensorObj07_LatExtRight : 185|7@1+ (0.05,-5) [-5|1.35] "m"  VCM
 SG_ RFSideSensorObj07_LatVelVar : 80|8@1+ (0.01,0) [0|2.55] "NotApplicable"  VCM
 SG_ RFSideSensorObj07_LongAccVar : 72|8@1+ (0.1,0) [0|25.5] "NotApplicable"  VCM
 SG_ RFSideSensorObj07_ObjClass : 292|4@1+ (1,0) [0|0] ""  VCM
 SG_ RFSideSensorObj07_LongExtBkVar : 64|8@1+ (0.1,0) [0|25.5] "NotApplicable"  VCM
 SG_ RFSideSensorObj07_TimeStamp : 24|16@1+ (0.1,0) [0|6553.5] "ms"  VCM
 SG_ RFSideSensorObj07_TrackStatus : 192|3@1+ (1,0) [0|0] ""  VCM
 SG_ RFSideSensorObj07_Height : 168|8@1+ (0.02,0) [0|5.1] "m"  VCM
 SG_ RFSideSensorObj07_LongPosVar : 48|8@1+ (0.01,0) [0|2.55] "NotApplicable"  VCM
 SG_ RFSideSensorObj07_LongVel : 195|13@1+ (0.032,-80) [-80|182.112] "m_per_s"  VCM
 SG_ RFSideSensorObj07_ObstacleConf : 300|7@1+ (0.01,0) [0|1.27] "NotApplicable"  VCM
 SG_ RFSideSensorObj07_LongExtFront : 247|10@1+ (0.05,0) [0|51.15] "m"  VCM
 SG_ RFSideSensorObj07_LongVelVar : 40|8@1+ (0.01,0) [0|2.55] "NotApplicable"  VCM
 SG_ RFSideSensorObj07_LongPos : 234|13@1+ (0.05,-180) [-180|229.55] "m"  VCM
 SG_ RFSideSensorObj07_HeadingVar : 120|8@1+ (0.001,0) [0|0.255] "NotApplicable"  VCM
 SG_ RFSideSensorObj07_LatExtLeftVar : 104|8@1+ (0.1,0) [0|25.5] "NotApplicable"  VCM

BO_ 806 RFSideSensorObj06: 48 SR_RF
 SG_ RFSideSensorObj06_Prioritisation : 290|2@1+ (1,0) [0|0] ""  VCM
 SG_ RFSideSensorObj06_LongExtFront : 247|10@1+ (0.05,0) [0|51.15] "m"  VCM
 SG_ RFSideSensorObj06_MOISPrio : 307|1@1+ (1,0) [0|0] ""  VCM
 SG_ RFSideSensorObj06_LatPosVar : 88|8@1+ (0.1,0) [0|25.5] "NotApplicable"  VCM
 SG_ RFSideSensorObj06_ObjID : 160|6@1+ (1,0) [0|63] "NotApplicable"  VCM
 SG_ RFSideSensorObj06_LongExtBack : 257|10@1+ (0.05,-50) [-50|1.15000000000001] "m"  VCM
 SG_ RFSideSensorObj06_ExistConf : 283|7@1+ (0.01,0) [0|1.27] "NotApplicable"  VCM
 SG_ RFSideSensorObj06_LatPos : 221|13@1+ (0.05,-180) [-180|229.55] "m"  VCM
 SG_ RFSideSensorObj06_ObjClassConf : 296|4@1+ (0.1,0) [0|1.5] "NotApplicable"  VCM
 SG_ RFSideSensorObj06_LongExtBkVar : 64|8@1+ (0.1,0) [0|25.5] "NotApplicable"  VCM
 SG_ RFSideSensorObj06_LongAccVar : 72|8@1+ (0.1,0) [0|25.5] "NotApplicable"  VCM
 SG_ RFSideSensorObj06_LongAcc : 176|9@1+ (0.08,-20) [-20|20.88] "m_per_s_squared"  VCM
 SG_ RFSideSensorObj06_TrackStatus : 192|3@1+ (1,0) [0|0] ""  VCM
 SG_ RFSideSensorObj06_LatAccVar : 112|8@1+ (0.1,0) [0|25.5] "NotApplicable"  VCM
 SG_ RFSideSensorObj06_ObjDynClass : 166|2@1+ (1,0) [0|0] ""  VCM
 SG_ RFSideSensorObj06_CoastIndex : 155|5@1+ (1,0) [0|31] "NotApplicable"  VCM
 SG_ RFSideSensorObj06_LongPosVar : 48|8@1+ (0.01,0) [0|2.55] "NotApplicable"  VCM
 SG_ RFSideSensorObj06_HeadingVar : 120|8@1+ (0.001,0) [0|0.255] "NotApplicable"  VCM
 SG_ RFSideSensorObj06_CRC : 0|16@1+ (1,0) [0|65535] "NotApplicable"  VCM
 SG_ RFSideSensorObj06_LongVel : 195|13@1+ (0.032,-80) [-80|182.112] "m_per_s"  VCM
 SG_ RFSideSensorObj06_ObstacleConf : 300|7@1+ (0.01,0) [0|1.27] "NotApplicable"  VCM
 SG_ RFSideSensorObj06_LatExtLeftVar : 104|8@1+ (0.1,0) [0|25.5] "NotApplicable"  VCM
 SG_ RFSideSensorObj06_TimeStamp : 24|16@1+ (0.1,0) [0|6553.5] "ms"  VCM
 SG_ RFSideSensorObj06_ObjClass : 292|4@1+ (1,0) [0|0] ""  VCM
 SG_ RFSideSensorObj06_LatVelVar : 80|8@1+ (0.01,0) [0|2.55] "NotApplicable"  VCM
 SG_ RFSideSensorObj06_LifeTime : 128|16@1+ (0.1,0) [0|6553.5] "s"  VCM
 SG_ RFSideSensorObj06_LatExtRtVar : 96|8@1+ (0.1,0) [0|25.5] "NotApplicable"  VCM
 SG_ RFSideSensorObj06_LatAcc : 267|9@1+ (0.08,-20) [-20|20.88] "m_per_s_squared"  VCM
 SG_ RFSideSensorObj06_LongExtFrVar : 56|8@1+ (0.1,0) [0|25.5] "NotApplicable"  VCM
 SG_ RFSideSensorObj06_Height : 168|8@1+ (0.02,0) [0|5.1] "m"  VCM
 SG_ RFSideSensorObj06_LongVelVar : 40|8@1+ (0.01,0) [0|2.55] "NotApplicable"  VCM
 SG_ RFSideSensorObj06_LongPos : 234|13@1+ (0.05,-180) [-180|229.55] "m"  VCM
 SG_ RFSideSensorObj06_LatExtRight : 185|7@1+ (0.05,-5) [-5|1.35] "m"  VCM
 SG_ RFSideSensorObj06_Heading : 144|11@1+ (0.005818,-4.71) [-4.71|7.199446] "rad"  VCM
 SG_ RFSideSensorObj06_LatVel : 208|13@1+ (0.032,-80) [-80|182.112] "m_per_s"  VCM
 SG_ RFSideSensorObj06_LatExtLeft : 276|7@1+ (0.05,0) [0|6.35] "m"  VCM
 SG_ RFSideSensorObj06_Counter : 16|8@1+ (1,0) [0|255] "Count"  VCM

BO_ 805 RFSideSensorObj05: 48 SR_RF
 SG_ RFSideSensorObj05_LongAcc : 176|9@1+ (0.08,-20) [-20|20.88] "m_per_s_squared"  VCM
 SG_ RFSideSensorObj05_LatPosVar : 88|8@1+ (0.1,0) [0|25.5] "NotApplicable"  VCM
 SG_ RFSideSensorObj05_LatPos : 221|13@1+ (0.05,-180) [-180|229.55] "m"  VCM
 SG_ RFSideSensorObj05_CRC : 0|16@1+ (1,0) [0|65535] "NotApplicable"  VCM
 SG_ RFSideSensorObj05_LongExtBack : 257|10@1+ (0.05,-50) [-50|1.15000000000001] "m"  VCM
 SG_ RFSideSensorObj05_Prioritisation : 290|2@1+ (1,0) [0|0] ""  VCM
 SG_ RFSideSensorObj05_LatExtRtVar : 96|8@1+ (0.1,0) [0|25.5] "NotApplicable"  VCM
 SG_ RFSideSensorObj05_LongExtFront : 247|10@1+ (0.05,0) [0|51.15] "m"  VCM
 SG_ RFSideSensorObj05_TrackStatus : 192|3@1+ (1,0) [0|0] ""  VCM
 SG_ RFSideSensorObj05_ObjDynClass : 166|2@1+ (1,0) [0|0] ""  VCM
 SG_ RFSideSensorObj05_HeadingVar : 120|8@1+ (0.001,0) [0|0.255] "NotApplicable"  VCM
 SG_ RFSideSensorObj05_LatAccVar : 112|8@1+ (0.1,0) [0|25.5] "NotApplicable"  VCM
 SG_ RFSideSensorObj05_LongExtFrVar : 56|8@1+ (0.1,0) [0|25.5] "NotApplicable"  VCM
 SG_ RFSideSensorObj05_ExistConf : 283|7@1+ (0.01,0) [0|1.27] "NotApplicable"  VCM
 SG_ RFSideSensorObj05_ObjClass : 292|4@1+ (1,0) [0|0] ""  VCM
 SG_ RFSideSensorObj05_LongPos : 234|13@1+ (0.05,-180) [-180|229.55] "m"  VCM
 SG_ RFSideSensorObj05_LatVelVar : 80|8@1+ (0.01,0) [0|2.55] "NotApplicable"  VCM
 SG_ RFSideSensorObj05_MOISPrio : 307|1@1+ (1,0) [0|0] ""  VCM
 SG_ RFSideSensorObj05_LatExtLeftVar : 104|8@1+ (0.1,0) [0|25.5] "NotApplicable"  VCM
 SG_ RFSideSensorObj05_LongAccVar : 72|8@1+ (0.1,0) [0|25.5] "NotApplicable"  VCM
 SG_ RFSideSensorObj05_TimeStamp : 24|16@1+ (0.1,0) [0|6553.5] "ms"  VCM
 SG_ RFSideSensorObj05_LatExtRight : 185|7@1+ (0.05,-5) [-5|1.35] "m"  VCM
 SG_ RFSideSensorObj05_LifeTime : 128|16@1+ (0.1,0) [0|6553.5] "s"  VCM
 SG_ RFSideSensorObj05_LongPosVar : 48|8@1+ (0.01,0) [0|2.55] "NotApplicable"  VCM
 SG_ RFSideSensorObj05_ObstacleConf : 300|7@1+ (0.01,0) [0|1.27] "NotApplicable"  VCM
 SG_ RFSideSensorObj05_Counter : 16|8@1+ (1,0) [0|255] "Count"  VCM
 SG_ RFSideSensorObj05_LongVelVar : 40|8@1+ (0.01,0) [0|2.55] "NotApplicable"  VCM
 SG_ RFSideSensorObj05_Height : 168|8@1+ (0.02,0) [0|5.1] "m"  VCM
 SG_ RFSideSensorObj05_LatExtLeft : 276|7@1+ (0.05,0) [0|6.35] "m"  VCM
 SG_ RFSideSensorObj05_LongExtBkVar : 64|8@1+ (0.1,0) [0|25.5] "NotApplicable"  VCM
 SG_ RFSideSensorObj05_ObjClassConf : 296|4@1+ (0.1,0) [0|1.5] "NotApplicable"  VCM
 SG_ RFSideSensorObj05_LatVel : 208|13@1+ (0.032,-80) [-80|182.112] "m_per_s"  VCM
 SG_ RFSideSensorObj05_CoastIndex : 155|5@1+ (1,0) [0|31] "NotApplicable"  VCM
 SG_ RFSideSensorObj05_ObjID : 160|6@1+ (1,0) [0|63] "NotApplicable"  VCM
 SG_ RFSideSensorObj05_LatAcc : 267|9@1+ (0.08,-20) [-20|20.88] "m_per_s_squared"  VCM
 SG_ RFSideSensorObj05_LongVel : 195|13@1+ (0.032,-80) [-80|182.112] "m_per_s"  VCM
 SG_ RFSideSensorObj05_Heading : 144|11@1+ (0.005818,-4.71) [-4.71|7.199446] "rad"  VCM

BO_ 804 RFSideSensorObj04: 48 SR_RF
 SG_ RFSideSensorObj04_LongExtFrVar : 56|8@1+ (0.1,0) [0|25.5] "NotApplicable"  VCM
 SG_ RFSideSensorObj04_TrackStatus : 192|3@1+ (1,0) [0|0] ""  VCM
 SG_ RFSideSensorObj04_HeadingVar : 120|8@1+ (0.001,0) [0|0.255] "NotApplicable"  VCM
 SG_ RFSideSensorObj04_LifeTime : 128|16@1+ (0.1,0) [0|6553.5] "s"  VCM
 SG_ RFSideSensorObj04_ObjClassConf : 296|4@1+ (0.1,0) [0|1.5] "NotApplicable"  VCM
 SG_ RFSideSensorObj04_LatExtLeftVar : 104|8@1+ (0.1,0) [0|25.5] "NotApplicable"  VCM
 SG_ RFSideSensorObj04_CoastIndex : 155|5@1+ (1,0) [0|31] "NotApplicable"  VCM
 SG_ RFSideSensorObj04_Heading : 144|11@1+ (0.005818,-4.71) [-4.71|7.199446] "rad"  VCM
 SG_ RFSideSensorObj04_Height : 168|8@1+ (0.02,0) [0|5.1] "m"  VCM
 SG_ RFSideSensorObj04_LongPosVar : 48|8@1+ (0.01,0) [0|2.55] "NotApplicable"  VCM
 SG_ RFSideSensorObj04_TimeStamp : 24|16@1+ (0.1,0) [0|6553.5] "ms"  VCM
 SG_ RFSideSensorObj04_LatExtRight : 185|7@1+ (0.05,-5) [-5|1.35] "m"  VCM
 SG_ RFSideSensorObj04_LatExtLeft : 276|7@1+ (0.05,0) [0|6.35] "m"  VCM
 SG_ RFSideSensorObj04_LatPosVar : 88|8@1+ (0.1,0) [0|25.5] "NotApplicable"  VCM
 SG_ RFSideSensorObj04_CRC : 0|16@1+ (1,0) [0|65535] "NotApplicable"  VCM
 SG_ RFSideSensorObj04_LatAccVar : 112|8@1+ (0.1,0) [0|25.5] "NotApplicable"  VCM
 SG_ RFSideSensorObj04_Counter : 16|8@1+ (1,0) [0|255] "Count"  VCM
 SG_ RFSideSensorObj04_LongExtFront : 247|10@1+ (0.05,0) [0|51.15] "m"  VCM
 SG_ RFSideSensorObj04_LatPos : 221|13@1+ (0.05,-180) [-180|229.55] "m"  VCM
 SG_ RFSideSensorObj04_ObstacleConf : 300|7@1+ (0.01,0) [0|1.27] "NotApplicable"  VCM
 SG_ RFSideSensorObj04_LatVel : 208|13@1+ (0.032,-80) [-80|182.112] "m_per_s"  VCM
 SG_ RFSideSensorObj04_LongVelVar : 40|8@1+ (0.01,0) [0|2.55] "NotApplicable"  VCM
 SG_ RFSideSensorObj04_LongExtBkVar : 64|8@1+ (0.1,0) [0|25.5] "NotApplicable"  VCM
 SG_ RFSideSensorObj04_LatVelVar : 80|8@1+ (0.01,0) [0|2.55] "NotApplicable"  VCM
 SG_ RFSideSensorObj04_LongPos : 234|13@1+ (0.05,-180) [-180|229.55] "m"  VCM
 SG_ RFSideSensorObj04_ObjDynClass : 166|2@1+ (1,0) [0|0] ""  VCM
 SG_ RFSideSensorObj04_Prioritisation : 290|2@1+ (1,0) [0|0] ""  VCM
 SG_ RFSideSensorObj04_ObjID : 160|6@1+ (1,0) [0|63] "NotApplicable"  VCM
 SG_ RFSideSensorObj04_LongAcc : 176|9@1+ (0.08,-20) [-20|20.88] "m_per_s_squared"  VCM
 SG_ RFSideSensorObj04_ObjClass : 292|4@1+ (1,0) [0|0] ""  VCM
 SG_ RFSideSensorObj04_ExistConf : 283|7@1+ (0.01,0) [0|1.27] "NotApplicable"  VCM
 SG_ RFSideSensorObj04_LongAccVar : 72|8@1+ (0.1,0) [0|25.5] "NotApplicable"  VCM
 SG_ RFSideSensorObj04_LatExtRtVar : 96|8@1+ (0.1,0) [0|25.5] "NotApplicable"  VCM
 SG_ RFSideSensorObj04_LatAcc : 267|9@1+ (0.08,-20) [-20|20.88] "m_per_s_squared"  VCM
 SG_ RFSideSensorObj04_MOISPrio : 307|1@1+ (1,0) [0|0] ""  VCM
 SG_ RFSideSensorObj04_LongExtBack : 257|10@1+ (0.05,-50) [-50|1.15000000000001] "m"  VCM
 SG_ RFSideSensorObj04_LongVel : 195|13@1+ (0.032,-80) [-80|182.112] "m_per_s"  VCM

BO_ 803 RFSideSensorObj03: 48 SR_RF
 SG_ RFSideSensorObj03_LongAcc : 176|9@1+ (0.08,-20) [-20|20.88] "m_per_s_squared"  VCM
 SG_ RFSideSensorObj03_LongAccVar : 72|8@1+ (0.1,0) [0|25.5] "NotApplicable"  VCM
 SG_ RFSideSensorObj03_LongExtBack : 257|10@1+ (0.05,-50) [-50|1.15000000000001] "m"  VCM
 SG_ RFSideSensorObj03_HeadingVar : 120|8@1+ (0.001,0) [0|0.255] "NotApplicable"  VCM
 SG_ RFSideSensorObj03_LifeTime : 128|16@1+ (0.1,0) [0|6553.5] "s"  VCM
 SG_ RFSideSensorObj03_Prioritisation : 290|2@1+ (1,0) [0|0] ""  VCM
 SG_ RFSideSensorObj03_LongVel : 195|13@1+ (0.032,-80) [-80|182.112] "m_per_s"  VCM
 SG_ RFSideSensorObj03_TimeStamp : 24|16@1+ (0.1,0) [0|6553.5] "ms"  VCM
 SG_ RFSideSensorObj03_ObstacleConf : 300|7@1+ (0.01,0) [0|1.27] "NotApplicable"  VCM
 SG_ RFSideSensorObj03_LatExtRtVar : 96|8@1+ (0.1,0) [0|25.5] "NotApplicable"  VCM
 SG_ RFSideSensorObj03_ObjClassConf : 296|4@1+ (0.1,0) [0|1.5] "NotApplicable"  VCM
 SG_ RFSideSensorObj03_Height : 168|8@1+ (0.02,0) [0|5.1] "m"  VCM
 SG_ RFSideSensorObj03_ExistConf : 283|7@1+ (0.01,0) [0|1.27] "NotApplicable"  VCM
 SG_ RFSideSensorObj03_LongVelVar : 40|8@1+ (0.01,0) [0|2.55] "NotApplicable"  VCM
 SG_ RFSideSensorObj03_LatAccVar : 112|8@1+ (0.1,0) [0|25.5] "NotApplicable"  VCM
 SG_ RFSideSensorObj03_LatVelVar : 80|8@1+ (0.01,0) [0|2.55] "NotApplicable"  VCM
 SG_ RFSideSensorObj03_LatVel : 208|13@1+ (0.032,-80) [-80|182.112] "m_per_s"  VCM
 SG_ RFSideSensorObj03_LongPosVar : 48|8@1+ (0.01,0) [0|2.55] "NotApplicable"  VCM
 SG_ RFSideSensorObj03_LatExtLeftVar : 104|8@1+ (0.1,0) [0|25.5] "NotApplicable"  VCM
 SG_ RFSideSensorObj03_LongExtFront : 247|10@1+ (0.05,0) [0|51.15] "m"  VCM
 SG_ RFSideSensorObj03_Counter : 16|8@1+ (1,0) [0|255] "Count"  VCM
 SG_ RFSideSensorObj03_LatExtLeft : 276|7@1+ (0.05,0) [0|6.35] "m"  VCM
 SG_ RFSideSensorObj03_CRC : 0|16@1+ (1,0) [0|65535] "NotApplicable"  VCM
 SG_ RFSideSensorObj03_ObjDynClass : 166|2@1+ (1,0) [0|0] ""  VCM
 SG_ RFSideSensorObj03_ObjClass : 292|4@1+ (1,0) [0|0] ""  VCM
 SG_ RFSideSensorObj03_LongExtBkVar : 64|8@1+ (0.1,0) [0|25.5] "NotApplicable"  VCM
 SG_ RFSideSensorObj03_LatExtRight : 185|7@1+ (0.05,-5) [-5|1.35] "m"  VCM
 SG_ RFSideSensorObj03_LatPos : 221|13@1+ (0.05,-180) [-180|229.55] "m"  VCM
 SG_ RFSideSensorObj03_MOISPrio : 307|1@1+ (1,0) [0|0] ""  VCM
 SG_ RFSideSensorObj03_CoastIndex : 155|5@1+ (1,0) [0|31] "NotApplicable"  VCM
 SG_ RFSideSensorObj03_LongPos : 234|13@1+ (0.05,-180) [-180|229.55] "m"  VCM
 SG_ RFSideSensorObj03_ObjID : 160|6@1+ (1,0) [0|63] "NotApplicable"  VCM
 SG_ RFSideSensorObj03_LatAcc : 267|9@1+ (0.08,-20) [-20|20.88] "m_per_s_squared"  VCM
 SG_ RFSideSensorObj03_TrackStatus : 192|3@1+ (1,0) [0|0] ""  VCM
 SG_ RFSideSensorObj03_LatPosVar : 88|8@1+ (0.1,0) [0|25.5] "NotApplicable"  VCM
 SG_ RFSideSensorObj03_LongExtFrVar : 56|8@1+ (0.1,0) [0|25.5] "NotApplicable"  VCM
 SG_ RFSideSensorObj03_Heading : 144|11@1+ (0.005818,-4.71) [-4.71|7.199446] "rad"  VCM

BO_ 802 RFSideSensorObj02: 48 SR_RF
 SG_ RFSideSensorObj02_Heading : 144|11@1+ (0.005818,-4.71) [-4.71|7.199446] "rad"  VCM
 SG_ RFSideSensorObj02_LongExtBkVar : 64|8@1+ (0.1,0) [0|25.5] "NotApplicable"  VCM
 SG_ RFSideSensorObj02_LatExtRight : 185|7@1+ (0.05,-5) [-5|1.35] "m"  VCM
 SG_ RFSideSensorObj02_Counter : 16|8@1+ (1,0) [0|255] "Count"  VCM
 SG_ RFSideSensorObj02_ObstacleConf : 300|7@1+ (0.01,0) [0|1.27] "NotApplicable"  VCM
 SG_ RFSideSensorObj02_ExistConf : 283|7@1+ (0.01,0) [0|1.27] "NotApplicable"  VCM
 SG_ RFSideSensorObj02_Height : 168|8@1+ (0.02,0) [0|5.1] "m"  VCM
 SG_ RFSideSensorObj02_LatAccVar : 112|8@1+ (0.1,0) [0|25.5] "NotApplicable"  VCM
 SG_ RFSideSensorObj02_ObjClass : 292|4@1+ (1,0) [0|0] ""  VCM
 SG_ RFSideSensorObj02_CRC : 0|16@1+ (1,0) [0|65535] "NotApplicable"  VCM
 SG_ RFSideSensorObj02_LongAcc : 176|9@1+ (0.08,-20) [-20|20.88] "m_per_s_squared"  VCM
 SG_ RFSideSensorObj02_LatVel : 208|13@1+ (0.032,-80) [-80|182.112] "m_per_s"  VCM
 SG_ RFSideSensorObj02_LatPosVar : 88|8@1+ (0.1,0) [0|25.5] "NotApplicable"  VCM
 SG_ RFSideSensorObj02_CoastIndex : 155|5@1+ (1,0) [0|31] "NotApplicable"  VCM
 SG_ RFSideSensorObj02_LongPosVar : 48|8@1+ (0.01,0) [0|2.55] "NotApplicable"  VCM
 SG_ RFSideSensorObj02_LatAcc : 267|9@1+ (0.08,-20) [-20|20.88] "m_per_s_squared"  VCM
 SG_ RFSideSensorObj02_ObjClassConf : 296|4@1+ (0.1,0) [0|1.5] "NotApplicable"  VCM
 SG_ RFSideSensorObj02_ObjDynClass : 166|2@1+ (1,0) [0|0] ""  VCM
 SG_ RFSideSensorObj02_LongExtBack : 257|10@1+ (0.05,-50) [-50|1.15000000000001] "m"  VCM
 SG_ RFSideSensorObj02_LatExtLeftVar : 104|8@1+ (0.1,0) [0|25.5] "NotApplicable"  VCM
 SG_ RFSideSensorObj02_LifeTime : 128|16@1+ (0.1,0) [0|6553.5] "s"  VCM
 SG_ RFSideSensorObj02_LongVel : 195|13@1+ (0.032,-80) [-80|182.112] "m_per_s"  VCM
 SG_ RFSideSensorObj02_LongAccVar : 72|8@1+ (0.1,0) [0|25.5] "NotApplicable"  VCM
 SG_ RFSideSensorObj02_LongExtFront : 247|10@1+ (0.05,0) [0|51.15] "m"  VCM
 SG_ RFSideSensorObj02_TrackStatus : 192|3@1+ (1,0) [0|0] ""  VCM
 SG_ RFSideSensorObj02_ObjID : 160|6@1+ (1,0) [0|63] "NotApplicable"  VCM
 SG_ RFSideSensorObj02_TimeStamp : 24|16@1+ (0.1,0) [0|6553.5] "ms"  VCM
 SG_ RFSideSensorObj02_LatPos : 221|13@1+ (0.05,-180) [-180|229.55] "m"  VCM
 SG_ RFSideSensorObj02_LatVelVar : 80|8@1+ (0.01,0) [0|2.55] "NotApplicable"  VCM
 SG_ RFSideSensorObj02_HeadingVar : 120|8@1+ (0.001,0) [0|0.255] "NotApplicable"  VCM
 SG_ RFSideSensorObj02_Prioritisation : 290|2@1+ (1,0) [0|0] ""  VCM
 SG_ RFSideSensorObj02_MOISPrio : 307|1@1+ (1,0) [0|0] ""  VCM
 SG_ RFSideSensorObj02_LatExtLeft : 276|7@1+ (0.05,0) [0|6.35] "m"  VCM
 SG_ RFSideSensorObj02_LongPos : 234|13@1+ (0.05,-180) [-180|229.55] "m"  VCM
 SG_ RFSideSensorObj02_LongExtFrVar : 56|8@1+ (0.1,0) [0|25.5] "NotApplicable"  VCM
 SG_ RFSideSensorObj02_LongVelVar : 40|8@1+ (0.01,0) [0|2.55] "NotApplicable"  VCM
 SG_ RFSideSensorObj02_LatExtRtVar : 96|8@1+ (0.1,0) [0|25.5] "NotApplicable"  VCM

BO_ 801 RFSideSensorObj01: 48 SR_RF
 SG_ RFSideSensorObj01_LatVel : 208|13@1+ (0.032,-80) [-80|182.112] "m_per_s"  VCM
 SG_ RFSideSensorObj01_LatAccVar : 112|8@1+ (0.1,0) [0|25.5] "NotApplicable"  VCM
 SG_ RFSideSensorObj01_ObjClassConf : 296|4@1+ (0.1,0) [0|1.5] "NotApplicable"  VCM
 SG_ RFSideSensorObj01_CoastIndex : 155|5@1+ (1,0) [0|31] "NotApplicable"  VCM
 SG_ RFSideSensorObj01_LatExtLeft : 276|7@1+ (0.05,0) [0|6.35] "m"  VCM
 SG_ RFSideSensorObj01_ExistConf : 283|7@1+ (0.01,0) [0|1.27] "NotApplicable"  VCM
 SG_ RFSideSensorObj01_LongVel : 195|13@1+ (0.032,-80) [-80|182.112] "m_per_s"  VCM
 SG_ RFSideSensorObj01_LongExtFront : 247|10@1+ (0.05,0) [0|51.15] "m"  VCM
 SG_ RFSideSensorObj01_LongPosVar : 48|8@1+ (0.01,0) [0|2.55] "NotApplicable"  VCM
 SG_ RFSideSensorObj01_Heading : 144|11@1+ (0.005818,-4.71) [-4.71|7.199446] "rad"  VCM
 SG_ RFSideSensorObj01_MOISPrio : 307|1@1+ (1,0) [0|0] ""  VCM
 SG_ RFSideSensorObj01_LongVelVar : 40|8@1+ (0.01,0) [0|2.55] "NotApplicable"  VCM
 SG_ RFSideSensorObj01_LatPos : 221|13@1+ (0.05,-180) [-180|229.55] "m"  VCM
 SG_ RFSideSensorObj01_LatExtLeftVar : 104|8@1+ (0.1,0) [0|25.5] "NotApplicable"  VCM
 SG_ RFSideSensorObj01_LongExtBkVar : 64|8@1+ (0.1,0) [0|25.5] "NotApplicable"  VCM
 SG_ RFSideSensorObj01_LatExtRight : 185|7@1+ (0.05,-5) [-5|1.35] "m"  VCM
 SG_ RFSideSensorObj01_LongAccVar : 72|8@1+ (0.1,0) [0|25.5] "NotApplicable"  VCM
 SG_ RFSideSensorObj01_LatExtRtVar : 96|8@1+ (0.1,0) [0|25.5] "NotApplicable"  VCM
 SG_ RFSideSensorObj01_LongAcc : 176|9@1+ (0.08,-20) [-20|20.88] "m_per_s_squared"  VCM
 SG_ RFSideSensorObj01_TimeStamp : 24|16@1+ (0.1,0) [0|6553.5] "ms"  VCM
 SG_ RFSideSensorObj01_Prioritisation : 290|2@1+ (1,0) [0|0] ""  VCM
 SG_ RFSideSensorObj01_LongExtBack : 257|10@1+ (0.05,-50) [-50|1.15000000000001] "m"  VCM
 SG_ RFSideSensorObj01_LatVelVar : 80|8@1+ (0.01,0) [0|2.55] "NotApplicable"  VCM
 SG_ RFSideSensorObj01_Counter : 16|8@1+ (1,0) [0|255] "Count"  VCM
 SG_ RFSideSensorObj01_Height : 168|8@1+ (0.02,0) [0|5.1] "m"  VCM
 SG_ RFSideSensorObj01_LatPosVar : 88|8@1+ (0.1,0) [0|25.5] "NotApplicable"  VCM
 SG_ RFSideSensorObj01_ObjDynClass : 166|2@1+ (1,0) [0|0] ""  VCM
 SG_ RFSideSensorObj01_CRC : 0|16@1+ (1,0) [0|65535] "NotApplicable"  VCM
 SG_ RFSideSensorObj01_LifeTime : 128|16@1+ (0.1,0) [0|6553.5] "s"  VCM
 SG_ RFSideSensorObj01_LongExtFrVar : 56|8@1+ (0.1,0) [0|25.5] "NotApplicable"  VCM
 SG_ RFSideSensorObj01_ObjID : 160|6@1+ (1,0) [0|63] "NotApplicable"  VCM
 SG_ RFSideSensorObj01_LatAcc : 267|9@1+ (0.08,-20) [-20|20.88] "m_per_s_squared"  VCM
 SG_ RFSideSensorObj01_TrackStatus : 192|3@1+ (1,0) [0|0] ""  VCM
 SG_ RFSideSensorObj01_LongPos : 234|13@1+ (0.05,-180) [-180|229.55] "m"  VCM
 SG_ RFSideSensorObj01_HeadingVar : 120|8@1+ (0.001,0) [0|0.255] "NotApplicable"  VCM
 SG_ RFSideSensorObj01_ObstacleConf : 300|7@1+ (0.01,0) [0|1.27] "NotApplicable"  VCM
 SG_ RFSideSensorObj01_ObjClass : 292|4@1+ (1,0) [0|0] ""  VCM

BO_ 800 RFSideSensorObj00: 48 SR_RF
 SG_ RFSideSensorObj00_LongPos : 234|13@1+ (0.05,-180) [-180|229.55] "m"  VCM
 SG_ RFSideSensorObj00_LongExtFrVar : 56|8@1+ (0.1,0) [0|25.5] "NotApplicable"  VCM
 SG_ RFSideSensorObj00_LatAccVar : 112|8@1+ (0.1,0) [0|25.5] "NotApplicable"  VCM
 SG_ RFSideSensorObj00_MOISPrio : 307|1@1+ (1,0) [0|0] ""  VCM
 SG_ RFSideSensorObj00_LongAcc : 176|9@1+ (0.08,-20) [-20|20.88] "m_per_s_squared"  VCM
 SG_ RFSideSensorObj00_ObstacleConf : 300|7@1+ (0.01,0) [0|1.27] "NotApplicable"  VCM
 SG_ RFSideSensorObj00_ObjClass : 292|4@1+ (1,0) [0|0] ""  VCM
 SG_ RFSideSensorObj00_LatExtLeft : 276|7@1+ (0.05,0) [0|6.35] "m"  VCM
 SG_ RFSideSensorObj00_ObjDynClass : 166|2@1+ (1,0) [0|0] ""  VCM
 SG_ RFSideSensorObj00_LatPosVar : 88|8@1+ (0.1,0) [0|25.5] "NotApplicable"  VCM
 SG_ RFSideSensorObj00_ObjID : 160|6@1+ (1,0) [0|63] "NotApplicable"  VCM
 SG_ RFSideSensorObj00_TimeStamp : 24|16@1+ (0.1,0) [0|6553.5] "ms"  VCM
 SG_ RFSideSensorObj00_LatVel : 208|13@1+ (0.032,-80) [-80|182.112] "m_per_s"  VCM
 SG_ RFSideSensorObj00_LongVelVar : 40|8@1+ (0.01,0) [0|2.55] "NotApplicable"  VCM
 SG_ RFSideSensorObj00_LatExtRtVar : 96|8@1+ (0.1,0) [0|25.5] "NotApplicable"  VCM
 SG_ RFSideSensorObj00_TrackStatus : 192|3@1+ (1,0) [0|0] ""  VCM
 SG_ RFSideSensorObj00_LongPosVar : 48|8@1+ (0.01,0) [0|2.55] "NotApplicable"  VCM
 SG_ RFSideSensorObj00_LatExtLeftVar : 104|8@1+ (0.1,0) [0|25.5] "NotApplicable"  VCM
 SG_ RFSideSensorObj00_HeadingVar : 120|8@1+ (0.001,0) [0|0.255] "NotApplicable"  VCM
 SG_ RFSideSensorObj00_LongExtBkVar : 64|8@1+ (0.1,0) [0|25.5] "NotApplicable"  VCM
 SG_ RFSideSensorObj00_LatVelVar : 80|8@1+ (0.01,0) [0|2.55] "NotApplicable"  VCM
 SG_ RFSideSensorObj00_LongAccVar : 72|8@1+ (0.1,0) [0|25.5] "NotApplicable"  VCM
 SG_ RFSideSensorObj00_Heading : 144|11@1+ (0.005818,-4.71) [-4.71|7.199446] "rad"  VCM
 SG_ RFSideSensorObj00_Height : 168|8@1+ (0.02,0) [0|5.1] "m"  VCM
 SG_ RFSideSensorObj00_LongExtBack : 257|10@1+ (0.05,-50) [-50|1.15000000000001] "m"  VCM
 SG_ RFSideSensorObj00_ObjClassConf : 296|4@1+ (0.1,0) [0|1.5] "NotApplicable"  VCM
 SG_ RFSideSensorObj00_LongVel : 195|13@1+ (0.032,-80) [-80|182.112] "m_per_s"  VCM
 SG_ RFSideSensorObj00_LatPos : 221|13@1+ (0.05,-180) [-180|229.55] "m"  VCM
 SG_ RFSideSensorObj00_CRC : 0|16@1+ (1,0) [0|65535] "NotApplicable"  VCM
 SG_ RFSideSensorObj00_LongExtFront : 247|10@1+ (0.05,0) [0|51.15] "m"  VCM
 SG_ RFSideSensorObj00_LatAcc : 267|9@1+ (0.08,-20) [-20|20.88] "m_per_s_squared"  VCM
 SG_ RFSideSensorObj00_Counter : 16|8@1+ (1,0) [0|255] "Count"  VCM
 SG_ RFSideSensorObj00_Prioritisation : 290|2@1+ (1,0) [0|0] ""  VCM
 SG_ RFSideSensorObj00_LifeTime : 128|16@1+ (0.1,0) [0|6553.5] "s"  VCM
 SG_ RFSideSensorObj00_ExistConf : 283|7@1+ (0.01,0) [0|1.27] "NotApplicable"  VCM
 SG_ RFSideSensorObj00_LatExtRight : 185|7@1+ (0.05,-5) [-5|1.35] "m"  VCM
 SG_ RFSideSensorObj00_CoastIndex : 155|5@1+ (1,0) [0|31] "NotApplicable"  VCM

BO_ 1554 RFSRSwVersion_Vic4: 64 SR_RF
 SG_ RFSRSwVersion_Substring0 : 0|64@1+ (1,0) [0|0] ""  VCM
 SG_ RFSRSwVersion_Substring7 : 448|64@1+ (1,0) [0|0] ""  VCM
 SG_ RFSRSwVersion_Substring5 : 320|64@1+ (1,0) [0|0] ""  VCM
 SG_ RFSRSwVersion_Substring2 : 128|64@1+ (1,0) [0|0] ""  VCM
 SG_ RFSRSwVersion_Substring6 : 384|64@1+ (1,0) [0|0] ""  VCM
 SG_ RFSRSwVersion_Substring3 : 192|64@1+ (1,0) [0|0] ""  VCM
 SG_ RFSRSwVersion_Substring4 : 256|64@1+ (1,0) [0|0] ""  VCM
 SG_ RFSRSwVersion_Substring1 : 64|64@1+ (1,0) [0|0] ""  VCM

BO_ 815 RFSRRaisedEdge_Vic4: 20 SR_RF
 SG_ RFSRRaisedEdge_LatDist : 114|12@1+ (0.005,-10) [-10|10.475] "m"  VCM
 SG_ RFSRRaisedEdge_CoastIndex : 75|5@1+ (1,0) [0|31] "NotApplicable"  VCM
 SG_ RFSRRaisedEdge_LatDistVar : 48|8@1+ (0.001,0) [0|0.255] "NotApplicable"  VCM
 SG_ RFSRRaisedEdge_HeadingAngle : 80|13@1+ (0.0005,-1.57) [-1.57|2.5255] "rad"  VCM
 SG_ RFSRRaisedEdge_TrackStatus : 93|3@1+ (1,0) [0|0] ""  VCM
 SG_ RFSRRaisedEdge_CurvatureRate : 64|11@1+ (5.1E-007,-0.000516) [-0.000516|0.00052797] "per_meter_squared"  VCM
 SG_ RFSRRaisedEdge_CRC : 0|16@1+ (1,0) [0|65535] "NotApplicable"  VCM
 SG_ RFSRRaisedEdge_DxStart : 40|8@1+ (1,0) [0|255] "m"  VCM
 SG_ RFSRRaisedEdge_DxEnd : 56|8@1+ (1,0) [0|255] "m"  VCM
 SG_ RFSRRaisedEdge_TimeStamp : 24|16@1+ (0.1,0) [0|6553.5] "ms"  VCM
 SG_ RFSRRaisedEdge_Confidence : 126|7@1+ (0.01,0) [0|1.27] "NotApplicable"  VCM
 SG_ RFSRRaisedEdge_Counter : 16|8@1+ (1,0) [0|255] "Count"  VCM
 SG_ RFSRRaisedEdge_Curvature : 96|18@1+ (1E-006,-0.1310705) [-0.1310705|0.1310725] "per_meter"  VCM
 SG_ RFSRRaisedEdge_Type : 133|3@1+ (1,0) [0|0] ""  VCM
 SG_ RFSRRaisedEdge_LifeTime : 136|16@1+ (0.1,0) [0|6553.5] "s"  VCM

BO_ 814 RFSREgoAssumpt_Vic4: 16 SR_RF
 SG_ RFSREgoAssumpt_EgoYawRate : 32|16@1+ (0.000122,-3.92) [-3.92|4.07527] "Rad_per_s"  VCM
 SG_ RFSREgoAssumpt_EgoRoadHeading : 80|13@1+ (0.0005,-1.57) [-1.57|2.5255] "rad"  VCM
 SG_ RFSREgoAssumpt_TimeStamp : 48|16@1+ (0.1,0) [0|6553.5] "ms"  VCM
 SG_ RFSREgoAssumpt_EgoRoadCurvRate : 93|11@1+ (5.1E-007,-0.000516) [-0.000516|0.00052797] "per_meter_squared"  VCM
 SG_ RFSREgoAssumpt_EgoLongAcc : 16|16@1+ (0.00048828125,-15.6875) [-15.6875|16.31201171875] "m_per_s_squared"  VCM
 SG_ RFSREgoAssumpt_VelCorrFactor : 64|8@1+ (0.002,0.75) [0.75|1.26] "NotApplicable"  VCM
 SG_ RFSREgoAssumpt_EgoLongVel : 0|16@1+ (0.00108507,0) [0|71.11006245] "m_per_s"  VCM
 SG_ RFSREgoAssumpt_EgoRoadCurvature : 104|18@1+ (1E-006,-0.1310705) [-0.1310705|0.1310725] "per_meter"  VCM
 SG_ RFSREgoAssumpt_EgoRoadEnd : 72|8@1+ (1,0) [0|255] "m"  VCM

BO_ 2671833707 PhysDiagRespMsg_F2_6B_Vic4: 8 SR_RF
 SG_ PhysDiagRespSig_F2_6B : 0|64@1+ (1,0) [0|0] ""  VCM

BO_ 2671833706 PhysDiagRespMsg_F2_6A_Vic4: 8 SR_RR
 SG_ PhysDiagRespSig_F2_6A : 0|64@1+ (1,0) [0|0] ""  VCM

BO_ 2671833705 PhysDiagRespMsg_F2_69_Vic4: 8 SR_LF
 SG_ PhysDiagRespSig_F2_69 : 0|64@1+ (1,0) [0|0] ""  VCM

BO_ 2671833704 PhysDiagRespMsg_F2_68_Vic4: 8 SR_LR
 SG_ PhysDiagRespSig_F2_68 : 0|64@1+ (1,0) [0|0] ""  VCM

BO_ 2671799282 PhysDiagReqMsg_6B_F2_Vic4: 8 DACU
 SG_ PhysDiagReqSig_6B_F2 : 0|64@1+ (1,0) [0|0] ""  SR_RF

BO_ 2671799026 PhysDiagReqMsg_6A_F2_Vic4: 8 DACU
 SG_ PhysDiagReqSig_6A_F2 : 0|64@1+ (1,0) [0|0] ""  SR_RR

BO_ 2671798770 PhysDiagReqMsg_69_F2_Vic4: 8 DACU
 SG_ PhysDiagReqSig_69_F2 : 0|64@1+ (1,0) [0|0] ""  SR_LF

BA_DEF_ BO_  "GenMsgStartDelayTime" INT 0 0;
BA_DEF_ BO_  "GenMsgDelayTime" INT 0 0;
BA_DEF_ BO_  "GenMsgCycleTime" INT 0 0;
BA_DEF_ BO_  "GenMsgSendType" ENUM  "Cyclic","NotUsed","NotUsed","NotUsed","NotUsed","NotUsed","NotUsed","IfActive","NoMsgSendType","NotUsed";
BA_DEF_ SG_  "GenSigStartValue" INT 0 0;
BA_DEF_ SG_  "GenSigCycleTimeActive" INT 0 0;
BA_DEF_ SG_  "GenSigCycleTime" INT 0 0;
BA_DEF_ SG_  "GenSigSendType" ENUM  "Cyclic","OnWrite","OnWriteWithRepetition","OnChange","OnChangeWithRepetition","IfActive","IfActiveWithRepetition","NoSigSendType","NotUsed","NotUsed","NotUsed","NotUsed","NotUsed";
BA_DEF_ BO_  "VFrameFormat" ENUM  "StandardCAN","ExtendedCAN","reserved","J1939PG","reserved","reserved","reserved","reserved","reserved","reserved","reserved","reserved","reserved","reserved","StandardCAN_FD","ExtendedCAN_FD";
BA_DEF_ SG_  "SigType" ENUM  "Default","Range","RangeSigned","ASCII","Discrete","Control","ReferencePGN","DTC","StringDelimiter","StringLength","StringLengthControl";
BA_DEF_ SG_  "SeToolVersion_SIGNAL" STRING ;
BA_DEF_ SG_  "SeToolUniqueID_SIGNAL" STRING ;
BA_DEF_ SG_  "SeToolName_SIGNAL" STRING ;
BA_DEF_ SG_  "SeToolItemID_SIGNAL" STRING ;
BA_DEF_ SG_  "SeToolAncestorID_SIGNAL" STRING ;
BA_DEF_ SG_  "Platform_VMCU1_Sig" ENUM  "No","Yes";
BA_DEF_ SG_  "NeedsUpdateBit" ENUM  "No","Yes";
BA_DEF_ SG_  "GenSigMaxLatency" INT 0 65535;
BA_DEF_ SG_  "GenSigILSupport" ENUM  "Yes","No";
BA_DEF_ BO_  "GenMsgILSupport" ENUM  "No","Yes";
BA_DEF_ SG_  "E2EProfile" STRING ;
BA_DEF_ SG_  "E2EDataLength" INT 0 65535;
BA_DEF_ SG_  "E2EDataId" INT 0 65535;
BA_DEF_ BO_  "DiagUUDTResponse" ENUM  "No","Yes";
BA_DEF_ BO_  "DiagState" ENUM  "No","Yes";
BA_DEF_ BO_  "DiagResponse" ENUM  "No","Yes";
BA_DEF_ BO_  "DiagRequest" ENUM  "No","Yes";
BA_DEF_ BO_  "DiagConnection" HEX 0 65535;
BA_DEF_ BO_  "CanTpFcFrameId" HEX 0 2147483647;
BA_DEF_ BO_  "CanTpBs" INT 0 255;
BA_DEF_ BO_  "CANFD_BRS" ENUM  "0","1";
BA_DEF_REL_ BU_SG_REL_  "GenSigTimeoutTime" INT 0 65535;
BA_DEF_REL_ BU_SG_REL_  "GenSigFirstTimeoutTime" INT 0 65535;
BA_DEF_DEF_  "GenMsgStartDelayTime" 0;
BA_DEF_DEF_  "GenMsgDelayTime" 0;
BA_DEF_DEF_  "GenMsgCycleTime" 0;
BA_DEF_DEF_  "GenMsgSendType" "Cyclic";
BA_DEF_DEF_  "GenSigStartValue" 0;
BA_DEF_DEF_  "GenSigCycleTimeActive" 0;
BA_DEF_DEF_  "GenSigCycleTime" 0;
BA_DEF_DEF_  "GenSigSendType" "Cyclic";
BA_DEF_DEF_  "VFrameFormat" "ExtendedCAN";
BA_DEF_DEF_  "SigType" "Default";
BA_DEF_DEF_  "SeToolVersion_SIGNAL" "";
BA_DEF_DEF_  "SeToolUniqueID_SIGNAL" "";
BA_DEF_DEF_  "SeToolName_SIGNAL" "";
BA_DEF_DEF_  "SeToolItemID_SIGNAL" "";
BA_DEF_DEF_  "SeToolAncestorID_SIGNAL" "";
BA_DEF_DEF_  "Platform_VMCU1_Sig" "No";
BA_DEF_DEF_  "NeedsUpdateBit" "No";
BA_DEF_DEF_  "GenSigMaxLatency" 0;
BA_DEF_DEF_  "GenSigILSupport" "Yes";
BA_DEF_DEF_  "GenMsgILSupport" "Yes";
BA_DEF_DEF_  "E2EProfile" "none";
BA_DEF_DEF_  "E2EDataLength" 0;
BA_DEF_DEF_  "E2EDataId" 0;
BA_DEF_DEF_  "DiagUUDTResponse" "No";
BA_DEF_DEF_  "DiagState" "No";
BA_DEF_DEF_  "DiagResponse" "No";
BA_DEF_DEF_  "DiagRequest" "No";
BA_DEF_DEF_  "DiagConnection" 0;
BA_DEF_DEF_  "CanTpFcFrameId" 2147483647;
BA_DEF_DEF_  "CanTpBs" 255;
BA_DEF_DEF_  "CANFD_BRS" "0";
BA_DEF_DEF_REL_ "GenSigTimeoutTime" 0;
BA_DEF_DEF_REL_ "GenSigFirstTimeoutTime" 0;
BA_ "CANFD_BRS" BO_ 816 1;
BA_ "GenMsgSendType" BO_ 816 8;
BA_ "GenMsgDelayTime" BO_ 816 10;
BA_ "VFrameFormat" BO_ 816 14;
BA_ "CANFD_BRS" BO_ 1555 1;
BA_ "GenMsgCycleTime" BO_ 1555 10000;
BA_ "GenMsgStartDelayTime" BO_ 1555 125;
BA_ "VFrameFormat" BO_ 1555 14;
BA_ "CANFD_BRS" BO_ 831 1;
BA_ "GenMsgSendType" BO_ 831 8;
BA_ "VFrameFormat" BO_ 831 14;
BA_ "CANFD_BRS" BO_ 830 1;
BA_ "GenMsgSendType" BO_ 830 8;
BA_ "VFrameFormat" BO_ 830 14;
BA_ "CANFD_BRS" BO_ 812 1;
BA_ "GenMsgSendType" BO_ 812 8;
BA_ "GenMsgDelayTime" BO_ 812 10;
BA_ "VFrameFormat" BO_ 812 14;
BA_ "CANFD_BRS" BO_ 811 1;
BA_ "GenMsgSendType" BO_ 811 8;
BA_ "GenMsgDelayTime" BO_ 811 10;
BA_ "VFrameFormat" BO_ 811 14;
BA_ "CANFD_BRS" BO_ 810 1;
BA_ "GenMsgSendType" BO_ 810 8;
BA_ "GenMsgDelayTime" BO_ 810 10;
BA_ "VFrameFormat" BO_ 810 14;
BA_ "CANFD_BRS" BO_ 809 1;
BA_ "GenMsgSendType" BO_ 809 8;
BA_ "GenMsgDelayTime" BO_ 809 10;
BA_ "VFrameFormat" BO_ 809 14;
BA_ "CANFD_BRS" BO_ 808 1;
BA_ "GenMsgSendType" BO_ 808 8;
BA_ "GenMsgDelayTime" BO_ 808 10;
BA_ "VFrameFormat" BO_ 808 14;
BA_ "CANFD_BRS" BO_ 807 1;
BA_ "GenMsgSendType" BO_ 807 8;
BA_ "GenMsgDelayTime" BO_ 807 10;
BA_ "VFrameFormat" BO_ 807 14;
BA_ "CANFD_BRS" BO_ 806 1;
BA_ "GenMsgSendType" BO_ 806 8;
BA_ "GenMsgDelayTime" BO_ 806 10;
BA_ "VFrameFormat" BO_ 806 14;
BA_ "CANFD_BRS" BO_ 805 1;
BA_ "GenMsgSendType" BO_ 805 8;
BA_ "GenMsgDelayTime" BO_ 805 10;
BA_ "VFrameFormat" BO_ 805 14;
BA_ "CANFD_BRS" BO_ 804 1;
BA_ "GenMsgSendType" BO_ 804 8;
BA_ "GenMsgDelayTime" BO_ 804 10;
BA_ "VFrameFormat" BO_ 804 14;
BA_ "CANFD_BRS" BO_ 803 1;
BA_ "GenMsgSendType" BO_ 803 8;
BA_ "GenMsgDelayTime" BO_ 803 10;
BA_ "VFrameFormat" BO_ 803 14;
BA_ "CANFD_BRS" BO_ 802 1;
BA_ "GenMsgSendType" BO_ 802 8;
BA_ "GenMsgDelayTime" BO_ 802 10;
BA_ "VFrameFormat" BO_ 802 14;
BA_ "CANFD_BRS" BO_ 801 1;
BA_ "GenMsgSendType" BO_ 801 8;
BA_ "GenMsgDelayTime" BO_ 801 10;
BA_ "VFrameFormat" BO_ 801 14;
BA_ "CANFD_BRS" BO_ 800 1;
BA_ "GenMsgSendType" BO_ 800 8;
BA_ "GenMsgDelayTime" BO_ 800 10;
BA_ "VFrameFormat" BO_ 800 14;
BA_ "CANFD_BRS" BO_ 1554 1;
BA_ "GenMsgCycleTime" BO_ 1554 10000;
BA_ "GenMsgStartDelayTime" BO_ 1554 125;
BA_ "VFrameFormat" BO_ 1554 14;
BA_ "CANFD_BRS" BO_ 815 1;
BA_ "GenMsgSendType" BO_ 815 8;
BA_ "VFrameFormat" BO_ 815 14;
BA_ "CANFD_BRS" BO_ 814 1;
BA_ "GenMsgSendType" BO_ 814 8;
BA_ "VFrameFormat" BO_ 814 14;
BA_ "DiagConnection" BO_ 2671833707 62059;
BA_ "DiagResponse" BO_ 2671833707 1;
BA_ "GenMsgILSupport" BO_ 2671833707 0;
BA_ "GenMsgSendType" BO_ 2671833707 8;
BA_ "DiagConnection" BO_ 2671833706 62058;
BA_ "DiagResponse" BO_ 2671833706 1;
BA_ "GenMsgILSupport" BO_ 2671833706 0;
BA_ "GenMsgSendType" BO_ 2671833706 8;
BA_ "DiagConnection" BO_ 2671833705 62057;
BA_ "DiagResponse" BO_ 2671833705 1;
BA_ "GenMsgILSupport" BO_ 2671833705 0;
BA_ "GenMsgSendType" BO_ 2671833705 8;
BA_ "DiagConnection" BO_ 2671833704 62056;
BA_ "DiagResponse" BO_ 2671833704 1;
BA_ "GenMsgILSupport" BO_ 2671833704 0;
BA_ "GenMsgSendType" BO_ 2671833704 8;
BA_ "DiagConnection" BO_ 2671799282 62059;
BA_ "DiagRequest" BO_ 2671799282 1;
BA_ "GenMsgILSupport" BO_ 2671799282 0;
BA_ "GenMsgSendType" BO_ 2671799282 8;
BA_ "DiagConnection" BO_ 2671799026 62058;
BA_ "DiagRequest" BO_ 2671799026 1;
BA_ "GenMsgILSupport" BO_ 2671799026 0;
BA_ "GenMsgSendType" BO_ 2671799026 8;
BA_ "DiagConnection" BO_ 2671798770 62057;
BA_ "DiagRequest" BO_ 2671798770 1;
BA_ "GenMsgILSupport" BO_ 2671798770 0;
BA_ "GenMsgSendType" BO_ 2671798770 8;
BA_ "GenSigSendType" SG_ 816 RRSideSensorObj00_ObjID 1;
BA_ "GenSigStartValue" SG_ 816 RRSideSensorObj00_ObjID 63;
BA_ "GenSigSendType" SG_ 816 RRSideSensorObj00_ObstacleConf 1;
BA_ "GenSigStartValue" SG_ 816 RRSideSensorObj00_ObstacleConf 127;
BA_ "GenSigSendType" SG_ 816 RRSideSensorObj00_ObjClass 1;
BA_ "GenSigStartValue" SG_ 816 RRSideSensorObj00_ObjClass 15;
BA_ "GenSigSendType" SG_ 816 RRSideSensorObj00_TrackStatus 1;
BA_ "GenSigStartValue" SG_ 816 RRSideSensorObj00_TrackStatus 7;
BA_ "GenSigSendType" SG_ 816 RRSideSensorObj00_LongPosVar 1;
BA_ "GenSigStartValue" SG_ 816 RRSideSensorObj00_LongPosVar 255;
BA_ "GenSigSendType" SG_ 816 RRSideSensorObj00_LongExtBack 1;
BA_ "GenSigStartValue" SG_ 816 RRSideSensorObj00_LongExtBack 1023;
BA_ "GenSigSendType" SG_ 816 RRSideSensorObj00_LatPos 1;
BA_ "GenSigStartValue" SG_ 816 RRSideSensorObj00_LatPos 8191;
BA_ "GenSigSendType" SG_ 816 RRSideSensorObj00_LongAccVar 1;
BA_ "GenSigStartValue" SG_ 816 RRSideSensorObj00_LongAccVar 255;
BA_ "GenSigSendType" SG_ 816 RRSideSensorObj00_LatExtRight 1;
BA_ "GenSigStartValue" SG_ 816 RRSideSensorObj00_LatExtRight 127;
BA_ "GenSigSendType" SG_ 816 RRSideSensorObj00_LatVelVar 1;
BA_ "GenSigStartValue" SG_ 816 RRSideSensorObj00_LatVelVar 255;
BA_ "GenSigSendType" SG_ 816 RRSideSensorObj00_CRC 1;
BA_ "GenSigStartValue" SG_ 816 RRSideSensorObj00_CRC 65535;
BA_ "E2EDataId" SG_ 816 RRSideSensorObj00_CRC 54;
BA_ "E2EDataLength" SG_ 816 RRSideSensorObj00_CRC 312;
BA_ "E2EProfile" SG_ 816 RRSideSensorObj00_CRC "P05";
BA_ "GenSigSendType" SG_ 816 RRSideSensorObj00_MOISPrio 1;
BA_ "GenSigSendType" SG_ 816 RRSideSensorObj00_ObjClassConf 1;
BA_ "GenSigStartValue" SG_ 816 RRSideSensorObj00_ObjClassConf 15;
BA_ "GenSigSendType" SG_ 816 RRSideSensorObj00_LatAcc 1;
BA_ "GenSigStartValue" SG_ 816 RRSideSensorObj00_LatAcc 511;
BA_ "GenSigSendType" SG_ 816 RRSideSensorObj00_LatExtRtVar 1;
BA_ "GenSigStartValue" SG_ 816 RRSideSensorObj00_LatExtRtVar 255;
BA_ "GenSigSendType" SG_ 816 RRSideSensorObj00_LongPos 1;
BA_ "GenSigStartValue" SG_ 816 RRSideSensorObj00_LongPos 8191;
BA_ "GenSigSendType" SG_ 816 RRSideSensorObj00_Height 1;
BA_ "GenSigStartValue" SG_ 816 RRSideSensorObj00_Height 255;
BA_ "GenSigSendType" SG_ 816 RRSideSensorObj00_TimeStamp 1;
BA_ "GenSigStartValue" SG_ 816 RRSideSensorObj00_TimeStamp 65535;
BA_ "GenSigSendType" SG_ 816 RRSideSensorObj00_LongExtFrVar 1;
BA_ "GenSigStartValue" SG_ 816 RRSideSensorObj00_LongExtFrVar 255;
BA_ "GenSigSendType" SG_ 816 RRSideSensorObj00_CoastIndex 1;
BA_ "GenSigStartValue" SG_ 816 RRSideSensorObj00_CoastIndex 31;
BA_ "GenSigSendType" SG_ 816 RRSideSensorObj00_LatExtLeft 1;
BA_ "GenSigStartValue" SG_ 816 RRSideSensorObj00_LatExtLeft 127;
BA_ "GenSigSendType" SG_ 816 RRSideSensorObj00_Counter 1;
BA_ "GenSigStartValue" SG_ 816 RRSideSensorObj00_Counter 255;
BA_ "GenSigSendType" SG_ 816 RRSideSensorObj00_ExistConf 1;
BA_ "GenSigStartValue" SG_ 816 RRSideSensorObj00_ExistConf 127;
BA_ "GenSigSendType" SG_ 816 RRSideSensorObj00_LatVel 1;
BA_ "GenSigStartValue" SG_ 816 RRSideSensorObj00_LatVel 8191;
BA_ "GenSigSendType" SG_ 816 RRSideSensorObj00_LongAcc 1;
BA_ "GenSigStartValue" SG_ 816 RRSideSensorObj00_LongAcc 511;
BA_ "GenSigSendType" SG_ 816 RRSideSensorObj00_HeadingVar 1;
BA_ "GenSigStartValue" SG_ 816 RRSideSensorObj00_HeadingVar 255;
BA_ "GenSigSendType" SG_ 816 RRSideSensorObj00_LatExtLeftVar 1;
BA_ "GenSigStartValue" SG_ 816 RRSideSensorObj00_LatExtLeftVar 255;
BA_ "GenSigSendType" SG_ 816 RRSideSensorObj00_LifeTime 1;
BA_ "GenSigStartValue" SG_ 816 RRSideSensorObj00_LifeTime 65535;
BA_ "GenSigSendType" SG_ 816 RRSideSensorObj00_LatPosVar 1;
BA_ "GenSigStartValue" SG_ 816 RRSideSensorObj00_LatPosVar 255;
BA_ "GenSigSendType" SG_ 816 RRSideSensorObj00_LongExtFront 1;
BA_ "GenSigStartValue" SG_ 816 RRSideSensorObj00_LongExtFront 1023;
BA_ "GenSigSendType" SG_ 816 RRSideSensorObj00_Heading 1;
BA_ "GenSigStartValue" SG_ 816 RRSideSensorObj00_Heading 2047;
BA_ "GenSigSendType" SG_ 816 RRSideSensorObj00_Prioritisation 1;
BA_ "GenSigStartValue" SG_ 816 RRSideSensorObj00_Prioritisation 3;
BA_ "GenSigSendType" SG_ 816 RRSideSensorObj00_LatAccVar 1;
BA_ "GenSigStartValue" SG_ 816 RRSideSensorObj00_LatAccVar 255;
BA_ "GenSigSendType" SG_ 816 RRSideSensorObj00_LongExtBkVar 1;
BA_ "GenSigStartValue" SG_ 816 RRSideSensorObj00_LongExtBkVar 255;
BA_ "GenSigSendType" SG_ 816 RRSideSensorObj00_LongVel 1;
BA_ "GenSigStartValue" SG_ 816 RRSideSensorObj00_LongVel 8191;
BA_ "GenSigSendType" SG_ 816 RRSideSensorObj00_ObjDynClass 1;
BA_ "GenSigStartValue" SG_ 816 RRSideSensorObj00_ObjDynClass 3;
BA_ "GenSigSendType" SG_ 816 RRSideSensorObj00_LongVelVar 1;
BA_ "GenSigStartValue" SG_ 816 RRSideSensorObj00_LongVelVar 255;
BA_ "GenSigCycleTime" SG_ 1555 RRSRSwVersion_Substring0 100;
BA_ "GenSigCycleTimeActive" SG_ 1555 RRSRSwVersion_Substring0 100;
BA_ "GenSigCycleTime" SG_ 1555 RRSRSwVersion_Substring4 100;
BA_ "GenSigCycleTimeActive" SG_ 1555 RRSRSwVersion_Substring4 100;
BA_ "GenSigCycleTime" SG_ 1555 RRSRSwVersion_Substring1 100;
BA_ "GenSigCycleTimeActive" SG_ 1555 RRSRSwVersion_Substring1 100;
BA_ "GenSigCycleTime" SG_ 1555 RRSRSwVersion_Substring7 100;
BA_ "GenSigCycleTimeActive" SG_ 1555 RRSRSwVersion_Substring7 100;
BA_ "GenSigCycleTime" SG_ 1555 RRSRSwVersion_Substring2 100;
BA_ "GenSigCycleTimeActive" SG_ 1555 RRSRSwVersion_Substring2 100;
BA_ "GenSigCycleTime" SG_ 1555 RRSRSwVersion_Substring3 100;
BA_ "GenSigCycleTimeActive" SG_ 1555 RRSRSwVersion_Substring3 100;
BA_ "GenSigCycleTime" SG_ 1555 RRSRSwVersion_Substring5 100;
BA_ "GenSigCycleTimeActive" SG_ 1555 RRSRSwVersion_Substring5 100;
BA_ "GenSigCycleTime" SG_ 1555 RRSRSwVersion_Substring6 100;
BA_ "GenSigCycleTimeActive" SG_ 1555 RRSRSwVersion_Substring6 100;
BA_ "GenSigSendType" SG_ 831 RRSRRaisedEdge_LifeTime 1;
BA_ "GenSigStartValue" SG_ 831 RRSRRaisedEdge_LifeTime 65535;
BA_ "GenSigSendType" SG_ 831 RRSRRaisedEdge_CRC 1;
BA_ "GenSigStartValue" SG_ 831 RRSRRaisedEdge_CRC 65535;
BA_ "E2EDataId" SG_ 831 RRSRRaisedEdge_CRC 115;
BA_ "E2EDataLength" SG_ 831 RRSRRaisedEdge_CRC 152;
BA_ "E2EProfile" SG_ 831 RRSRRaisedEdge_CRC "P05";
BA_ "GenSigSendType" SG_ 831 RRSRRaisedEdge_HeadingAngle 1;
BA_ "GenSigStartValue" SG_ 831 RRSRRaisedEdge_HeadingAngle 8191;
BA_ "GenSigSendType" SG_ 831 RRSRRaisedEdge_Type 1;
BA_ "GenSigStartValue" SG_ 831 RRSRRaisedEdge_Type 7;
BA_ "GenSigSendType" SG_ 831 RRSRRaisedEdge_DxStart 1;
BA_ "GenSigStartValue" SG_ 831 RRSRRaisedEdge_DxStart 255;
BA_ "GenSigSendType" SG_ 831 RRSRRaisedEdge_TimeStamp 1;
BA_ "GenSigStartValue" SG_ 831 RRSRRaisedEdge_TimeStamp 65535;
BA_ "GenSigSendType" SG_ 831 RRSRRaisedEdge_Confidence 1;
BA_ "GenSigStartValue" SG_ 831 RRSRRaisedEdge_Confidence 127;
BA_ "GenSigSendType" SG_ 831 RRSRRaisedEdge_DxEnd 1;
BA_ "GenSigStartValue" SG_ 831 RRSRRaisedEdge_DxEnd 255;
BA_ "GenSigSendType" SG_ 831 RRSRRaisedEdge_LatDistVar 1;
BA_ "GenSigStartValue" SG_ 831 RRSRRaisedEdge_LatDistVar 255;
BA_ "GenSigSendType" SG_ 831 RRSRRaisedEdge_CoastIndex 1;
BA_ "GenSigStartValue" SG_ 831 RRSRRaisedEdge_CoastIndex 31;
BA_ "GenSigSendType" SG_ 831 RRSRRaisedEdge_LatDist 1;
BA_ "GenSigStartValue" SG_ 831 RRSRRaisedEdge_LatDist 4095;
BA_ "GenSigSendType" SG_ 831 RRSRRaisedEdge_Counter 1;
BA_ "GenSigStartValue" SG_ 831 RRSRRaisedEdge_Counter 255;
BA_ "GenSigSendType" SG_ 831 RRSRRaisedEdge_CurvatureRate 1;
BA_ "GenSigStartValue" SG_ 831 RRSRRaisedEdge_CurvatureRate 2047;
BA_ "GenSigSendType" SG_ 831 RRSRRaisedEdge_TrackStatus 1;
BA_ "GenSigStartValue" SG_ 831 RRSRRaisedEdge_TrackStatus 7;
BA_ "GenSigSendType" SG_ 831 RRSRRaisedEdge_Curvature 1;
BA_ "GenSigStartValue" SG_ 831 RRSRRaisedEdge_Curvature 262143;
BA_ "GenSigSendType" SG_ 830 RRSREgoAssumpt_EgoYawRate 1;
BA_ "GenSigStartValue" SG_ 830 RRSREgoAssumpt_EgoYawRate 65535;
BA_ "GenSigSendType" SG_ 830 RRSREgoAssumpt_EgoRoadEnd 1;
BA_ "GenSigStartValue" SG_ 830 RRSREgoAssumpt_EgoRoadEnd 255;
BA_ "GenSigSendType" SG_ 830 RRSREgoAssumpt_EgoRoadHeading 1;
BA_ "GenSigStartValue" SG_ 830 RRSREgoAssumpt_EgoRoadHeading 8191;
BA_ "GenSigSendType" SG_ 830 RRSREgoAssumpt_EgoRoadCurvRate 1;
BA_ "GenSigStartValue" SG_ 830 RRSREgoAssumpt_EgoRoadCurvRate 2047;
BA_ "GenSigSendType" SG_ 830 RRSREgoAssumpt_EgoLongVel 1;
BA_ "GenSigStartValue" SG_ 830 RRSREgoAssumpt_EgoLongVel 65535;
BA_ "GenSigSendType" SG_ 830 RRSREgoAssumpt_VelCorrFactor 1;
BA_ "GenSigStartValue" SG_ 830 RRSREgoAssumpt_VelCorrFactor 255;
BA_ "GenSigSendType" SG_ 830 RRSREgoAssumpt_EgoRoadCurvature 1;
BA_ "GenSigStartValue" SG_ 830 RRSREgoAssumpt_EgoRoadCurvature 262143;
BA_ "GenSigSendType" SG_ 830 RRSREgoAssumpt_EgoLongAcc 1;
BA_ "GenSigStartValue" SG_ 830 RRSREgoAssumpt_EgoLongAcc 65535;
BA_ "GenSigSendType" SG_ 830 RRSREgoAssumpt_TimeStamp 1;
BA_ "GenSigStartValue" SG_ 830 RRSREgoAssumpt_TimeStamp 65535;
BA_ "GenSigSendType" SG_ 812 RFSideSensorTrlrObj_TrlrTypeConf 1;
BA_ "GenSigStartValue" SG_ 812 RFSideSensorTrlrObj_TrlrTypeConf 127;
BA_ "GenSigSendType" SG_ 812 RFSideSensorTrlrObj_WheelBased3 1;
BA_ "GenSigStartValue" SG_ 812 RFSideSensorTrlrObj_WheelBased3 2047;
BA_ "GenSigSendType" SG_ 812 RFSideSensorTrlrObj_TrlAnglConf 1;
BA_ "GenSigStartValue" SG_ 812 RFSideSensorTrlrObj_TrlAnglConf 127;
BA_ "GenSigSendType" SG_ 812 RFSideSensorTrlrObj_Seg5Length 1;
BA_ "GenSigStartValue" SG_ 812 RFSideSensorTrlrObj_Seg5Length 511;
BA_ "GenSigSendType" SG_ 812 RFSideSensorTrlrObj_SegAngle3 1;
BA_ "GenSigStartValue" SG_ 812 RFSideSensorTrlrObj_SegAngle3 4095;
BA_ "GenSigSendType" SG_ 812 RFSideSensorTrlrObj_SegAngle1 1;
BA_ "GenSigStartValue" SG_ 812 RFSideSensorTrlrObj_SegAngle1 4095;
BA_ "GenSigSendType" SG_ 812 RFSideSensorTrlrObj_SegTrlrType3 1;
BA_ "GenSigStartValue" SG_ 812 RFSideSensorTrlrObj_SegTrlrType3 15;
BA_ "GenSigSendType" SG_ 812 RFSideSensorTrlrObj_Seg1Length 1;
BA_ "GenSigStartValue" SG_ 812 RFSideSensorTrlrObj_Seg1Length 511;
BA_ "GenSigSendType" SG_ 812 RFSideSensorTrlrObj_WheelBased2 1;
BA_ "GenSigStartValue" SG_ 812 RFSideSensorTrlrObj_WheelBased2 2047;
BA_ "GenSigSendType" SG_ 812 RFSideSensorTrlrObj_SegTrlrType1 1;
BA_ "GenSigStartValue" SG_ 812 RFSideSensorTrlrObj_SegTrlrType1 15;
BA_ "GenSigSendType" SG_ 812 RFSideSensorTrlrObj_SegAngle2 1;
BA_ "GenSigStartValue" SG_ 812 RFSideSensorTrlrObj_SegAngle2 4095;
BA_ "GenSigSendType" SG_ 812 RFSideSensorTrlrObj_SegAngle4 1;
BA_ "GenSigStartValue" SG_ 812 RFSideSensorTrlrObj_SegAngle4 4095;
BA_ "GenSigSendType" SG_ 812 RFSideSensorTrlrObj_Seg3Length 1;
BA_ "GenSigStartValue" SG_ 812 RFSideSensorTrlrObj_Seg3Length 511;
BA_ "GenSigSendType" SG_ 812 RFSideSensorTrlrObj_Seg2Length 1;
BA_ "GenSigStartValue" SG_ 812 RFSideSensorTrlrObj_Seg2Length 511;
BA_ "GenSigSendType" SG_ 812 RFSideSensorTrlrObj_WhlBasedConf 1;
BA_ "GenSigStartValue" SG_ 812 RFSideSensorTrlrObj_WhlBasedConf 127;
BA_ "GenSigSendType" SG_ 812 RFSideSensorTrlrObj_WheelBased1 1;
BA_ "GenSigStartValue" SG_ 812 RFSideSensorTrlrObj_WheelBased1 2047;
BA_ "GenSigSendType" SG_ 812 RFSideSensorTrlrObj_SegTrlrType5 1;
BA_ "GenSigStartValue" SG_ 812 RFSideSensorTrlrObj_SegTrlrType5 15;
BA_ "GenSigSendType" SG_ 812 RFSideSensorTrlrObj_Seg4Length 1;
BA_ "GenSigStartValue" SG_ 812 RFSideSensorTrlrObj_Seg4Length 511;
BA_ "GenSigSendType" SG_ 812 RFSideSensorTrlrObj_WheelBased4 1;
BA_ "GenSigStartValue" SG_ 812 RFSideSensorTrlrObj_WheelBased4 2047;
BA_ "GenSigSendType" SG_ 812 RFSideSensorTrlrObj_SegAngle5 1;
BA_ "GenSigStartValue" SG_ 812 RFSideSensorTrlrObj_SegAngle5 4095;
BA_ "GenSigSendType" SG_ 812 RFSideSensorTrlrObj_TotLenConf 1;
BA_ "GenSigStartValue" SG_ 812 RFSideSensorTrlrObj_TotLenConf 7;
BA_ "GenSigSendType" SG_ 812 RFSideSensorTrlrObj_SegTrlrType4 1;
BA_ "GenSigStartValue" SG_ 812 RFSideSensorTrlrObj_SegTrlrType4 15;
BA_ "GenSigSendType" SG_ 812 RFSideSensorTrlrObj_WheelBased5 1;
BA_ "GenSigStartValue" SG_ 812 RFSideSensorTrlrObj_WheelBased5 2047;
BA_ "GenSigSendType" SG_ 812 RFSideSensorTrlrObj_SegTrlrType2 1;
BA_ "GenSigStartValue" SG_ 812 RFSideSensorTrlrObj_SegTrlrType2 15;
BA_ "GenSigSendType" SG_ 812 RFSideSensorTrlrObj_TotalLength 1;
BA_ "GenSigStartValue" SG_ 812 RFSideSensorTrlrObj_TotalLength 2047;
BA_ "GenSigSendType" SG_ 811 RFSideSensorObj11_HeadingVar 1;
BA_ "GenSigStartValue" SG_ 811 RFSideSensorObj11_HeadingVar 255;
BA_ "GenSigSendType" SG_ 811 RFSideSensorObj11_LatPosVar 1;
BA_ "GenSigStartValue" SG_ 811 RFSideSensorObj11_LatPosVar 255;
BA_ "GenSigSendType" SG_ 811 RFSideSensorObj11_MOISPrio 1;
BA_ "GenSigSendType" SG_ 811 RFSideSensorObj11_CRC 1;
BA_ "GenSigStartValue" SG_ 811 RFSideSensorObj11_CRC 65535;
BA_ "E2EDataId" SG_ 811 RFSideSensorObj11_CRC 53;
BA_ "E2EDataLength" SG_ 811 RFSideSensorObj11_CRC 312;
BA_ "E2EProfile" SG_ 811 RFSideSensorObj11_CRC "P05";
BA_ "GenSigSendType" SG_ 811 RFSideSensorObj11_LatVel 1;
BA_ "GenSigStartValue" SG_ 811 RFSideSensorObj11_LatVel 8191;
BA_ "GenSigSendType" SG_ 811 RFSideSensorObj11_LatAcc 1;
BA_ "GenSigStartValue" SG_ 811 RFSideSensorObj11_LatAcc 511;
BA_ "GenSigSendType" SG_ 811 RFSideSensorObj11_LatExtRtVar 1;
BA_ "GenSigStartValue" SG_ 811 RFSideSensorObj11_LatExtRtVar 255;
BA_ "GenSigSendType" SG_ 811 RFSideSensorObj11_LatExtLeftVar 1;
BA_ "GenSigStartValue" SG_ 811 RFSideSensorObj11_LatExtLeftVar 255;
BA_ "GenSigSendType" SG_ 811 RFSideSensorObj11_LongPosVar 1;
BA_ "GenSigStartValue" SG_ 811 RFSideSensorObj11_LongPosVar 255;
BA_ "GenSigSendType" SG_ 811 RFSideSensorObj11_ObjClassConf 1;
BA_ "GenSigStartValue" SG_ 811 RFSideSensorObj11_ObjClassConf 15;
BA_ "GenSigSendType" SG_ 811 RFSideSensorObj11_ObstacleConf 1;
BA_ "GenSigStartValue" SG_ 811 RFSideSensorObj11_ObstacleConf 127;
BA_ "GenSigSendType" SG_ 811 RFSideSensorObj11_LongVelVar 1;
BA_ "GenSigStartValue" SG_ 811 RFSideSensorObj11_LongVelVar 255;
BA_ "GenSigSendType" SG_ 811 RFSideSensorObj11_LongAcc 1;
BA_ "GenSigStartValue" SG_ 811 RFSideSensorObj11_LongAcc 511;
BA_ "GenSigSendType" SG_ 811 RFSideSensorObj11_ObjID 1;
BA_ "GenSigStartValue" SG_ 811 RFSideSensorObj11_ObjID 63;
BA_ "GenSigSendType" SG_ 811 RFSideSensorObj11_LifeTime 1;
BA_ "GenSigStartValue" SG_ 811 RFSideSensorObj11_LifeTime 65535;
BA_ "GenSigSendType" SG_ 811 RFSideSensorObj11_Counter 1;
BA_ "GenSigStartValue" SG_ 811 RFSideSensorObj11_Counter 255;
BA_ "GenSigSendType" SG_ 811 RFSideSensorObj11_LongExtFront 1;
BA_ "GenSigStartValue" SG_ 811 RFSideSensorObj11_LongExtFront 1023;
BA_ "GenSigSendType" SG_ 811 RFSideSensorObj11_ObjDynClass 1;
BA_ "GenSigStartValue" SG_ 811 RFSideSensorObj11_ObjDynClass 3;
BA_ "GenSigSendType" SG_ 811 RFSideSensorObj11_LongPos 1;
BA_ "GenSigStartValue" SG_ 811 RFSideSensorObj11_LongPos 8191;
BA_ "GenSigSendType" SG_ 811 RFSideSensorObj11_LongExtFrVar 1;
BA_ "GenSigStartValue" SG_ 811 RFSideSensorObj11_LongExtFrVar 255;
BA_ "GenSigSendType" SG_ 811 RFSideSensorObj11_LongExtBack 1;
BA_ "GenSigStartValue" SG_ 811 RFSideSensorObj11_LongExtBack 1023;
BA_ "GenSigSendType" SG_ 811 RFSideSensorObj11_LongExtBkVar 1;
BA_ "GenSigStartValue" SG_ 811 RFSideSensorObj11_LongExtBkVar 255;
BA_ "GenSigSendType" SG_ 811 RFSideSensorObj11_Prioritisation 1;
BA_ "GenSigStartValue" SG_ 811 RFSideSensorObj11_Prioritisation 3;
BA_ "GenSigSendType" SG_ 811 RFSideSensorObj11_LatExtRight 1;
BA_ "GenSigStartValue" SG_ 811 RFSideSensorObj11_LatExtRight 127;
BA_ "GenSigSendType" SG_ 811 RFSideSensorObj11_LatAccVar 1;
BA_ "GenSigStartValue" SG_ 811 RFSideSensorObj11_LatAccVar 255;
BA_ "GenSigSendType" SG_ 811 RFSideSensorObj11_ExistConf 1;
BA_ "GenSigStartValue" SG_ 811 RFSideSensorObj11_ExistConf 127;
BA_ "GenSigSendType" SG_ 811 RFSideSensorObj11_Heading 1;
BA_ "GenSigStartValue" SG_ 811 RFSideSensorObj11_Heading 2047;
BA_ "GenSigSendType" SG_ 811 RFSideSensorObj11_LongAccVar 1;
BA_ "GenSigStartValue" SG_ 811 RFSideSensorObj11_LongAccVar 255;
BA_ "GenSigSendType" SG_ 811 RFSideSensorObj11_TrackStatus 1;
BA_ "GenSigStartValue" SG_ 811 RFSideSensorObj11_TrackStatus 7;
BA_ "GenSigSendType" SG_ 811 RFSideSensorObj11_LatPos 1;
BA_ "GenSigStartValue" SG_ 811 RFSideSensorObj11_LatPos 8191;
BA_ "GenSigSendType" SG_ 811 RFSideSensorObj11_TimeStamp 1;
BA_ "GenSigStartValue" SG_ 811 RFSideSensorObj11_TimeStamp 65535;
BA_ "GenSigSendType" SG_ 811 RFSideSensorObj11_LatVelVar 1;
BA_ "GenSigStartValue" SG_ 811 RFSideSensorObj11_LatVelVar 255;
BA_ "GenSigSendType" SG_ 811 RFSideSensorObj11_LatExtLeft 1;
BA_ "GenSigStartValue" SG_ 811 RFSideSensorObj11_LatExtLeft 127;
BA_ "GenSigSendType" SG_ 811 RFSideSensorObj11_LongVel 1;
BA_ "GenSigStartValue" SG_ 811 RFSideSensorObj11_LongVel 8191;
BA_ "GenSigSendType" SG_ 811 RFSideSensorObj11_CoastIndex 1;
BA_ "GenSigStartValue" SG_ 811 RFSideSensorObj11_CoastIndex 31;
BA_ "GenSigSendType" SG_ 811 RFSideSensorObj11_ObjClass 1;
BA_ "GenSigStartValue" SG_ 811 RFSideSensorObj11_ObjClass 15;
BA_ "GenSigSendType" SG_ 811 RFSideSensorObj11_Height 1;
BA_ "GenSigStartValue" SG_ 811 RFSideSensorObj11_Height 255;
BA_ "GenSigSendType" SG_ 810 RFSideSensorObj10_Prioritisation 1;
BA_ "GenSigStartValue" SG_ 810 RFSideSensorObj10_Prioritisation 3;
BA_ "GenSigSendType" SG_ 810 RFSideSensorObj10_LatAcc 1;
BA_ "GenSigStartValue" SG_ 810 RFSideSensorObj10_LatAcc 511;
BA_ "GenSigSendType" SG_ 810 RFSideSensorObj10_LatPosVar 1;
BA_ "GenSigStartValue" SG_ 810 RFSideSensorObj10_LatPosVar 255;
BA_ "GenSigSendType" SG_ 810 RFSideSensorObj10_LatExtLeftVar 1;
BA_ "GenSigStartValue" SG_ 810 RFSideSensorObj10_LatExtLeftVar 255;
BA_ "GenSigSendType" SG_ 810 RFSideSensorObj10_ObjDynClass 1;
BA_ "GenSigStartValue" SG_ 810 RFSideSensorObj10_ObjDynClass 3;
BA_ "GenSigSendType" SG_ 810 RFSideSensorObj10_CoastIndex 1;
BA_ "GenSigStartValue" SG_ 810 RFSideSensorObj10_CoastIndex 31;
BA_ "GenSigSendType" SG_ 810 RFSideSensorObj10_LongExtFront 1;
BA_ "GenSigStartValue" SG_ 810 RFSideSensorObj10_LongExtFront 1023;
BA_ "GenSigSendType" SG_ 810 RFSideSensorObj10_LatExtLeft 1;
BA_ "GenSigStartValue" SG_ 810 RFSideSensorObj10_LatExtLeft 127;
BA_ "GenSigSendType" SG_ 810 RFSideSensorObj10_ExistConf 1;
BA_ "GenSigStartValue" SG_ 810 RFSideSensorObj10_ExistConf 127;
BA_ "GenSigSendType" SG_ 810 RFSideSensorObj10_ObjClass 1;
BA_ "GenSigStartValue" SG_ 810 RFSideSensorObj10_ObjClass 15;
BA_ "GenSigSendType" SG_ 810 RFSideSensorObj10_LongExtBack 1;
BA_ "GenSigStartValue" SG_ 810 RFSideSensorObj10_LongExtBack 1023;
BA_ "GenSigSendType" SG_ 810 RFSideSensorObj10_HeadingVar 1;
BA_ "GenSigStartValue" SG_ 810 RFSideSensorObj10_HeadingVar 255;
BA_ "GenSigSendType" SG_ 810 RFSideSensorObj10_LatExtRight 1;
BA_ "GenSigStartValue" SG_ 810 RFSideSensorObj10_LatExtRight 127;
BA_ "GenSigSendType" SG_ 810 RFSideSensorObj10_LatVelVar 1;
BA_ "GenSigStartValue" SG_ 810 RFSideSensorObj10_LatVelVar 255;
BA_ "GenSigSendType" SG_ 810 RFSideSensorObj10_LongVelVar 1;
BA_ "GenSigStartValue" SG_ 810 RFSideSensorObj10_LongVelVar 255;
BA_ "GenSigSendType" SG_ 810 RFSideSensorObj10_TrackStatus 1;
BA_ "GenSigStartValue" SG_ 810 RFSideSensorObj10_TrackStatus 7;
BA_ "GenSigSendType" SG_ 810 RFSideSensorObj10_LongPosVar 1;
BA_ "GenSigStartValue" SG_ 810 RFSideSensorObj10_LongPosVar 255;
BA_ "GenSigSendType" SG_ 810 RFSideSensorObj10_LatVel 1;
BA_ "GenSigStartValue" SG_ 810 RFSideSensorObj10_LatVel 8191;
BA_ "GenSigSendType" SG_ 810 RFSideSensorObj10_MOISPrio 1;
BA_ "GenSigSendType" SG_ 810 RFSideSensorObj10_Height 1;
BA_ "GenSigStartValue" SG_ 810 RFSideSensorObj10_Height 255;
BA_ "GenSigSendType" SG_ 810 RFSideSensorObj10_LongAccVar 1;
BA_ "GenSigStartValue" SG_ 810 RFSideSensorObj10_LongAccVar 255;
BA_ "GenSigSendType" SG_ 810 RFSideSensorObj10_LifeTime 1;
BA_ "GenSigStartValue" SG_ 810 RFSideSensorObj10_LifeTime 65535;
BA_ "GenSigSendType" SG_ 810 RFSideSensorObj10_ObjID 1;
BA_ "GenSigStartValue" SG_ 810 RFSideSensorObj10_ObjID 63;
BA_ "GenSigSendType" SG_ 810 RFSideSensorObj10_LatExtRtVar 1;
BA_ "GenSigStartValue" SG_ 810 RFSideSensorObj10_LatExtRtVar 255;
BA_ "GenSigSendType" SG_ 810 RFSideSensorObj10_TimeStamp 1;
BA_ "GenSigStartValue" SG_ 810 RFSideSensorObj10_TimeStamp 65535;
BA_ "GenSigSendType" SG_ 810 RFSideSensorObj10_LongVel 1;
BA_ "GenSigStartValue" SG_ 810 RFSideSensorObj10_LongVel 8191;
BA_ "GenSigSendType" SG_ 810 RFSideSensorObj10_Heading 1;
BA_ "GenSigStartValue" SG_ 810 RFSideSensorObj10_Heading 2047;
BA_ "GenSigSendType" SG_ 810 RFSideSensorObj10_LongPos 1;
BA_ "GenSigStartValue" SG_ 810 RFSideSensorObj10_LongPos 8191;
BA_ "GenSigSendType" SG_ 810 RFSideSensorObj10_LongExtFrVar 1;
BA_ "GenSigStartValue" SG_ 810 RFSideSensorObj10_LongExtFrVar 255;
BA_ "GenSigSendType" SG_ 810 RFSideSensorObj10_LatAccVar 1;
BA_ "GenSigStartValue" SG_ 810 RFSideSensorObj10_LatAccVar 255;
BA_ "GenSigSendType" SG_ 810 RFSideSensorObj10_ObjClassConf 1;
BA_ "GenSigStartValue" SG_ 810 RFSideSensorObj10_ObjClassConf 15;
BA_ "GenSigSendType" SG_ 810 RFSideSensorObj10_ObstacleConf 1;
BA_ "GenSigStartValue" SG_ 810 RFSideSensorObj10_ObstacleConf 127;
BA_ "GenSigSendType" SG_ 810 RFSideSensorObj10_LongAcc 1;
BA_ "GenSigStartValue" SG_ 810 RFSideSensorObj10_LongAcc 511;
BA_ "GenSigSendType" SG_ 810 RFSideSensorObj10_LongExtBkVar 1;
BA_ "GenSigStartValue" SG_ 810 RFSideSensorObj10_LongExtBkVar 255;
BA_ "GenSigSendType" SG_ 810 RFSideSensorObj10_LatPos 1;
BA_ "GenSigStartValue" SG_ 810 RFSideSensorObj10_LatPos 8191;
BA_ "GenSigSendType" SG_ 810 RFSideSensorObj10_CRC 1;
BA_ "GenSigStartValue" SG_ 810 RFSideSensorObj10_CRC 65535;
BA_ "E2EDataId" SG_ 810 RFSideSensorObj10_CRC 52;
BA_ "E2EDataLength" SG_ 810 RFSideSensorObj10_CRC 312;
BA_ "E2EProfile" SG_ 810 RFSideSensorObj10_CRC "P05";
BA_ "GenSigSendType" SG_ 810 RFSideSensorObj10_Counter 1;
BA_ "GenSigStartValue" SG_ 810 RFSideSensorObj10_Counter 255;
BA_ "GenSigSendType" SG_ 809 RFSideSensorObj09_LongPos 1;
BA_ "GenSigStartValue" SG_ 809 RFSideSensorObj09_LongPos 8191;
BA_ "GenSigSendType" SG_ 809 RFSideSensorObj09_ObjClass 1;
BA_ "GenSigStartValue" SG_ 809 RFSideSensorObj09_ObjClass 15;
BA_ "GenSigSendType" SG_ 809 RFSideSensorObj09_LongVelVar 1;
BA_ "GenSigStartValue" SG_ 809 RFSideSensorObj09_LongVelVar 255;
BA_ "GenSigSendType" SG_ 809 RFSideSensorObj09_LongPosVar 1;
BA_ "GenSigStartValue" SG_ 809 RFSideSensorObj09_LongPosVar 255;
BA_ "GenSigSendType" SG_ 809 RFSideSensorObj09_LatPosVar 1;
BA_ "GenSigStartValue" SG_ 809 RFSideSensorObj09_LatPosVar 255;
BA_ "GenSigSendType" SG_ 809 RFSideSensorObj09_Prioritisation 1;
BA_ "GenSigStartValue" SG_ 809 RFSideSensorObj09_Prioritisation 3;
BA_ "GenSigSendType" SG_ 809 RFSideSensorObj09_LifeTime 1;
BA_ "GenSigStartValue" SG_ 809 RFSideSensorObj09_LifeTime 65535;
BA_ "GenSigSendType" SG_ 809 RFSideSensorObj09_MOISPrio 1;
BA_ "GenSigSendType" SG_ 809 RFSideSensorObj09_CoastIndex 1;
BA_ "GenSigStartValue" SG_ 809 RFSideSensorObj09_CoastIndex 31;
BA_ "GenSigSendType" SG_ 809 RFSideSensorObj09_LatVel 1;
BA_ "GenSigStartValue" SG_ 809 RFSideSensorObj09_LatVel 8191;
BA_ "GenSigSendType" SG_ 809 RFSideSensorObj09_LongExtBack 1;
BA_ "GenSigStartValue" SG_ 809 RFSideSensorObj09_LongExtBack 1023;
BA_ "GenSigSendType" SG_ 809 RFSideSensorObj09_LatExtLeft 1;
BA_ "GenSigStartValue" SG_ 809 RFSideSensorObj09_LatExtLeft 127;
BA_ "GenSigSendType" SG_ 809 RFSideSensorObj09_LatVelVar 1;
BA_ "GenSigStartValue" SG_ 809 RFSideSensorObj09_LatVelVar 255;
BA_ "GenSigSendType" SG_ 809 RFSideSensorObj09_LongVel 1;
BA_ "GenSigStartValue" SG_ 809 RFSideSensorObj09_LongVel 8191;
BA_ "GenSigSendType" SG_ 809 RFSideSensorObj09_LatExtRtVar 1;
BA_ "GenSigStartValue" SG_ 809 RFSideSensorObj09_LatExtRtVar 255;
BA_ "GenSigSendType" SG_ 809 RFSideSensorObj09_LatPos 1;
BA_ "GenSigStartValue" SG_ 809 RFSideSensorObj09_LatPos 8191;
BA_ "GenSigSendType" SG_ 809 RFSideSensorObj09_LatExtLeftVar 1;
BA_ "GenSigStartValue" SG_ 809 RFSideSensorObj09_LatExtLeftVar 255;
BA_ "GenSigSendType" SG_ 809 RFSideSensorObj09_LongAccVar 1;
BA_ "GenSigStartValue" SG_ 809 RFSideSensorObj09_LongAccVar 255;
BA_ "GenSigSendType" SG_ 809 RFSideSensorObj09_ObjID 1;
BA_ "GenSigStartValue" SG_ 809 RFSideSensorObj09_ObjID 63;
BA_ "GenSigSendType" SG_ 809 RFSideSensorObj09_LongExtFrVar 1;
BA_ "GenSigStartValue" SG_ 809 RFSideSensorObj09_LongExtFrVar 255;
BA_ "GenSigSendType" SG_ 809 RFSideSensorObj09_LongExtBkVar 1;
BA_ "GenSigStartValue" SG_ 809 RFSideSensorObj09_LongExtBkVar 255;
BA_ "GenSigSendType" SG_ 809 RFSideSensorObj09_CRC 1;
BA_ "GenSigStartValue" SG_ 809 RFSideSensorObj09_CRC 65535;
BA_ "E2EDataId" SG_ 809 RFSideSensorObj09_CRC 51;
BA_ "E2EDataLength" SG_ 809 RFSideSensorObj09_CRC 312;
BA_ "E2EProfile" SG_ 809 RFSideSensorObj09_CRC "P05";
BA_ "GenSigSendType" SG_ 809 RFSideSensorObj09_LongExtFront 1;
BA_ "GenSigStartValue" SG_ 809 RFSideSensorObj09_LongExtFront 1023;
BA_ "GenSigSendType" SG_ 809 RFSideSensorObj09_LatExtRight 1;
BA_ "GenSigStartValue" SG_ 809 RFSideSensorObj09_LatExtRight 127;
BA_ "GenSigSendType" SG_ 809 RFSideSensorObj09_LatAccVar 1;
BA_ "GenSigStartValue" SG_ 809 RFSideSensorObj09_LatAccVar 255;
BA_ "GenSigSendType" SG_ 809 RFSideSensorObj09_LongAcc 1;
BA_ "GenSigStartValue" SG_ 809 RFSideSensorObj09_LongAcc 511;
BA_ "GenSigSendType" SG_ 809 RFSideSensorObj09_LatAcc 1;
BA_ "GenSigStartValue" SG_ 809 RFSideSensorObj09_LatAcc 511;
BA_ "GenSigSendType" SG_ 809 RFSideSensorObj09_ObjClassConf 1;
BA_ "GenSigStartValue" SG_ 809 RFSideSensorObj09_ObjClassConf 15;
BA_ "GenSigSendType" SG_ 809 RFSideSensorObj09_TrackStatus 1;
BA_ "GenSigStartValue" SG_ 809 RFSideSensorObj09_TrackStatus 7;
BA_ "GenSigSendType" SG_ 809 RFSideSensorObj09_HeadingVar 1;
BA_ "GenSigStartValue" SG_ 809 RFSideSensorObj09_HeadingVar 255;
BA_ "GenSigSendType" SG_ 809 RFSideSensorObj09_Height 1;
BA_ "GenSigStartValue" SG_ 809 RFSideSensorObj09_Height 255;
BA_ "GenSigSendType" SG_ 809 RFSideSensorObj09_ObstacleConf 1;
BA_ "GenSigStartValue" SG_ 809 RFSideSensorObj09_ObstacleConf 127;
BA_ "GenSigSendType" SG_ 809 RFSideSensorObj09_Counter 1;
BA_ "GenSigStartValue" SG_ 809 RFSideSensorObj09_Counter 255;
BA_ "GenSigSendType" SG_ 809 RFSideSensorObj09_TimeStamp 1;
BA_ "GenSigStartValue" SG_ 809 RFSideSensorObj09_TimeStamp 65535;
BA_ "GenSigSendType" SG_ 809 RFSideSensorObj09_Heading 1;
BA_ "GenSigStartValue" SG_ 809 RFSideSensorObj09_Heading 2047;
BA_ "GenSigSendType" SG_ 809 RFSideSensorObj09_ExistConf 1;
BA_ "GenSigStartValue" SG_ 809 RFSideSensorObj09_ExistConf 127;
BA_ "GenSigSendType" SG_ 809 RFSideSensorObj09_ObjDynClass 1;
BA_ "GenSigStartValue" SG_ 809 RFSideSensorObj09_ObjDynClass 3;
BA_ "GenSigSendType" SG_ 808 RFSideSensorObj08_LongExtBack 1;
BA_ "GenSigStartValue" SG_ 808 RFSideSensorObj08_LongExtBack 1023;
BA_ "GenSigSendType" SG_ 808 RFSideSensorObj08_LongPos 1;
BA_ "GenSigStartValue" SG_ 808 RFSideSensorObj08_LongPos 8191;
BA_ "GenSigSendType" SG_ 808 RFSideSensorObj08_LifeTime 1;
BA_ "GenSigStartValue" SG_ 808 RFSideSensorObj08_LifeTime 65535;
BA_ "GenSigSendType" SG_ 808 RFSideSensorObj08_CRC 1;
BA_ "GenSigStartValue" SG_ 808 RFSideSensorObj08_CRC 65535;
BA_ "E2EDataId" SG_ 808 RFSideSensorObj08_CRC 50;
BA_ "E2EDataLength" SG_ 808 RFSideSensorObj08_CRC 312;
BA_ "E2EProfile" SG_ 808 RFSideSensorObj08_CRC "P05";
BA_ "GenSigSendType" SG_ 808 RFSideSensorObj08_LongExtBkVar 1;
BA_ "GenSigStartValue" SG_ 808 RFSideSensorObj08_LongExtBkVar 255;
BA_ "GenSigSendType" SG_ 808 RFSideSensorObj08_Prioritisation 1;
BA_ "GenSigStartValue" SG_ 808 RFSideSensorObj08_Prioritisation 3;
BA_ "GenSigSendType" SG_ 808 RFSideSensorObj08_LatVel 1;
BA_ "GenSigStartValue" SG_ 808 RFSideSensorObj08_LatVel 8191;
BA_ "GenSigSendType" SG_ 808 RFSideSensorObj08_ObjClass 1;
BA_ "GenSigStartValue" SG_ 808 RFSideSensorObj08_ObjClass 15;
BA_ "GenSigSendType" SG_ 808 RFSideSensorObj08_TrackStatus 1;
BA_ "GenSigStartValue" SG_ 808 RFSideSensorObj08_TrackStatus 7;
BA_ "GenSigSendType" SG_ 808 RFSideSensorObj08_MOISPrio 1;
BA_ "GenSigSendType" SG_ 808 RFSideSensorObj08_LatExtLeftVar 1;
BA_ "GenSigStartValue" SG_ 808 RFSideSensorObj08_LatExtLeftVar 255;
BA_ "GenSigSendType" SG_ 808 RFSideSensorObj08_ObstacleConf 1;
BA_ "GenSigStartValue" SG_ 808 RFSideSensorObj08_ObstacleConf 127;
BA_ "GenSigSendType" SG_ 808 RFSideSensorObj08_LongExtFrVar 1;
BA_ "GenSigStartValue" SG_ 808 RFSideSensorObj08_LongExtFrVar 255;
BA_ "GenSigSendType" SG_ 808 RFSideSensorObj08_LongAccVar 1;
BA_ "GenSigStartValue" SG_ 808 RFSideSensorObj08_LongAccVar 255;
BA_ "GenSigSendType" SG_ 808 RFSideSensorObj08_TimeStamp 1;
BA_ "GenSigStartValue" SG_ 808 RFSideSensorObj08_TimeStamp 65535;
BA_ "GenSigSendType" SG_ 808 RFSideSensorObj08_LatPos 1;
BA_ "GenSigStartValue" SG_ 808 RFSideSensorObj08_LatPos 8191;
BA_ "GenSigSendType" SG_ 808 RFSideSensorObj08_LatPosVar 1;
BA_ "GenSigStartValue" SG_ 808 RFSideSensorObj08_LatPosVar 255;
BA_ "GenSigSendType" SG_ 808 RFSideSensorObj08_ObjDynClass 1;
BA_ "GenSigStartValue" SG_ 808 RFSideSensorObj08_ObjDynClass 3;
BA_ "GenSigSendType" SG_ 808 RFSideSensorObj08_LongVelVar 1;
BA_ "GenSigStartValue" SG_ 808 RFSideSensorObj08_LongVelVar 255;
BA_ "GenSigSendType" SG_ 808 RFSideSensorObj08_LatAcc 1;
BA_ "GenSigStartValue" SG_ 808 RFSideSensorObj08_LatAcc 511;
BA_ "GenSigSendType" SG_ 808 RFSideSensorObj08_LatVelVar 1;
BA_ "GenSigStartValue" SG_ 808 RFSideSensorObj08_LatVelVar 255;
BA_ "GenSigSendType" SG_ 808 RFSideSensorObj08_ObjID 1;
BA_ "GenSigStartValue" SG_ 808 RFSideSensorObj08_ObjID 63;
BA_ "GenSigSendType" SG_ 808 RFSideSensorObj08_Height 1;
BA_ "GenSigStartValue" SG_ 808 RFSideSensorObj08_Height 255;
BA_ "GenSigSendType" SG_ 808 RFSideSensorObj08_CoastIndex 1;
BA_ "GenSigStartValue" SG_ 808 RFSideSensorObj08_CoastIndex 31;
BA_ "GenSigSendType" SG_ 808 RFSideSensorObj08_LatExtRtVar 1;
BA_ "GenSigStartValue" SG_ 808 RFSideSensorObj08_LatExtRtVar 255;
BA_ "GenSigSendType" SG_ 808 RFSideSensorObj08_LongExtFront 1;
BA_ "GenSigStartValue" SG_ 808 RFSideSensorObj08_LongExtFront 1023;
BA_ "GenSigSendType" SG_ 808 RFSideSensorObj08_LongPosVar 1;
BA_ "GenSigStartValue" SG_ 808 RFSideSensorObj08_LongPosVar 255;
BA_ "GenSigSendType" SG_ 808 RFSideSensorObj08_ObjClassConf 1;
BA_ "GenSigStartValue" SG_ 808 RFSideSensorObj08_ObjClassConf 15;
BA_ "GenSigSendType" SG_ 808 RFSideSensorObj08_HeadingVar 1;
BA_ "GenSigStartValue" SG_ 808 RFSideSensorObj08_HeadingVar 255;
BA_ "GenSigSendType" SG_ 808 RFSideSensorObj08_LatExtLeft 1;
BA_ "GenSigStartValue" SG_ 808 RFSideSensorObj08_LatExtLeft 127;
BA_ "GenSigSendType" SG_ 808 RFSideSensorObj08_Heading 1;
BA_ "GenSigStartValue" SG_ 808 RFSideSensorObj08_Heading 2047;
BA_ "GenSigSendType" SG_ 808 RFSideSensorObj08_LatExtRight 1;
BA_ "GenSigStartValue" SG_ 808 RFSideSensorObj08_LatExtRight 127;
BA_ "GenSigSendType" SG_ 808 RFSideSensorObj08_LongAcc 1;
BA_ "GenSigStartValue" SG_ 808 RFSideSensorObj08_LongAcc 511;
BA_ "GenSigSendType" SG_ 808 RFSideSensorObj08_LatAccVar 1;
BA_ "GenSigStartValue" SG_ 808 RFSideSensorObj08_LatAccVar 255;
BA_ "GenSigSendType" SG_ 808 RFSideSensorObj08_Counter 1;
BA_ "GenSigStartValue" SG_ 808 RFSideSensorObj08_Counter 255;
BA_ "GenSigSendType" SG_ 808 RFSideSensorObj08_ExistConf 1;
BA_ "GenSigStartValue" SG_ 808 RFSideSensorObj08_ExistConf 127;
BA_ "GenSigSendType" SG_ 808 RFSideSensorObj08_LongVel 1;
BA_ "GenSigStartValue" SG_ 808 RFSideSensorObj08_LongVel 8191;
BA_ "GenSigSendType" SG_ 807 RFSideSensorObj07_LatVel 1;
BA_ "GenSigStartValue" SG_ 807 RFSideSensorObj07_LatVel 8191;
BA_ "GenSigSendType" SG_ 807 RFSideSensorObj07_LatPosVar 1;
BA_ "GenSigStartValue" SG_ 807 RFSideSensorObj07_LatPosVar 255;
BA_ "GenSigSendType" SG_ 807 RFSideSensorObj07_ExistConf 1;
BA_ "GenSigStartValue" SG_ 807 RFSideSensorObj07_ExistConf 127;
BA_ "GenSigSendType" SG_ 807 RFSideSensorObj07_MOISPrio 1;
BA_ "GenSigSendType" SG_ 807 RFSideSensorObj07_LatAcc 1;
BA_ "GenSigStartValue" SG_ 807 RFSideSensorObj07_LatAcc 511;
BA_ "GenSigSendType" SG_ 807 RFSideSensorObj07_LongExtBack 1;
BA_ "GenSigStartValue" SG_ 807 RFSideSensorObj07_LongExtBack 1023;
BA_ "GenSigSendType" SG_ 807 RFSideSensorObj07_LatExtLeft 1;
BA_ "GenSigStartValue" SG_ 807 RFSideSensorObj07_LatExtLeft 127;
BA_ "GenSigSendType" SG_ 807 RFSideSensorObj07_Heading 1;
BA_ "GenSigStartValue" SG_ 807 RFSideSensorObj07_Heading 2047;
BA_ "GenSigSendType" SG_ 807 RFSideSensorObj07_LongExtFrVar 1;
BA_ "GenSigStartValue" SG_ 807 RFSideSensorObj07_LongExtFrVar 255;
BA_ "GenSigSendType" SG_ 807 RFSideSensorObj07_LongAcc 1;
BA_ "GenSigStartValue" SG_ 807 RFSideSensorObj07_LongAcc 511;
BA_ "GenSigSendType" SG_ 807 RFSideSensorObj07_Prioritisation 1;
BA_ "GenSigStartValue" SG_ 807 RFSideSensorObj07_Prioritisation 3;
BA_ "GenSigSendType" SG_ 807 RFSideSensorObj07_CoastIndex 1;
BA_ "GenSigStartValue" SG_ 807 RFSideSensorObj07_CoastIndex 31;
BA_ "GenSigSendType" SG_ 807 RFSideSensorObj07_LatAccVar 1;
BA_ "GenSigStartValue" SG_ 807 RFSideSensorObj07_LatAccVar 255;
BA_ "GenSigSendType" SG_ 807 RFSideSensorObj07_LatPos 1;
BA_ "GenSigStartValue" SG_ 807 RFSideSensorObj07_LatPos 8191;
BA_ "GenSigSendType" SG_ 807 RFSideSensorObj07_Counter 1;
BA_ "GenSigStartValue" SG_ 807 RFSideSensorObj07_Counter 255;
BA_ "GenSigSendType" SG_ 807 RFSideSensorObj07_LifeTime 1;
BA_ "GenSigStartValue" SG_ 807 RFSideSensorObj07_LifeTime 65535;
BA_ "GenSigSendType" SG_ 807 RFSideSensorObj07_ObjDynClass 1;
BA_ "GenSigStartValue" SG_ 807 RFSideSensorObj07_ObjDynClass 3;
BA_ "GenSigSendType" SG_ 807 RFSideSensorObj07_CRC 1;
BA_ "GenSigStartValue" SG_ 807 RFSideSensorObj07_CRC 65535;
BA_ "E2EDataId" SG_ 807 RFSideSensorObj07_CRC 49;
BA_ "E2EDataLength" SG_ 807 RFSideSensorObj07_CRC 312;
BA_ "E2EProfile" SG_ 807 RFSideSensorObj07_CRC "P05";
BA_ "GenSigSendType" SG_ 807 RFSideSensorObj07_LatExtRtVar 1;
BA_ "GenSigStartValue" SG_ 807 RFSideSensorObj07_LatExtRtVar 255;
BA_ "GenSigSendType" SG_ 807 RFSideSensorObj07_ObjID 1;
BA_ "GenSigStartValue" SG_ 807 RFSideSensorObj07_ObjID 63;
BA_ "GenSigSendType" SG_ 807 RFSideSensorObj07_ObjClassConf 1;
BA_ "GenSigStartValue" SG_ 807 RFSideSensorObj07_ObjClassConf 15;
BA_ "GenSigSendType" SG_ 807 RFSideSensorObj07_LatExtRight 1;
BA_ "GenSigStartValue" SG_ 807 RFSideSensorObj07_LatExtRight 127;
BA_ "GenSigSendType" SG_ 807 RFSideSensorObj07_LatVelVar 1;
BA_ "GenSigStartValue" SG_ 807 RFSideSensorObj07_LatVelVar 255;
BA_ "GenSigSendType" SG_ 807 RFSideSensorObj07_LongAccVar 1;
BA_ "GenSigStartValue" SG_ 807 RFSideSensorObj07_LongAccVar 255;
BA_ "GenSigSendType" SG_ 807 RFSideSensorObj07_ObjClass 1;
BA_ "GenSigStartValue" SG_ 807 RFSideSensorObj07_ObjClass 15;
BA_ "GenSigSendType" SG_ 807 RFSideSensorObj07_LongExtBkVar 1;
BA_ "GenSigStartValue" SG_ 807 RFSideSensorObj07_LongExtBkVar 255;
BA_ "GenSigSendType" SG_ 807 RFSideSensorObj07_TimeStamp 1;
BA_ "GenSigStartValue" SG_ 807 RFSideSensorObj07_TimeStamp 65535;
BA_ "GenSigSendType" SG_ 807 RFSideSensorObj07_TrackStatus 1;
BA_ "GenSigStartValue" SG_ 807 RFSideSensorObj07_TrackStatus 7;
BA_ "GenSigSendType" SG_ 807 RFSideSensorObj07_Height 1;
BA_ "GenSigStartValue" SG_ 807 RFSideSensorObj07_Height 255;
BA_ "GenSigSendType" SG_ 807 RFSideSensorObj07_LongPosVar 1;
BA_ "GenSigStartValue" SG_ 807 RFSideSensorObj07_LongPosVar 255;
BA_ "GenSigSendType" SG_ 807 RFSideSensorObj07_LongVel 1;
BA_ "GenSigStartValue" SG_ 807 RFSideSensorObj07_LongVel 8191;
BA_ "GenSigSendType" SG_ 807 RFSideSensorObj07_ObstacleConf 1;
BA_ "GenSigStartValue" SG_ 807 RFSideSensorObj07_ObstacleConf 127;
BA_ "GenSigSendType" SG_ 807 RFSideSensorObj07_LongExtFront 1;
BA_ "GenSigStartValue" SG_ 807 RFSideSensorObj07_LongExtFront 1023;
BA_ "GenSigSendType" SG_ 807 RFSideSensorObj07_LongVelVar 1;
BA_ "GenSigStartValue" SG_ 807 RFSideSensorObj07_LongVelVar 255;
BA_ "GenSigSendType" SG_ 807 RFSideSensorObj07_LongPos 1;
BA_ "GenSigStartValue" SG_ 807 RFSideSensorObj07_LongPos 8191;
BA_ "GenSigSendType" SG_ 807 RFSideSensorObj07_HeadingVar 1;
BA_ "GenSigStartValue" SG_ 807 RFSideSensorObj07_HeadingVar 255;
BA_ "GenSigSendType" SG_ 807 RFSideSensorObj07_LatExtLeftVar 1;
BA_ "GenSigStartValue" SG_ 807 RFSideSensorObj07_LatExtLeftVar 255;
BA_ "GenSigSendType" SG_ 806 RFSideSensorObj06_Prioritisation 1;
BA_ "GenSigStartValue" SG_ 806 RFSideSensorObj06_Prioritisation 3;
BA_ "GenSigSendType" SG_ 806 RFSideSensorObj06_LongExtFront 1;
BA_ "GenSigStartValue" SG_ 806 RFSideSensorObj06_LongExtFront 1023;
BA_ "GenSigSendType" SG_ 806 RFSideSensorObj06_MOISPrio 1;
BA_ "GenSigSendType" SG_ 806 RFSideSensorObj06_LatPosVar 1;
BA_ "GenSigStartValue" SG_ 806 RFSideSensorObj06_LatPosVar 255;
BA_ "GenSigSendType" SG_ 806 RFSideSensorObj06_ObjID 1;
BA_ "GenSigStartValue" SG_ 806 RFSideSensorObj06_ObjID 63;
BA_ "GenSigSendType" SG_ 806 RFSideSensorObj06_LongExtBack 1;
BA_ "GenSigStartValue" SG_ 806 RFSideSensorObj06_LongExtBack 1023;
BA_ "GenSigSendType" SG_ 806 RFSideSensorObj06_ExistConf 1;
BA_ "GenSigStartValue" SG_ 806 RFSideSensorObj06_ExistConf 127;
BA_ "GenSigSendType" SG_ 806 RFSideSensorObj06_LatPos 1;
BA_ "GenSigStartValue" SG_ 806 RFSideSensorObj06_LatPos 8191;
BA_ "GenSigSendType" SG_ 806 RFSideSensorObj06_ObjClassConf 1;
BA_ "GenSigStartValue" SG_ 806 RFSideSensorObj06_ObjClassConf 15;
BA_ "GenSigSendType" SG_ 806 RFSideSensorObj06_LongExtBkVar 1;
BA_ "GenSigStartValue" SG_ 806 RFSideSensorObj06_LongExtBkVar 255;
BA_ "GenSigSendType" SG_ 806 RFSideSensorObj06_LongAccVar 1;
BA_ "GenSigStartValue" SG_ 806 RFSideSensorObj06_LongAccVar 255;
BA_ "GenSigSendType" SG_ 806 RFSideSensorObj06_LongAcc 1;
BA_ "GenSigStartValue" SG_ 806 RFSideSensorObj06_LongAcc 511;
BA_ "GenSigSendType" SG_ 806 RFSideSensorObj06_TrackStatus 1;
BA_ "GenSigStartValue" SG_ 806 RFSideSensorObj06_TrackStatus 7;
BA_ "GenSigSendType" SG_ 806 RFSideSensorObj06_LatAccVar 1;
BA_ "GenSigStartValue" SG_ 806 RFSideSensorObj06_LatAccVar 255;
BA_ "GenSigSendType" SG_ 806 RFSideSensorObj06_ObjDynClass 1;
BA_ "GenSigStartValue" SG_ 806 RFSideSensorObj06_ObjDynClass 3;
BA_ "GenSigSendType" SG_ 806 RFSideSensorObj06_CoastIndex 1;
BA_ "GenSigStartValue" SG_ 806 RFSideSensorObj06_CoastIndex 31;
BA_ "GenSigSendType" SG_ 806 RFSideSensorObj06_LongPosVar 1;
BA_ "GenSigStartValue" SG_ 806 RFSideSensorObj06_LongPosVar 255;
BA_ "GenSigSendType" SG_ 806 RFSideSensorObj06_HeadingVar 1;
BA_ "GenSigStartValue" SG_ 806 RFSideSensorObj06_HeadingVar 255;
BA_ "GenSigSendType" SG_ 806 RFSideSensorObj06_CRC 1;
BA_ "GenSigStartValue" SG_ 806 RFSideSensorObj06_CRC 65535;
BA_ "E2EDataId" SG_ 806 RFSideSensorObj06_CRC 48;
BA_ "E2EDataLength" SG_ 806 RFSideSensorObj06_CRC 312;
BA_ "E2EProfile" SG_ 806 RFSideSensorObj06_CRC "P05";
BA_ "GenSigSendType" SG_ 806 RFSideSensorObj06_LongVel 1;
BA_ "GenSigStartValue" SG_ 806 RFSideSensorObj06_LongVel 8191;
BA_ "GenSigSendType" SG_ 806 RFSideSensorObj06_ObstacleConf 1;
BA_ "GenSigStartValue" SG_ 806 RFSideSensorObj06_ObstacleConf 127;
BA_ "GenSigSendType" SG_ 806 RFSideSensorObj06_LatExtLeftVar 1;
BA_ "GenSigStartValue" SG_ 806 RFSideSensorObj06_LatExtLeftVar 255;
BA_ "GenSigSendType" SG_ 806 RFSideSensorObj06_TimeStamp 1;
BA_ "GenSigStartValue" SG_ 806 RFSideSensorObj06_TimeStamp 65535;
BA_ "GenSigSendType" SG_ 806 RFSideSensorObj06_ObjClass 1;
BA_ "GenSigStartValue" SG_ 806 RFSideSensorObj06_ObjClass 15;
BA_ "GenSigSendType" SG_ 806 RFSideSensorObj06_LatVelVar 1;
BA_ "GenSigStartValue" SG_ 806 RFSideSensorObj06_LatVelVar 255;
BA_ "GenSigSendType" SG_ 806 RFSideSensorObj06_LifeTime 1;
BA_ "GenSigStartValue" SG_ 806 RFSideSensorObj06_LifeTime 65535;
BA_ "GenSigSendType" SG_ 806 RFSideSensorObj06_LatExtRtVar 1;
BA_ "GenSigStartValue" SG_ 806 RFSideSensorObj06_LatExtRtVar 255;
BA_ "GenSigSendType" SG_ 806 RFSideSensorObj06_LatAcc 1;
BA_ "GenSigStartValue" SG_ 806 RFSideSensorObj06_LatAcc 511;
BA_ "GenSigSendType" SG_ 806 RFSideSensorObj06_LongExtFrVar 1;
BA_ "GenSigStartValue" SG_ 806 RFSideSensorObj06_LongExtFrVar 255;
BA_ "GenSigSendType" SG_ 806 RFSideSensorObj06_Height 1;
BA_ "GenSigStartValue" SG_ 806 RFSideSensorObj06_Height 255;
BA_ "GenSigSendType" SG_ 806 RFSideSensorObj06_LongVelVar 1;
BA_ "GenSigStartValue" SG_ 806 RFSideSensorObj06_LongVelVar 255;
BA_ "GenSigSendType" SG_ 806 RFSideSensorObj06_LongPos 1;
BA_ "GenSigStartValue" SG_ 806 RFSideSensorObj06_LongPos 8191;
BA_ "GenSigSendType" SG_ 806 RFSideSensorObj06_LatExtRight 1;
BA_ "GenSigStartValue" SG_ 806 RFSideSensorObj06_LatExtRight 127;
BA_ "GenSigSendType" SG_ 806 RFSideSensorObj06_Heading 1;
BA_ "GenSigStartValue" SG_ 806 RFSideSensorObj06_Heading 2047;
BA_ "GenSigSendType" SG_ 806 RFSideSensorObj06_LatVel 1;
BA_ "GenSigStartValue" SG_ 806 RFSideSensorObj06_LatVel 8191;
BA_ "GenSigSendType" SG_ 806 RFSideSensorObj06_LatExtLeft 1;
BA_ "GenSigStartValue" SG_ 806 RFSideSensorObj06_LatExtLeft 127;
BA_ "GenSigSendType" SG_ 806 RFSideSensorObj06_Counter 1;
BA_ "GenSigStartValue" SG_ 806 RFSideSensorObj06_Counter 255;
BA_ "GenSigSendType" SG_ 805 RFSideSensorObj05_LongAcc 1;
BA_ "GenSigStartValue" SG_ 805 RFSideSensorObj05_LongAcc 511;
BA_ "GenSigSendType" SG_ 805 RFSideSensorObj05_LatPosVar 1;
BA_ "GenSigStartValue" SG_ 805 RFSideSensorObj05_LatPosVar 255;
BA_ "GenSigSendType" SG_ 805 RFSideSensorObj05_LatPos 1;
BA_ "GenSigStartValue" SG_ 805 RFSideSensorObj05_LatPos 8191;
BA_ "GenSigSendType" SG_ 805 RFSideSensorObj05_CRC 1;
BA_ "GenSigStartValue" SG_ 805 RFSideSensorObj05_CRC 65535;
BA_ "E2EDataId" SG_ 805 RFSideSensorObj05_CRC 47;
BA_ "E2EDataLength" SG_ 805 RFSideSensorObj05_CRC 312;
BA_ "E2EProfile" SG_ 805 RFSideSensorObj05_CRC "P05";
BA_ "GenSigSendType" SG_ 805 RFSideSensorObj05_LongExtBack 1;
BA_ "GenSigStartValue" SG_ 805 RFSideSensorObj05_LongExtBack 1023;
BA_ "GenSigSendType" SG_ 805 RFSideSensorObj05_Prioritisation 1;
BA_ "GenSigStartValue" SG_ 805 RFSideSensorObj05_Prioritisation 3;
BA_ "GenSigSendType" SG_ 805 RFSideSensorObj05_LatExtRtVar 1;
BA_ "GenSigStartValue" SG_ 805 RFSideSensorObj05_LatExtRtVar 255;
BA_ "GenSigSendType" SG_ 805 RFSideSensorObj05_LongExtFront 1;
BA_ "GenSigStartValue" SG_ 805 RFSideSensorObj05_LongExtFront 1023;
BA_ "GenSigSendType" SG_ 805 RFSideSensorObj05_TrackStatus 1;
BA_ "GenSigStartValue" SG_ 805 RFSideSensorObj05_TrackStatus 7;
BA_ "GenSigSendType" SG_ 805 RFSideSensorObj05_ObjDynClass 1;
BA_ "GenSigStartValue" SG_ 805 RFSideSensorObj05_ObjDynClass 3;
BA_ "GenSigSendType" SG_ 805 RFSideSensorObj05_HeadingVar 1;
BA_ "GenSigStartValue" SG_ 805 RFSideSensorObj05_HeadingVar 255;
BA_ "GenSigSendType" SG_ 805 RFSideSensorObj05_LatAccVar 1;
BA_ "GenSigStartValue" SG_ 805 RFSideSensorObj05_LatAccVar 255;
BA_ "GenSigSendType" SG_ 805 RFSideSensorObj05_LongExtFrVar 1;
BA_ "GenSigStartValue" SG_ 805 RFSideSensorObj05_LongExtFrVar 255;
BA_ "GenSigSendType" SG_ 805 RFSideSensorObj05_ExistConf 1;
BA_ "GenSigStartValue" SG_ 805 RFSideSensorObj05_ExistConf 127;
BA_ "GenSigSendType" SG_ 805 RFSideSensorObj05_ObjClass 1;
BA_ "GenSigStartValue" SG_ 805 RFSideSensorObj05_ObjClass 15;
BA_ "GenSigSendType" SG_ 805 RFSideSensorObj05_LongPos 1;
BA_ "GenSigStartValue" SG_ 805 RFSideSensorObj05_LongPos 8191;
BA_ "GenSigSendType" SG_ 805 RFSideSensorObj05_LatVelVar 1;
BA_ "GenSigStartValue" SG_ 805 RFSideSensorObj05_LatVelVar 255;
BA_ "GenSigSendType" SG_ 805 RFSideSensorObj05_MOISPrio 1;
BA_ "GenSigSendType" SG_ 805 RFSideSensorObj05_LatExtLeftVar 1;
BA_ "GenSigStartValue" SG_ 805 RFSideSensorObj05_LatExtLeftVar 255;
BA_ "GenSigSendType" SG_ 805 RFSideSensorObj05_LongAccVar 1;
BA_ "GenSigStartValue" SG_ 805 RFSideSensorObj05_LongAccVar 255;
BA_ "GenSigSendType" SG_ 805 RFSideSensorObj05_TimeStamp 1;
BA_ "GenSigStartValue" SG_ 805 RFSideSensorObj05_TimeStamp 65535;
BA_ "GenSigSendType" SG_ 805 RFSideSensorObj05_LatExtRight 1;
BA_ "GenSigStartValue" SG_ 805 RFSideSensorObj05_LatExtRight 127;
BA_ "GenSigSendType" SG_ 805 RFSideSensorObj05_LifeTime 1;
BA_ "GenSigStartValue" SG_ 805 RFSideSensorObj05_LifeTime 65535;
BA_ "GenSigSendType" SG_ 805 RFSideSensorObj05_LongPosVar 1;
BA_ "GenSigStartValue" SG_ 805 RFSideSensorObj05_LongPosVar 255;
BA_ "GenSigSendType" SG_ 805 RFSideSensorObj05_ObstacleConf 1;
BA_ "GenSigStartValue" SG_ 805 RFSideSensorObj05_ObstacleConf 127;
BA_ "GenSigSendType" SG_ 805 RFSideSensorObj05_Counter 1;
BA_ "GenSigStartValue" SG_ 805 RFSideSensorObj05_Counter 255;
BA_ "GenSigSendType" SG_ 805 RFSideSensorObj05_LongVelVar 1;
BA_ "GenSigStartValue" SG_ 805 RFSideSensorObj05_LongVelVar 255;
BA_ "GenSigSendType" SG_ 805 RFSideSensorObj05_Height 1;
BA_ "GenSigStartValue" SG_ 805 RFSideSensorObj05_Height 255;
BA_ "GenSigSendType" SG_ 805 RFSideSensorObj05_LatExtLeft 1;
BA_ "GenSigStartValue" SG_ 805 RFSideSensorObj05_LatExtLeft 127;
BA_ "GenSigSendType" SG_ 805 RFSideSensorObj05_LongExtBkVar 1;
BA_ "GenSigStartValue" SG_ 805 RFSideSensorObj05_LongExtBkVar 255;
BA_ "GenSigSendType" SG_ 805 RFSideSensorObj05_ObjClassConf 1;
BA_ "GenSigStartValue" SG_ 805 RFSideSensorObj05_ObjClassConf 15;
BA_ "GenSigSendType" SG_ 805 RFSideSensorObj05_LatVel 1;
BA_ "GenSigStartValue" SG_ 805 RFSideSensorObj05_LatVel 8191;
BA_ "GenSigSendType" SG_ 805 RFSideSensorObj05_CoastIndex 1;
BA_ "GenSigStartValue" SG_ 805 RFSideSensorObj05_CoastIndex 31;
BA_ "GenSigSendType" SG_ 805 RFSideSensorObj05_ObjID 1;
BA_ "GenSigStartValue" SG_ 805 RFSideSensorObj05_ObjID 63;
BA_ "GenSigSendType" SG_ 805 RFSideSensorObj05_LatAcc 1;
BA_ "GenSigStartValue" SG_ 805 RFSideSensorObj05_LatAcc 511;
BA_ "GenSigSendType" SG_ 805 RFSideSensorObj05_LongVel 1;
BA_ "GenSigStartValue" SG_ 805 RFSideSensorObj05_LongVel 8191;
BA_ "GenSigSendType" SG_ 805 RFSideSensorObj05_Heading 1;
BA_ "GenSigStartValue" SG_ 805 RFSideSensorObj05_Heading 2047;
BA_ "GenSigSendType" SG_ 804 RFSideSensorObj04_LongExtFrVar 1;
BA_ "GenSigStartValue" SG_ 804 RFSideSensorObj04_LongExtFrVar 255;
BA_ "GenSigSendType" SG_ 804 RFSideSensorObj04_TrackStatus 1;
BA_ "GenSigStartValue" SG_ 804 RFSideSensorObj04_TrackStatus 7;
BA_ "GenSigSendType" SG_ 804 RFSideSensorObj04_HeadingVar 1;
BA_ "GenSigStartValue" SG_ 804 RFSideSensorObj04_HeadingVar 255;
BA_ "GenSigSendType" SG_ 804 RFSideSensorObj04_LifeTime 1;
BA_ "GenSigStartValue" SG_ 804 RFSideSensorObj04_LifeTime 65535;
BA_ "GenSigSendType" SG_ 804 RFSideSensorObj04_ObjClassConf 1;
BA_ "GenSigStartValue" SG_ 804 RFSideSensorObj04_ObjClassConf 15;
BA_ "GenSigSendType" SG_ 804 RFSideSensorObj04_LatExtLeftVar 1;
BA_ "GenSigStartValue" SG_ 804 RFSideSensorObj04_LatExtLeftVar 255;
BA_ "GenSigSendType" SG_ 804 RFSideSensorObj04_CoastIndex 1;
BA_ "GenSigStartValue" SG_ 804 RFSideSensorObj04_CoastIndex 31;
BA_ "GenSigSendType" SG_ 804 RFSideSensorObj04_Heading 1;
BA_ "GenSigStartValue" SG_ 804 RFSideSensorObj04_Heading 2047;
BA_ "GenSigSendType" SG_ 804 RFSideSensorObj04_Height 1;
BA_ "GenSigStartValue" SG_ 804 RFSideSensorObj04_Height 255;
BA_ "GenSigSendType" SG_ 804 RFSideSensorObj04_LongPosVar 1;
BA_ "GenSigStartValue" SG_ 804 RFSideSensorObj04_LongPosVar 255;
BA_ "GenSigSendType" SG_ 804 RFSideSensorObj04_TimeStamp 1;
BA_ "GenSigStartValue" SG_ 804 RFSideSensorObj04_TimeStamp 65535;
BA_ "GenSigSendType" SG_ 804 RFSideSensorObj04_LatExtRight 1;
BA_ "GenSigStartValue" SG_ 804 RFSideSensorObj04_LatExtRight 127;
BA_ "GenSigSendType" SG_ 804 RFSideSensorObj04_LatExtLeft 1;
BA_ "GenSigStartValue" SG_ 804 RFSideSensorObj04_LatExtLeft 127;
BA_ "GenSigSendType" SG_ 804 RFSideSensorObj04_LatPosVar 1;
BA_ "GenSigStartValue" SG_ 804 RFSideSensorObj04_LatPosVar 255;
BA_ "GenSigSendType" SG_ 804 RFSideSensorObj04_CRC 1;
BA_ "GenSigStartValue" SG_ 804 RFSideSensorObj04_CRC 65535;
BA_ "E2EDataId" SG_ 804 RFSideSensorObj04_CRC 46;
BA_ "E2EDataLength" SG_ 804 RFSideSensorObj04_CRC 312;
BA_ "E2EProfile" SG_ 804 RFSideSensorObj04_CRC "P05";
BA_ "GenSigSendType" SG_ 804 RFSideSensorObj04_LatAccVar 1;
BA_ "GenSigStartValue" SG_ 804 RFSideSensorObj04_LatAccVar 255;
BA_ "GenSigSendType" SG_ 804 RFSideSensorObj04_Counter 1;
BA_ "GenSigStartValue" SG_ 804 RFSideSensorObj04_Counter 255;
BA_ "GenSigSendType" SG_ 804 RFSideSensorObj04_LongExtFront 1;
BA_ "GenSigStartValue" SG_ 804 RFSideSensorObj04_LongExtFront 1023;
BA_ "GenSigSendType" SG_ 804 RFSideSensorObj04_LatPos 1;
BA_ "GenSigStartValue" SG_ 804 RFSideSensorObj04_LatPos 8191;
BA_ "GenSigSendType" SG_ 804 RFSideSensorObj04_ObstacleConf 1;
BA_ "GenSigStartValue" SG_ 804 RFSideSensorObj04_ObstacleConf 127;
BA_ "GenSigSendType" SG_ 804 RFSideSensorObj04_LatVel 1;
BA_ "GenSigStartValue" SG_ 804 RFSideSensorObj04_LatVel 8191;
BA_ "GenSigSendType" SG_ 804 RFSideSensorObj04_LongVelVar 1;
BA_ "GenSigStartValue" SG_ 804 RFSideSensorObj04_LongVelVar 255;
BA_ "GenSigSendType" SG_ 804 RFSideSensorObj04_LongExtBkVar 1;
BA_ "GenSigStartValue" SG_ 804 RFSideSensorObj04_LongExtBkVar 255;
BA_ "GenSigSendType" SG_ 804 RFSideSensorObj04_LatVelVar 1;
BA_ "GenSigStartValue" SG_ 804 RFSideSensorObj04_LatVelVar 255;
BA_ "GenSigSendType" SG_ 804 RFSideSensorObj04_LongPos 1;
BA_ "GenSigStartValue" SG_ 804 RFSideSensorObj04_LongPos 8191;
BA_ "GenSigSendType" SG_ 804 RFSideSensorObj04_ObjDynClass 1;
BA_ "GenSigStartValue" SG_ 804 RFSideSensorObj04_ObjDynClass 3;
BA_ "GenSigSendType" SG_ 804 RFSideSensorObj04_Prioritisation 1;
BA_ "GenSigStartValue" SG_ 804 RFSideSensorObj04_Prioritisation 3;
BA_ "GenSigSendType" SG_ 804 RFSideSensorObj04_ObjID 1;
BA_ "GenSigStartValue" SG_ 804 RFSideSensorObj04_ObjID 63;
BA_ "GenSigSendType" SG_ 804 RFSideSensorObj04_LongAcc 1;
BA_ "GenSigStartValue" SG_ 804 RFSideSensorObj04_LongAcc 511;
BA_ "GenSigSendType" SG_ 804 RFSideSensorObj04_ObjClass 1;
BA_ "GenSigStartValue" SG_ 804 RFSideSensorObj04_ObjClass 15;
BA_ "GenSigSendType" SG_ 804 RFSideSensorObj04_ExistConf 1;
BA_ "GenSigStartValue" SG_ 804 RFSideSensorObj04_ExistConf 127;
BA_ "GenSigSendType" SG_ 804 RFSideSensorObj04_LongAccVar 1;
BA_ "GenSigStartValue" SG_ 804 RFSideSensorObj04_LongAccVar 255;
BA_ "GenSigSendType" SG_ 804 RFSideSensorObj04_LatExtRtVar 1;
BA_ "GenSigStartValue" SG_ 804 RFSideSensorObj04_LatExtRtVar 255;
BA_ "GenSigSendType" SG_ 804 RFSideSensorObj04_LatAcc 1;
BA_ "GenSigStartValue" SG_ 804 RFSideSensorObj04_LatAcc 511;
BA_ "GenSigSendType" SG_ 804 RFSideSensorObj04_MOISPrio 1;
BA_ "GenSigSendType" SG_ 804 RFSideSensorObj04_LongExtBack 1;
BA_ "GenSigStartValue" SG_ 804 RFSideSensorObj04_LongExtBack 1023;
BA_ "GenSigSendType" SG_ 804 RFSideSensorObj04_LongVel 1;
BA_ "GenSigStartValue" SG_ 804 RFSideSensorObj04_LongVel 8191;
BA_ "GenSigSendType" SG_ 803 RFSideSensorObj03_LongAcc 1;
BA_ "GenSigStartValue" SG_ 803 RFSideSensorObj03_LongAcc 511;
BA_ "GenSigSendType" SG_ 803 RFSideSensorObj03_LongAccVar 1;
BA_ "GenSigStartValue" SG_ 803 RFSideSensorObj03_LongAccVar 255;
BA_ "GenSigSendType" SG_ 803 RFSideSensorObj03_LongExtBack 1;
BA_ "GenSigStartValue" SG_ 803 RFSideSensorObj03_LongExtBack 1023;
BA_ "GenSigSendType" SG_ 803 RFSideSensorObj03_HeadingVar 1;
BA_ "GenSigStartValue" SG_ 803 RFSideSensorObj03_HeadingVar 255;
BA_ "GenSigSendType" SG_ 803 RFSideSensorObj03_LifeTime 1;
BA_ "GenSigStartValue" SG_ 803 RFSideSensorObj03_LifeTime 65535;
BA_ "GenSigSendType" SG_ 803 RFSideSensorObj03_Prioritisation 1;
BA_ "GenSigStartValue" SG_ 803 RFSideSensorObj03_Prioritisation 3;
BA_ "GenSigSendType" SG_ 803 RFSideSensorObj03_LongVel 1;
BA_ "GenSigStartValue" SG_ 803 RFSideSensorObj03_LongVel 8191;
BA_ "GenSigSendType" SG_ 803 RFSideSensorObj03_TimeStamp 1;
BA_ "GenSigStartValue" SG_ 803 RFSideSensorObj03_TimeStamp 65535;
BA_ "GenSigSendType" SG_ 803 RFSideSensorObj03_ObstacleConf 1;
BA_ "GenSigStartValue" SG_ 803 RFSideSensorObj03_ObstacleConf 127;
BA_ "GenSigSendType" SG_ 803 RFSideSensorObj03_LatExtRtVar 1;
BA_ "GenSigStartValue" SG_ 803 RFSideSensorObj03_LatExtRtVar 255;
BA_ "GenSigSendType" SG_ 803 RFSideSensorObj03_ObjClassConf 1;
BA_ "GenSigStartValue" SG_ 803 RFSideSensorObj03_ObjClassConf 15;
BA_ "GenSigSendType" SG_ 803 RFSideSensorObj03_Height 1;
BA_ "GenSigStartValue" SG_ 803 RFSideSensorObj03_Height 255;
BA_ "GenSigSendType" SG_ 803 RFSideSensorObj03_ExistConf 1;
BA_ "GenSigStartValue" SG_ 803 RFSideSensorObj03_ExistConf 127;
BA_ "GenSigSendType" SG_ 803 RFSideSensorObj03_LongVelVar 1;
BA_ "GenSigStartValue" SG_ 803 RFSideSensorObj03_LongVelVar 255;
BA_ "GenSigSendType" SG_ 803 RFSideSensorObj03_LatAccVar 1;
BA_ "GenSigStartValue" SG_ 803 RFSideSensorObj03_LatAccVar 255;
BA_ "GenSigSendType" SG_ 803 RFSideSensorObj03_LatVelVar 1;
BA_ "GenSigStartValue" SG_ 803 RFSideSensorObj03_LatVelVar 255;
BA_ "GenSigSendType" SG_ 803 RFSideSensorObj03_LatVel 1;
BA_ "GenSigStartValue" SG_ 803 RFSideSensorObj03_LatVel 8191;
BA_ "GenSigSendType" SG_ 803 RFSideSensorObj03_LongPosVar 1;
BA_ "GenSigStartValue" SG_ 803 RFSideSensorObj03_LongPosVar 255;
BA_ "GenSigSendType" SG_ 803 RFSideSensorObj03_LatExtLeftVar 1;
BA_ "GenSigStartValue" SG_ 803 RFSideSensorObj03_LatExtLeftVar 255;
BA_ "GenSigSendType" SG_ 803 RFSideSensorObj03_LongExtFront 1;
BA_ "GenSigStartValue" SG_ 803 RFSideSensorObj03_LongExtFront 1023;
BA_ "GenSigSendType" SG_ 803 RFSideSensorObj03_Counter 1;
BA_ "GenSigStartValue" SG_ 803 RFSideSensorObj03_Counter 255;
BA_ "GenSigSendType" SG_ 803 RFSideSensorObj03_LatExtLeft 1;
BA_ "GenSigStartValue" SG_ 803 RFSideSensorObj03_LatExtLeft 127;
BA_ "GenSigSendType" SG_ 803 RFSideSensorObj03_CRC 1;
BA_ "GenSigStartValue" SG_ 803 RFSideSensorObj03_CRC 65535;
BA_ "E2EDataId" SG_ 803 RFSideSensorObj03_CRC 45;
BA_ "E2EDataLength" SG_ 803 RFSideSensorObj03_CRC 312;
BA_ "E2EProfile" SG_ 803 RFSideSensorObj03_CRC "P05";
BA_ "GenSigSendType" SG_ 803 RFSideSensorObj03_ObjDynClass 1;
BA_ "GenSigStartValue" SG_ 803 RFSideSensorObj03_ObjDynClass 3;
BA_ "GenSigSendType" SG_ 803 RFSideSensorObj03_ObjClass 1;
BA_ "GenSigStartValue" SG_ 803 RFSideSensorObj03_ObjClass 15;
BA_ "GenSigSendType" SG_ 803 RFSideSensorObj03_LongExtBkVar 1;
BA_ "GenSigStartValue" SG_ 803 RFSideSensorObj03_LongExtBkVar 255;
BA_ "GenSigSendType" SG_ 803 RFSideSensorObj03_LatExtRight 1;
BA_ "GenSigStartValue" SG_ 803 RFSideSensorObj03_LatExtRight 127;
BA_ "GenSigSendType" SG_ 803 RFSideSensorObj03_LatPos 1;
BA_ "GenSigStartValue" SG_ 803 RFSideSensorObj03_LatPos 8191;
BA_ "GenSigSendType" SG_ 803 RFSideSensorObj03_MOISPrio 1;
BA_ "GenSigSendType" SG_ 803 RFSideSensorObj03_CoastIndex 1;
BA_ "GenSigStartValue" SG_ 803 RFSideSensorObj03_CoastIndex 31;
BA_ "GenSigSendType" SG_ 803 RFSideSensorObj03_LongPos 1;
BA_ "GenSigStartValue" SG_ 803 RFSideSensorObj03_LongPos 8191;
BA_ "GenSigSendType" SG_ 803 RFSideSensorObj03_ObjID 1;
BA_ "GenSigStartValue" SG_ 803 RFSideSensorObj03_ObjID 63;
BA_ "GenSigSendType" SG_ 803 RFSideSensorObj03_LatAcc 1;
BA_ "GenSigStartValue" SG_ 803 RFSideSensorObj03_LatAcc 511;
BA_ "GenSigSendType" SG_ 803 RFSideSensorObj03_TrackStatus 1;
BA_ "GenSigStartValue" SG_ 803 RFSideSensorObj03_TrackStatus 7;
BA_ "GenSigSendType" SG_ 803 RFSideSensorObj03_LatPosVar 1;
BA_ "GenSigStartValue" SG_ 803 RFSideSensorObj03_LatPosVar 255;
BA_ "GenSigSendType" SG_ 803 RFSideSensorObj03_LongExtFrVar 1;
BA_ "GenSigStartValue" SG_ 803 RFSideSensorObj03_LongExtFrVar 255;
BA_ "GenSigSendType" SG_ 803 RFSideSensorObj03_Heading 1;
BA_ "GenSigStartValue" SG_ 803 RFSideSensorObj03_Heading 2047;
BA_ "GenSigSendType" SG_ 802 RFSideSensorObj02_Heading 1;
BA_ "GenSigStartValue" SG_ 802 RFSideSensorObj02_Heading 2047;
BA_ "GenSigSendType" SG_ 802 RFSideSensorObj02_LongExtBkVar 1;
BA_ "GenSigStartValue" SG_ 802 RFSideSensorObj02_LongExtBkVar 255;
BA_ "GenSigSendType" SG_ 802 RFSideSensorObj02_LatExtRight 1;
BA_ "GenSigStartValue" SG_ 802 RFSideSensorObj02_LatExtRight 127;
BA_ "GenSigSendType" SG_ 802 RFSideSensorObj02_Counter 1;
BA_ "GenSigStartValue" SG_ 802 RFSideSensorObj02_Counter 255;
BA_ "GenSigSendType" SG_ 802 RFSideSensorObj02_ObstacleConf 1;
BA_ "GenSigStartValue" SG_ 802 RFSideSensorObj02_ObstacleConf 127;
BA_ "GenSigSendType" SG_ 802 RFSideSensorObj02_ExistConf 1;
BA_ "GenSigStartValue" SG_ 802 RFSideSensorObj02_ExistConf 127;
BA_ "GenSigSendType" SG_ 802 RFSideSensorObj02_Height 1;
BA_ "GenSigStartValue" SG_ 802 RFSideSensorObj02_Height 255;
BA_ "GenSigSendType" SG_ 802 RFSideSensorObj02_LatAccVar 1;
BA_ "GenSigStartValue" SG_ 802 RFSideSensorObj02_LatAccVar 255;
BA_ "GenSigSendType" SG_ 802 RFSideSensorObj02_ObjClass 1;
BA_ "GenSigStartValue" SG_ 802 RFSideSensorObj02_ObjClass 15;
BA_ "GenSigSendType" SG_ 802 RFSideSensorObj02_CRC 1;
BA_ "GenSigStartValue" SG_ 802 RFSideSensorObj02_CRC 65535;
BA_ "E2EDataId" SG_ 802 RFSideSensorObj02_CRC 44;
BA_ "E2EDataLength" SG_ 802 RFSideSensorObj02_CRC 312;
BA_ "E2EProfile" SG_ 802 RFSideSensorObj02_CRC "P05";
BA_ "GenSigSendType" SG_ 802 RFSideSensorObj02_LongAcc 1;
BA_ "GenSigStartValue" SG_ 802 RFSideSensorObj02_LongAcc 511;
BA_ "GenSigSendType" SG_ 802 RFSideSensorObj02_LatVel 1;
BA_ "GenSigStartValue" SG_ 802 RFSideSensorObj02_LatVel 8191;
BA_ "GenSigSendType" SG_ 802 RFSideSensorObj02_LatPosVar 1;
BA_ "GenSigStartValue" SG_ 802 RFSideSensorObj02_LatPosVar 255;
BA_ "GenSigSendType" SG_ 802 RFSideSensorObj02_CoastIndex 1;
BA_ "GenSigStartValue" SG_ 802 RFSideSensorObj02_CoastIndex 31;
BA_ "GenSigSendType" SG_ 802 RFSideSensorObj02_LongPosVar 1;
BA_ "GenSigStartValue" SG_ 802 RFSideSensorObj02_LongPosVar 255;
BA_ "GenSigSendType" SG_ 802 RFSideSensorObj02_LatAcc 1;
BA_ "GenSigStartValue" SG_ 802 RFSideSensorObj02_LatAcc 511;
BA_ "GenSigSendType" SG_ 802 RFSideSensorObj02_ObjClassConf 1;
BA_ "GenSigStartValue" SG_ 802 RFSideSensorObj02_ObjClassConf 15;
BA_ "GenSigSendType" SG_ 802 RFSideSensorObj02_ObjDynClass 1;
BA_ "GenSigStartValue" SG_ 802 RFSideSensorObj02_ObjDynClass 3;
BA_ "GenSigSendType" SG_ 802 RFSideSensorObj02_LongExtBack 1;
BA_ "GenSigStartValue" SG_ 802 RFSideSensorObj02_LongExtBack 1023;
BA_ "GenSigSendType" SG_ 802 RFSideSensorObj02_LatExtLeftVar 1;
BA_ "GenSigStartValue" SG_ 802 RFSideSensorObj02_LatExtLeftVar 255;
BA_ "GenSigSendType" SG_ 802 RFSideSensorObj02_LifeTime 1;
BA_ "GenSigStartValue" SG_ 802 RFSideSensorObj02_LifeTime 65535;
BA_ "GenSigSendType" SG_ 802 RFSideSensorObj02_LongVel 1;
BA_ "GenSigStartValue" SG_ 802 RFSideSensorObj02_LongVel 8191;
BA_ "GenSigSendType" SG_ 802 RFSideSensorObj02_LongAccVar 1;
BA_ "GenSigStartValue" SG_ 802 RFSideSensorObj02_LongAccVar 255;
BA_ "GenSigSendType" SG_ 802 RFSideSensorObj02_LongExtFront 1;
BA_ "GenSigStartValue" SG_ 802 RFSideSensorObj02_LongExtFront 1023;
BA_ "GenSigSendType" SG_ 802 RFSideSensorObj02_TrackStatus 1;
BA_ "GenSigStartValue" SG_ 802 RFSideSensorObj02_TrackStatus 7;
BA_ "GenSigSendType" SG_ 802 RFSideSensorObj02_ObjID 1;
BA_ "GenSigStartValue" SG_ 802 RFSideSensorObj02_ObjID 63;
BA_ "GenSigSendType" SG_ 802 RFSideSensorObj02_TimeStamp 1;
BA_ "GenSigStartValue" SG_ 802 RFSideSensorObj02_TimeStamp 65535;
BA_ "GenSigSendType" SG_ 802 RFSideSensorObj02_LatPos 1;
BA_ "GenSigStartValue" SG_ 802 RFSideSensorObj02_LatPos 8191;
BA_ "GenSigSendType" SG_ 802 RFSideSensorObj02_LatVelVar 1;
BA_ "GenSigStartValue" SG_ 802 RFSideSensorObj02_LatVelVar 255;
BA_ "GenSigSendType" SG_ 802 RFSideSensorObj02_HeadingVar 1;
BA_ "GenSigStartValue" SG_ 802 RFSideSensorObj02_HeadingVar 255;
BA_ "GenSigSendType" SG_ 802 RFSideSensorObj02_Prioritisation 1;
BA_ "GenSigStartValue" SG_ 802 RFSideSensorObj02_Prioritisation 3;
BA_ "GenSigSendType" SG_ 802 RFSideSensorObj02_MOISPrio 1;
BA_ "GenSigSendType" SG_ 802 RFSideSensorObj02_LatExtLeft 1;
BA_ "GenSigStartValue" SG_ 802 RFSideSensorObj02_LatExtLeft 127;
BA_ "GenSigSendType" SG_ 802 RFSideSensorObj02_LongPos 1;
BA_ "GenSigStartValue" SG_ 802 RFSideSensorObj02_LongPos 8191;
BA_ "GenSigSendType" SG_ 802 RFSideSensorObj02_LongExtFrVar 1;
BA_ "GenSigStartValue" SG_ 802 RFSideSensorObj02_LongExtFrVar 255;
BA_ "GenSigSendType" SG_ 802 RFSideSensorObj02_LongVelVar 1;
BA_ "GenSigStartValue" SG_ 802 RFSideSensorObj02_LongVelVar 255;
BA_ "GenSigSendType" SG_ 802 RFSideSensorObj02_LatExtRtVar 1;
BA_ "GenSigStartValue" SG_ 802 RFSideSensorObj02_LatExtRtVar 255;
BA_ "GenSigSendType" SG_ 801 RFSideSensorObj01_LatVel 1;
BA_ "GenSigStartValue" SG_ 801 RFSideSensorObj01_LatVel 8191;
BA_ "GenSigSendType" SG_ 801 RFSideSensorObj01_LatAccVar 1;
BA_ "GenSigStartValue" SG_ 801 RFSideSensorObj01_LatAccVar 255;
BA_ "GenSigSendType" SG_ 801 RFSideSensorObj01_ObjClassConf 1;
BA_ "GenSigStartValue" SG_ 801 RFSideSensorObj01_ObjClassConf 15;
BA_ "GenSigSendType" SG_ 801 RFSideSensorObj01_CoastIndex 1;
BA_ "GenSigStartValue" SG_ 801 RFSideSensorObj01_CoastIndex 31;
BA_ "GenSigSendType" SG_ 801 RFSideSensorObj01_LatExtLeft 1;
BA_ "GenSigStartValue" SG_ 801 RFSideSensorObj01_LatExtLeft 127;
BA_ "GenSigSendType" SG_ 801 RFSideSensorObj01_ExistConf 1;
BA_ "GenSigStartValue" SG_ 801 RFSideSensorObj01_ExistConf 127;
BA_ "GenSigSendType" SG_ 801 RFSideSensorObj01_LongVel 1;
BA_ "GenSigStartValue" SG_ 801 RFSideSensorObj01_LongVel 8191;
BA_ "GenSigSendType" SG_ 801 RFSideSensorObj01_LongExtFront 1;
BA_ "GenSigStartValue" SG_ 801 RFSideSensorObj01_LongExtFront 1023;
BA_ "GenSigSendType" SG_ 801 RFSideSensorObj01_LongPosVar 1;
BA_ "GenSigStartValue" SG_ 801 RFSideSensorObj01_LongPosVar 255;
BA_ "GenSigSendType" SG_ 801 RFSideSensorObj01_Heading 1;
BA_ "GenSigStartValue" SG_ 801 RFSideSensorObj01_Heading 2047;
BA_ "GenSigSendType" SG_ 801 RFSideSensorObj01_MOISPrio 1;
BA_ "GenSigSendType" SG_ 801 RFSideSensorObj01_LongVelVar 1;
BA_ "GenSigStartValue" SG_ 801 RFSideSensorObj01_LongVelVar 255;
BA_ "GenSigSendType" SG_ 801 RFSideSensorObj01_LatPos 1;
BA_ "GenSigStartValue" SG_ 801 RFSideSensorObj01_LatPos 8191;
BA_ "GenSigSendType" SG_ 801 RFSideSensorObj01_LatExtLeftVar 1;
BA_ "GenSigStartValue" SG_ 801 RFSideSensorObj01_LatExtLeftVar 255;
BA_ "GenSigSendType" SG_ 801 RFSideSensorObj01_LongExtBkVar 1;
BA_ "GenSigStartValue" SG_ 801 RFSideSensorObj01_LongExtBkVar 255;
BA_ "GenSigSendType" SG_ 801 RFSideSensorObj01_LatExtRight 1;
BA_ "GenSigStartValue" SG_ 801 RFSideSensorObj01_LatExtRight 127;
BA_ "GenSigSendType" SG_ 801 RFSideSensorObj01_LongAccVar 1;
BA_ "GenSigStartValue" SG_ 801 RFSideSensorObj01_LongAccVar 255;
BA_ "GenSigSendType" SG_ 801 RFSideSensorObj01_LatExtRtVar 1;
BA_ "GenSigStartValue" SG_ 801 RFSideSensorObj01_LatExtRtVar 255;
BA_ "GenSigSendType" SG_ 801 RFSideSensorObj01_LongAcc 1;
BA_ "GenSigStartValue" SG_ 801 RFSideSensorObj01_LongAcc 511;
BA_ "GenSigSendType" SG_ 801 RFSideSensorObj01_TimeStamp 1;
BA_ "GenSigStartValue" SG_ 801 RFSideSensorObj01_TimeStamp 65535;
BA_ "GenSigSendType" SG_ 801 RFSideSensorObj01_Prioritisation 1;
BA_ "GenSigStartValue" SG_ 801 RFSideSensorObj01_Prioritisation 3;
BA_ "GenSigSendType" SG_ 801 RFSideSensorObj01_LongExtBack 1;
BA_ "GenSigStartValue" SG_ 801 RFSideSensorObj01_LongExtBack 1023;
BA_ "GenSigSendType" SG_ 801 RFSideSensorObj01_LatVelVar 1;
BA_ "GenSigStartValue" SG_ 801 RFSideSensorObj01_LatVelVar 255;
BA_ "GenSigSendType" SG_ 801 RFSideSensorObj01_Counter 1;
BA_ "GenSigStartValue" SG_ 801 RFSideSensorObj01_Counter 255;
BA_ "GenSigSendType" SG_ 801 RFSideSensorObj01_Height 1;
BA_ "GenSigStartValue" SG_ 801 RFSideSensorObj01_Height 255;
BA_ "GenSigSendType" SG_ 801 RFSideSensorObj01_LatPosVar 1;
BA_ "GenSigStartValue" SG_ 801 RFSideSensorObj01_LatPosVar 255;
BA_ "GenSigSendType" SG_ 801 RFSideSensorObj01_ObjDynClass 1;
BA_ "GenSigStartValue" SG_ 801 RFSideSensorObj01_ObjDynClass 3;
BA_ "GenSigSendType" SG_ 801 RFSideSensorObj01_CRC 1;
BA_ "GenSigStartValue" SG_ 801 RFSideSensorObj01_CRC 65535;
BA_ "E2EDataId" SG_ 801 RFSideSensorObj01_CRC 43;
BA_ "E2EDataLength" SG_ 801 RFSideSensorObj01_CRC 312;
BA_ "E2EProfile" SG_ 801 RFSideSensorObj01_CRC "P05";
BA_ "GenSigSendType" SG_ 801 RFSideSensorObj01_LifeTime 1;
BA_ "GenSigStartValue" SG_ 801 RFSideSensorObj01_LifeTime 65535;
BA_ "GenSigSendType" SG_ 801 RFSideSensorObj01_LongExtFrVar 1;
BA_ "GenSigStartValue" SG_ 801 RFSideSensorObj01_LongExtFrVar 255;
BA_ "GenSigSendType" SG_ 801 RFSideSensorObj01_ObjID 1;
BA_ "GenSigStartValue" SG_ 801 RFSideSensorObj01_ObjID 63;
BA_ "GenSigSendType" SG_ 801 RFSideSensorObj01_LatAcc 1;
BA_ "GenSigStartValue" SG_ 801 RFSideSensorObj01_LatAcc 511;
BA_ "GenSigSendType" SG_ 801 RFSideSensorObj01_TrackStatus 1;
BA_ "GenSigStartValue" SG_ 801 RFSideSensorObj01_TrackStatus 7;
BA_ "GenSigSendType" SG_ 801 RFSideSensorObj01_LongPos 1;
BA_ "GenSigStartValue" SG_ 801 RFSideSensorObj01_LongPos 8191;
BA_ "GenSigSendType" SG_ 801 RFSideSensorObj01_HeadingVar 1;
BA_ "GenSigStartValue" SG_ 801 RFSideSensorObj01_HeadingVar 255;
BA_ "GenSigSendType" SG_ 801 RFSideSensorObj01_ObstacleConf 1;
BA_ "GenSigStartValue" SG_ 801 RFSideSensorObj01_ObstacleConf 127;
BA_ "GenSigSendType" SG_ 801 RFSideSensorObj01_ObjClass 1;
BA_ "GenSigStartValue" SG_ 801 RFSideSensorObj01_ObjClass 15;
BA_ "GenSigSendType" SG_ 800 RFSideSensorObj00_LongPos 1;
BA_ "GenSigStartValue" SG_ 800 RFSideSensorObj00_LongPos 8191;
BA_ "GenSigSendType" SG_ 800 RFSideSensorObj00_LongExtFrVar 1;
BA_ "GenSigStartValue" SG_ 800 RFSideSensorObj00_LongExtFrVar 255;
BA_ "GenSigSendType" SG_ 800 RFSideSensorObj00_LatAccVar 1;
BA_ "GenSigStartValue" SG_ 800 RFSideSensorObj00_LatAccVar 255;
BA_ "GenSigSendType" SG_ 800 RFSideSensorObj00_MOISPrio 1;
BA_ "GenSigSendType" SG_ 800 RFSideSensorObj00_LongAcc 1;
BA_ "GenSigStartValue" SG_ 800 RFSideSensorObj00_LongAcc 511;
BA_ "GenSigSendType" SG_ 800 RFSideSensorObj00_ObstacleConf 1;
BA_ "GenSigStartValue" SG_ 800 RFSideSensorObj00_ObstacleConf 127;
BA_ "GenSigSendType" SG_ 800 RFSideSensorObj00_ObjClass 1;
BA_ "GenSigStartValue" SG_ 800 RFSideSensorObj00_ObjClass 15;
BA_ "GenSigSendType" SG_ 800 RFSideSensorObj00_LatExtLeft 1;
BA_ "GenSigStartValue" SG_ 800 RFSideSensorObj00_LatExtLeft 127;
BA_ "GenSigSendType" SG_ 800 RFSideSensorObj00_ObjDynClass 1;
BA_ "GenSigStartValue" SG_ 800 RFSideSensorObj00_ObjDynClass 3;
BA_ "GenSigSendType" SG_ 800 RFSideSensorObj00_LatPosVar 1;
BA_ "GenSigStartValue" SG_ 800 RFSideSensorObj00_LatPosVar 255;
BA_ "GenSigSendType" SG_ 800 RFSideSensorObj00_ObjID 1;
BA_ "GenSigStartValue" SG_ 800 RFSideSensorObj00_ObjID 63;
BA_ "GenSigSendType" SG_ 800 RFSideSensorObj00_TimeStamp 1;
BA_ "GenSigStartValue" SG_ 800 RFSideSensorObj00_TimeStamp 65535;
BA_ "GenSigSendType" SG_ 800 RFSideSensorObj00_LatVel 1;
BA_ "GenSigStartValue" SG_ 800 RFSideSensorObj00_LatVel 8191;
BA_ "GenSigSendType" SG_ 800 RFSideSensorObj00_LongVelVar 1;
BA_ "GenSigStartValue" SG_ 800 RFSideSensorObj00_LongVelVar 255;
BA_ "GenSigSendType" SG_ 800 RFSideSensorObj00_LatExtRtVar 1;
BA_ "GenSigStartValue" SG_ 800 RFSideSensorObj00_LatExtRtVar 255;
BA_ "GenSigSendType" SG_ 800 RFSideSensorObj00_TrackStatus 1;
BA_ "GenSigStartValue" SG_ 800 RFSideSensorObj00_TrackStatus 7;
BA_ "GenSigSendType" SG_ 800 RFSideSensorObj00_LongPosVar 1;
BA_ "GenSigStartValue" SG_ 800 RFSideSensorObj00_LongPosVar 255;
BA_ "GenSigSendType" SG_ 800 RFSideSensorObj00_LatExtLeftVar 1;
BA_ "GenSigStartValue" SG_ 800 RFSideSensorObj00_LatExtLeftVar 255;
BA_ "GenSigSendType" SG_ 800 RFSideSensorObj00_HeadingVar 1;
BA_ "GenSigStartValue" SG_ 800 RFSideSensorObj00_HeadingVar 255;
BA_ "GenSigSendType" SG_ 800 RFSideSensorObj00_LongExtBkVar 1;
BA_ "GenSigStartValue" SG_ 800 RFSideSensorObj00_LongExtBkVar 255;
BA_ "GenSigSendType" SG_ 800 RFSideSensorObj00_LatVelVar 1;
BA_ "GenSigStartValue" SG_ 800 RFSideSensorObj00_LatVelVar 255;
BA_ "GenSigSendType" SG_ 800 RFSideSensorObj00_LongAccVar 1;
BA_ "GenSigStartValue" SG_ 800 RFSideSensorObj00_LongAccVar 255;
BA_ "GenSigSendType" SG_ 800 RFSideSensorObj00_Heading 1;
BA_ "GenSigStartValue" SG_ 800 RFSideSensorObj00_Heading 2047;
BA_ "GenSigSendType" SG_ 800 RFSideSensorObj00_Height 1;
BA_ "GenSigStartValue" SG_ 800 RFSideSensorObj00_Height 255;
BA_ "GenSigSendType" SG_ 800 RFSideSensorObj00_LongExtBack 1;
BA_ "GenSigStartValue" SG_ 800 RFSideSensorObj00_LongExtBack 1023;
BA_ "GenSigSendType" SG_ 800 RFSideSensorObj00_ObjClassConf 1;
BA_ "GenSigStartValue" SG_ 800 RFSideSensorObj00_ObjClassConf 15;
BA_ "GenSigSendType" SG_ 800 RFSideSensorObj00_LongVel 1;
BA_ "GenSigStartValue" SG_ 800 RFSideSensorObj00_LongVel 8191;
BA_ "GenSigSendType" SG_ 800 RFSideSensorObj00_LatPos 1;
BA_ "GenSigStartValue" SG_ 800 RFSideSensorObj00_LatPos 8191;
BA_ "GenSigSendType" SG_ 800 RFSideSensorObj00_CRC 1;
BA_ "GenSigStartValue" SG_ 800 RFSideSensorObj00_CRC 65535;
BA_ "E2EDataId" SG_ 800 RFSideSensorObj00_CRC 42;
BA_ "E2EDataLength" SG_ 800 RFSideSensorObj00_CRC 312;
BA_ "E2EProfile" SG_ 800 RFSideSensorObj00_CRC "P05";
BA_ "GenSigSendType" SG_ 800 RFSideSensorObj00_LongExtFront 1;
BA_ "GenSigStartValue" SG_ 800 RFSideSensorObj00_LongExtFront 1023;
BA_ "GenSigSendType" SG_ 800 RFSideSensorObj00_LatAcc 1;
BA_ "GenSigStartValue" SG_ 800 RFSideSensorObj00_LatAcc 511;
BA_ "GenSigSendType" SG_ 800 RFSideSensorObj00_Counter 1;
BA_ "GenSigStartValue" SG_ 800 RFSideSensorObj00_Counter 255;
BA_ "GenSigSendType" SG_ 800 RFSideSensorObj00_Prioritisation 1;
BA_ "GenSigStartValue" SG_ 800 RFSideSensorObj00_Prioritisation 3;
BA_ "GenSigSendType" SG_ 800 RFSideSensorObj00_LifeTime 1;
BA_ "GenSigStartValue" SG_ 800 RFSideSensorObj00_LifeTime 65535;
BA_ "GenSigSendType" SG_ 800 RFSideSensorObj00_ExistConf 1;
BA_ "GenSigStartValue" SG_ 800 RFSideSensorObj00_ExistConf 127;
BA_ "GenSigSendType" SG_ 800 RFSideSensorObj00_LatExtRight 1;
BA_ "GenSigStartValue" SG_ 800 RFSideSensorObj00_LatExtRight 127;
BA_ "GenSigSendType" SG_ 800 RFSideSensorObj00_CoastIndex 1;
BA_ "GenSigStartValue" SG_ 800 RFSideSensorObj00_CoastIndex 31;
BA_ "GenSigCycleTime" SG_ 1554 RFSRSwVersion_Substring0 100;
BA_ "GenSigCycleTimeActive" SG_ 1554 RFSRSwVersion_Substring0 100;
BA_ "GenSigCycleTime" SG_ 1554 RFSRSwVersion_Substring7 100;
BA_ "GenSigCycleTimeActive" SG_ 1554 RFSRSwVersion_Substring7 100;
BA_ "GenSigCycleTime" SG_ 1554 RFSRSwVersion_Substring5 100;
BA_ "GenSigCycleTimeActive" SG_ 1554 RFSRSwVersion_Substring5 100;
BA_ "GenSigCycleTime" SG_ 1554 RFSRSwVersion_Substring2 100;
BA_ "GenSigCycleTimeActive" SG_ 1554 RFSRSwVersion_Substring2 100;
BA_ "GenSigCycleTime" SG_ 1554 RFSRSwVersion_Substring6 100;
BA_ "GenSigCycleTimeActive" SG_ 1554 RFSRSwVersion_Substring6 100;
BA_ "GenSigCycleTime" SG_ 1554 RFSRSwVersion_Substring3 100;
BA_ "GenSigCycleTimeActive" SG_ 1554 RFSRSwVersion_Substring3 100;
BA_ "GenSigCycleTime" SG_ 1554 RFSRSwVersion_Substring4 100;
BA_ "GenSigCycleTimeActive" SG_ 1554 RFSRSwVersion_Substring4 100;
BA_ "GenSigCycleTime" SG_ 1554 RFSRSwVersion_Substring1 100;
BA_ "GenSigCycleTimeActive" SG_ 1554 RFSRSwVersion_Substring1 100;
BA_ "GenSigSendType" SG_ 815 RFSRRaisedEdge_LatDist 1;
BA_ "GenSigStartValue" SG_ 815 RFSRRaisedEdge_LatDist 4095;
BA_ "GenSigSendType" SG_ 815 RFSRRaisedEdge_CoastIndex 1;
BA_ "GenSigStartValue" SG_ 815 RFSRRaisedEdge_CoastIndex 31;
BA_ "GenSigSendType" SG_ 815 RFSRRaisedEdge_LatDistVar 1;
BA_ "GenSigStartValue" SG_ 815 RFSRRaisedEdge_LatDistVar 255;
BA_ "GenSigSendType" SG_ 815 RFSRRaisedEdge_HeadingAngle 1;
BA_ "GenSigStartValue" SG_ 815 RFSRRaisedEdge_HeadingAngle 8191;
BA_ "GenSigSendType" SG_ 815 RFSRRaisedEdge_TrackStatus 1;
BA_ "GenSigStartValue" SG_ 815 RFSRRaisedEdge_TrackStatus 7;
BA_ "GenSigSendType" SG_ 815 RFSRRaisedEdge_CurvatureRate 1;
BA_ "GenSigStartValue" SG_ 815 RFSRRaisedEdge_CurvatureRate 2047;
BA_ "GenSigSendType" SG_ 815 RFSRRaisedEdge_CRC 1;
BA_ "GenSigStartValue" SG_ 815 RFSRRaisedEdge_CRC 65535;
BA_ "E2EDataId" SG_ 815 RFSRRaisedEdge_CRC 113;
BA_ "E2EDataLength" SG_ 815 RFSRRaisedEdge_CRC 152;
BA_ "E2EProfile" SG_ 815 RFSRRaisedEdge_CRC "P05";
BA_ "GenSigSendType" SG_ 815 RFSRRaisedEdge_DxStart 1;
BA_ "GenSigStartValue" SG_ 815 RFSRRaisedEdge_DxStart 255;
BA_ "GenSigSendType" SG_ 815 RFSRRaisedEdge_DxEnd 1;
BA_ "GenSigStartValue" SG_ 815 RFSRRaisedEdge_DxEnd 255;
BA_ "GenSigSendType" SG_ 815 RFSRRaisedEdge_TimeStamp 1;
BA_ "GenSigStartValue" SG_ 815 RFSRRaisedEdge_TimeStamp 65535;
BA_ "GenSigSendType" SG_ 815 RFSRRaisedEdge_Confidence 1;
BA_ "GenSigStartValue" SG_ 815 RFSRRaisedEdge_Confidence 127;
BA_ "GenSigSendType" SG_ 815 RFSRRaisedEdge_Counter 1;
BA_ "GenSigStartValue" SG_ 815 RFSRRaisedEdge_Counter 255;
BA_ "GenSigSendType" SG_ 815 RFSRRaisedEdge_Curvature 1;
BA_ "GenSigStartValue" SG_ 815 RFSRRaisedEdge_Curvature 262143;
BA_ "GenSigSendType" SG_ 815 RFSRRaisedEdge_Type 1;
BA_ "GenSigStartValue" SG_ 815 RFSRRaisedEdge_Type 7;
BA_ "GenSigSendType" SG_ 815 RFSRRaisedEdge_LifeTime 1;
BA_ "GenSigStartValue" SG_ 815 RFSRRaisedEdge_LifeTime 65535;
BA_ "GenSigSendType" SG_ 814 RFSREgoAssumpt_EgoYawRate 1;
BA_ "GenSigStartValue" SG_ 814 RFSREgoAssumpt_EgoYawRate 65535;
BA_ "GenSigSendType" SG_ 814 RFSREgoAssumpt_EgoRoadHeading 1;
BA_ "GenSigStartValue" SG_ 814 RFSREgoAssumpt_EgoRoadHeading 8191;
BA_ "GenSigSendType" SG_ 814 RFSREgoAssumpt_TimeStamp 1;
BA_ "GenSigStartValue" SG_ 814 RFSREgoAssumpt_TimeStamp 65535;
BA_ "GenSigSendType" SG_ 814 RFSREgoAssumpt_EgoRoadCurvRate 1;
BA_ "GenSigStartValue" SG_ 814 RFSREgoAssumpt_EgoRoadCurvRate 2047;
BA_ "GenSigSendType" SG_ 814 RFSREgoAssumpt_EgoLongAcc 1;
BA_ "GenSigStartValue" SG_ 814 RFSREgoAssumpt_EgoLongAcc 65535;
BA_ "GenSigSendType" SG_ 814 RFSREgoAssumpt_VelCorrFactor 1;
BA_ "GenSigStartValue" SG_ 814 RFSREgoAssumpt_VelCorrFactor 255;
BA_ "GenSigSendType" SG_ 814 RFSREgoAssumpt_EgoLongVel 1;
BA_ "GenSigStartValue" SG_ 814 RFSREgoAssumpt_EgoLongVel 65535;
BA_ "GenSigSendType" SG_ 814 RFSREgoAssumpt_EgoRoadCurvature 1;
BA_ "GenSigStartValue" SG_ 814 RFSREgoAssumpt_EgoRoadCurvature 262143;
BA_ "GenSigSendType" SG_ 814 RFSREgoAssumpt_EgoRoadEnd 1;
BA_ "GenSigStartValue" SG_ 814 RFSREgoAssumpt_EgoRoadEnd 255;
BA_ "GenSigSendType" SG_ 2671833707 PhysDiagRespSig_F2_6B 7;
BA_ "GenSigSendType" SG_ 2671833706 PhysDiagRespSig_F2_6A 7;
BA_ "GenSigSendType" SG_ 2671833705 PhysDiagRespSig_F2_69 7;
BA_ "GenSigSendType" SG_ 2671833704 PhysDiagRespSig_F2_68 7;
BA_ "GenSigSendType" SG_ 2671799282 PhysDiagReqSig_6B_F2 7;
BA_ "GenSigSendType" SG_ 2671799026 PhysDiagReqSig_6A_F2 7;
BA_ "GenSigSendType" SG_ 2671798770 PhysDiagReqSig_69_F2 7;
BA_REL_ "GenSigFirstTimeoutTime" BU_SG_REL_ DACU SG_ 1555 RRSRSwVersion_Substring0 60000;
BA_REL_ "GenSigTimeoutTime" BU_SG_REL_ DACU SG_ 1555 RRSRSwVersion_Substring0 60000;
BA_REL_ "GenSigFirstTimeoutTime" BU_SG_REL_ DACU SG_ 1555 RRSRSwVersion_Substring4 60000;
BA_REL_ "GenSigTimeoutTime" BU_SG_REL_ DACU SG_ 1555 RRSRSwVersion_Substring4 60000;
BA_REL_ "GenSigFirstTimeoutTime" BU_SG_REL_ DACU SG_ 1555 RRSRSwVersion_Substring1 60000;
BA_REL_ "GenSigTimeoutTime" BU_SG_REL_ DACU SG_ 1555 RRSRSwVersion_Substring1 60000;
BA_REL_ "GenSigFirstTimeoutTime" BU_SG_REL_ DACU SG_ 1555 RRSRSwVersion_Substring7 60000;
BA_REL_ "GenSigTimeoutTime" BU_SG_REL_ DACU SG_ 1555 RRSRSwVersion_Substring7 60000;
BA_REL_ "GenSigFirstTimeoutTime" BU_SG_REL_ DACU SG_ 1555 RRSRSwVersion_Substring2 60000;
BA_REL_ "GenSigTimeoutTime" BU_SG_REL_ DACU SG_ 1555 RRSRSwVersion_Substring2 60000;
BA_REL_ "GenSigFirstTimeoutTime" BU_SG_REL_ DACU SG_ 1555 RRSRSwVersion_Substring3 60000;
BA_REL_ "GenSigTimeoutTime" BU_SG_REL_ DACU SG_ 1555 RRSRSwVersion_Substring3 60000;
BA_REL_ "GenSigFirstTimeoutTime" BU_SG_REL_ DACU SG_ 1555 RRSRSwVersion_Substring5 60000;
BA_REL_ "GenSigTimeoutTime" BU_SG_REL_ DACU SG_ 1555 RRSRSwVersion_Substring5 60000;
BA_REL_ "GenSigFirstTimeoutTime" BU_SG_REL_ DACU SG_ 1555 RRSRSwVersion_Substring6 60000;
BA_REL_ "GenSigTimeoutTime" BU_SG_REL_ DACU SG_ 1555 RRSRSwVersion_Substring6 60000;
BA_REL_ "GenSigFirstTimeoutTime" BU_SG_REL_ DACU SG_ 831 RRSRRaisedEdge_LifeTime 3000;
BA_REL_ "GenSigTimeoutTime" BU_SG_REL_ DACU SG_ 831 RRSRRaisedEdge_LifeTime 300;
BA_REL_ "GenSigFirstTimeoutTime" BU_SG_REL_ DACU SG_ 831 RRSRRaisedEdge_CRC 3000;
BA_REL_ "GenSigTimeoutTime" BU_SG_REL_ DACU SG_ 831 RRSRRaisedEdge_CRC 300;
BA_REL_ "GenSigFirstTimeoutTime" BU_SG_REL_ DACU SG_ 831 RRSRRaisedEdge_HeadingAngle 3000;
BA_REL_ "GenSigTimeoutTime" BU_SG_REL_ DACU SG_ 831 RRSRRaisedEdge_HeadingAngle 300;
BA_REL_ "GenSigFirstTimeoutTime" BU_SG_REL_ DACU SG_ 831 RRSRRaisedEdge_Type 3000;
BA_REL_ "GenSigTimeoutTime" BU_SG_REL_ DACU SG_ 831 RRSRRaisedEdge_Type 300;
BA_REL_ "GenSigFirstTimeoutTime" BU_SG_REL_ DACU SG_ 831 RRSRRaisedEdge_DxStart 3000;
BA_REL_ "GenSigTimeoutTime" BU_SG_REL_ DACU SG_ 831 RRSRRaisedEdge_DxStart 300;
BA_REL_ "GenSigFirstTimeoutTime" BU_SG_REL_ DACU SG_ 831 RRSRRaisedEdge_TimeStamp 3000;
BA_REL_ "GenSigTimeoutTime" BU_SG_REL_ DACU SG_ 831 RRSRRaisedEdge_TimeStamp 300;
BA_REL_ "GenSigFirstTimeoutTime" BU_SG_REL_ DACU SG_ 831 RRSRRaisedEdge_Confidence 3000;
BA_REL_ "GenSigTimeoutTime" BU_SG_REL_ DACU SG_ 831 RRSRRaisedEdge_Confidence 300;
BA_REL_ "GenSigFirstTimeoutTime" BU_SG_REL_ DACU SG_ 831 RRSRRaisedEdge_DxEnd 3000;
BA_REL_ "GenSigTimeoutTime" BU_SG_REL_ DACU SG_ 831 RRSRRaisedEdge_DxEnd 300;
BA_REL_ "GenSigFirstTimeoutTime" BU_SG_REL_ DACU SG_ 831 RRSRRaisedEdge_LatDistVar 3000;
BA_REL_ "GenSigTimeoutTime" BU_SG_REL_ DACU SG_ 831 RRSRRaisedEdge_LatDistVar 300;
BA_REL_ "GenSigFirstTimeoutTime" BU_SG_REL_ DACU SG_ 831 RRSRRaisedEdge_CoastIndex 3000;
BA_REL_ "GenSigTimeoutTime" BU_SG_REL_ DACU SG_ 831 RRSRRaisedEdge_CoastIndex 300;
BA_REL_ "GenSigFirstTimeoutTime" BU_SG_REL_ DACU SG_ 831 RRSRRaisedEdge_LatDist 3000;
BA_REL_ "GenSigTimeoutTime" BU_SG_REL_ DACU SG_ 831 RRSRRaisedEdge_LatDist 300;
BA_REL_ "GenSigFirstTimeoutTime" BU_SG_REL_ DACU SG_ 831 RRSRRaisedEdge_Counter 3000;
BA_REL_ "GenSigTimeoutTime" BU_SG_REL_ DACU SG_ 831 RRSRRaisedEdge_Counter 300;
BA_REL_ "GenSigFirstTimeoutTime" BU_SG_REL_ DACU SG_ 831 RRSRRaisedEdge_CurvatureRate 3000;
BA_REL_ "GenSigTimeoutTime" BU_SG_REL_ DACU SG_ 831 RRSRRaisedEdge_CurvatureRate 300;
BA_REL_ "GenSigFirstTimeoutTime" BU_SG_REL_ DACU SG_ 831 RRSRRaisedEdge_TrackStatus 3000;
BA_REL_ "GenSigTimeoutTime" BU_SG_REL_ DACU SG_ 831 RRSRRaisedEdge_TrackStatus 300;
BA_REL_ "GenSigFirstTimeoutTime" BU_SG_REL_ DACU SG_ 831 RRSRRaisedEdge_Curvature 3000;
BA_REL_ "GenSigTimeoutTime" BU_SG_REL_ DACU SG_ 831 RRSRRaisedEdge_Curvature 300;
BA_REL_ "GenSigFirstTimeoutTime" BU_SG_REL_ DACU SG_ 830 RRSREgoAssumpt_EgoYawRate 3000;
BA_REL_ "GenSigTimeoutTime" BU_SG_REL_ DACU SG_ 830 RRSREgoAssumpt_EgoYawRate 300;
BA_REL_ "GenSigFirstTimeoutTime" BU_SG_REL_ DACU SG_ 830 RRSREgoAssumpt_EgoRoadEnd 3000;
BA_REL_ "GenSigTimeoutTime" BU_SG_REL_ DACU SG_ 830 RRSREgoAssumpt_EgoRoadEnd 300;
BA_REL_ "GenSigFirstTimeoutTime" BU_SG_REL_ DACU SG_ 830 RRSREgoAssumpt_EgoRoadHeading 3000;
BA_REL_ "GenSigTimeoutTime" BU_SG_REL_ DACU SG_ 830 RRSREgoAssumpt_EgoRoadHeading 300;
BA_REL_ "GenSigFirstTimeoutTime" BU_SG_REL_ DACU SG_ 830 RRSREgoAssumpt_EgoRoadCurvRate 3000;
BA_REL_ "GenSigTimeoutTime" BU_SG_REL_ DACU SG_ 830 RRSREgoAssumpt_EgoRoadCurvRate 300;
BA_REL_ "GenSigFirstTimeoutTime" BU_SG_REL_ DACU SG_ 830 RRSREgoAssumpt_EgoLongVel 3000;
BA_REL_ "GenSigTimeoutTime" BU_SG_REL_ DACU SG_ 830 RRSREgoAssumpt_EgoLongVel 300;
BA_REL_ "GenSigFirstTimeoutTime" BU_SG_REL_ DACU SG_ 830 RRSREgoAssumpt_VelCorrFactor 3000;
BA_REL_ "GenSigTimeoutTime" BU_SG_REL_ DACU SG_ 830 RRSREgoAssumpt_VelCorrFactor 300;
BA_REL_ "GenSigFirstTimeoutTime" BU_SG_REL_ DACU SG_ 830 RRSREgoAssumpt_EgoRoadCurvature 3000;
BA_REL_ "GenSigTimeoutTime" BU_SG_REL_ DACU SG_ 830 RRSREgoAssumpt_EgoRoadCurvature 300;
BA_REL_ "GenSigFirstTimeoutTime" BU_SG_REL_ DACU SG_ 830 RRSREgoAssumpt_EgoLongAcc 3000;
BA_REL_ "GenSigTimeoutTime" BU_SG_REL_ DACU SG_ 830 RRSREgoAssumpt_EgoLongAcc 300;
BA_REL_ "GenSigFirstTimeoutTime" BU_SG_REL_ DACU SG_ 830 RRSREgoAssumpt_TimeStamp 3000;
BA_REL_ "GenSigTimeoutTime" BU_SG_REL_ DACU SG_ 830 RRSREgoAssumpt_TimeStamp 300;
BA_REL_ "GenSigFirstTimeoutTime" BU_SG_REL_ DACU SG_ 812 RFSideSensorTrlrObj_TrlrTypeConf 3000;
BA_REL_ "GenSigTimeoutTime" BU_SG_REL_ DACU SG_ 812 RFSideSensorTrlrObj_TrlrTypeConf 300;
BA_REL_ "GenSigFirstTimeoutTime" BU_SG_REL_ DACU SG_ 812 RFSideSensorTrlrObj_WheelBased3 3000;
BA_REL_ "GenSigTimeoutTime" BU_SG_REL_ DACU SG_ 812 RFSideSensorTrlrObj_WheelBased3 300;
BA_REL_ "GenSigFirstTimeoutTime" BU_SG_REL_ DACU SG_ 812 RFSideSensorTrlrObj_TrlAnglConf 3000;
BA_REL_ "GenSigTimeoutTime" BU_SG_REL_ DACU SG_ 812 RFSideSensorTrlrObj_TrlAnglConf 300;
BA_REL_ "GenSigFirstTimeoutTime" BU_SG_REL_ DACU SG_ 812 RFSideSensorTrlrObj_Seg5Length 3000;
BA_REL_ "GenSigTimeoutTime" BU_SG_REL_ DACU SG_ 812 RFSideSensorTrlrObj_Seg5Length 300;
BA_REL_ "GenSigFirstTimeoutTime" BU_SG_REL_ DACU SG_ 812 RFSideSensorTrlrObj_SegAngle3 3000;
BA_REL_ "GenSigTimeoutTime" BU_SG_REL_ DACU SG_ 812 RFSideSensorTrlrObj_SegAngle3 300;
BA_REL_ "GenSigFirstTimeoutTime" BU_SG_REL_ DACU SG_ 812 RFSideSensorTrlrObj_SegAngle1 3000;
BA_REL_ "GenSigTimeoutTime" BU_SG_REL_ DACU SG_ 812 RFSideSensorTrlrObj_SegAngle1 300;
BA_REL_ "GenSigFirstTimeoutTime" BU_SG_REL_ DACU SG_ 812 RFSideSensorTrlrObj_SegTrlrType3 3000;
BA_REL_ "GenSigTimeoutTime" BU_SG_REL_ DACU SG_ 812 RFSideSensorTrlrObj_SegTrlrType3 300;
BA_REL_ "GenSigFirstTimeoutTime" BU_SG_REL_ DACU SG_ 812 RFSideSensorTrlrObj_Seg1Length 3000;
BA_REL_ "GenSigTimeoutTime" BU_SG_REL_ DACU SG_ 812 RFSideSensorTrlrObj_Seg1Length 300;
BA_REL_ "GenSigFirstTimeoutTime" BU_SG_REL_ DACU SG_ 812 RFSideSensorTrlrObj_WheelBased2 3000;
BA_REL_ "GenSigTimeoutTime" BU_SG_REL_ DACU SG_ 812 RFSideSensorTrlrObj_WheelBased2 300;
BA_REL_ "GenSigFirstTimeoutTime" BU_SG_REL_ DACU SG_ 812 RFSideSensorTrlrObj_SegTrlrType1 3000;
BA_REL_ "GenSigTimeoutTime" BU_SG_REL_ DACU SG_ 812 RFSideSensorTrlrObj_SegTrlrType1 300;
BA_REL_ "GenSigFirstTimeoutTime" BU_SG_REL_ DACU SG_ 812 RFSideSensorTrlrObj_SegAngle2 3000;
BA_REL_ "GenSigTimeoutTime" BU_SG_REL_ DACU SG_ 812 RFSideSensorTrlrObj_SegAngle2 300;
BA_REL_ "GenSigFirstTimeoutTime" BU_SG_REL_ DACU SG_ 812 RFSideSensorTrlrObj_SegAngle4 3000;
BA_REL_ "GenSigTimeoutTime" BU_SG_REL_ DACU SG_ 812 RFSideSensorTrlrObj_SegAngle4 300;
BA_REL_ "GenSigFirstTimeoutTime" BU_SG_REL_ DACU SG_ 812 RFSideSensorTrlrObj_Seg3Length 3000;
BA_REL_ "GenSigTimeoutTime" BU_SG_REL_ DACU SG_ 812 RFSideSensorTrlrObj_Seg3Length 300;
BA_REL_ "GenSigFirstTimeoutTime" BU_SG_REL_ DACU SG_ 812 RFSideSensorTrlrObj_Seg2Length 3000;
BA_REL_ "GenSigTimeoutTime" BU_SG_REL_ DACU SG_ 812 RFSideSensorTrlrObj_Seg2Length 300;
BA_REL_ "GenSigFirstTimeoutTime" BU_SG_REL_ DACU SG_ 812 RFSideSensorTrlrObj_WhlBasedConf 3000;
BA_REL_ "GenSigTimeoutTime" BU_SG_REL_ DACU SG_ 812 RFSideSensorTrlrObj_WhlBasedConf 300;
BA_REL_ "GenSigFirstTimeoutTime" BU_SG_REL_ DACU SG_ 812 RFSideSensorTrlrObj_WheelBased1 3000;
BA_REL_ "GenSigTimeoutTime" BU_SG_REL_ DACU SG_ 812 RFSideSensorTrlrObj_WheelBased1 300;
BA_REL_ "GenSigFirstTimeoutTime" BU_SG_REL_ DACU SG_ 812 RFSideSensorTrlrObj_SegTrlrType5 3000;
BA_REL_ "GenSigTimeoutTime" BU_SG_REL_ DACU SG_ 812 RFSideSensorTrlrObj_SegTrlrType5 300;
BA_REL_ "GenSigFirstTimeoutTime" BU_SG_REL_ DACU SG_ 812 RFSideSensorTrlrObj_Seg4Length 3000;
BA_REL_ "GenSigTimeoutTime" BU_SG_REL_ DACU SG_ 812 RFSideSensorTrlrObj_Seg4Length 300;
BA_REL_ "GenSigFirstTimeoutTime" BU_SG_REL_ DACU SG_ 812 RFSideSensorTrlrObj_WheelBased4 3000;
BA_REL_ "GenSigTimeoutTime" BU_SG_REL_ DACU SG_ 812 RFSideSensorTrlrObj_WheelBased4 300;
BA_REL_ "GenSigFirstTimeoutTime" BU_SG_REL_ DACU SG_ 812 RFSideSensorTrlrObj_SegAngle5 3000;
BA_REL_ "GenSigTimeoutTime" BU_SG_REL_ DACU SG_ 812 RFSideSensorTrlrObj_SegAngle5 300;
BA_REL_ "GenSigFirstTimeoutTime" BU_SG_REL_ DACU SG_ 812 RFSideSensorTrlrObj_TotLenConf 3000;
BA_REL_ "GenSigTimeoutTime" BU_SG_REL_ DACU SG_ 812 RFSideSensorTrlrObj_TotLenConf 300;
BA_REL_ "GenSigFirstTimeoutTime" BU_SG_REL_ DACU SG_ 812 RFSideSensorTrlrObj_SegTrlrType4 3000;
BA_REL_ "GenSigTimeoutTime" BU_SG_REL_ DACU SG_ 812 RFSideSensorTrlrObj_SegTrlrType4 300;
BA_REL_ "GenSigFirstTimeoutTime" BU_SG_REL_ DACU SG_ 812 RFSideSensorTrlrObj_WheelBased5 3000;
BA_REL_ "GenSigTimeoutTime" BU_SG_REL_ DACU SG_ 812 RFSideSensorTrlrObj_WheelBased5 300;
BA_REL_ "GenSigFirstTimeoutTime" BU_SG_REL_ DACU SG_ 812 RFSideSensorTrlrObj_SegTrlrType2 3000;
BA_REL_ "GenSigTimeoutTime" BU_SG_REL_ DACU SG_ 812 RFSideSensorTrlrObj_SegTrlrType2 300;
BA_REL_ "GenSigFirstTimeoutTime" BU_SG_REL_ DACU SG_ 812 RFSideSensorTrlrObj_TotalLength 3000;
BA_REL_ "GenSigTimeoutTime" BU_SG_REL_ DACU SG_ 812 RFSideSensorTrlrObj_TotalLength 300;
BA_REL_ "GenSigFirstTimeoutTime" BU_SG_REL_ DACU SG_ 1554 RFSRSwVersion_Substring0 60000;
BA_REL_ "GenSigTimeoutTime" BU_SG_REL_ DACU SG_ 1554 RFSRSwVersion_Substring0 60000;
BA_REL_ "GenSigFirstTimeoutTime" BU_SG_REL_ DACU SG_ 1554 RFSRSwVersion_Substring7 60000;
BA_REL_ "GenSigTimeoutTime" BU_SG_REL_ DACU SG_ 1554 RFSRSwVersion_Substring7 60000;
BA_REL_ "GenSigFirstTimeoutTime" BU_SG_REL_ DACU SG_ 1554 RFSRSwVersion_Substring5 60000;
BA_REL_ "GenSigTimeoutTime" BU_SG_REL_ DACU SG_ 1554 RFSRSwVersion_Substring5 60000;
BA_REL_ "GenSigFirstTimeoutTime" BU_SG_REL_ DACU SG_ 1554 RFSRSwVersion_Substring2 60000;
BA_REL_ "GenSigTimeoutTime" BU_SG_REL_ DACU SG_ 1554 RFSRSwVersion_Substring2 60000;
BA_REL_ "GenSigFirstTimeoutTime" BU_SG_REL_ DACU SG_ 1554 RFSRSwVersion_Substring6 60000;
BA_REL_ "GenSigTimeoutTime" BU_SG_REL_ DACU SG_ 1554 RFSRSwVersion_Substring6 60000;
BA_REL_ "GenSigFirstTimeoutTime" BU_SG_REL_ DACU SG_ 1554 RFSRSwVersion_Substring3 60000;
BA_REL_ "GenSigTimeoutTime" BU_SG_REL_ DACU SG_ 1554 RFSRSwVersion_Substring3 60000;
BA_REL_ "GenSigFirstTimeoutTime" BU_SG_REL_ DACU SG_ 1554 RFSRSwVersion_Substring4 60000;
BA_REL_ "GenSigTimeoutTime" BU_SG_REL_ DACU SG_ 1554 RFSRSwVersion_Substring4 60000;
BA_REL_ "GenSigFirstTimeoutTime" BU_SG_REL_ DACU SG_ 1554 RFSRSwVersion_Substring1 60000;
BA_REL_ "GenSigTimeoutTime" BU_SG_REL_ DACU SG_ 1554 RFSRSwVersion_Substring1 60000;
BA_REL_ "GenSigFirstTimeoutTime" BU_SG_REL_ DACU SG_ 815 RFSRRaisedEdge_LatDist 3000;
BA_REL_ "GenSigTimeoutTime" BU_SG_REL_ DACU SG_ 815 RFSRRaisedEdge_LatDist 300;
BA_REL_ "GenSigFirstTimeoutTime" BU_SG_REL_ DACU SG_ 815 RFSRRaisedEdge_CoastIndex 3000;
BA_REL_ "GenSigTimeoutTime" BU_SG_REL_ DACU SG_ 815 RFSRRaisedEdge_CoastIndex 300;
BA_REL_ "GenSigFirstTimeoutTime" BU_SG_REL_ DACU SG_ 815 RFSRRaisedEdge_LatDistVar 3000;
BA_REL_ "GenSigTimeoutTime" BU_SG_REL_ DACU SG_ 815 RFSRRaisedEdge_LatDistVar 300;
BA_REL_ "GenSigFirstTimeoutTime" BU_SG_REL_ DACU SG_ 815 RFSRRaisedEdge_HeadingAngle 3000;
BA_REL_ "GenSigTimeoutTime" BU_SG_REL_ DACU SG_ 815 RFSRRaisedEdge_HeadingAngle 300;
BA_REL_ "GenSigFirstTimeoutTime" BU_SG_REL_ DACU SG_ 815 RFSRRaisedEdge_TrackStatus 3000;
BA_REL_ "GenSigTimeoutTime" BU_SG_REL_ DACU SG_ 815 RFSRRaisedEdge_TrackStatus 300;
BA_REL_ "GenSigFirstTimeoutTime" BU_SG_REL_ DACU SG_ 815 RFSRRaisedEdge_CurvatureRate 3000;
BA_REL_ "GenSigTimeoutTime" BU_SG_REL_ DACU SG_ 815 RFSRRaisedEdge_CurvatureRate 300;
BA_REL_ "GenSigFirstTimeoutTime" BU_SG_REL_ DACU SG_ 815 RFSRRaisedEdge_CRC 3000;
BA_REL_ "GenSigTimeoutTime" BU_SG_REL_ DACU SG_ 815 RFSRRaisedEdge_CRC 300;
BA_REL_ "GenSigFirstTimeoutTime" BU_SG_REL_ DACU SG_ 815 RFSRRaisedEdge_DxStart 3000;
BA_REL_ "GenSigTimeoutTime" BU_SG_REL_ DACU SG_ 815 RFSRRaisedEdge_DxStart 300;
BA_REL_ "GenSigFirstTimeoutTime" BU_SG_REL_ DACU SG_ 815 RFSRRaisedEdge_DxEnd 3000;
BA_REL_ "GenSigTimeoutTime" BU_SG_REL_ DACU SG_ 815 RFSRRaisedEdge_DxEnd 300;
BA_REL_ "GenSigFirstTimeoutTime" BU_SG_REL_ DACU SG_ 815 RFSRRaisedEdge_TimeStamp 3000;
BA_REL_ "GenSigTimeoutTime" BU_SG_REL_ DACU SG_ 815 RFSRRaisedEdge_TimeStamp 300;
BA_REL_ "GenSigFirstTimeoutTime" BU_SG_REL_ DACU SG_ 815 RFSRRaisedEdge_Confidence 3000;
BA_REL_ "GenSigTimeoutTime" BU_SG_REL_ DACU SG_ 815 RFSRRaisedEdge_Confidence 300;
BA_REL_ "GenSigFirstTimeoutTime" BU_SG_REL_ DACU SG_ 815 RFSRRaisedEdge_Counter 3000;
BA_REL_ "GenSigTimeoutTime" BU_SG_REL_ DACU SG_ 815 RFSRRaisedEdge_Counter 300;
BA_REL_ "GenSigFirstTimeoutTime" BU_SG_REL_ DACU SG_ 815 RFSRRaisedEdge_Curvature 3000;
BA_REL_ "GenSigTimeoutTime" BU_SG_REL_ DACU SG_ 815 RFSRRaisedEdge_Curvature 300;
BA_REL_ "GenSigFirstTimeoutTime" BU_SG_REL_ DACU SG_ 815 RFSRRaisedEdge_Type 3000;
BA_REL_ "GenSigTimeoutTime" BU_SG_REL_ DACU SG_ 815 RFSRRaisedEdge_Type 300;
BA_REL_ "GenSigFirstTimeoutTime" BU_SG_REL_ DACU SG_ 815 RFSRRaisedEdge_LifeTime 3000;
BA_REL_ "GenSigTimeoutTime" BU_SG_REL_ DACU SG_ 815 RFSRRaisedEdge_LifeTime 300;
BA_REL_ "GenSigFirstTimeoutTime" BU_SG_REL_ DACU SG_ 814 RFSREgoAssumpt_EgoYawRate 3000;
BA_REL_ "GenSigTimeoutTime" BU_SG_REL_ DACU SG_ 814 RFSREgoAssumpt_EgoYawRate 300;
BA_REL_ "GenSigFirstTimeoutTime" BU_SG_REL_ DACU SG_ 814 RFSREgoAssumpt_EgoRoadHeading 3000;
BA_REL_ "GenSigTimeoutTime" BU_SG_REL_ DACU SG_ 814 RFSREgoAssumpt_EgoRoadHeading 300;
BA_REL_ "GenSigFirstTimeoutTime" BU_SG_REL_ DACU SG_ 814 RFSREgoAssumpt_TimeStamp 3000;
BA_REL_ "GenSigTimeoutTime" BU_SG_REL_ DACU SG_ 814 RFSREgoAssumpt_TimeStamp 300;
BA_REL_ "GenSigFirstTimeoutTime" BU_SG_REL_ DACU SG_ 814 RFSREgoAssumpt_EgoRoadCurvRate 3000;
BA_REL_ "GenSigTimeoutTime" BU_SG_REL_ DACU SG_ 814 RFSREgoAssumpt_EgoRoadCurvRate 300;
BA_REL_ "GenSigFirstTimeoutTime" BU_SG_REL_ DACU SG_ 814 RFSREgoAssumpt_EgoLongAcc 3000;
BA_REL_ "GenSigTimeoutTime" BU_SG_REL_ DACU SG_ 814 RFSREgoAssumpt_EgoLongAcc 300;
BA_REL_ "GenSigFirstTimeoutTime" BU_SG_REL_ DACU SG_ 814 RFSREgoAssumpt_VelCorrFactor 3000;
BA_REL_ "GenSigTimeoutTime" BU_SG_REL_ DACU SG_ 814 RFSREgoAssumpt_VelCorrFactor 300;
BA_REL_ "GenSigFirstTimeoutTime" BU_SG_REL_ DACU SG_ 814 RFSREgoAssumpt_EgoLongVel 3000;
BA_REL_ "GenSigTimeoutTime" BU_SG_REL_ DACU SG_ 814 RFSREgoAssumpt_EgoLongVel 300;
BA_REL_ "GenSigFirstTimeoutTime" BU_SG_REL_ DACU SG_ 814 RFSREgoAssumpt_EgoRoadCurvature 3000;
BA_REL_ "GenSigTimeoutTime" BU_SG_REL_ DACU SG_ 814 RFSREgoAssumpt_EgoRoadCurvature 300;
BA_REL_ "GenSigFirstTimeoutTime" BU_SG_REL_ DACU SG_ 814 RFSREgoAssumpt_EgoRoadEnd 3000;
BA_REL_ "GenSigTimeoutTime" BU_SG_REL_ DACU SG_ 814 RFSREgoAssumpt_EgoRoadEnd 300;
VAL_ 816 RRSideSensorObj00_ObjClass 15 "ObjClassSideS_NotAvailable" 14 "ObjClassSideS_Error" 13 "ObjClassSideS_Spare4" 12 "ObjClassSideS_Spare3" 11 "ObjClassSideS_Motorcycle" 10 "ObjClassSideS_Bicycle" 9 "ObjClassSideS_UnidentifiedMovableObject" 8 "ObjClassSideS_UnidentifiedVRU" 7 "ObjClassSideS_UnidentifiedVehicle" 6 "ObjClassSideS_StaticObject" 5 "ObjClassSideS_Pedestrian" 4 "ObjClassSideS_2Wheeler" 3 "ObjClassSideS_HeavyVehicle" 2 "ObjClassSideS_Car" 1 "ObjClassSideS_Obstacle" 0 "ObjClassSideS_Undetermined" ;
VAL_ 816 RRSideSensorObj00_TrackStatus 7 "TrackStatus_NotAvailable" 6 "TrackStatus_Error" 5 "TrackStatus_Spare3" 4 "TrackStatus_Spare2" 3 "TrackStatus_Spare1" 2 "TrackStatus_Invalid" 1 "TrackStatus_Predicted" 0 "TrackStatus_Tracked" ;
VAL_ 816 RRSideSensorObj00_Prioritisation 3 "Prioritisation_NotAvailable" 2 "Prioritisation_StaticPrioritisation" 1 "Prioritisation_VolvoPrioritisation" 0 "Prioritisation_BoschPrioritisation" ;
VAL_ 816 RRSideSensorObj00_ObjDynClass 3 "ObjDynClass_Error" 2 "ObjDynClass_Movable" 1 "ObjDynClass_Stationary" 0 "ObjDynClass_Reserved" ;
VAL_ 831 RRSRRaisedEdge_Type 7 "RaisedEdgeType_NotAvailable" 6 "RaisedEdgeType_Error" 5 "RaisedEdgeType_Spare2" 4 "RaisedEdgeType_Spare1" 3 "RaisedEdgeType_Barrier" 2 "RaisedEdgeType_NonElevatedBoundary" 1 "RaisedEdgeType_ElevatedBoundary" 0 "RaisedEdgeType_Unknown" ;
VAL_ 831 RRSRRaisedEdge_TrackStatus 7 "TrackStatus_NotAvailable" 6 "TrackStatus_Error" 5 "TrackStatus_Spare3" 4 "TrackStatus_Spare2" 3 "TrackStatus_Spare1" 2 "TrackStatus_Invalid" 1 "TrackStatus_Predicted" 0 "TrackStatus_Tracked" ;
VAL_ 812 RFSideSensorTrlrObj_SegTrlrType3 15 "SegTrailerType_NotAvailable" 14 "SegTrailerType_Error" 13 "SegTrailerType_Spare6" 12 "SegTrailerType_Spare5" 11 "SegTrailerType_Spare4" 10 "SegTrailerType_Spare3" 9 "SegTrailerType_Spare2" 8 "SegTrailerType_Spare1" 7 "SegTrailerType_TowingFullTrailer" 6 "SegTrailerType_TowingCentreAxleTrailer" 5 "SegTrailerType_TowingSemiTrailer" 4 "SegTrailerType_LinkTrailer" 3 "SegTrailerType_ConverterDolly" 2 "SegTrailerType_FullTrailer" 1 "SegTrailerType_CentreAxleTrailer" 0 "SegTrailerType_SemiTrailer" ;
VAL_ 812 RFSideSensorTrlrObj_SegTrlrType1 15 "SegTrailerType_NotAvailable" 14 "SegTrailerType_Error" 13 "SegTrailerType_Spare6" 12 "SegTrailerType_Spare5" 11 "SegTrailerType_Spare4" 10 "SegTrailerType_Spare3" 9 "SegTrailerType_Spare2" 8 "SegTrailerType_Spare1" 7 "SegTrailerType_TowingFullTrailer" 6 "SegTrailerType_TowingCentreAxleTrailer" 5 "SegTrailerType_TowingSemiTrailer" 4 "SegTrailerType_LinkTrailer" 3 "SegTrailerType_ConverterDolly" 2 "SegTrailerType_FullTrailer" 1 "SegTrailerType_CentreAxleTrailer" 0 "SegTrailerType_SemiTrailer" ;
VAL_ 812 RFSideSensorTrlrObj_SegTrlrType5 15 "SegTrailerType_NotAvailable" 14 "SegTrailerType_Error" 13 "SegTrailerType_Spare6" 12 "SegTrailerType_Spare5" 11 "SegTrailerType_Spare4" 10 "SegTrailerType_Spare3" 9 "SegTrailerType_Spare2" 8 "SegTrailerType_Spare1" 7 "SegTrailerType_TowingFullTrailer" 6 "SegTrailerType_TowingCentreAxleTrailer" 5 "SegTrailerType_TowingSemiTrailer" 4 "SegTrailerType_LinkTrailer" 3 "SegTrailerType_ConverterDolly" 2 "SegTrailerType_FullTrailer" 1 "SegTrailerType_CentreAxleTrailer" 0 "SegTrailerType_SemiTrailer" ;
VAL_ 812 RFSideSensorTrlrObj_TotLenConf 7 "TotLenConf_NotAvailable" 6 "TotLenConf_Error" 5 "TotLenConf_Spare" 4 "TotLenConf_LessThanPoint1m" 3 "TotLenConf_LessThanPoint5m" 2 "TotLenConf_LessThan1m" 1 "TotLenConf_LessThan3m" 0 "TotLenConf_GreaterThan3m" ;
VAL_ 812 RFSideSensorTrlrObj_SegTrlrType4 15 "SegTrailerType_NotAvailable" 14 "SegTrailerType_Error" 13 "SegTrailerType_Spare6" 12 "SegTrailerType_Spare5" 11 "SegTrailerType_Spare4" 10 "SegTrailerType_Spare3" 9 "SegTrailerType_Spare2" 8 "SegTrailerType_Spare1" 7 "SegTrailerType_TowingFullTrailer" 6 "SegTrailerType_TowingCentreAxleTrailer" 5 "SegTrailerType_TowingSemiTrailer" 4 "SegTrailerType_LinkTrailer" 3 "SegTrailerType_ConverterDolly" 2 "SegTrailerType_FullTrailer" 1 "SegTrailerType_CentreAxleTrailer" 0 "SegTrailerType_SemiTrailer" ;
VAL_ 812 RFSideSensorTrlrObj_SegTrlrType2 15 "SegTrailerType_NotAvailable" 14 "SegTrailerType_Error" 13 "SegTrailerType_Spare6" 12 "SegTrailerType_Spare5" 11 "SegTrailerType_Spare4" 10 "SegTrailerType_Spare3" 9 "SegTrailerType_Spare2" 8 "SegTrailerType_Spare1" 7 "SegTrailerType_TowingFullTrailer" 6 "SegTrailerType_TowingCentreAxleTrailer" 5 "SegTrailerType_TowingSemiTrailer" 4 "SegTrailerType_LinkTrailer" 3 "SegTrailerType_ConverterDolly" 2 "SegTrailerType_FullTrailer" 1 "SegTrailerType_CentreAxleTrailer" 0 "SegTrailerType_SemiTrailer" ;
VAL_ 811 RFSideSensorObj11_ObjDynClass 3 "ObjDynClass_Error" 2 "ObjDynClass_Movable" 1 "ObjDynClass_Stationary" 0 "ObjDynClass_Reserved" ;
VAL_ 811 RFSideSensorObj11_Prioritisation 3 "Prioritisation_NotAvailable" 2 "Prioritisation_StaticPrioritisation" 1 "Prioritisation_VolvoPrioritisation" 0 "Prioritisation_BoschPrioritisation" ;
VAL_ 811 RFSideSensorObj11_TrackStatus 7 "TrackStatus_NotAvailable" 6 "TrackStatus_Error" 5 "TrackStatus_Spare3" 4 "TrackStatus_Spare2" 3 "TrackStatus_Spare1" 2 "TrackStatus_Invalid" 1 "TrackStatus_Predicted" 0 "TrackStatus_Tracked" ;
VAL_ 811 RFSideSensorObj11_ObjClass 15 "ObjClassSideS_NotAvailable" 14 "ObjClassSideS_Error" 13 "ObjClassSideS_Spare4" 12 "ObjClassSideS_Spare3" 11 "ObjClassSideS_Motorcycle" 10 "ObjClassSideS_Bicycle" 9 "ObjClassSideS_UnidentifiedMovableObject" 8 "ObjClassSideS_UnidentifiedVRU" 7 "ObjClassSideS_UnidentifiedVehicle" 6 "ObjClassSideS_StaticObject" 5 "ObjClassSideS_Pedestrian" 4 "ObjClassSideS_2Wheeler" 3 "ObjClassSideS_HeavyVehicle" 2 "ObjClassSideS_Car" 1 "ObjClassSideS_Obstacle" 0 "ObjClassSideS_Undetermined" ;
VAL_ 810 RFSideSensorObj10_Prioritisation 3 "Prioritisation_NotAvailable" 2 "Prioritisation_StaticPrioritisation" 1 "Prioritisation_VolvoPrioritisation" 0 "Prioritisation_BoschPrioritisation" ;
VAL_ 810 RFSideSensorObj10_ObjDynClass 3 "ObjDynClass_Error" 2 "ObjDynClass_Movable" 1 "ObjDynClass_Stationary" 0 "ObjDynClass_Reserved" ;
VAL_ 810 RFSideSensorObj10_ObjClass 15 "ObjClassSideS_NotAvailable" 14 "ObjClassSideS_Error" 13 "ObjClassSideS_Spare4" 12 "ObjClassSideS_Spare3" 11 "ObjClassSideS_Motorcycle" 10 "ObjClassSideS_Bicycle" 9 "ObjClassSideS_UnidentifiedMovableObject" 8 "ObjClassSideS_UnidentifiedVRU" 7 "ObjClassSideS_UnidentifiedVehicle" 6 "ObjClassSideS_StaticObject" 5 "ObjClassSideS_Pedestrian" 4 "ObjClassSideS_2Wheeler" 3 "ObjClassSideS_HeavyVehicle" 2 "ObjClassSideS_Car" 1 "ObjClassSideS_Obstacle" 0 "ObjClassSideS_Undetermined" ;
VAL_ 810 RFSideSensorObj10_TrackStatus 7 "TrackStatus_NotAvailable" 6 "TrackStatus_Error" 5 "TrackStatus_Spare3" 4 "TrackStatus_Spare2" 3 "TrackStatus_Spare1" 2 "TrackStatus_Invalid" 1 "TrackStatus_Predicted" 0 "TrackStatus_Tracked" ;
VAL_ 809 RFSideSensorObj09_ObjClass 15 "ObjClassSideS_NotAvailable" 14 "ObjClassSideS_Error" 13 "ObjClassSideS_Spare4" 12 "ObjClassSideS_Spare3" 11 "ObjClassSideS_Motorcycle" 10 "ObjClassSideS_Bicycle" 9 "ObjClassSideS_UnidentifiedMovableObject" 8 "ObjClassSideS_UnidentifiedVRU" 7 "ObjClassSideS_UnidentifiedVehicle" 6 "ObjClassSideS_StaticObject" 5 "ObjClassSideS_Pedestrian" 4 "ObjClassSideS_2Wheeler" 3 "ObjClassSideS_HeavyVehicle" 2 "ObjClassSideS_Car" 1 "ObjClassSideS_Obstacle" 0 "ObjClassSideS_Undetermined" ;
VAL_ 809 RFSideSensorObj09_Prioritisation 3 "Prioritisation_NotAvailable" 2 "Prioritisation_StaticPrioritisation" 1 "Prioritisation_VolvoPrioritisation" 0 "Prioritisation_BoschPrioritisation" ;
VAL_ 809 RFSideSensorObj09_TrackStatus 7 "TrackStatus_NotAvailable" 6 "TrackStatus_Error" 5 "TrackStatus_Spare3" 4 "TrackStatus_Spare2" 3 "TrackStatus_Spare1" 2 "TrackStatus_Invalid" 1 "TrackStatus_Predicted" 0 "TrackStatus_Tracked" ;
VAL_ 809 RFSideSensorObj09_ObjDynClass 3 "ObjDynClass_Error" 2 "ObjDynClass_Movable" 1 "ObjDynClass_Stationary" 0 "ObjDynClass_Reserved" ;
VAL_ 808 RFSideSensorObj08_Prioritisation 3 "Prioritisation_NotAvailable" 2 "Prioritisation_StaticPrioritisation" 1 "Prioritisation_VolvoPrioritisation" 0 "Prioritisation_BoschPrioritisation" ;
VAL_ 808 RFSideSensorObj08_ObjClass 15 "ObjClassSideS_NotAvailable" 14 "ObjClassSideS_Error" 13 "ObjClassSideS_Spare4" 12 "ObjClassSideS_Spare3" 11 "ObjClassSideS_Motorcycle" 10 "ObjClassSideS_Bicycle" 9 "ObjClassSideS_UnidentifiedMovableObject" 8 "ObjClassSideS_UnidentifiedVRU" 7 "ObjClassSideS_UnidentifiedVehicle" 6 "ObjClassSideS_StaticObject" 5 "ObjClassSideS_Pedestrian" 4 "ObjClassSideS_2Wheeler" 3 "ObjClassSideS_HeavyVehicle" 2 "ObjClassSideS_Car" 1 "ObjClassSideS_Obstacle" 0 "ObjClassSideS_Undetermined" ;
VAL_ 808 RFSideSensorObj08_TrackStatus 7 "TrackStatus_NotAvailable" 6 "TrackStatus_Error" 5 "TrackStatus_Spare3" 4 "TrackStatus_Spare2" 3 "TrackStatus_Spare1" 2 "TrackStatus_Invalid" 1 "TrackStatus_Predicted" 0 "TrackStatus_Tracked" ;
VAL_ 808 RFSideSensorObj08_ObjDynClass 3 "ObjDynClass_Error" 2 "ObjDynClass_Movable" 1 "ObjDynClass_Stationary" 0 "ObjDynClass_Reserved" ;
VAL_ 807 RFSideSensorObj07_Prioritisation 3 "Prioritisation_NotAvailable" 2 "Prioritisation_StaticPrioritisation" 1 "Prioritisation_VolvoPrioritisation" 0 "Prioritisation_BoschPrioritisation" ;
VAL_ 807 RFSideSensorObj07_ObjDynClass 3 "ObjDynClass_Error" 2 "ObjDynClass_Movable" 1 "ObjDynClass_Stationary" 0 "ObjDynClass_Reserved" ;
VAL_ 807 RFSideSensorObj07_ObjClass 15 "ObjClassSideS_NotAvailable" 14 "ObjClassSideS_Error" 13 "ObjClassSideS_Spare4" 12 "ObjClassSideS_Spare3" 11 "ObjClassSideS_Motorcycle" 10 "ObjClassSideS_Bicycle" 9 "ObjClassSideS_UnidentifiedMovableObject" 8 "ObjClassSideS_UnidentifiedVRU" 7 "ObjClassSideS_UnidentifiedVehicle" 6 "ObjClassSideS_StaticObject" 5 "ObjClassSideS_Pedestrian" 4 "ObjClassSideS_2Wheeler" 3 "ObjClassSideS_HeavyVehicle" 2 "ObjClassSideS_Car" 1 "ObjClassSideS_Obstacle" 0 "ObjClassSideS_Undetermined" ;
VAL_ 807 RFSideSensorObj07_TrackStatus 7 "TrackStatus_NotAvailable" 6 "TrackStatus_Error" 5 "TrackStatus_Spare3" 4 "TrackStatus_Spare2" 3 "TrackStatus_Spare1" 2 "TrackStatus_Invalid" 1 "TrackStatus_Predicted" 0 "TrackStatus_Tracked" ;
VAL_ 806 RFSideSensorObj06_Prioritisation 3 "Prioritisation_NotAvailable" 2 "Prioritisation_StaticPrioritisation" 1 "Prioritisation_VolvoPrioritisation" 0 "Prioritisation_BoschPrioritisation" ;
VAL_ 806 RFSideSensorObj06_TrackStatus 7 "TrackStatus_NotAvailable" 6 "TrackStatus_Error" 5 "TrackStatus_Spare3" 4 "TrackStatus_Spare2" 3 "TrackStatus_Spare1" 2 "TrackStatus_Invalid" 1 "TrackStatus_Predicted" 0 "TrackStatus_Tracked" ;
VAL_ 806 RFSideSensorObj06_ObjDynClass 3 "ObjDynClass_Error" 2 "ObjDynClass_Movable" 1 "ObjDynClass_Stationary" 0 "ObjDynClass_Reserved" ;
VAL_ 806 RFSideSensorObj06_ObjClass 15 "ObjClassSideS_NotAvailable" 14 "ObjClassSideS_Error" 13 "ObjClassSideS_Spare4" 12 "ObjClassSideS_Spare3" 11 "ObjClassSideS_Motorcycle" 10 "ObjClassSideS_Bicycle" 9 "ObjClassSideS_UnidentifiedMovableObject" 8 "ObjClassSideS_UnidentifiedVRU" 7 "ObjClassSideS_UnidentifiedVehicle" 6 "ObjClassSideS_StaticObject" 5 "ObjClassSideS_Pedestrian" 4 "ObjClassSideS_2Wheeler" 3 "ObjClassSideS_HeavyVehicle" 2 "ObjClassSideS_Car" 1 "ObjClassSideS_Obstacle" 0 "ObjClassSideS_Undetermined" ;
VAL_ 805 RFSideSensorObj05_Prioritisation 3 "Prioritisation_NotAvailable" 2 "Prioritisation_StaticPrioritisation" 1 "Prioritisation_VolvoPrioritisation" 0 "Prioritisation_BoschPrioritisation" ;
VAL_ 805 RFSideSensorObj05_TrackStatus 7 "TrackStatus_NotAvailable" 6 "TrackStatus_Error" 5 "TrackStatus_Spare3" 4 "TrackStatus_Spare2" 3 "TrackStatus_Spare1" 2 "TrackStatus_Invalid" 1 "TrackStatus_Predicted" 0 "TrackStatus_Tracked" ;
VAL_ 805 RFSideSensorObj05_ObjDynClass 3 "ObjDynClass_Error" 2 "ObjDynClass_Movable" 1 "ObjDynClass_Stationary" 0 "ObjDynClass_Reserved" ;
VAL_ 805 RFSideSensorObj05_ObjClass 15 "ObjClassSideS_NotAvailable" 14 "ObjClassSideS_Error" 13 "ObjClassSideS_Spare4" 12 "ObjClassSideS_Spare3" 11 "ObjClassSideS_Motorcycle" 10 "ObjClassSideS_Bicycle" 9 "ObjClassSideS_UnidentifiedMovableObject" 8 "ObjClassSideS_UnidentifiedVRU" 7 "ObjClassSideS_UnidentifiedVehicle" 6 "ObjClassSideS_StaticObject" 5 "ObjClassSideS_Pedestrian" 4 "ObjClassSideS_2Wheeler" 3 "ObjClassSideS_HeavyVehicle" 2 "ObjClassSideS_Car" 1 "ObjClassSideS_Obstacle" 0 "ObjClassSideS_Undetermined" ;
VAL_ 804 RFSideSensorObj04_TrackStatus 7 "TrackStatus_NotAvailable" 6 "TrackStatus_Error" 5 "TrackStatus_Spare3" 4 "TrackStatus_Spare2" 3 "TrackStatus_Spare1" 2 "TrackStatus_Invalid" 1 "TrackStatus_Predicted" 0 "TrackStatus_Tracked" ;
VAL_ 804 RFSideSensorObj04_ObjDynClass 3 "ObjDynClass_Error" 2 "ObjDynClass_Movable" 1 "ObjDynClass_Stationary" 0 "ObjDynClass_Reserved" ;
VAL_ 804 RFSideSensorObj04_Prioritisation 3 "Prioritisation_NotAvailable" 2 "Prioritisation_StaticPrioritisation" 1 "Prioritisation_VolvoPrioritisation" 0 "Prioritisation_BoschPrioritisation" ;
VAL_ 804 RFSideSensorObj04_ObjClass 15 "ObjClassSideS_NotAvailable" 14 "ObjClassSideS_Error" 13 "ObjClassSideS_Spare4" 12 "ObjClassSideS_Spare3" 11 "ObjClassSideS_Motorcycle" 10 "ObjClassSideS_Bicycle" 9 "ObjClassSideS_UnidentifiedMovableObject" 8 "ObjClassSideS_UnidentifiedVRU" 7 "ObjClassSideS_UnidentifiedVehicle" 6 "ObjClassSideS_StaticObject" 5 "ObjClassSideS_Pedestrian" 4 "ObjClassSideS_2Wheeler" 3 "ObjClassSideS_HeavyVehicle" 2 "ObjClassSideS_Car" 1 "ObjClassSideS_Obstacle" 0 "ObjClassSideS_Undetermined" ;
VAL_ 803 RFSideSensorObj03_Prioritisation 3 "Prioritisation_NotAvailable" 2 "Prioritisation_StaticPrioritisation" 1 "Prioritisation_VolvoPrioritisation" 0 "Prioritisation_BoschPrioritisation" ;
VAL_ 803 RFSideSensorObj03_ObjDynClass 3 "ObjDynClass_Error" 2 "ObjDynClass_Movable" 1 "ObjDynClass_Stationary" 0 "ObjDynClass_Reserved" ;
VAL_ 803 RFSideSensorObj03_ObjClass 15 "ObjClassSideS_NotAvailable" 14 "ObjClassSideS_Error" 13 "ObjClassSideS_Spare4" 12 "ObjClassSideS_Spare3" 11 "ObjClassSideS_Motorcycle" 10 "ObjClassSideS_Bicycle" 9 "ObjClassSideS_UnidentifiedMovableObject" 8 "ObjClassSideS_UnidentifiedVRU" 7 "ObjClassSideS_UnidentifiedVehicle" 6 "ObjClassSideS_StaticObject" 5 "ObjClassSideS_Pedestrian" 4 "ObjClassSideS_2Wheeler" 3 "ObjClassSideS_HeavyVehicle" 2 "ObjClassSideS_Car" 1 "ObjClassSideS_Obstacle" 0 "ObjClassSideS_Undetermined" ;
VAL_ 803 RFSideSensorObj03_TrackStatus 7 "TrackStatus_NotAvailable" 6 "TrackStatus_Error" 5 "TrackStatus_Spare3" 4 "TrackStatus_Spare2" 3 "TrackStatus_Spare1" 2 "TrackStatus_Invalid" 1 "TrackStatus_Predicted" 0 "TrackStatus_Tracked" ;
VAL_ 802 RFSideSensorObj02_ObjClass 15 "ObjClassSideS_NotAvailable" 14 "ObjClassSideS_Error" 13 "ObjClassSideS_Spare4" 12 "ObjClassSideS_Spare3" 11 "ObjClassSideS_Motorcycle" 10 "ObjClassSideS_Bicycle" 9 "ObjClassSideS_UnidentifiedMovableObject" 8 "ObjClassSideS_UnidentifiedVRU" 7 "ObjClassSideS_UnidentifiedVehicle" 6 "ObjClassSideS_StaticObject" 5 "ObjClassSideS_Pedestrian" 4 "ObjClassSideS_2Wheeler" 3 "ObjClassSideS_HeavyVehicle" 2 "ObjClassSideS_Car" 1 "ObjClassSideS_Obstacle" 0 "ObjClassSideS_Undetermined" ;
VAL_ 802 RFSideSensorObj02_ObjDynClass 3 "ObjDynClass_Error" 2 "ObjDynClass_Movable" 1 "ObjDynClass_Stationary" 0 "ObjDynClass_Reserved" ;
VAL_ 802 RFSideSensorObj02_TrackStatus 7 "TrackStatus_NotAvailable" 6 "TrackStatus_Error" 5 "TrackStatus_Spare3" 4 "TrackStatus_Spare2" 3 "TrackStatus_Spare1" 2 "TrackStatus_Invalid" 1 "TrackStatus_Predicted" 0 "TrackStatus_Tracked" ;
VAL_ 802 RFSideSensorObj02_Prioritisation 3 "Prioritisation_NotAvailable" 2 "Prioritisation_StaticPrioritisation" 1 "Prioritisation_VolvoPrioritisation" 0 "Prioritisation_BoschPrioritisation" ;
VAL_ 801 RFSideSensorObj01_Prioritisation 3 "Prioritisation_NotAvailable" 2 "Prioritisation_StaticPrioritisation" 1 "Prioritisation_VolvoPrioritisation" 0 "Prioritisation_BoschPrioritisation" ;
VAL_ 801 RFSideSensorObj01_ObjDynClass 3 "ObjDynClass_Error" 2 "ObjDynClass_Movable" 1 "ObjDynClass_Stationary" 0 "ObjDynClass_Reserved" ;
VAL_ 801 RFSideSensorObj01_TrackStatus 7 "TrackStatus_NotAvailable" 6 "TrackStatus_Error" 5 "TrackStatus_Spare3" 4 "TrackStatus_Spare2" 3 "TrackStatus_Spare1" 2 "TrackStatus_Invalid" 1 "TrackStatus_Predicted" 0 "TrackStatus_Tracked" ;
VAL_ 801 RFSideSensorObj01_ObjClass 15 "ObjClassSideS_NotAvailable" 14 "ObjClassSideS_Error" 13 "ObjClassSideS_Spare4" 12 "ObjClassSideS_Spare3" 11 "ObjClassSideS_Motorcycle" 10 "ObjClassSideS_Bicycle" 9 "ObjClassSideS_UnidentifiedMovableObject" 8 "ObjClassSideS_UnidentifiedVRU" 7 "ObjClassSideS_UnidentifiedVehicle" 6 "ObjClassSideS_StaticObject" 5 "ObjClassSideS_Pedestrian" 4 "ObjClassSideS_2Wheeler" 3 "ObjClassSideS_HeavyVehicle" 2 "ObjClassSideS_Car" 1 "ObjClassSideS_Obstacle" 0 "ObjClassSideS_Undetermined" ;
VAL_ 800 RFSideSensorObj00_ObjClass 15 "ObjClassSideS_NotAvailable" 14 "ObjClassSideS_Error" 13 "ObjClassSideS_Spare4" 12 "ObjClassSideS_Spare3" 11 "ObjClassSideS_Motorcycle" 10 "ObjClassSideS_Bicycle" 9 "ObjClassSideS_UnidentifiedMovableObject" 8 "ObjClassSideS_UnidentifiedVRU" 7 "ObjClassSideS_UnidentifiedVehicle" 6 "ObjClassSideS_StaticObject" 5 "ObjClassSideS_Pedestrian" 4 "ObjClassSideS_2Wheeler" 3 "ObjClassSideS_HeavyVehicle" 2 "ObjClassSideS_Car" 1 "ObjClassSideS_Obstacle" 0 "ObjClassSideS_Undetermined" ;
VAL_ 800 RFSideSensorObj00_ObjDynClass 3 "ObjDynClass_Error" 2 "ObjDynClass_Movable" 1 "ObjDynClass_Stationary" 0 "ObjDynClass_Reserved" ;
VAL_ 800 RFSideSensorObj00_TrackStatus 7 "TrackStatus_NotAvailable" 6 "TrackStatus_Error" 5 "TrackStatus_Spare3" 4 "TrackStatus_Spare2" 3 "TrackStatus_Spare1" 2 "TrackStatus_Invalid" 1 "TrackStatus_Predicted" 0 "TrackStatus_Tracked" ;
VAL_ 800 RFSideSensorObj00_Prioritisation 3 "Prioritisation_NotAvailable" 2 "Prioritisation_StaticPrioritisation" 1 "Prioritisation_VolvoPrioritisation" 0 "Prioritisation_BoschPrioritisation" ;
VAL_ 815 RFSRRaisedEdge_TrackStatus 7 "TrackStatus_NotAvailable" 6 "TrackStatus_Error" 5 "TrackStatus_Spare3" 4 "TrackStatus_Spare2" 3 "TrackStatus_Spare1" 2 "TrackStatus_Invalid" 1 "TrackStatus_Predicted" 0 "TrackStatus_Tracked" ;
VAL_ 815 RFSRRaisedEdge_Type 7 "RaisedEdgeType_NotAvailable" 6 "RaisedEdgeType_Error" 5 "RaisedEdgeType_Spare2" 4 "RaisedEdgeType_Spare1" 3 "RaisedEdgeType_Barrier" 2 "RaisedEdgeType_NonElevatedBoundary" 1 "RaisedEdgeType_ElevatedBoundary" 0 "RaisedEdgeType_Unknown" ;
SIG_GROUP_ 816 RRSideSensorObj00_sg 1 : RRSideSensorObj00_ObjID RRSideSensorObj00_ObstacleConf RRSideSensorObj00_ObjClass RRSideSensorObj00_TrackStatus RRSideSensorObj00_LongPosVar RRSideSensorObj00_LongExtBack RRSideSensorObj00_LatPos RRSideSensorObj00_LongAccVar RRSideSensorObj00_LatExtRight RRSideSensorObj00_LatVelVar RRSideSensorObj00_CRC RRSideSensorObj00_MOISPrio RRSideSensorObj00_ObjClassConf RRSideSensorObj00_LatAcc RRSideSensorObj00_LatExtRtVar RRSideSensorObj00_LongPos RRSideSensorObj00_Height RRSideSensorObj00_TimeStamp RRSideSensorObj00_LongExtFrVar RRSideSensorObj00_CoastIndex RRSideSensorObj00_LatExtLeft RRSideSensorObj00_Counter RRSideSensorObj00_ExistConf RRSideSensorObj00_LatVel RRSideSensorObj00_LongAcc RRSideSensorObj00_HeadingVar RRSideSensorObj00_LatExtLeftVar RRSideSensorObj00_LifeTime RRSideSensorObj00_LatPosVar RRSideSensorObj00_LongExtFront RRSideSensorObj00_Heading RRSideSensorObj00_Prioritisation RRSideSensorObj00_LatAccVar RRSideSensorObj00_LongExtBkVar RRSideSensorObj00_LongVel RRSideSensorObj00_ObjDynClass RRSideSensorObj00_LongVelVar;
SIG_GROUP_ 1555 RRSRSwVersion_sg 1 : RRSRSwVersion_Substring0 RRSRSwVersion_Substring4 RRSRSwVersion_Substring1 RRSRSwVersion_Substring7 RRSRSwVersion_Substring2 RRSRSwVersion_Substring3 RRSRSwVersion_Substring5 RRSRSwVersion_Substring6;
SIG_GROUP_ 831 RRSRRaisedEdge_sg 1 : RRSRRaisedEdge_LifeTime RRSRRaisedEdge_CRC RRSRRaisedEdge_HeadingAngle RRSRRaisedEdge_Type RRSRRaisedEdge_DxStart RRSRRaisedEdge_TimeStamp RRSRRaisedEdge_Confidence RRSRRaisedEdge_DxEnd RRSRRaisedEdge_LatDistVar RRSRRaisedEdge_CoastIndex RRSRRaisedEdge_LatDist RRSRRaisedEdge_Counter RRSRRaisedEdge_CurvatureRate RRSRRaisedEdge_TrackStatus RRSRRaisedEdge_Curvature;
SIG_GROUP_ 830 RRSREgoAssumpt_sg 1 : RRSREgoAssumpt_EgoYawRate RRSREgoAssumpt_EgoRoadEnd RRSREgoAssumpt_EgoRoadHeading RRSREgoAssumpt_EgoRoadCurvRate RRSREgoAssumpt_EgoLongVel RRSREgoAssumpt_VelCorrFactor RRSREgoAssumpt_EgoRoadCurvature RRSREgoAssumpt_EgoLongAcc RRSREgoAssumpt_TimeStamp;
SIG_GROUP_ 812 RFSideSensorTrlrObj_sg 1 : RFSideSensorTrlrObj_TrlrTypeConf RFSideSensorTrlrObj_WheelBased3 RFSideSensorTrlrObj_TrlAnglConf RFSideSensorTrlrObj_Seg5Length RFSideSensorTrlrObj_SegAngle3 RFSideSensorTrlrObj_SegAngle1 RFSideSensorTrlrObj_SegTrlrType3 RFSideSensorTrlrObj_Seg1Length RFSideSensorTrlrObj_WheelBased2 RFSideSensorTrlrObj_SegTrlrType1 RFSideSensorTrlrObj_SegAngle2 RFSideSensorTrlrObj_SegAngle4 RFSideSensorTrlrObj_Seg3Length RFSideSensorTrlrObj_Seg2Length RFSideSensorTrlrObj_WhlBasedConf RFSideSensorTrlrObj_WheelBased1 RFSideSensorTrlrObj_SegTrlrType5 RFSideSensorTrlrObj_Seg4Length RFSideSensorTrlrObj_WheelBased4 RFSideSensorTrlrObj_SegAngle5 RFSideSensorTrlrObj_TotLenConf RFSideSensorTrlrObj_SegTrlrType4 RFSideSensorTrlrObj_WheelBased5 RFSideSensorTrlrObj_SegTrlrType2 RFSideSensorTrlrObj_TotalLength;
SIG_GROUP_ 811 RFSideSensorObj11_sg 1 : RFSideSensorObj11_HeadingVar RFSideSensorObj11_LatPosVar RFSideSensorObj11_MOISPrio RFSideSensorObj11_CRC RFSideSensorObj11_LatVel RFSideSensorObj11_LatAcc RFSideSensorObj11_LatExtRtVar RFSideSensorObj11_LatExtLeftVar RFSideSensorObj11_LongPosVar RFSideSensorObj11_ObjClassConf RFSideSensorObj11_ObstacleConf RFSideSensorObj11_LongVelVar RFSideSensorObj11_LongAcc RFSideSensorObj11_ObjID RFSideSensorObj11_LifeTime RFSideSensorObj11_Counter RFSideSensorObj11_LongExtFront RFSideSensorObj11_ObjDynClass RFSideSensorObj11_LongPos RFSideSensorObj11_LongExtFrVar RFSideSensorObj11_LongExtBack RFSideSensorObj11_LongExtBkVar RFSideSensorObj11_Prioritisation RFSideSensorObj11_LatExtRight RFSideSensorObj11_LatAccVar RFSideSensorObj11_ExistConf RFSideSensorObj11_Heading RFSideSensorObj11_LongAccVar RFSideSensorObj11_TrackStatus RFSideSensorObj11_LatPos RFSideSensorObj11_TimeStamp RFSideSensorObj11_LatVelVar RFSideSensorObj11_LatExtLeft RFSideSensorObj11_LongVel RFSideSensorObj11_CoastIndex RFSideSensorObj11_ObjClass RFSideSensorObj11_Height;
SIG_GROUP_ 810 RFSideSensorObj10_sg 1 : RFSideSensorObj10_Prioritisation RFSideSensorObj10_LatAcc RFSideSensorObj10_LatPosVar RFSideSensorObj10_LatExtLeftVar RFSideSensorObj10_ObjDynClass RFSideSensorObj10_CoastIndex RFSideSensorObj10_LongExtFront RFSideSensorObj10_LatExtLeft RFSideSensorObj10_ExistConf RFSideSensorObj10_ObjClass RFSideSensorObj10_LongExtBack RFSideSensorObj10_HeadingVar RFSideSensorObj10_LatExtRight RFSideSensorObj10_LatVelVar RFSideSensorObj10_LongVelVar RFSideSensorObj10_TrackStatus RFSideSensorObj10_LongPosVar RFSideSensorObj10_LatVel RFSideSensorObj10_MOISPrio RFSideSensorObj10_Height RFSideSensorObj10_LongAccVar RFSideSensorObj10_LifeTime RFSideSensorObj10_ObjID RFSideSensorObj10_LatExtRtVar RFSideSensorObj10_TimeStamp RFSideSensorObj10_LongVel RFSideSensorObj10_Heading RFSideSensorObj10_LongPos RFSideSensorObj10_LongExtFrVar RFSideSensorObj10_LatAccVar RFSideSensorObj10_ObjClassConf RFSideSensorObj10_ObstacleConf RFSideSensorObj10_LongAcc RFSideSensorObj10_LongExtBkVar RFSideSensorObj10_LatPos RFSideSensorObj10_CRC RFSideSensorObj10_Counter;
SIG_GROUP_ 809 RFSideSensorObj09_sg 1 : RFSideSensorObj09_LongPos RFSideSensorObj09_ObjClass RFSideSensorObj09_LongVelVar RFSideSensorObj09_LongPosVar RFSideSensorObj09_LatPosVar RFSideSensorObj09_Prioritisation RFSideSensorObj09_LifeTime RFSideSensorObj09_MOISPrio RFSideSensorObj09_CoastIndex RFSideSensorObj09_LatVel RFSideSensorObj09_LongExtBack RFSideSensorObj09_LatExtLeft RFSideSensorObj09_LatVelVar RFSideSensorObj09_LongVel RFSideSensorObj09_LatExtRtVar RFSideSensorObj09_LatPos RFSideSensorObj09_LatExtLeftVar RFSideSensorObj09_LongAccVar RFSideSensorObj09_ObjID RFSideSensorObj09_LongExtFrVar RFSideSensorObj09_LongExtBkVar RFSideSensorObj09_CRC RFSideSensorObj09_LongExtFront RFSideSensorObj09_LatExtRight RFSideSensorObj09_LatAccVar RFSideSensorObj09_LongAcc RFSideSensorObj09_LatAcc RFSideSensorObj09_ObjClassConf RFSideSensorObj09_TrackStatus RFSideSensorObj09_HeadingVar RFSideSensorObj09_Height RFSideSensorObj09_ObstacleConf RFSideSensorObj09_Counter RFSideSensorObj09_TimeStamp RFSideSensorObj09_Heading RFSideSensorObj09_ExistConf RFSideSensorObj09_ObjDynClass;
SIG_GROUP_ 808 RFSideSensorObj08_sg 1 : RFSideSensorObj08_LongExtBack RFSideSensorObj08_LongPos RFSideSensorObj08_LifeTime RFSideSensorObj08_CRC RFSideSensorObj08_LongExtBkVar RFSideSensorObj08_Prioritisation RFSideSensorObj08_LatVel RFSideSensorObj08_ObjClass RFSideSensorObj08_TrackStatus RFSideSensorObj08_MOISPrio RFSideSensorObj08_LatExtLeftVar RFSideSensorObj08_ObstacleConf RFSideSensorObj08_LongExtFrVar RFSideSensorObj08_LongAccVar RFSideSensorObj08_TimeStamp RFSideSensorObj08_LatPos RFSideSensorObj08_LatPosVar RFSideSensorObj08_ObjDynClass RFSideSensorObj08_LongVelVar RFSideSensorObj08_LatAcc RFSideSensorObj08_LatVelVar RFSideSensorObj08_ObjID RFSideSensorObj08_Height RFSideSensorObj08_CoastIndex RFSideSensorObj08_LatExtRtVar RFSideSensorObj08_LongExtFront RFSideSensorObj08_LongPosVar RFSideSensorObj08_ObjClassConf RFSideSensorObj08_HeadingVar RFSideSensorObj08_LatExtLeft RFSideSensorObj08_Heading RFSideSensorObj08_LatExtRight RFSideSensorObj08_LongAcc RFSideSensorObj08_LatAccVar RFSideSensorObj08_Counter RFSideSensorObj08_ExistConf RFSideSensorObj08_LongVel;
SIG_GROUP_ 807 RFSideSensorObj07_sg 1 : RFSideSensorObj07_LatVel RFSideSensorObj07_LatPosVar RFSideSensorObj07_ExistConf RFSideSensorObj07_MOISPrio RFSideSensorObj07_LatAcc RFSideSensorObj07_LongExtBack RFSideSensorObj07_LatExtLeft RFSideSensorObj07_Heading RFSideSensorObj07_LongExtFrVar RFSideSensorObj07_LongAcc RFSideSensorObj07_Prioritisation RFSideSensorObj07_CoastIndex RFSideSensorObj07_LatAccVar RFSideSensorObj07_LatPos RFSideSensorObj07_Counter RFSideSensorObj07_LifeTime RFSideSensorObj07_ObjDynClass RFSideSensorObj07_CRC RFSideSensorObj07_LatExtRtVar RFSideSensorObj07_ObjID RFSideSensorObj07_ObjClassConf RFSideSensorObj07_LatExtRight RFSideSensorObj07_LatVelVar RFSideSensorObj07_LongAccVar RFSideSensorObj07_ObjClass RFSideSensorObj07_LongExtBkVar RFSideSensorObj07_TimeStamp RFSideSensorObj07_TrackStatus RFSideSensorObj07_Height RFSideSensorObj07_LongPosVar RFSideSensorObj07_LongVel RFSideSensorObj07_ObstacleConf RFSideSensorObj07_LongExtFront RFSideSensorObj07_LongVelVar RFSideSensorObj07_LongPos RFSideSensorObj07_HeadingVar RFSideSensorObj07_LatExtLeftVar;
SIG_GROUP_ 806 RFSideSensorObj06_sg 1 : RFSideSensorObj06_Prioritisation RFSideSensorObj06_LongExtFront RFSideSensorObj06_MOISPrio RFSideSensorObj06_LatPosVar RFSideSensorObj06_ObjID RFSideSensorObj06_LongExtBack RFSideSensorObj06_ExistConf RFSideSensorObj06_LatPos RFSideSensorObj06_ObjClassConf RFSideSensorObj06_LongExtBkVar RFSideSensorObj06_LongAccVar RFSideSensorObj06_LongAcc RFSideSensorObj06_TrackStatus RFSideSensorObj06_LatAccVar RFSideSensorObj06_ObjDynClass RFSideSensorObj06_CoastIndex RFSideSensorObj06_LongPosVar RFSideSensorObj06_HeadingVar RFSideSensorObj06_CRC RFSideSensorObj06_LongVel RFSideSensorObj06_ObstacleConf RFSideSensorObj06_LatExtLeftVar RFSideSensorObj06_TimeStamp RFSideSensorObj06_ObjClass RFSideSensorObj06_LatVelVar RFSideSensorObj06_LifeTime RFSideSensorObj06_LatExtRtVar RFSideSensorObj06_LatAcc RFSideSensorObj06_LongExtFrVar RFSideSensorObj06_Height RFSideSensorObj06_LongVelVar RFSideSensorObj06_LongPos RFSideSensorObj06_LatExtRight RFSideSensorObj06_Heading RFSideSensorObj06_LatVel RFSideSensorObj06_LatExtLeft RFSideSensorObj06_Counter;
SIG_GROUP_ 805 RFSideSensorObj05_sg 1 : RFSideSensorObj05_LongAcc RFSideSensorObj05_LatPosVar RFSideSensorObj05_LatPos RFSideSensorObj05_CRC RFSideSensorObj05_LongExtBack RFSideSensorObj05_Prioritisation RFSideSensorObj05_LatExtRtVar RFSideSensorObj05_LongExtFront RFSideSensorObj05_TrackStatus RFSideSensorObj05_ObjDynClass RFSideSensorObj05_HeadingVar RFSideSensorObj05_LatAccVar RFSideSensorObj05_LongExtFrVar RFSideSensorObj05_ExistConf RFSideSensorObj05_ObjClass RFSideSensorObj05_LongPos RFSideSensorObj05_LatVelVar RFSideSensorObj05_MOISPrio RFSideSensorObj05_LatExtLeftVar RFSideSensorObj05_LongAccVar RFSideSensorObj05_TimeStamp RFSideSensorObj05_LatExtRight RFSideSensorObj05_LifeTime RFSideSensorObj05_LongPosVar RFSideSensorObj05_ObstacleConf RFSideSensorObj05_Counter RFSideSensorObj05_LongVelVar RFSideSensorObj05_Height RFSideSensorObj05_LatExtLeft RFSideSensorObj05_LongExtBkVar RFSideSensorObj05_ObjClassConf RFSideSensorObj05_LatVel RFSideSensorObj05_CoastIndex RFSideSensorObj05_ObjID RFSideSensorObj05_LatAcc RFSideSensorObj05_LongVel RFSideSensorObj05_Heading;
SIG_GROUP_ 804 RFSideSensorObj04_sg 1 : RFSideSensorObj04_LongExtFrVar RFSideSensorObj04_TrackStatus RFSideSensorObj04_HeadingVar RFSideSensorObj04_LifeTime RFSideSensorObj04_ObjClassConf RFSideSensorObj04_LatExtLeftVar RFSideSensorObj04_CoastIndex RFSideSensorObj04_Heading RFSideSensorObj04_Height RFSideSensorObj04_LongPosVar RFSideSensorObj04_TimeStamp RFSideSensorObj04_LatExtRight RFSideSensorObj04_LatExtLeft RFSideSensorObj04_LatPosVar RFSideSensorObj04_CRC RFSideSensorObj04_LatAccVar RFSideSensorObj04_Counter RFSideSensorObj04_LongExtFront RFSideSensorObj04_LatPos RFSideSensorObj04_ObstacleConf RFSideSensorObj04_LatVel RFSideSensorObj04_LongVelVar RFSideSensorObj04_LongExtBkVar RFSideSensorObj04_LatVelVar RFSideSensorObj04_LongPos RFSideSensorObj04_ObjDynClass RFSideSensorObj04_Prioritisation RFSideSensorObj04_ObjID RFSideSensorObj04_LongAcc RFSideSensorObj04_ObjClass RFSideSensorObj04_ExistConf RFSideSensorObj04_LongAccVar RFSideSensorObj04_LatExtRtVar RFSideSensorObj04_LatAcc RFSideSensorObj04_MOISPrio RFSideSensorObj04_LongExtBack RFSideSensorObj04_LongVel;
SIG_GROUP_ 803 RFSideSensorObj03_sg 1 : RFSideSensorObj03_LongAcc RFSideSensorObj03_LongAccVar RFSideSensorObj03_LongExtBack RFSideSensorObj03_HeadingVar RFSideSensorObj03_LifeTime RFSideSensorObj03_Prioritisation RFSideSensorObj03_LongVel RFSideSensorObj03_TimeStamp RFSideSensorObj03_ObstacleConf RFSideSensorObj03_LatExtRtVar RFSideSensorObj03_ObjClassConf RFSideSensorObj03_Height RFSideSensorObj03_ExistConf RFSideSensorObj03_LongVelVar RFSideSensorObj03_LatAccVar RFSideSensorObj03_LatVelVar RFSideSensorObj03_LatVel RFSideSensorObj03_LongPosVar RFSideSensorObj03_LatExtLeftVar RFSideSensorObj03_LongExtFront RFSideSensorObj03_Counter RFSideSensorObj03_LatExtLeft RFSideSensorObj03_CRC RFSideSensorObj03_ObjDynClass RFSideSensorObj03_ObjClass RFSideSensorObj03_LongExtBkVar RFSideSensorObj03_LatExtRight RFSideSensorObj03_LatPos RFSideSensorObj03_MOISPrio RFSideSensorObj03_CoastIndex RFSideSensorObj03_LongPos RFSideSensorObj03_ObjID RFSideSensorObj03_LatAcc RFSideSensorObj03_TrackStatus RFSideSensorObj03_LatPosVar RFSideSensorObj03_LongExtFrVar RFSideSensorObj03_Heading;
SIG_GROUP_ 802 RFSideSensorObj02_sg 1 : RFSideSensorObj02_Heading RFSideSensorObj02_LongExtBkVar RFSideSensorObj02_LatExtRight RFSideSensorObj02_Counter RFSideSensorObj02_ObstacleConf RFSideSensorObj02_ExistConf RFSideSensorObj02_Height RFSideSensorObj02_LatAccVar RFSideSensorObj02_ObjClass RFSideSensorObj02_CRC RFSideSensorObj02_LongAcc RFSideSensorObj02_LatVel RFSideSensorObj02_LatPosVar RFSideSensorObj02_CoastIndex RFSideSensorObj02_LongPosVar RFSideSensorObj02_LatAcc RFSideSensorObj02_ObjClassConf RFSideSensorObj02_ObjDynClass RFSideSensorObj02_LongExtBack RFSideSensorObj02_LatExtLeftVar RFSideSensorObj02_LifeTime RFSideSensorObj02_LongVel RFSideSensorObj02_LongAccVar RFSideSensorObj02_LongExtFront RFSideSensorObj02_TrackStatus RFSideSensorObj02_ObjID RFSideSensorObj02_TimeStamp RFSideSensorObj02_LatPos RFSideSensorObj02_LatVelVar RFSideSensorObj02_HeadingVar RFSideSensorObj02_Prioritisation RFSideSensorObj02_MOISPrio RFSideSensorObj02_LatExtLeft RFSideSensorObj02_LongPos RFSideSensorObj02_LongExtFrVar RFSideSensorObj02_LongVelVar RFSideSensorObj02_LatExtRtVar;
SIG_GROUP_ 801 RFSideSensorObj01_sg 1 : RFSideSensorObj01_LatVel RFSideSensorObj01_LatAccVar RFSideSensorObj01_ObjClassConf RFSideSensorObj01_CoastIndex RFSideSensorObj01_LatExtLeft RFSideSensorObj01_ExistConf RFSideSensorObj01_LongVel RFSideSensorObj01_LongExtFront RFSideSensorObj01_LongPosVar RFSideSensorObj01_Heading RFSideSensorObj01_MOISPrio RFSideSensorObj01_LongVelVar RFSideSensorObj01_LatPos RFSideSensorObj01_LatExtLeftVar RFSideSensorObj01_LongExtBkVar RFSideSensorObj01_LatExtRight RFSideSensorObj01_LongAccVar RFSideSensorObj01_LatExtRtVar RFSideSensorObj01_LongAcc RFSideSensorObj01_TimeStamp RFSideSensorObj01_Prioritisation RFSideSensorObj01_LongExtBack RFSideSensorObj01_LatVelVar RFSideSensorObj01_Counter RFSideSensorObj01_Height RFSideSensorObj01_LatPosVar RFSideSensorObj01_ObjDynClass RFSideSensorObj01_CRC RFSideSensorObj01_LifeTime RFSideSensorObj01_LongExtFrVar RFSideSensorObj01_ObjID RFSideSensorObj01_LatAcc RFSideSensorObj01_TrackStatus RFSideSensorObj01_LongPos RFSideSensorObj01_HeadingVar RFSideSensorObj01_ObstacleConf RFSideSensorObj01_ObjClass;
SIG_GROUP_ 800 RFSideSensorObj00_sg 1 : RFSideSensorObj00_LongPos RFSideSensorObj00_LongExtFrVar RFSideSensorObj00_LatAccVar RFSideSensorObj00_MOISPrio RFSideSensorObj00_LongAcc RFSideSensorObj00_ObstacleConf RFSideSensorObj00_ObjClass RFSideSensorObj00_LatExtLeft RFSideSensorObj00_ObjDynClass RFSideSensorObj00_LatPosVar RFSideSensorObj00_ObjID RFSideSensorObj00_TimeStamp RFSideSensorObj00_LatVel RFSideSensorObj00_LongVelVar RFSideSensorObj00_LatExtRtVar RFSideSensorObj00_TrackStatus RFSideSensorObj00_LongPosVar RFSideSensorObj00_LatExtLeftVar RFSideSensorObj00_HeadingVar RFSideSensorObj00_LongExtBkVar RFSideSensorObj00_LatVelVar RFSideSensorObj00_LongAccVar RFSideSensorObj00_Heading RFSideSensorObj00_Height RFSideSensorObj00_LongExtBack RFSideSensorObj00_ObjClassConf RFSideSensorObj00_LongVel RFSideSensorObj00_LatPos RFSideSensorObj00_CRC RFSideSensorObj00_LongExtFront RFSideSensorObj00_LatAcc RFSideSensorObj00_Counter RFSideSensorObj00_Prioritisation RFSideSensorObj00_LifeTime RFSideSensorObj00_ExistConf RFSideSensorObj00_LatExtRight RFSideSensorObj00_CoastIndex;
SIG_GROUP_ 1554 RFSRSwVersion_sg 1 : RFSRSwVersion_Substring0 RFSRSwVersion_Substring7 RFSRSwVersion_Substring5 RFSRSwVersion_Substring2 RFSRSwVersion_Substring6 RFSRSwVersion_Substring3 RFSRSwVersion_Substring4 RFSRSwVersion_Substring1;
SIG_GROUP_ 815 RFSRRaisedEdge_sg 1 : RFSRRaisedEdge_LatDist RFSRRaisedEdge_CoastIndex RFSRRaisedEdge_LatDistVar RFSRRaisedEdge_HeadingAngle RFSRRaisedEdge_TrackStatus RFSRRaisedEdge_CurvatureRate RFSRRaisedEdge_CRC RFSRRaisedEdge_DxStart RFSRRaisedEdge_DxEnd RFSRRaisedEdge_TimeStamp RFSRRaisedEdge_Confidence RFSRRaisedEdge_Counter RFSRRaisedEdge_Curvature RFSRRaisedEdge_Type RFSRRaisedEdge_LifeTime;
SIG_GROUP_ 814 RFSREgoAssumpt_sg 1 : RFSREgoAssumpt_EgoYawRate RFSREgoAssumpt_EgoRoadHeading RFSREgoAssumpt_TimeStamp RFSREgoAssumpt_EgoRoadCurvRate RFSREgoAssumpt_EgoLongAcc RFSREgoAssumpt_VelCorrFactor RFSREgoAssumpt_EgoLongVel RFSREgoAssumpt_EgoRoadCurvature RFSREgoAssumpt_EgoRoadEnd;
