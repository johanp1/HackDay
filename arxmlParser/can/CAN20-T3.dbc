VERSION ""

NS_ :

BS_:

BU_: HUA FLR2 DACU

BO_ 2671902706 TesterFuncDiagMsg_Vic1: 8 DACU
 SG_ FuncDiagDataTester : 0|64@1+ (1,0) [0|0] ""  FLR2

BO_ 2671833682 PhysDiagRespMsg_F2_52_Vic1: 8 FLR2
 SG_ PhysDiagRespSig_F2_52 : 0|64@1+ (1,0) [0|0] ""  VCM

BO_ 2671792882 PhysDiagReqMsg_52_F2_Vic1: 8 DACU
 SG_ PhysDiagReqSig_52_F2 : 0|64@1+ (1,0) [0|0] ""  FLR2

BO_ 2671902708 IntTesterTGW2FuncDiagMsg_Vic1: 8 DACU
 SG_ FuncDiagDataIntTesterTGW2 : 0|64@1+ (1,0) [0|0] ""  FLR2

BO_ 1507 HUA_01P_Vic1: 12 HUA
 SG_ HUA_SN_Byte2 : 24|8@1+ (1,0) [0|0] ""  VCM
 SG_ HUA_SNPN_Byte3 : 64|8@1+ (1,0) [0|0] ""  VCM
 SG_ DiagInfoHUA : 0|7@1+ (1,0) [0|127] "NotApplicable"  VCM
 SG_ HUA_SNPN_Byte2 : 56|8@1+ (1,0) [0|0] ""  VCM
 SG_ HUA_SN_Byte0 : 8|8@1+ (1,0) [0|0] ""  VCM
 SG_ HUA_SN_Byte3 : 32|8@1+ (1,0) [0|0] ""  VCM
 SG_ HUA_SNPN_Byte1 : 48|8@1+ (1,0) [0|0] ""  VCM
 SG_ HUA_SN_Byte1 : 16|8@1+ (1,0) [0|0] ""  VCM
 SG_ HUA_SNPN_Byte0 : 40|8@1+ (1,0) [0|0] ""  VCM
 SG_ HUA_SNPN_Byte4 : 72|8@1+ (1,0) [0|0] ""  VCM

BO_ 1553 FLR_SwVersion_Vic1: 64 FLR2
 SG_ FLRSwVersion_Substring1 : 64|64@1+ (1,0) [0|0] ""  VCM
 SG_ FLRSwVersion_Substring3 : 192|64@1+ (1,0) [0|0] ""  VCM
 SG_ FLRSwVersion_Substring5 : 320|64@1+ (1,0) [0|0] ""  VCM
 SG_ FLRSwVersion_Substring2 : 128|64@1+ (1,0) [0|0] ""  VCM
 SG_ FLRSwVersion_Substring6 : 384|64@1+ (1,0) [0|0] ""  VCM
 SG_ FLRSwVersion_Substring7 : 448|64@1+ (1,0) [0|0] ""  VCM
 SG_ FLRSwVersion_Substring4 : 256|64@1+ (1,0) [0|0] ""  VCM
 SG_ FLRSwVersion_Substring0 : 0|64@1+ (1,0) [0|0] ""  VCM

BO_ 859 FLR_RightRoadBoundary_Vic1: 20 FLR2
 SG_ RightRoadBoundary_Curvature : 96|18@1+ (1E-006,-0.1310705) [-0.1310705|0.1310725] "per_meter"  VCM
 SG_ RightRoadBoundary_LatDistVar : 48|8@1+ (0.001,0) [0|0.255] "NotApplicable"  VCM
 SG_ RightRoadBoundary_Type : 133|3@1+ (1,0) [0|0] ""  VCM
 SG_ RightRoadBoundary_CRC : 0|16@1+ (1,0) [0|65535] "NotApplicable"  VCM
 SG_ RightRoadBoundary_LifeTime : 136|16@1+ (0.1,0) [0|6553.5] "s"  VCM
 SG_ RightRoadBoundary_TrackStatus : 93|3@1+ (1,0) [0|0] ""  VCM
 SG_ RightRoadBoundary_HeadingAngle : 80|13@1+ (0.0005,-1.57) [-1.57|2.5255] "rad"  VCM
 SG_ RightRoadBoundary_Counter : 16|8@1+ (1,0) [0|255] "Count"  VCM
 SG_ RightRoadBoundary_LatDist : 114|12@1+ (0.005,-10) [-10|10.475] "m"  VCM
 SG_ RightRoadBoundary_TimeStamp : 24|16@1+ (0.1,0) [0|6553.5] "ms"  VCM
 SG_ RightRoadBoundary_CoastIndex : 75|5@1+ (1,0) [0|31] "NotApplicable"  VCM
 SG_ RightRoadBoundary_Confidence : 126|7@1+ (0.01,0) [0|1.27] "NotApplicable"  VCM
 SG_ RightRoadBoundary_CurvatureRate : 64|11@1+ (5.1E-007,-0.000516) [-0.000516|0.00052797] "per_meter_squared"  VCM
 SG_ RightRoadBoundary_DxStart : 40|8@1+ (1,0) [0|255] "m"  VCM
 SG_ RightRoadBoundary_DxEnd : 56|8@1+ (1,0) [0|255] "m"  VCM

BO_ 806 FLR_Obj23_Vic1: 48 FLR2
 SG_ FLRObj23_ObjClassConf : 177|7@1+ (0.01,0) [0|1.27] "NotApplicable"  VCM
 SG_ FLRObj23_LongPosVar : 112|8@1+ (0.01,0) [0|2.55] "NotApplicable"  VCM
 SG_ FLRObj23_LongAccVar : 88|8@1+ (0.01,0) [0|2.55] "NotApplicable"  VCM
 SG_ FLRObj23_TrackStatus : 141|3@1+ (1,0) [0|0] ""  VCM
 SG_ FLRObj23_ObjID : 234|6@1+ (1,0) [0|63] "NotApplicable"  VCM
 SG_ FLRObj23_ObjDynClassRestricted : 306|2@1+ (1,0) [0|0] ""  VCM
 SG_ FLRObj23_LatExtRtVar : 64|8@1+ (0.01,0) [0|2.55] "NotApplicable"  VCM
 SG_ FLRObj23_ExistConf : 290|7@1+ (0.01,0) [0|1.27] "NotApplicable"  VCM
 SG_ FLRObj23_HeadingVar : 40|8@1+ (0.001,0) [0|0.255] "NotApplicable"  VCM
 SG_ FLRObj23_LongExtFront : 224|10@1+ (0.05,0) [0|51.15] "m"  VCM
 SG_ FLRObj23_Counter : 16|8@1+ (1,0) [0|255] "Count"  VCM
 SG_ FLRObj23_LatExtLeft : 266|7@1+ (0.05,0) [0|6.35] "m"  VCM
 SG_ FLRObj23_ObstacleConfRestricted : 308|7@1+ (0.01,0) [0|1.27] "NotApplicable"  VCM
 SG_ FLRObj23_LatExtRight : 193|7@1+ (0.05,-5) [-5|1.35] "m"  VCM
 SG_ FLRObj23_LatVelVar : 80|8@1+ (0.1,0) [0|25.5] "NotApplicable"  VCM
 SG_ FLRObj23_LongExtBack : 280|10@1+ (0.05,-50) [-50|1.15000000000001] "m"  VCM
 SG_ FLRObj23_LongVel : 240|13@1+ (0.032,-80) [-80|182.112] "m_per_s"  VCM
 SG_ FLRObj23_LatPosVar : 72|8@1+ (0.01,0) [0|2.55] "NotApplicable"  VCM
 SG_ FLRObj23_LatAcc : 168|9@1+ (0.08,-20) [-20|20.88] "m_per_s_squared"  VCM
 SG_ FLRObj23_ObstacleConf : 297|7@1+ (0.01,0) [0|1.27] "NotApplicable"  VCM
 SG_ FLRObj23_LatPos : 128|13@1+ (0.05,-180) [-180|229.55] "m"  VCM
 SG_ FLRObj23_LatVel : 144|13@1+ (0.032,-80) [-80|182.112] "m_per_s"  VCM
 SG_ FLRObj23_TimeStamp : 200|16@1+ (0.1,0) [0|6553.5] "ms"  VCM
 SG_ FLRObj23_Heading : 157|11@1+ (0.005818,-4.71) [-4.71|7.199446] "rad"  VCM
 SG_ FLRObj23_CRC : 0|16@1+ (1,0) [0|65535] "NotApplicable"  VCM
 SG_ FLRObj23_ObjDynClass : 278|2@1+ (1,0) [0|0] ""  VCM
 SG_ FLRObj23_Height : 220|4@1+ (0.5,0) [0|7.5] "m"  VCM
 SG_ FLRObj23_LongExtBkVar : 96|8@1+ (0.01,0) [0|2.55] "NotApplicable"  VCM
 SG_ FLRObj23_CoastIndex : 273|5@1+ (1,0) [0|31] "NotApplicable"  VCM
 SG_ FLRObj23_LifeTime : 24|16@1+ (0.1,0) [0|6553.5] "s"  VCM
 SG_ FLRObj23_LongPos : 253|13@1+ (0.05,-180) [-180|229.55] "m"  VCM
 SG_ FLRObj23_LongVelVar : 120|8@1+ (0.01,0) [0|2.55] "NotApplicable"  VCM
 SG_ FLRObj23_LatAccVar : 48|8@1+ (0.1,0) [0|25.5] "NotApplicable"  VCM
 SG_ FLRObj23_LongExtFrVar : 104|8@1+ (0.01,0) [0|2.55] "NotApplicable"  VCM
 SG_ FLRObj23_AsilLvl : 304|2@1+ (1,0) [0|0] ""  VCM
 SG_ FLRObj23_LongAcc : 184|9@1+ (0.08,-20) [-20|20.88] "m_per_s_squared"  VCM
 SG_ FLRObj23_LatExtLeftVar : 56|8@1+ (0.01,0) [0|2.55] "NotApplicable"  VCM
 SG_ FLRObj23_ObjClass : 216|4@1+ (1,0) [0|0] ""  VCM

BO_ 805 FLR_Obj22_Vic1: 48 FLR2
 SG_ FLRObj22_TimeStamp : 200|16@1+ (0.1,0) [0|6553.5] "ms"  VCM
 SG_ FLRObj22_LatAcc : 168|9@1+ (0.08,-20) [-20|20.88] "m_per_s_squared"  VCM
 SG_ FLRObj22_LatAccVar : 48|8@1+ (0.1,0) [0|25.5] "NotApplicable"  VCM
 SG_ FLRObj22_LongPosVar : 112|8@1+ (0.01,0) [0|2.55] "NotApplicable"  VCM
 SG_ FLRObj22_ExistConf : 290|7@1+ (0.01,0) [0|1.27] "NotApplicable"  VCM
 SG_ FLRObj22_LongVel : 240|13@1+ (0.032,-80) [-80|182.112] "m_per_s"  VCM
 SG_ FLRObj22_ObjID : 234|6@1+ (1,0) [0|63] "NotApplicable"  VCM
 SG_ FLRObj22_Counter : 16|8@1+ (1,0) [0|255] "Count"  VCM
 SG_ FLRObj22_LongVelVar : 120|8@1+ (0.01,0) [0|2.55] "NotApplicable"  VCM
 SG_ FLRObj22_LongAccVar : 88|8@1+ (0.01,0) [0|2.55] "NotApplicable"  VCM
 SG_ FLRObj22_LongExtBkVar : 96|8@1+ (0.01,0) [0|2.55] "NotApplicable"  VCM
 SG_ FLRObj22_LatVelVar : 80|8@1+ (0.1,0) [0|25.5] "NotApplicable"  VCM
 SG_ FLRObj22_LatExtRtVar : 64|8@1+ (0.01,0) [0|2.55] "NotApplicable"  VCM
 SG_ FLRObj22_ObjDynClassRestricted : 306|2@1+ (1,0) [0|0] ""  VCM
 SG_ FLRObj22_LongAcc : 184|9@1+ (0.08,-20) [-20|20.88] "m_per_s_squared"  VCM
 SG_ FLRObj22_AsilLvl : 304|2@1+ (1,0) [0|0] ""  VCM
 SG_ FLRObj22_LongExtFront : 224|10@1+ (0.05,0) [0|51.15] "m"  VCM
 SG_ FLRObj22_HeadingVar : 40|8@1+ (0.001,0) [0|0.255] "NotApplicable"  VCM
 SG_ FLRObj22_CRC : 0|16@1+ (1,0) [0|65535] "NotApplicable"  VCM
 SG_ FLRObj22_LatVel : 144|13@1+ (0.032,-80) [-80|182.112] "m_per_s"  VCM
 SG_ FLRObj22_CoastIndex : 273|5@1+ (1,0) [0|31] "NotApplicable"  VCM
 SG_ FLRObj22_Heading : 157|11@1+ (0.005818,-4.71) [-4.71|7.199446] "rad"  VCM
 SG_ FLRObj22_LifeTime : 24|16@1+ (0.1,0) [0|6553.5] "s"  VCM
 SG_ FLRObj22_LatPosVar : 72|8@1+ (0.01,0) [0|2.55] "NotApplicable"  VCM
 SG_ FLRObj22_ObstacleConfRestricted : 308|7@1+ (0.01,0) [0|1.27] "NotApplicable"  VCM
 SG_ FLRObj22_LatPos : 128|13@1+ (0.05,-180) [-180|229.55] "m"  VCM
 SG_ FLRObj22_Height : 220|4@1+ (0.5,0) [0|7.5] "m"  VCM
 SG_ FLRObj22_LongPos : 253|13@1+ (0.05,-180) [-180|229.55] "m"  VCM
 SG_ FLRObj22_ObjClassConf : 177|7@1+ (0.01,0) [0|1.27] "NotApplicable"  VCM
 SG_ FLRObj22_TrackStatus : 141|3@1+ (1,0) [0|0] ""  VCM
 SG_ FLRObj22_ObjClass : 216|4@1+ (1,0) [0|0] ""  VCM
 SG_ FLRObj22_LongExtFrVar : 104|8@1+ (0.01,0) [0|2.55] "NotApplicable"  VCM
 SG_ FLRObj22_LongExtBack : 280|10@1+ (0.05,-50) [-50|1.15000000000001] "m"  VCM
 SG_ FLRObj22_ObstacleConf : 297|7@1+ (0.01,0) [0|1.27] "NotApplicable"  VCM
 SG_ FLRObj22_LatExtLeftVar : 56|8@1+ (0.01,0) [0|2.55] "NotApplicable"  VCM
 SG_ FLRObj22_LatExtLeft : 266|7@1+ (0.05,0) [0|6.35] "m"  VCM
 SG_ FLRObj22_LatExtRight : 193|7@1+ (0.05,-5) [-5|1.35] "m"  VCM
 SG_ FLRObj22_ObjDynClass : 278|2@1+ (1,0) [0|0] ""  VCM

BO_ 804 FLR_Obj21_Vic1: 48 FLR2
 SG_ FLRObj21_LatAccVar : 48|8@1+ (0.1,0) [0|25.5] "NotApplicable"  VCM
 SG_ FLRObj21_TrackStatus : 141|3@1+ (1,0) [0|0] ""  VCM
 SG_ FLRObj21_LongPos : 253|13@1+ (0.05,-180) [-180|229.55] "m"  VCM
 SG_ FLRObj21_LongAcc : 184|9@1+ (0.08,-20) [-20|20.88] "m_per_s_squared"  VCM
 SG_ FLRObj21_Height : 220|4@1+ (0.5,0) [0|7.5] "m"  VCM
 SG_ FLRObj21_LatVel : 144|13@1+ (0.032,-80) [-80|182.112] "m_per_s"  VCM
 SG_ FLRObj21_LatPos : 128|13@1+ (0.05,-180) [-180|229.55] "m"  VCM
 SG_ FLRObj21_LatExtRtVar : 64|8@1+ (0.01,0) [0|2.55] "NotApplicable"  VCM
 SG_ FLRObj21_ObstacleConfRestricted : 308|7@1+ (0.01,0) [0|1.27] "NotApplicable"  VCM
 SG_ FLRObj21_ObstacleConf : 297|7@1+ (0.01,0) [0|1.27] "NotApplicable"  VCM
 SG_ FLRObj21_LongExtBack : 280|10@1+ (0.05,-50) [-50|1.15000000000001] "m"  VCM
 SG_ FLRObj21_LongAccVar : 88|8@1+ (0.01,0) [0|2.55] "NotApplicable"  VCM
 SG_ FLRObj21_ObjClass : 216|4@1+ (1,0) [0|0] ""  VCM
 SG_ FLRObj21_ObjClassConf : 177|7@1+ (0.01,0) [0|1.27] "NotApplicable"  VCM
 SG_ FLRObj21_LongExtBkVar : 96|8@1+ (0.01,0) [0|2.55] "NotApplicable"  VCM
 SG_ FLRObj21_LatPosVar : 72|8@1+ (0.01,0) [0|2.55] "NotApplicable"  VCM
 SG_ FLRObj21_LongVelVar : 120|8@1+ (0.01,0) [0|2.55] "NotApplicable"  VCM
 SG_ FLRObj21_LongPosVar : 112|8@1+ (0.01,0) [0|2.55] "NotApplicable"  VCM
 SG_ FLRObj21_LatExtRight : 193|7@1+ (0.05,-5) [-5|1.35] "m"  VCM
 SG_ FLRObj21_ObjID : 234|6@1+ (1,0) [0|63] "NotApplicable"  VCM
 SG_ FLRObj21_CoastIndex : 273|5@1+ (1,0) [0|31] "NotApplicable"  VCM
 SG_ FLRObj21_AsilLvl : 304|2@1+ (1,0) [0|0] ""  VCM
 SG_ FLRObj21_LatAcc : 168|9@1+ (0.08,-20) [-20|20.88] "m_per_s_squared"  VCM
 SG_ FLRObj21_LatVelVar : 80|8@1+ (0.1,0) [0|25.5] "NotApplicable"  VCM
 SG_ FLRObj21_TimeStamp : 200|16@1+ (0.1,0) [0|6553.5] "ms"  VCM
 SG_ FLRObj21_ExistConf : 290|7@1+ (0.01,0) [0|1.27] "NotApplicable"  VCM
 SG_ FLRObj21_ObjDynClassRestricted : 306|2@1+ (1,0) [0|0] ""  VCM
 SG_ FLRObj21_LongExtFrVar : 104|8@1+ (0.01,0) [0|2.55] "NotApplicable"  VCM
 SG_ FLRObj21_LongVel : 240|13@1+ (0.032,-80) [-80|182.112] "m_per_s"  VCM
 SG_ FLRObj21_ObjDynClass : 278|2@1+ (1,0) [0|0] ""  VCM
 SG_ FLRObj21_Counter : 16|8@1+ (1,0) [0|255] "Count"  VCM
 SG_ FLRObj21_LifeTime : 24|16@1+ (0.1,0) [0|6553.5] "s"  VCM
 SG_ FLRObj21_LongExtFront : 224|10@1+ (0.05,0) [0|51.15] "m"  VCM
 SG_ FLRObj21_LatExtLeft : 266|7@1+ (0.05,0) [0|6.35] "m"  VCM
 SG_ FLRObj21_LatExtLeftVar : 56|8@1+ (0.01,0) [0|2.55] "NotApplicable"  VCM
 SG_ FLRObj21_HeadingVar : 40|8@1+ (0.001,0) [0|0.255] "NotApplicable"  VCM
 SG_ FLRObj21_Heading : 157|11@1+ (0.005818,-4.71) [-4.71|7.199446] "rad"  VCM
 SG_ FLRObj21_CRC : 0|16@1+ (1,0) [0|65535] "NotApplicable"  VCM

BO_ 803 FLR_Obj20_Vic1: 48 FLR2
 SG_ FLRObj20_ExistConf : 290|7@1+ (0.01,0) [0|1.27] "NotApplicable"  VCM
 SG_ FLRObj20_ObjClass : 216|4@1+ (1,0) [0|0] ""  VCM
 SG_ FLRObj20_LongVelVar : 120|8@1+ (0.01,0) [0|2.55] "NotApplicable"  VCM
 SG_ FLRObj20_LongExtBkVar : 96|8@1+ (0.01,0) [0|2.55] "NotApplicable"  VCM
 SG_ FLRObj20_Heading : 157|11@1+ (0.005818,-4.71) [-4.71|7.199446] "rad"  VCM
 SG_ FLRObj20_LatExtRight : 193|7@1+ (0.05,-5) [-5|1.35] "m"  VCM
 SG_ FLRObj20_LongAcc : 184|9@1+ (0.08,-20) [-20|20.88] "m_per_s_squared"  VCM
 SG_ FLRObj20_LatExtLeftVar : 56|8@1+ (0.01,0) [0|2.55] "NotApplicable"  VCM
 SG_ FLRObj20_AsilLvl : 304|2@1+ (1,0) [0|0] ""  VCM
 SG_ FLRObj20_LatPosVar : 72|8@1+ (0.01,0) [0|2.55] "NotApplicable"  VCM
 SG_ FLRObj20_LatExtLeft : 266|7@1+ (0.05,0) [0|6.35] "m"  VCM
 SG_ FLRObj20_Height : 220|4@1+ (0.5,0) [0|7.5] "m"  VCM
 SG_ FLRObj20_LatAccVar : 48|8@1+ (0.1,0) [0|25.5] "NotApplicable"  VCM
 SG_ FLRObj20_LatVel : 144|13@1+ (0.032,-80) [-80|182.112] "m_per_s"  VCM
 SG_ FLRObj20_ObjID : 234|6@1+ (1,0) [0|63] "NotApplicable"  VCM
 SG_ FLRObj20_LifeTime : 24|16@1+ (0.1,0) [0|6553.5] "s"  VCM
 SG_ FLRObj20_LongExtFront : 224|10@1+ (0.05,0) [0|51.15] "m"  VCM
 SG_ FLRObj20_Counter : 16|8@1+ (1,0) [0|255] "Count"  VCM
 SG_ FLRObj20_CoastIndex : 273|5@1+ (1,0) [0|31] "NotApplicable"  VCM
 SG_ FLRObj20_LongExtBack : 280|10@1+ (0.05,-50) [-50|1.15000000000001] "m"  VCM
 SG_ FLRObj20_LongExtFrVar : 104|8@1+ (0.01,0) [0|2.55] "NotApplicable"  VCM
 SG_ FLRObj20_LatAcc : 168|9@1+ (0.08,-20) [-20|20.88] "m_per_s_squared"  VCM
 SG_ FLRObj20_ObjDynClass : 278|2@1+ (1,0) [0|0] ""  VCM
 SG_ FLRObj20_LongPos : 253|13@1+ (0.05,-180) [-180|229.55] "m"  VCM
 SG_ FLRObj20_ObstacleConfRestricted : 308|7@1+ (0.01,0) [0|1.27] "NotApplicable"  VCM
 SG_ FLRObj20_ObjDynClassRestricted : 306|2@1+ (1,0) [0|0] ""  VCM
 SG_ FLRObj20_LongVel : 240|13@1+ (0.032,-80) [-80|182.112] "m_per_s"  VCM
 SG_ FLRObj20_TrackStatus : 141|3@1+ (1,0) [0|0] ""  VCM
 SG_ FLRObj20_LatExtRtVar : 64|8@1+ (0.01,0) [0|2.55] "NotApplicable"  VCM
 SG_ FLRObj20_CRC : 0|16@1+ (1,0) [0|65535] "NotApplicable"  VCM
 SG_ FLRObj20_HeadingVar : 40|8@1+ (0.001,0) [0|0.255] "NotApplicable"  VCM
 SG_ FLRObj20_TimeStamp : 200|16@1+ (0.1,0) [0|6553.5] "ms"  VCM
 SG_ FLRObj20_LongAccVar : 88|8@1+ (0.01,0) [0|2.55] "NotApplicable"  VCM
 SG_ FLRObj20_ObstacleConf : 297|7@1+ (0.01,0) [0|1.27] "NotApplicable"  VCM
 SG_ FLRObj20_ObjClassConf : 177|7@1+ (0.01,0) [0|1.27] "NotApplicable"  VCM
 SG_ FLRObj20_LongPosVar : 112|8@1+ (0.01,0) [0|2.55] "NotApplicable"  VCM
 SG_ FLRObj20_LatPos : 128|13@1+ (0.05,-180) [-180|229.55] "m"  VCM
 SG_ FLRObj20_LatVelVar : 80|8@1+ (0.1,0) [0|25.5] "NotApplicable"  VCM

BO_ 802 FLR_Obj19_Vic1: 48 FLR2
 SG_ FLRObj19_LongVelVar : 120|8@1+ (0.01,0) [0|2.55] "NotApplicable"  VCM
 SG_ FLRObj19_LatPosVar : 72|8@1+ (0.01,0) [0|2.55] "NotApplicable"  VCM
 SG_ FLRObj19_LatVelVar : 80|8@1+ (0.1,0) [0|25.5] "NotApplicable"  VCM
 SG_ FLRObj19_TrackStatus : 141|3@1+ (1,0) [0|0] ""  VCM
 SG_ FLRObj19_ObjClassConf : 177|7@1+ (0.01,0) [0|1.27] "NotApplicable"  VCM
 SG_ FLRObj19_LatExtLeft : 266|7@1+ (0.05,0) [0|6.35] "m"  VCM
 SG_ FLRObj19_LongAccVar : 88|8@1+ (0.01,0) [0|2.55] "NotApplicable"  VCM
 SG_ FLRObj19_ExistConf : 290|7@1+ (0.01,0) [0|1.27] "NotApplicable"  VCM
 SG_ FLRObj19_ObjClass : 216|4@1+ (1,0) [0|0] ""  VCM
 SG_ FLRObj19_CRC : 0|16@1+ (1,0) [0|65535] "NotApplicable"  VCM
 SG_ FLRObj19_LongExtFront : 224|10@1+ (0.05,0) [0|51.15] "m"  VCM
 SG_ FLRObj19_ObstacleConf : 297|7@1+ (0.01,0) [0|1.27] "NotApplicable"  VCM
 SG_ FLRObj19_LatExtRtVar : 64|8@1+ (0.01,0) [0|2.55] "NotApplicable"  VCM
 SG_ FLRObj19_CoastIndex : 273|5@1+ (1,0) [0|31] "NotApplicable"  VCM
 SG_ FLRObj19_LongVel : 240|13@1+ (0.032,-80) [-80|182.112] "m_per_s"  VCM
 SG_ FLRObj19_LongExtBack : 280|10@1+ (0.05,-50) [-50|1.15000000000001] "m"  VCM
 SG_ FLRObj19_LifeTime : 24|16@1+ (0.1,0) [0|6553.5] "s"  VCM
 SG_ FLRObj19_ObstacleConfRestricted : 308|7@1+ (0.01,0) [0|1.27] "NotApplicable"  VCM
 SG_ FLRObj19_LatVel : 144|13@1+ (0.032,-80) [-80|182.112] "m_per_s"  VCM
 SG_ FLRObj19_LatAccVar : 48|8@1+ (0.1,0) [0|25.5] "NotApplicable"  VCM
 SG_ FLRObj19_LongPos : 253|13@1+ (0.05,-180) [-180|229.55] "m"  VCM
 SG_ FLRObj19_Counter : 16|8@1+ (1,0) [0|255] "Count"  VCM
 SG_ FLRObj19_ObjDynClass : 278|2@1+ (1,0) [0|0] ""  VCM
 SG_ FLRObj19_LongPosVar : 112|8@1+ (0.01,0) [0|2.55] "NotApplicable"  VCM
 SG_ FLRObj19_ObjDynClassRestricted : 306|2@1+ (1,0) [0|0] ""  VCM
 SG_ FLRObj19_ObjID : 234|6@1+ (1,0) [0|63] "NotApplicable"  VCM
 SG_ FLRObj19_Height : 220|4@1+ (0.5,0) [0|7.5] "m"  VCM
 SG_ FLRObj19_LatAcc : 168|9@1+ (0.08,-20) [-20|20.88] "m_per_s_squared"  VCM
 SG_ FLRObj19_LatExtRight : 193|7@1+ (0.05,-5) [-5|1.35] "m"  VCM
 SG_ FLRObj19_LongExtFrVar : 104|8@1+ (0.01,0) [0|2.55] "NotApplicable"  VCM
 SG_ FLRObj19_AsilLvl : 304|2@1+ (1,0) [0|0] ""  VCM
 SG_ FLRObj19_LongExtBkVar : 96|8@1+ (0.01,0) [0|2.55] "NotApplicable"  VCM
 SG_ FLRObj19_LatPos : 128|13@1+ (0.05,-180) [-180|229.55] "m"  VCM
 SG_ FLRObj19_Heading : 157|11@1+ (0.005818,-4.71) [-4.71|7.199446] "rad"  VCM
 SG_ FLRObj19_TimeStamp : 200|16@1+ (0.1,0) [0|6553.5] "ms"  VCM
 SG_ FLRObj19_HeadingVar : 40|8@1+ (0.001,0) [0|0.255] "NotApplicable"  VCM
 SG_ FLRObj19_LongAcc : 184|9@1+ (0.08,-20) [-20|20.88] "m_per_s_squared"  VCM
 SG_ FLRObj19_LatExtLeftVar : 56|8@1+ (0.01,0) [0|2.55] "NotApplicable"  VCM

BO_ 801 FLR_Obj18_Vic1: 48 FLR2
 SG_ FLRObj18_LatVel : 144|13@1+ (0.032,-80) [-80|182.112] "m_per_s"  VCM
 SG_ FLRObj18_AsilLvl : 304|2@1+ (1,0) [0|0] ""  VCM
 SG_ FLRObj18_ObjDynClassRestricted : 306|2@1+ (1,0) [0|0] ""  VCM
 SG_ FLRObj18_TimeStamp : 200|16@1+ (0.1,0) [0|6553.5] "ms"  VCM
 SG_ FLRObj18_Height : 220|4@1+ (0.5,0) [0|7.5] "m"  VCM
 SG_ FLRObj18_LongExtBkVar : 96|8@1+ (0.01,0) [0|2.55] "NotApplicable"  VCM
 SG_ FLRObj18_CRC : 0|16@1+ (1,0) [0|65535] "NotApplicable"  VCM
 SG_ FLRObj18_LongExtFrVar : 104|8@1+ (0.01,0) [0|2.55] "NotApplicable"  VCM
 SG_ FLRObj18_LongPos : 253|13@1+ (0.05,-180) [-180|229.55] "m"  VCM
 SG_ FLRObj18_TrackStatus : 141|3@1+ (1,0) [0|0] ""  VCM
 SG_ FLRObj18_LatAccVar : 48|8@1+ (0.1,0) [0|25.5] "NotApplicable"  VCM
 SG_ FLRObj18_LongExtBack : 280|10@1+ (0.05,-50) [-50|1.15000000000001] "m"  VCM
 SG_ FLRObj18_ObjClassConf : 177|7@1+ (0.01,0) [0|1.27] "NotApplicable"  VCM
 SG_ FLRObj18_ObjID : 234|6@1+ (1,0) [0|63] "NotApplicable"  VCM
 SG_ FLRObj18_LongExtFront : 224|10@1+ (0.05,0) [0|51.15] "m"  VCM
 SG_ FLRObj18_LongAccVar : 88|8@1+ (0.01,0) [0|2.55] "NotApplicable"  VCM
 SG_ FLRObj18_Heading : 157|11@1+ (0.005818,-4.71) [-4.71|7.199446] "rad"  VCM
 SG_ FLRObj18_Counter : 16|8@1+ (1,0) [0|255] "Count"  VCM
 SG_ FLRObj18_LatExtLeftVar : 56|8@1+ (0.01,0) [0|2.55] "NotApplicable"  VCM
 SG_ FLRObj18_LatExtLeft : 266|7@1+ (0.05,0) [0|6.35] "m"  VCM
 SG_ FLRObj18_LongVel : 240|13@1+ (0.032,-80) [-80|182.112] "m_per_s"  VCM
 SG_ FLRObj18_LifeTime : 24|16@1+ (0.1,0) [0|6553.5] "s"  VCM
 SG_ FLRObj18_LongPosVar : 112|8@1+ (0.01,0) [0|2.55] "NotApplicable"  VCM
 SG_ FLRObj18_ObstacleConf : 297|7@1+ (0.01,0) [0|1.27] "NotApplicable"  VCM
 SG_ FLRObj18_LatExtRight : 193|7@1+ (0.05,-5) [-5|1.35] "m"  VCM
 SG_ FLRObj18_LongAcc : 184|9@1+ (0.08,-20) [-20|20.88] "m_per_s_squared"  VCM
 SG_ FLRObj18_ObstacleConfRestricted : 308|7@1+ (0.01,0) [0|1.27] "NotApplicable"  VCM
 SG_ FLRObj18_LatPos : 128|13@1+ (0.05,-180) [-180|229.55] "m"  VCM
 SG_ FLRObj18_LatPosVar : 72|8@1+ (0.01,0) [0|2.55] "NotApplicable"  VCM
 SG_ FLRObj18_LongVelVar : 120|8@1+ (0.01,0) [0|2.55] "NotApplicable"  VCM
 SG_ FLRObj18_CoastIndex : 273|5@1+ (1,0) [0|31] "NotApplicable"  VCM
 SG_ FLRObj18_LatAcc : 168|9@1+ (0.08,-20) [-20|20.88] "m_per_s_squared"  VCM
 SG_ FLRObj18_ExistConf : 290|7@1+ (0.01,0) [0|1.27] "NotApplicable"  VCM
 SG_ FLRObj18_LatVelVar : 80|8@1+ (0.1,0) [0|25.5] "NotApplicable"  VCM
 SG_ FLRObj18_HeadingVar : 40|8@1+ (0.001,0) [0|0.255] "NotApplicable"  VCM
 SG_ FLRObj18_ObjDynClass : 278|2@1+ (1,0) [0|0] ""  VCM
 SG_ FLRObj18_LatExtRtVar : 64|8@1+ (0.01,0) [0|2.55] "NotApplicable"  VCM
 SG_ FLRObj18_ObjClass : 216|4@1+ (1,0) [0|0] ""  VCM

BO_ 800 FLR_Obj17_Vic1: 48 FLR2
 SG_ FLRObj17_LatAccVar : 48|8@1+ (0.1,0) [0|25.5] "NotApplicable"  VCM
 SG_ FLRObj17_ObstacleConf : 297|7@1+ (0.01,0) [0|1.27] "NotApplicable"  VCM
 SG_ FLRObj17_LifeTime : 24|16@1+ (0.1,0) [0|6553.5] "s"  VCM
 SG_ FLRObj17_LongExtFrVar : 104|8@1+ (0.01,0) [0|2.55] "NotApplicable"  VCM
 SG_ FLRObj17_LongAcc : 184|9@1+ (0.08,-20) [-20|20.88] "m_per_s_squared"  VCM
 SG_ FLRObj17_LongAccVar : 88|8@1+ (0.01,0) [0|2.55] "NotApplicable"  VCM
 SG_ FLRObj17_LongExtBack : 280|10@1+ (0.05,-50) [-50|1.15000000000001] "m"  VCM
 SG_ FLRObj17_LongVel : 240|13@1+ (0.032,-80) [-80|182.112] "m_per_s"  VCM
 SG_ FLRObj17_LongPosVar : 112|8@1+ (0.01,0) [0|2.55] "NotApplicable"  VCM
 SG_ FLRObj17_ObjDynClass : 278|2@1+ (1,0) [0|0] ""  VCM
 SG_ FLRObj17_LatAcc : 168|9@1+ (0.08,-20) [-20|20.88] "m_per_s_squared"  VCM
 SG_ FLRObj17_ObjDynClassRestricted : 306|2@1+ (1,0) [0|0] ""  VCM
 SG_ FLRObj17_CRC : 0|16@1+ (1,0) [0|65535] "NotApplicable"  VCM
 SG_ FLRObj17_HeadingVar : 40|8@1+ (0.001,0) [0|0.255] "NotApplicable"  VCM
 SG_ FLRObj17_Heading : 157|11@1+ (0.005818,-4.71) [-4.71|7.199446] "rad"  VCM
 SG_ FLRObj17_ObstacleConfRestricted : 308|7@1+ (0.01,0) [0|1.27] "NotApplicable"  VCM
 SG_ FLRObj17_ExistConf : 290|7@1+ (0.01,0) [0|1.27] "NotApplicable"  VCM
 SG_ FLRObj17_TrackStatus : 141|3@1+ (1,0) [0|0] ""  VCM
 SG_ FLRObj17_LongPos : 253|13@1+ (0.05,-180) [-180|229.55] "m"  VCM
 SG_ FLRObj17_LongExtBkVar : 96|8@1+ (0.01,0) [0|2.55] "NotApplicable"  VCM
 SG_ FLRObj17_LatPos : 128|13@1+ (0.05,-180) [-180|229.55] "m"  VCM
 SG_ FLRObj17_CoastIndex : 273|5@1+ (1,0) [0|31] "NotApplicable"  VCM
 SG_ FLRObj17_ObjClass : 216|4@1+ (1,0) [0|0] ""  VCM
 SG_ FLRObj17_LatPosVar : 72|8@1+ (0.01,0) [0|2.55] "NotApplicable"  VCM
 SG_ FLRObj17_LongVelVar : 120|8@1+ (0.01,0) [0|2.55] "NotApplicable"  VCM
 SG_ FLRObj17_LatExtLeft : 266|7@1+ (0.05,0) [0|6.35] "m"  VCM
 SG_ FLRObj17_Height : 220|4@1+ (0.5,0) [0|7.5] "m"  VCM
 SG_ FLRObj17_LatVelVar : 80|8@1+ (0.1,0) [0|25.5] "NotApplicable"  VCM
 SG_ FLRObj17_LatVel : 144|13@1+ (0.032,-80) [-80|182.112] "m_per_s"  VCM
 SG_ FLRObj17_Counter : 16|8@1+ (1,0) [0|255] "Count"  VCM
 SG_ FLRObj17_LatExtRtVar : 64|8@1+ (0.01,0) [0|2.55] "NotApplicable"  VCM
 SG_ FLRObj17_AsilLvl : 304|2@1+ (1,0) [0|0] ""  VCM
 SG_ FLRObj17_ObjClassConf : 177|7@1+ (0.01,0) [0|1.27] "NotApplicable"  VCM
 SG_ FLRObj17_LongExtFront : 224|10@1+ (0.05,0) [0|51.15] "m"  VCM
 SG_ FLRObj17_TimeStamp : 200|16@1+ (0.1,0) [0|6553.5] "ms"  VCM
 SG_ FLRObj17_LatExtLeftVar : 56|8@1+ (0.01,0) [0|2.55] "NotApplicable"  VCM
 SG_ FLRObj17_ObjID : 234|6@1+ (1,0) [0|63] "NotApplicable"  VCM
 SG_ FLRObj17_LatExtRight : 193|7@1+ (0.05,-5) [-5|1.35] "m"  VCM

BO_ 799 FLR_Obj16_Vic1: 48 FLR2
 SG_ FLRObj16_ObstacleConfRestricted : 308|7@1+ (0.01,0) [0|1.27] "NotApplicable"  VCM
 SG_ FLRObj16_LongExtFrVar : 104|8@1+ (0.01,0) [0|2.55] "NotApplicable"  VCM
 SG_ FLRObj16_LatVelVar : 80|8@1+ (0.1,0) [0|25.5] "NotApplicable"  VCM
 SG_ FLRObj16_TimeStamp : 200|16@1+ (0.1,0) [0|6553.5] "ms"  VCM
 SG_ FLRObj16_LongPosVar : 112|8@1+ (0.01,0) [0|2.55] "NotApplicable"  VCM
 SG_ FLRObj16_LifeTime : 24|16@1+ (0.1,0) [0|6553.5] "s"  VCM
 SG_ FLRObj16_LatAccVar : 48|8@1+ (0.1,0) [0|25.5] "NotApplicable"  VCM
 SG_ FLRObj16_ObjDynClass : 278|2@1+ (1,0) [0|0] ""  VCM
 SG_ FLRObj16_ObjClass : 216|4@1+ (1,0) [0|0] ""  VCM
 SG_ FLRObj16_ObjID : 234|6@1+ (1,0) [0|63] "NotApplicable"  VCM
 SG_ FLRObj16_LatAcc : 168|9@1+ (0.08,-20) [-20|20.88] "m_per_s_squared"  VCM
 SG_ FLRObj16_LongPos : 253|13@1+ (0.05,-180) [-180|229.55] "m"  VCM
 SG_ FLRObj16_LatPosVar : 72|8@1+ (0.01,0) [0|2.55] "NotApplicable"  VCM
 SG_ FLRObj16_HeadingVar : 40|8@1+ (0.001,0) [0|0.255] "NotApplicable"  VCM
 SG_ FLRObj16_LatPos : 128|13@1+ (0.05,-180) [-180|229.55] "m"  VCM
 SG_ FLRObj16_LongExtBack : 280|10@1+ (0.05,-50) [-50|1.15000000000001] "m"  VCM
 SG_ FLRObj16_ExistConf : 290|7@1+ (0.01,0) [0|1.27] "NotApplicable"  VCM
 SG_ FLRObj16_LongExtFront : 224|10@1+ (0.05,0) [0|51.15] "m"  VCM
 SG_ FLRObj16_Counter : 16|8@1+ (1,0) [0|255] "Count"  VCM
 SG_ FLRObj16_Height : 220|4@1+ (0.5,0) [0|7.5] "m"  VCM
 SG_ FLRObj16_Heading : 157|11@1+ (0.005818,-4.71) [-4.71|7.199446] "rad"  VCM
 SG_ FLRObj16_LongAcc : 184|9@1+ (0.08,-20) [-20|20.88] "m_per_s_squared"  VCM
 SG_ FLRObj16_CRC : 0|16@1+ (1,0) [0|65535] "NotApplicable"  VCM
 SG_ FLRObj16_LatExtRight : 193|7@1+ (0.05,-5) [-5|1.35] "m"  VCM
 SG_ FLRObj16_LatVel : 144|13@1+ (0.032,-80) [-80|182.112] "m_per_s"  VCM
 SG_ FLRObj16_LongAccVar : 88|8@1+ (0.01,0) [0|2.55] "NotApplicable"  VCM
 SG_ FLRObj16_LatExtLeft : 266|7@1+ (0.05,0) [0|6.35] "m"  VCM
 SG_ FLRObj16_TrackStatus : 141|3@1+ (1,0) [0|0] ""  VCM
 SG_ FLRObj16_ObjDynClassRestricted : 306|2@1+ (1,0) [0|0] ""  VCM
 SG_ FLRObj16_LatExtLeftVar : 56|8@1+ (0.01,0) [0|2.55] "NotApplicable"  VCM
 SG_ FLRObj16_AsilLvl : 304|2@1+ (1,0) [0|0] ""  VCM
 SG_ FLRObj16_CoastIndex : 273|5@1+ (1,0) [0|31] "NotApplicable"  VCM
 SG_ FLRObj16_LongVel : 240|13@1+ (0.032,-80) [-80|182.112] "m_per_s"  VCM
 SG_ FLRObj16_ObstacleConf : 297|7@1+ (0.01,0) [0|1.27] "NotApplicable"  VCM
 SG_ FLRObj16_ObjClassConf : 177|7@1+ (0.01,0) [0|1.27] "NotApplicable"  VCM
 SG_ FLRObj16_LatExtRtVar : 64|8@1+ (0.01,0) [0|2.55] "NotApplicable"  VCM
 SG_ FLRObj16_LongExtBkVar : 96|8@1+ (0.01,0) [0|2.55] "NotApplicable"  VCM
 SG_ FLRObj16_LongVelVar : 120|8@1+ (0.01,0) [0|2.55] "NotApplicable"  VCM

BO_ 798 FLR_Obj15_Vic1: 48 FLR2
 SG_ FLRObj15_LatAccVar : 48|8@1+ (0.1,0) [0|25.5] "NotApplicable"  VCM
 SG_ FLRObj15_Counter : 16|8@1+ (1,0) [0|255] "Count"  VCM
 SG_ FLRObj15_LongExtBack : 280|10@1+ (0.05,-50) [-50|1.15000000000001] "m"  VCM
 SG_ FLRObj15_ObstacleConf : 297|7@1+ (0.01,0) [0|1.27] "NotApplicable"  VCM
 SG_ FLRObj15_CoastIndex : 273|5@1+ (1,0) [0|31] "NotApplicable"  VCM
 SG_ FLRObj15_ObjDynClass : 278|2@1+ (1,0) [0|0] ""  VCM
 SG_ FLRObj15_HeadingVar : 40|8@1+ (0.001,0) [0|0.255] "NotApplicable"  VCM
 SG_ FLRObj15_LatAcc : 168|9@1+ (0.08,-20) [-20|20.88] "m_per_s_squared"  VCM
 SG_ FLRObj15_LatExtLeftVar : 56|8@1+ (0.01,0) [0|2.55] "NotApplicable"  VCM
 SG_ FLRObj15_LongExtFrVar : 104|8@1+ (0.01,0) [0|2.55] "NotApplicable"  VCM
 SG_ FLRObj15_LatExtLeft : 266|7@1+ (0.05,0) [0|6.35] "m"  VCM
 SG_ FLRObj15_LatPosVar : 72|8@1+ (0.01,0) [0|2.55] "NotApplicable"  VCM
 SG_ FLRObj15_LongExtFront : 224|10@1+ (0.05,0) [0|51.15] "m"  VCM
 SG_ FLRObj15_Height : 220|4@1+ (0.5,0) [0|7.5] "m"  VCM
 SG_ FLRObj15_ObjClassConf : 177|7@1+ (0.01,0) [0|1.27] "NotApplicable"  VCM
 SG_ FLRObj15_LatExtRight : 193|7@1+ (0.05,-5) [-5|1.35] "m"  VCM
 SG_ FLRObj15_LongPosVar : 112|8@1+ (0.01,0) [0|2.55] "NotApplicable"  VCM
 SG_ FLRObj15_ObstacleConfRestricted : 308|7@1+ (0.01,0) [0|1.27] "NotApplicable"  VCM
 SG_ FLRObj15_LongExtBkVar : 96|8@1+ (0.01,0) [0|2.55] "NotApplicable"  VCM
 SG_ FLRObj15_LatExtRtVar : 64|8@1+ (0.01,0) [0|2.55] "NotApplicable"  VCM
 SG_ FLRObj15_TrackStatus : 141|3@1+ (1,0) [0|0] ""  VCM
 SG_ FLRObj15_ObjClass : 216|4@1+ (1,0) [0|0] ""  VCM
 SG_ FLRObj15_LatVelVar : 80|8@1+ (0.1,0) [0|25.5] "NotApplicable"  VCM
 SG_ FLRObj15_LongAcc : 184|9@1+ (0.08,-20) [-20|20.88] "m_per_s_squared"  VCM
 SG_ FLRObj15_ObjDynClassRestricted : 306|2@1+ (1,0) [0|0] ""  VCM
 SG_ FLRObj15_Heading : 157|11@1+ (0.005818,-4.71) [-4.71|7.199446] "rad"  VCM
 SG_ FLRObj15_LongVelVar : 120|8@1+ (0.01,0) [0|2.55] "NotApplicable"  VCM
 SG_ FLRObj15_LatPos : 128|13@1+ (0.05,-180) [-180|229.55] "m"  VCM
 SG_ FLRObj15_LongPos : 253|13@1+ (0.05,-180) [-180|229.55] "m"  VCM
 SG_ FLRObj15_AsilLvl : 304|2@1+ (1,0) [0|0] ""  VCM
 SG_ FLRObj15_ObjID : 234|6@1+ (1,0) [0|63] "NotApplicable"  VCM
 SG_ FLRObj15_LongVel : 240|13@1+ (0.032,-80) [-80|182.112] "m_per_s"  VCM
 SG_ FLRObj15_ExistConf : 290|7@1+ (0.01,0) [0|1.27] "NotApplicable"  VCM
 SG_ FLRObj15_LifeTime : 24|16@1+ (0.1,0) [0|6553.5] "s"  VCM
 SG_ FLRObj15_TimeStamp : 200|16@1+ (0.1,0) [0|6553.5] "ms"  VCM
 SG_ FLRObj15_LatVel : 144|13@1+ (0.032,-80) [-80|182.112] "m_per_s"  VCM
 SG_ FLRObj15_LongAccVar : 88|8@1+ (0.01,0) [0|2.55] "NotApplicable"  VCM
 SG_ FLRObj15_CRC : 0|16@1+ (1,0) [0|65535] "NotApplicable"  VCM

CM_ "COM_MATRIX_T2_1.27.0";
CM_ BU_ HUA "Head-Up Alert";
CM_ BU_ FLR2 "Forward Looking Radar";
CM_ BU_ DACU "Driver Assistance Control Unit";
BA_DEF_ BO_  "GenMsgStartDelayTime" INT 0 0;
BA_DEF_ BO_  "GenMsgDelayTime" INT 0 0;
BA_DEF_ BO_  "GenMsgCycleTime" INT 0 0;
BA_DEF_ BO_  "GenMsgSendType" ENUM  "Cyclic","NotUsed","NotUsed","NotUsed","NotUsed","NotUsed","NotUsed","IfActive","NoMsgSendType","NotUsed";
BA_DEF_ SG_  "GenSigStartValue" INT 0 0;
BA_DEF_ SG_  "GenSigCycleTimeActive" INT 0 0;
BA_DEF_ SG_  "GenSigCycleTime" INT 0 0;
BA_DEF_ SG_  "GenSigSendType" ENUM  "Cyclic","OnWrite","OnWriteWithRepetition","OnChange","OnChangeWithRepetition","IfActive","IfActiveWithRepetition","NoSigSendType","NotUsed","NotUsed","NotUsed","NotUsed","NotUsed";
BA_DEF_  "Baudrate" INT 0 1000000;
BA_DEF_  "NmType" STRING ;
BA_DEF_  "Manufacturer" STRING ;
BA_DEF_  "VersionYear" INT 0 99;
BA_DEF_  "VersionNumber" INT 0 99;
BA_DEF_  "VersionMonth" INT 1 12;
BA_DEF_  "VersionDay" INT 1 31;
BA_DEF_ BO_  "VFrameFormat" ENUM  "StandardCAN","ExtendedCAN","reserved","J1939PG","reserved","reserved","reserved","reserved","reserved","reserved","reserved","reserved","reserved","reserved","StandardCAN_FD","ExtendedCAN_FD";
BA_DEF_ BU_  "TpOwnSystemEcuNumber" HEX 0 255;
BA_DEF_ SG_  "SigType" ENUM  "Default","Range","RangeSigned","ASCII","Discrete","Control","ReferencePGN","DTC","StringDelimiter","StringLength","StringLengthControl";
BA_DEF_ SG_  "SeToolVersion_SIGNAL" STRING ;
BA_DEF_ SG_  "SeToolUniqueID_SIGNAL" STRING ;
BA_DEF_ SG_  "SeToolName_SIGNAL" STRING ;
BA_DEF_ SG_  "SeToolItemID_SIGNAL" STRING ;
BA_DEF_ SG_  "SeToolAncestorID_SIGNAL" STRING ;
BA_DEF_  "ProtocolType" STRING ;
BA_DEF_ BU_  "NmStationAddress" INT 0 255;
BA_DEF_  "NmAsrWaitBusSleepTime" INT 0 65535;
BA_DEF_  "NmAsrTimeoutTime" INT 0 65535;
BA_DEF_  "NmAsrRepeatMessageTime" INT 0 65535;
BA_DEF_ BU_  "NmAsrNodeIdentifier" HEX 0 253;
BA_DEF_ BU_  "NmAsrNode" ENUM  "No","Yes";
BA_DEF_  "NmAsrMessageCount" INT 1 256;
BA_DEF_  "NmAsrCanMsgCycleTime" INT 0 65535;
BA_DEF_  "NmAsrBaseAddress" HEX 0 536870911;
BA_DEF_ SG_  "NeedsUpdateBit" ENUM  "No","Yes";
BA_DEF_ SG_  "GenSigILSupport" ENUM  "Yes","No";
BA_DEF_ BO_  "GenMsgILSupport" ENUM  "No","Yes";
BA_DEF_ SG_  "E2EProfile" STRING ;
BA_DEF_  "E2EP05WindowSize" INT 0 65535;
BA_DEF_  "E2EP05ProfileName" STRING ;
BA_DEF_  "E2EP05MinOkStateValid" INT 0 65535;
BA_DEF_  "E2EP05MinOkStateInvalid" INT 0 65535;
BA_DEF_  "E2EP05MinOkStateInit" INT 0 65535;
BA_DEF_  "E2EP05MaxErrorStateValid" INT 0 65535;
BA_DEF_  "E2EP05MaxErrorStateInvalid" INT 0 65535;
BA_DEF_  "E2EP05MaxErrorStateInit" INT 0 65535;
BA_DEF_  "E2EP05MaxDeltaCounter" INT 0 65535;
BA_DEF_  "E2EP01WindowSize" INT 0 65535;
BA_DEF_  "E2EP01SyncCounterInit" INT 0 65535;
BA_DEF_  "E2EP01ProfileName" STRING ;
BA_DEF_  "E2EP01MinOkStateValid" INT 0 65535;
BA_DEF_  "E2EP01MinOkStateInvalid" INT 0 65535;
BA_DEF_  "E2EP01MinOkStateInit" INT 0 65535;
BA_DEF_  "E2EP01MaxNoNewOrRepeatedData" INT 0 65535;
BA_DEF_  "E2EP01MaxErrorStateValid" INT 0 65535;
BA_DEF_  "E2EP01MaxErrorStateInvalid" INT 0 65535;
BA_DEF_  "E2EP01MaxErrorStateInit" INT 0 65535;
BA_DEF_  "E2EP01MaxDeltaCounter" INT 0 65535;
BA_DEF_  "E2EP01DataIdMode" ENUM  "all16Bit","alternating8Bit","lower12Bit","lower8Bit";
BA_DEF_  "E2EP01CounterOffset" INT 0 65535;
BA_DEF_ SG_  "E2EDataLength" INT 0 65535;
BA_DEF_ SG_  "E2EDataId" INT 0 65535;
BA_DEF_ BO_  "DiagUUDTResponse" ENUM  "No","Yes";
BA_DEF_ BO_  "DiagState" ENUM  "No","Yes";
BA_DEF_ BO_  "DiagResponse" ENUM  "No","Yes";
BA_DEF_ BO_  "DiagRequest" ENUM  "No","Yes";
BA_DEF_ BO_  "DiagConnection" HEX 0 65535;
BA_DEF_  "DBName" STRING ;
BA_DEF_ BO_  "CanTpFcFrameId" HEX 0 2147483647;
BA_DEF_ BO_  "CanTpBs" INT 0 255;
BA_DEF_ BO_  "CANFD_BRS" ENUM  "0","1";
BA_DEF_  "BusType" STRING ;
BA_DEF_  "BaudrateCANFD" INT 0 5000000;
BA_DEF_REL_ BU_SG_REL_  "GenSigTimeoutTime" INT 0 65535;
BA_DEF_REL_ BU_SG_REL_  "GenSigFirstTimeoutTime" INT 0 65535;
BA_DEF_DEF_  "GenMsgStartDelayTime" 0;
BA_DEF_DEF_  "GenMsgDelayTime" 0;
BA_DEF_DEF_  "GenMsgCycleTime" 0;
BA_DEF_DEF_  "GenMsgSendType" "Cyclic";
BA_DEF_DEF_  "GenSigStartValue" 0;
BA_DEF_DEF_  "GenSigCycleTimeActive" 0;
BA_DEF_DEF_  "GenSigCycleTime" 0;
BA_DEF_DEF_  "GenSigSendType" "Cyclic";
BA_DEF_DEF_  "Baudrate" 500000;
BA_DEF_DEF_  "NmType" "";
BA_DEF_DEF_  "Manufacturer" "VOLVO_AB";
BA_DEF_DEF_  "VersionYear" 0;
BA_DEF_DEF_  "VersionNumber" 0;
BA_DEF_DEF_  "VersionMonth" 1;
BA_DEF_DEF_  "VersionDay" 1;
BA_DEF_DEF_  "VFrameFormat" "ExtendedCAN";
BA_DEF_DEF_  "TpOwnSystemEcuNumber" 0;
BA_DEF_DEF_  "SigType" "Default";
BA_DEF_DEF_  "SeToolVersion_SIGNAL" "";
BA_DEF_DEF_  "SeToolUniqueID_SIGNAL" "";
BA_DEF_DEF_  "SeToolName_SIGNAL" "";
BA_DEF_DEF_  "SeToolItemID_SIGNAL" "";
BA_DEF_DEF_  "SeToolAncestorID_SIGNAL" "";
BA_DEF_DEF_  "ProtocolType" "";
BA_DEF_DEF_  "NmStationAddress" 254;
BA_DEF_DEF_  "NmAsrWaitBusSleepTime" 750;
BA_DEF_DEF_  "NmAsrTimeoutTime" 5000;
BA_DEF_DEF_  "NmAsrRepeatMessageTime" 300;
BA_DEF_DEF_  "NmAsrNodeIdentifier" 0;
BA_DEF_DEF_  "NmAsrNode" "Yes";
BA_DEF_DEF_  "NmAsrMessageCount" 256;
BA_DEF_DEF_  "NmAsrCanMsgCycleTime" 200;
BA_DEF_DEF_  "NmAsrBaseAddress" 486506496;
BA_DEF_DEF_  "NeedsUpdateBit" "No";
BA_DEF_DEF_  "GenSigILSupport" "Yes";
BA_DEF_DEF_  "GenMsgILSupport" "Yes";
BA_DEF_DEF_  "E2EProfile" "none";
BA_DEF_DEF_  "E2EP05WindowSize" 5;
BA_DEF_DEF_  "E2EP05ProfileName" "PROFILE_05";
BA_DEF_DEF_  "E2EP05MinOkStateValid" 1;
BA_DEF_DEF_  "E2EP05MinOkStateInvalid" 3;
BA_DEF_DEF_  "E2EP05MinOkStateInit" 1;
BA_DEF_DEF_  "E2EP05MaxErrorStateValid" 3;
BA_DEF_DEF_  "E2EP05MaxErrorStateInvalid" 1;
BA_DEF_DEF_  "E2EP05MaxErrorStateInit" 2;
BA_DEF_DEF_  "E2EP05MaxDeltaCounter" 1;
BA_DEF_DEF_  "E2EP01WindowSize" 5;
BA_DEF_DEF_  "E2EP01SyncCounterInit" 1;
BA_DEF_DEF_  "E2EP01ProfileName" "PROFILE_01";
BA_DEF_DEF_  "E2EP01MinOkStateValid" 1;
BA_DEF_DEF_  "E2EP01MinOkStateInvalid" 3;
BA_DEF_DEF_  "E2EP01MinOkStateInit" 1;
BA_DEF_DEF_  "E2EP01MaxNoNewOrRepeatedData" 5;
BA_DEF_DEF_  "E2EP01MaxErrorStateValid" 3;
BA_DEF_DEF_  "E2EP01MaxErrorStateInvalid" 1;
BA_DEF_DEF_  "E2EP01MaxErrorStateInit" 2;
BA_DEF_DEF_  "E2EP01MaxDeltaCounter" 1;
BA_DEF_DEF_  "E2EP01DataIdMode" "all16Bit";
BA_DEF_DEF_  "E2EP01CounterOffset" 8;
BA_DEF_DEF_  "E2EDataLength" 0;
BA_DEF_DEF_  "E2EDataId" 0;
BA_DEF_DEF_  "DiagUUDTResponse" "No";
BA_DEF_DEF_  "DiagState" "No";
BA_DEF_DEF_  "DiagResponse" "No";
BA_DEF_DEF_  "DiagRequest" "No";
BA_DEF_DEF_  "DiagConnection" 0;
BA_DEF_DEF_  "DBName" "";
BA_DEF_DEF_  "CanTpFcFrameId" 2147483647;
BA_DEF_DEF_  "CanTpBs" 255;
BA_DEF_DEF_  "CANFD_BRS" "0";
BA_DEF_DEF_  "BusType" "";
BA_DEF_DEF_  "BaudrateCANFD" 0;
BA_DEF_DEF_REL_ "GenSigTimeoutTime" 0;
BA_DEF_DEF_REL_ "GenSigFirstTimeoutTime" 0;
BA_ "BusType" "CAN FD";
BA_ "BaudrateCANFD" 1000000;
BA_ "ProtocolType" "CAN";
BA_ "VersionDay" 12;
BA_ "VersionMonth" 5;
BA_ "VersionNumber" 1;
BA_ "VersionYear" 22;
BA_ "DBName" "VicinityNet1";
BA_ "NmAsrNode" BU_ HUA 0;
BA_ "TpOwnSystemEcuNumber" BU_ FLR2 82;
BA_ "NmAsrNode" BU_ FLR2 0;
BA_ "NmAsrNodeIdentifier" BU_ FLR2 82;
BA_ "TpOwnSystemEcuNumber" BU_ DACU 80;
BA_ "NmAsrNode" BU_ DACU 0;
BA_ "NmAsrNodeIdentifier" BU_ DACU 80;
BA_ "DiagConnection" BO_ 2671902706 62034;
BA_ "DiagState" BO_ 2671902706 1;
BA_ "GenMsgILSupport" BO_ 2671902706 0;
BA_ "GenMsgSendType" BO_ 2671902706 8;
BA_ "DiagConnection" BO_ 2671833682 62034;
BA_ "DiagResponse" BO_ 2671833682 1;
BA_ "GenMsgILSupport" BO_ 2671833682 0;
BA_ "GenMsgSendType" BO_ 2671833682 8;
BA_ "DiagConnection" BO_ 2671792882 62034;
BA_ "DiagRequest" BO_ 2671792882 1;
BA_ "GenMsgILSupport" BO_ 2671792882 0;
BA_ "GenMsgSendType" BO_ 2671792882 8;
BA_ "DiagConnection" BO_ 2671902708 62546;
BA_ "DiagState" BO_ 2671902708 1;
BA_ "GenMsgILSupport" BO_ 2671902708 0;
BA_ "GenMsgSendType" BO_ 2671902708 8;
BA_ "CANFD_BRS" BO_ 1507 1;
BA_ "GenMsgCycleTime" BO_ 1507 1000;
BA_ "VFrameFormat" BO_ 1507 14;
BA_ "CANFD_BRS" BO_ 1553 1;
BA_ "GenMsgCycleTime" BO_ 1553 10000;
BA_ "VFrameFormat" BO_ 1553 14;
BA_ "CANFD_BRS" BO_ 859 1;
BA_ "GenMsgSendType" BO_ 859 8;
BA_ "VFrameFormat" BO_ 859 14;
BA_ "CANFD_BRS" BO_ 806 1;
BA_ "GenMsgSendType" BO_ 806 8;
BA_ "VFrameFormat" BO_ 806 14;
BA_ "CANFD_BRS" BO_ 805 1;
BA_ "GenMsgSendType" BO_ 805 8;
BA_ "VFrameFormat" BO_ 805 14;
BA_ "CANFD_BRS" BO_ 804 1;
BA_ "GenMsgSendType" BO_ 804 8;
BA_ "VFrameFormat" BO_ 804 14;
BA_ "CANFD_BRS" BO_ 803 1;
BA_ "GenMsgSendType" BO_ 803 8;
BA_ "VFrameFormat" BO_ 803 14;
BA_ "CANFD_BRS" BO_ 802 1;
BA_ "GenMsgSendType" BO_ 802 8;
BA_ "VFrameFormat" BO_ 802 14;
BA_ "CANFD_BRS" BO_ 801 1;
BA_ "GenMsgSendType" BO_ 801 8;
BA_ "VFrameFormat" BO_ 801 14;
BA_ "CANFD_BRS" BO_ 800 1;
BA_ "GenMsgSendType" BO_ 800 8;
BA_ "VFrameFormat" BO_ 800 14;
BA_ "CANFD_BRS" BO_ 799 1;
BA_ "GenMsgSendType" BO_ 799 8;
BA_ "VFrameFormat" BO_ 799 14;
BA_ "CANFD_BRS" BO_ 798 1;
BA_ "GenMsgSendType" BO_ 798 8;
BA_ "VFrameFormat" BO_ 798 14;
BA_ "GenSigSendType" SG_ 2671902706 FuncDiagDataTester 7;
BA_ "GenSigSendType" SG_ 2671833682 PhysDiagRespSig_F2_52 7;
BA_ "GenSigSendType" SG_ 2671792882 PhysDiagReqSig_52_F2 7;
BA_ "GenSigSendType" SG_ 2671902708 FuncDiagDataIntTesterTGW2 7;
BA_ "GenSigCycleTime" SG_ 1507 HUA_SN_Byte2 100;
BA_ "GenSigCycleTimeActive" SG_ 1507 HUA_SN_Byte2 100;
BA_ "GenSigStartValue" SG_ 1507 HUA_SN_Byte2 255;
BA_ "GenSigCycleTime" SG_ 1507 HUA_SNPN_Byte3 100;
BA_ "GenSigCycleTimeActive" SG_ 1507 HUA_SNPN_Byte3 100;
BA_ "GenSigStartValue" SG_ 1507 HUA_SNPN_Byte3 255;
BA_ "GenSigCycleTime" SG_ 1507 DiagInfoHUA 100;
BA_ "GenSigCycleTimeActive" SG_ 1507 DiagInfoHUA 100;
BA_ "GenSigCycleTime" SG_ 1507 HUA_SNPN_Byte2 100;
BA_ "GenSigCycleTimeActive" SG_ 1507 HUA_SNPN_Byte2 100;
BA_ "GenSigStartValue" SG_ 1507 HUA_SNPN_Byte2 255;
BA_ "GenSigCycleTime" SG_ 1507 HUA_SN_Byte0 100;
BA_ "GenSigCycleTimeActive" SG_ 1507 HUA_SN_Byte0 100;
BA_ "GenSigStartValue" SG_ 1507 HUA_SN_Byte0 255;
BA_ "GenSigCycleTime" SG_ 1507 HUA_SN_Byte3 100;
BA_ "GenSigCycleTimeActive" SG_ 1507 HUA_SN_Byte3 100;
BA_ "GenSigStartValue" SG_ 1507 HUA_SN_Byte3 255;
BA_ "GenSigCycleTime" SG_ 1507 HUA_SNPN_Byte1 100;
BA_ "GenSigCycleTimeActive" SG_ 1507 HUA_SNPN_Byte1 100;
BA_ "GenSigStartValue" SG_ 1507 HUA_SNPN_Byte1 255;
BA_ "GenSigCycleTime" SG_ 1507 HUA_SN_Byte1 100;
BA_ "GenSigCycleTimeActive" SG_ 1507 HUA_SN_Byte1 100;
BA_ "GenSigStartValue" SG_ 1507 HUA_SN_Byte1 255;
BA_ "GenSigCycleTime" SG_ 1507 HUA_SNPN_Byte0 100;
BA_ "GenSigCycleTimeActive" SG_ 1507 HUA_SNPN_Byte0 100;
BA_ "GenSigStartValue" SG_ 1507 HUA_SNPN_Byte0 255;
BA_ "GenSigCycleTime" SG_ 1507 HUA_SNPN_Byte4 100;
BA_ "GenSigCycleTimeActive" SG_ 1507 HUA_SNPN_Byte4 100;
BA_ "GenSigStartValue" SG_ 1507 HUA_SNPN_Byte4 255;
BA_ "GenSigCycleTime" SG_ 1553 FLRSwVersion_Substring1 100;
BA_ "GenSigCycleTimeActive" SG_ 1553 FLRSwVersion_Substring1 100;
BA_ "GenSigCycleTime" SG_ 1553 FLRSwVersion_Substring3 100;
BA_ "GenSigCycleTimeActive" SG_ 1553 FLRSwVersion_Substring3 100;
BA_ "GenSigCycleTime" SG_ 1553 FLRSwVersion_Substring5 100;
BA_ "GenSigCycleTimeActive" SG_ 1553 FLRSwVersion_Substring5 100;
BA_ "GenSigCycleTime" SG_ 1553 FLRSwVersion_Substring2 100;
BA_ "GenSigCycleTimeActive" SG_ 1553 FLRSwVersion_Substring2 100;
BA_ "GenSigCycleTime" SG_ 1553 FLRSwVersion_Substring6 100;
BA_ "GenSigCycleTimeActive" SG_ 1553 FLRSwVersion_Substring6 100;
BA_ "GenSigCycleTime" SG_ 1553 FLRSwVersion_Substring7 100;
BA_ "GenSigCycleTimeActive" SG_ 1553 FLRSwVersion_Substring7 100;
BA_ "GenSigCycleTime" SG_ 1553 FLRSwVersion_Substring4 100;
BA_ "GenSigCycleTimeActive" SG_ 1553 FLRSwVersion_Substring4 100;
BA_ "GenSigCycleTime" SG_ 1553 FLRSwVersion_Substring0 100;
BA_ "GenSigCycleTimeActive" SG_ 1553 FLRSwVersion_Substring0 100;
BA_ "GenSigSendType" SG_ 859 RightRoadBoundary_Curvature 1;
BA_ "GenSigStartValue" SG_ 859 RightRoadBoundary_Curvature 262143;
BA_ "GenSigSendType" SG_ 859 RightRoadBoundary_LatDistVar 1;
BA_ "GenSigStartValue" SG_ 859 RightRoadBoundary_LatDistVar 255;
BA_ "GenSigSendType" SG_ 859 RightRoadBoundary_Type 1;
BA_ "GenSigStartValue" SG_ 859 RightRoadBoundary_Type 7;
BA_ "GenSigSendType" SG_ 859 RightRoadBoundary_CRC 1;
BA_ "GenSigStartValue" SG_ 859 RightRoadBoundary_CRC 65535;
BA_ "E2EDataId" SG_ 859 RightRoadBoundary_CRC 114;
BA_ "E2EDataLength" SG_ 859 RightRoadBoundary_CRC 152;
BA_ "E2EProfile" SG_ 859 RightRoadBoundary_CRC "P05";
BA_ "GenSigSendType" SG_ 859 RightRoadBoundary_LifeTime 1;
BA_ "GenSigStartValue" SG_ 859 RightRoadBoundary_LifeTime 65535;
BA_ "GenSigSendType" SG_ 859 RightRoadBoundary_TrackStatus 1;
BA_ "GenSigStartValue" SG_ 859 RightRoadBoundary_TrackStatus 7;
BA_ "GenSigSendType" SG_ 859 RightRoadBoundary_HeadingAngle 1;
BA_ "GenSigStartValue" SG_ 859 RightRoadBoundary_HeadingAngle 8191;
BA_ "GenSigSendType" SG_ 859 RightRoadBoundary_Counter 1;
BA_ "GenSigStartValue" SG_ 859 RightRoadBoundary_Counter 255;
BA_ "GenSigSendType" SG_ 859 RightRoadBoundary_LatDist 1;
BA_ "GenSigStartValue" SG_ 859 RightRoadBoundary_LatDist 4095;
BA_ "GenSigSendType" SG_ 859 RightRoadBoundary_TimeStamp 1;
BA_ "GenSigStartValue" SG_ 859 RightRoadBoundary_TimeStamp 65535;
BA_ "GenSigSendType" SG_ 859 RightRoadBoundary_CoastIndex 1;
BA_ "GenSigStartValue" SG_ 859 RightRoadBoundary_CoastIndex 31;
BA_ "GenSigSendType" SG_ 859 RightRoadBoundary_Confidence 1;
BA_ "GenSigStartValue" SG_ 859 RightRoadBoundary_Confidence 127;
BA_ "GenSigSendType" SG_ 859 RightRoadBoundary_CurvatureRate 1;
BA_ "GenSigStartValue" SG_ 859 RightRoadBoundary_CurvatureRate 2047;
BA_ "GenSigSendType" SG_ 859 RightRoadBoundary_DxStart 1;
BA_ "GenSigStartValue" SG_ 859 RightRoadBoundary_DxStart 255;
BA_ "GenSigSendType" SG_ 859 RightRoadBoundary_DxEnd 1;
BA_ "GenSigStartValue" SG_ 859 RightRoadBoundary_DxEnd 255;
BA_ "GenSigSendType" SG_ 806 FLRObj23_ObjClassConf 1;
BA_ "GenSigStartValue" SG_ 806 FLRObj23_ObjClassConf 127;
BA_ "GenSigSendType" SG_ 806 FLRObj23_LongPosVar 1;
BA_ "GenSigStartValue" SG_ 806 FLRObj23_LongPosVar 255;
BA_ "GenSigSendType" SG_ 806 FLRObj23_LongAccVar 1;
BA_ "GenSigStartValue" SG_ 806 FLRObj23_LongAccVar 255;
BA_ "GenSigSendType" SG_ 806 FLRObj23_TrackStatus 1;
BA_ "GenSigStartValue" SG_ 806 FLRObj23_TrackStatus 7;
BA_ "GenSigSendType" SG_ 806 FLRObj23_ObjID 1;
BA_ "GenSigStartValue" SG_ 806 FLRObj23_ObjID 63;
BA_ "GenSigSendType" SG_ 806 FLRObj23_ObjDynClassRestricted 1;
BA_ "GenSigStartValue" SG_ 806 FLRObj23_ObjDynClassRestricted 3;
BA_ "GenSigSendType" SG_ 806 FLRObj23_LatExtRtVar 1;
BA_ "GenSigStartValue" SG_ 806 FLRObj23_LatExtRtVar 255;
BA_ "GenSigSendType" SG_ 806 FLRObj23_ExistConf 1;
BA_ "GenSigStartValue" SG_ 806 FLRObj23_ExistConf 127;
BA_ "GenSigSendType" SG_ 806 FLRObj23_HeadingVar 1;
BA_ "GenSigStartValue" SG_ 806 FLRObj23_HeadingVar 255;
BA_ "GenSigSendType" SG_ 806 FLRObj23_LongExtFront 1;
BA_ "GenSigStartValue" SG_ 806 FLRObj23_LongExtFront 1023;
BA_ "GenSigSendType" SG_ 806 FLRObj23_Counter 1;
BA_ "GenSigStartValue" SG_ 806 FLRObj23_Counter 255;
BA_ "GenSigSendType" SG_ 806 FLRObj23_LatExtLeft 1;
BA_ "GenSigStartValue" SG_ 806 FLRObj23_LatExtLeft 127;
BA_ "GenSigSendType" SG_ 806 FLRObj23_ObstacleConfRestricted 1;
BA_ "GenSigStartValue" SG_ 806 FLRObj23_ObstacleConfRestricted 127;
BA_ "GenSigSendType" SG_ 806 FLRObj23_LatExtRight 1;
BA_ "GenSigStartValue" SG_ 806 FLRObj23_LatExtRight 127;
BA_ "GenSigSendType" SG_ 806 FLRObj23_LatVelVar 1;
BA_ "GenSigStartValue" SG_ 806 FLRObj23_LatVelVar 255;
BA_ "GenSigSendType" SG_ 806 FLRObj23_LongExtBack 1;
BA_ "GenSigStartValue" SG_ 806 FLRObj23_LongExtBack 1023;
BA_ "GenSigSendType" SG_ 806 FLRObj23_LongVel 1;
BA_ "GenSigStartValue" SG_ 806 FLRObj23_LongVel 8191;
BA_ "GenSigSendType" SG_ 806 FLRObj23_LatPosVar 1;
BA_ "GenSigStartValue" SG_ 806 FLRObj23_LatPosVar 255;
BA_ "GenSigSendType" SG_ 806 FLRObj23_LatAcc 1;
BA_ "GenSigStartValue" SG_ 806 FLRObj23_LatAcc 511;
BA_ "GenSigSendType" SG_ 806 FLRObj23_ObstacleConf 1;
BA_ "GenSigStartValue" SG_ 806 FLRObj23_ObstacleConf 127;
BA_ "GenSigSendType" SG_ 806 FLRObj23_LatPos 1;
BA_ "GenSigStartValue" SG_ 806 FLRObj23_LatPos 8191;
BA_ "GenSigSendType" SG_ 806 FLRObj23_LatVel 1;
BA_ "GenSigStartValue" SG_ 806 FLRObj23_LatVel 8191;
BA_ "GenSigSendType" SG_ 806 FLRObj23_TimeStamp 1;
BA_ "GenSigStartValue" SG_ 806 FLRObj23_TimeStamp 65535;
BA_ "GenSigSendType" SG_ 806 FLRObj23_Heading 1;
BA_ "GenSigStartValue" SG_ 806 FLRObj23_Heading 2047;
BA_ "GenSigSendType" SG_ 806 FLRObj23_CRC 1;
BA_ "GenSigStartValue" SG_ 806 FLRObj23_CRC 65535;
BA_ "E2EDataId" SG_ 806 FLRObj23_CRC 140;
BA_ "E2EDataLength" SG_ 806 FLRObj23_CRC 320;
BA_ "E2EProfile" SG_ 806 FLRObj23_CRC "P05";
BA_ "GenSigSendType" SG_ 806 FLRObj23_ObjDynClass 1;
BA_ "GenSigStartValue" SG_ 806 FLRObj23_ObjDynClass 3;
BA_ "GenSigSendType" SG_ 806 FLRObj23_Height 1;
BA_ "GenSigStartValue" SG_ 806 FLRObj23_Height 15;
BA_ "GenSigSendType" SG_ 806 FLRObj23_LongExtBkVar 1;
BA_ "GenSigStartValue" SG_ 806 FLRObj23_LongExtBkVar 255;
BA_ "GenSigSendType" SG_ 806 FLRObj23_CoastIndex 1;
BA_ "GenSigStartValue" SG_ 806 FLRObj23_CoastIndex 31;
BA_ "GenSigSendType" SG_ 806 FLRObj23_LifeTime 1;
BA_ "GenSigStartValue" SG_ 806 FLRObj23_LifeTime 65535;
BA_ "GenSigSendType" SG_ 806 FLRObj23_LongPos 1;
BA_ "GenSigStartValue" SG_ 806 FLRObj23_LongPos 8191;
BA_ "GenSigSendType" SG_ 806 FLRObj23_LongVelVar 1;
BA_ "GenSigStartValue" SG_ 806 FLRObj23_LongVelVar 255;
BA_ "GenSigSendType" SG_ 806 FLRObj23_LatAccVar 1;
BA_ "GenSigStartValue" SG_ 806 FLRObj23_LatAccVar 255;
BA_ "GenSigSendType" SG_ 806 FLRObj23_LongExtFrVar 1;
BA_ "GenSigStartValue" SG_ 806 FLRObj23_LongExtFrVar 255;
BA_ "GenSigSendType" SG_ 806 FLRObj23_AsilLvl 1;
BA_ "GenSigStartValue" SG_ 806 FLRObj23_AsilLvl 3;
BA_ "GenSigSendType" SG_ 806 FLRObj23_LongAcc 1;
BA_ "GenSigStartValue" SG_ 806 FLRObj23_LongAcc 511;
BA_ "GenSigSendType" SG_ 806 FLRObj23_LatExtLeftVar 1;
BA_ "GenSigStartValue" SG_ 806 FLRObj23_LatExtLeftVar 255;
BA_ "GenSigSendType" SG_ 806 FLRObj23_ObjClass 1;
BA_ "GenSigStartValue" SG_ 806 FLRObj23_ObjClass 15;
BA_ "GenSigSendType" SG_ 805 FLRObj22_TimeStamp 1;
BA_ "GenSigStartValue" SG_ 805 FLRObj22_TimeStamp 65535;
BA_ "GenSigSendType" SG_ 805 FLRObj22_LatAcc 1;
BA_ "GenSigStartValue" SG_ 805 FLRObj22_LatAcc 511;
BA_ "GenSigSendType" SG_ 805 FLRObj22_LatAccVar 1;
BA_ "GenSigStartValue" SG_ 805 FLRObj22_LatAccVar 255;
BA_ "GenSigSendType" SG_ 805 FLRObj22_LongPosVar 1;
BA_ "GenSigStartValue" SG_ 805 FLRObj22_LongPosVar 255;
BA_ "GenSigSendType" SG_ 805 FLRObj22_ExistConf 1;
BA_ "GenSigStartValue" SG_ 805 FLRObj22_ExistConf 127;
BA_ "GenSigSendType" SG_ 805 FLRObj22_LongVel 1;
BA_ "GenSigStartValue" SG_ 805 FLRObj22_LongVel 8191;
BA_ "GenSigSendType" SG_ 805 FLRObj22_ObjID 1;
BA_ "GenSigStartValue" SG_ 805 FLRObj22_ObjID 63;
BA_ "GenSigSendType" SG_ 805 FLRObj22_Counter 1;
BA_ "GenSigStartValue" SG_ 805 FLRObj22_Counter 255;
BA_ "GenSigSendType" SG_ 805 FLRObj22_LongVelVar 1;
BA_ "GenSigStartValue" SG_ 805 FLRObj22_LongVelVar 255;
BA_ "GenSigSendType" SG_ 805 FLRObj22_LongAccVar 1;
BA_ "GenSigStartValue" SG_ 805 FLRObj22_LongAccVar 255;
BA_ "GenSigSendType" SG_ 805 FLRObj22_LongExtBkVar 1;
BA_ "GenSigStartValue" SG_ 805 FLRObj22_LongExtBkVar 255;
BA_ "GenSigSendType" SG_ 805 FLRObj22_LatVelVar 1;
BA_ "GenSigStartValue" SG_ 805 FLRObj22_LatVelVar 255;
BA_ "GenSigSendType" SG_ 805 FLRObj22_LatExtRtVar 1;
BA_ "GenSigStartValue" SG_ 805 FLRObj22_LatExtRtVar 255;
BA_ "GenSigSendType" SG_ 805 FLRObj22_ObjDynClassRestricted 1;
BA_ "GenSigStartValue" SG_ 805 FLRObj22_ObjDynClassRestricted 3;
BA_ "GenSigSendType" SG_ 805 FLRObj22_LongAcc 1;
BA_ "GenSigStartValue" SG_ 805 FLRObj22_LongAcc 511;
BA_ "GenSigSendType" SG_ 805 FLRObj22_AsilLvl 1;
BA_ "GenSigStartValue" SG_ 805 FLRObj22_AsilLvl 3;
BA_ "GenSigSendType" SG_ 805 FLRObj22_LongExtFront 1;
BA_ "GenSigStartValue" SG_ 805 FLRObj22_LongExtFront 1023;
BA_ "GenSigSendType" SG_ 805 FLRObj22_HeadingVar 1;
BA_ "GenSigStartValue" SG_ 805 FLRObj22_HeadingVar 255;
BA_ "GenSigSendType" SG_ 805 FLRObj22_CRC 1;
BA_ "GenSigStartValue" SG_ 805 FLRObj22_CRC 65535;
BA_ "E2EDataId" SG_ 805 FLRObj22_CRC 139;
BA_ "E2EDataLength" SG_ 805 FLRObj22_CRC 320;
BA_ "E2EProfile" SG_ 805 FLRObj22_CRC "P05";
BA_ "GenSigSendType" SG_ 805 FLRObj22_LatVel 1;
BA_ "GenSigStartValue" SG_ 805 FLRObj22_LatVel 8191;
BA_ "GenSigSendType" SG_ 805 FLRObj22_CoastIndex 1;
BA_ "GenSigStartValue" SG_ 805 FLRObj22_CoastIndex 31;
BA_ "GenSigSendType" SG_ 805 FLRObj22_Heading 1;
BA_ "GenSigStartValue" SG_ 805 FLRObj22_Heading 2047;
BA_ "GenSigSendType" SG_ 805 FLRObj22_LifeTime 1;
BA_ "GenSigStartValue" SG_ 805 FLRObj22_LifeTime 65535;
BA_ "GenSigSendType" SG_ 805 FLRObj22_LatPosVar 1;
BA_ "GenSigStartValue" SG_ 805 FLRObj22_LatPosVar 255;
BA_ "GenSigSendType" SG_ 805 FLRObj22_ObstacleConfRestricted 1;
BA_ "GenSigStartValue" SG_ 805 FLRObj22_ObstacleConfRestricted 127;
BA_ "GenSigSendType" SG_ 805 FLRObj22_LatPos 1;
BA_ "GenSigStartValue" SG_ 805 FLRObj22_LatPos 8191;
BA_ "GenSigSendType" SG_ 805 FLRObj22_Height 1;
BA_ "GenSigStartValue" SG_ 805 FLRObj22_Height 15;
BA_ "GenSigSendType" SG_ 805 FLRObj22_LongPos 1;
BA_ "GenSigStartValue" SG_ 805 FLRObj22_LongPos 8191;
BA_ "GenSigSendType" SG_ 805 FLRObj22_ObjClassConf 1;
BA_ "GenSigStartValue" SG_ 805 FLRObj22_ObjClassConf 127;
BA_ "GenSigSendType" SG_ 805 FLRObj22_TrackStatus 1;
BA_ "GenSigStartValue" SG_ 805 FLRObj22_TrackStatus 7;
BA_ "GenSigSendType" SG_ 805 FLRObj22_ObjClass 1;
BA_ "GenSigStartValue" SG_ 805 FLRObj22_ObjClass 15;
BA_ "GenSigSendType" SG_ 805 FLRObj22_LongExtFrVar 1;
BA_ "GenSigStartValue" SG_ 805 FLRObj22_LongExtFrVar 255;
BA_ "GenSigSendType" SG_ 805 FLRObj22_LongExtBack 1;
BA_ "GenSigStartValue" SG_ 805 FLRObj22_LongExtBack 1023;
BA_ "GenSigSendType" SG_ 805 FLRObj22_ObstacleConf 1;
BA_ "GenSigStartValue" SG_ 805 FLRObj22_ObstacleConf 127;
BA_ "GenSigSendType" SG_ 805 FLRObj22_LatExtLeftVar 1;
BA_ "GenSigStartValue" SG_ 805 FLRObj22_LatExtLeftVar 255;
BA_ "GenSigSendType" SG_ 805 FLRObj22_LatExtLeft 1;
BA_ "GenSigStartValue" SG_ 805 FLRObj22_LatExtLeft 127;
BA_ "GenSigSendType" SG_ 805 FLRObj22_LatExtRight 1;
BA_ "GenSigStartValue" SG_ 805 FLRObj22_LatExtRight 127;
BA_ "GenSigSendType" SG_ 805 FLRObj22_ObjDynClass 1;
BA_ "GenSigStartValue" SG_ 805 FLRObj22_ObjDynClass 3;
BA_ "GenSigSendType" SG_ 804 FLRObj21_LatAccVar 1;
BA_ "GenSigStartValue" SG_ 804 FLRObj21_LatAccVar 255;
BA_ "GenSigSendType" SG_ 804 FLRObj21_TrackStatus 1;
BA_ "GenSigStartValue" SG_ 804 FLRObj21_TrackStatus 7;
BA_ "GenSigSendType" SG_ 804 FLRObj21_LongPos 1;
BA_ "GenSigStartValue" SG_ 804 FLRObj21_LongPos 8191;
BA_ "GenSigSendType" SG_ 804 FLRObj21_LongAcc 1;
BA_ "GenSigStartValue" SG_ 804 FLRObj21_LongAcc 511;
BA_ "GenSigSendType" SG_ 804 FLRObj21_Height 1;
BA_ "GenSigStartValue" SG_ 804 FLRObj21_Height 15;
BA_ "GenSigSendType" SG_ 804 FLRObj21_LatVel 1;
BA_ "GenSigStartValue" SG_ 804 FLRObj21_LatVel 8191;
BA_ "GenSigSendType" SG_ 804 FLRObj21_LatPos 1;
BA_ "GenSigStartValue" SG_ 804 FLRObj21_LatPos 8191;
BA_ "GenSigSendType" SG_ 804 FLRObj21_LatExtRtVar 1;
BA_ "GenSigStartValue" SG_ 804 FLRObj21_LatExtRtVar 255;
BA_ "GenSigSendType" SG_ 804 FLRObj21_ObstacleConfRestricted 1;
BA_ "GenSigStartValue" SG_ 804 FLRObj21_ObstacleConfRestricted 127;
BA_ "GenSigSendType" SG_ 804 FLRObj21_ObstacleConf 1;
BA_ "GenSigStartValue" SG_ 804 FLRObj21_ObstacleConf 127;
BA_ "GenSigSendType" SG_ 804 FLRObj21_LongExtBack 1;
BA_ "GenSigStartValue" SG_ 804 FLRObj21_LongExtBack 1023;
BA_ "GenSigSendType" SG_ 804 FLRObj21_LongAccVar 1;
BA_ "GenSigStartValue" SG_ 804 FLRObj21_LongAccVar 255;
BA_ "GenSigSendType" SG_ 804 FLRObj21_ObjClass 1;
BA_ "GenSigStartValue" SG_ 804 FLRObj21_ObjClass 15;
BA_ "GenSigSendType" SG_ 804 FLRObj21_ObjClassConf 1;
BA_ "GenSigStartValue" SG_ 804 FLRObj21_ObjClassConf 127;
BA_ "GenSigSendType" SG_ 804 FLRObj21_LongExtBkVar 1;
BA_ "GenSigStartValue" SG_ 804 FLRObj21_LongExtBkVar 255;
BA_ "GenSigSendType" SG_ 804 FLRObj21_LatPosVar 1;
BA_ "GenSigStartValue" SG_ 804 FLRObj21_LatPosVar 255;
BA_ "GenSigSendType" SG_ 804 FLRObj21_LongVelVar 1;
BA_ "GenSigStartValue" SG_ 804 FLRObj21_LongVelVar 255;
BA_ "GenSigSendType" SG_ 804 FLRObj21_LongPosVar 1;
BA_ "GenSigStartValue" SG_ 804 FLRObj21_LongPosVar 255;
BA_ "GenSigSendType" SG_ 804 FLRObj21_LatExtRight 1;
BA_ "GenSigStartValue" SG_ 804 FLRObj21_LatExtRight 127;
BA_ "GenSigSendType" SG_ 804 FLRObj21_ObjID 1;
BA_ "GenSigStartValue" SG_ 804 FLRObj21_ObjID 63;
BA_ "GenSigSendType" SG_ 804 FLRObj21_CoastIndex 1;
BA_ "GenSigStartValue" SG_ 804 FLRObj21_CoastIndex 31;
BA_ "GenSigSendType" SG_ 804 FLRObj21_AsilLvl 1;
BA_ "GenSigStartValue" SG_ 804 FLRObj21_AsilLvl 3;
BA_ "GenSigSendType" SG_ 804 FLRObj21_LatAcc 1;
BA_ "GenSigStartValue" SG_ 804 FLRObj21_LatAcc 511;
BA_ "GenSigSendType" SG_ 804 FLRObj21_LatVelVar 1;
BA_ "GenSigStartValue" SG_ 804 FLRObj21_LatVelVar 255;
BA_ "GenSigSendType" SG_ 804 FLRObj21_TimeStamp 1;
BA_ "GenSigStartValue" SG_ 804 FLRObj21_TimeStamp 65535;
BA_ "GenSigSendType" SG_ 804 FLRObj21_ExistConf 1;
BA_ "GenSigStartValue" SG_ 804 FLRObj21_ExistConf 127;
BA_ "GenSigSendType" SG_ 804 FLRObj21_ObjDynClassRestricted 1;
BA_ "GenSigStartValue" SG_ 804 FLRObj21_ObjDynClassRestricted 3;
BA_ "GenSigSendType" SG_ 804 FLRObj21_LongExtFrVar 1;
BA_ "GenSigStartValue" SG_ 804 FLRObj21_LongExtFrVar 255;
BA_ "GenSigSendType" SG_ 804 FLRObj21_LongVel 1;
BA_ "GenSigStartValue" SG_ 804 FLRObj21_LongVel 8191;
BA_ "GenSigSendType" SG_ 804 FLRObj21_ObjDynClass 1;
BA_ "GenSigStartValue" SG_ 804 FLRObj21_ObjDynClass 3;
BA_ "GenSigSendType" SG_ 804 FLRObj21_Counter 1;
BA_ "GenSigStartValue" SG_ 804 FLRObj21_Counter 255;
BA_ "GenSigSendType" SG_ 804 FLRObj21_LifeTime 1;
BA_ "GenSigStartValue" SG_ 804 FLRObj21_LifeTime 65535;
BA_ "GenSigSendType" SG_ 804 FLRObj21_LongExtFront 1;
BA_ "GenSigStartValue" SG_ 804 FLRObj21_LongExtFront 1023;
BA_ "GenSigSendType" SG_ 804 FLRObj21_LatExtLeft 1;
BA_ "GenSigStartValue" SG_ 804 FLRObj21_LatExtLeft 127;
BA_ "GenSigSendType" SG_ 804 FLRObj21_LatExtLeftVar 1;
BA_ "GenSigStartValue" SG_ 804 FLRObj21_LatExtLeftVar 255;
BA_ "GenSigSendType" SG_ 804 FLRObj21_HeadingVar 1;
BA_ "GenSigStartValue" SG_ 804 FLRObj21_HeadingVar 255;
BA_ "GenSigSendType" SG_ 804 FLRObj21_Heading 1;
BA_ "GenSigStartValue" SG_ 804 FLRObj21_Heading 2047;
BA_ "GenSigSendType" SG_ 804 FLRObj21_CRC 1;
BA_ "GenSigStartValue" SG_ 804 FLRObj21_CRC 65535;
BA_ "E2EDataId" SG_ 804 FLRObj21_CRC 138;
BA_ "E2EDataLength" SG_ 804 FLRObj21_CRC 320;
BA_ "E2EProfile" SG_ 804 FLRObj21_CRC "P05";
BA_ "GenSigSendType" SG_ 803 FLRObj20_ExistConf 1;
BA_ "GenSigStartValue" SG_ 803 FLRObj20_ExistConf 127;
BA_ "GenSigSendType" SG_ 803 FLRObj20_ObjClass 1;
BA_ "GenSigStartValue" SG_ 803 FLRObj20_ObjClass 15;
BA_ "GenSigSendType" SG_ 803 FLRObj20_LongVelVar 1;
BA_ "GenSigStartValue" SG_ 803 FLRObj20_LongVelVar 255;
BA_ "GenSigSendType" SG_ 803 FLRObj20_LongExtBkVar 1;
BA_ "GenSigStartValue" SG_ 803 FLRObj20_LongExtBkVar 255;
BA_ "GenSigSendType" SG_ 803 FLRObj20_Heading 1;
BA_ "GenSigStartValue" SG_ 803 FLRObj20_Heading 2047;
BA_ "GenSigSendType" SG_ 803 FLRObj20_LatExtRight 1;
BA_ "GenSigStartValue" SG_ 803 FLRObj20_LatExtRight 127;
BA_ "GenSigSendType" SG_ 803 FLRObj20_LongAcc 1;
BA_ "GenSigStartValue" SG_ 803 FLRObj20_LongAcc 511;
BA_ "GenSigSendType" SG_ 803 FLRObj20_LatExtLeftVar 1;
BA_ "GenSigStartValue" SG_ 803 FLRObj20_LatExtLeftVar 255;
BA_ "GenSigSendType" SG_ 803 FLRObj20_AsilLvl 1;
BA_ "GenSigStartValue" SG_ 803 FLRObj20_AsilLvl 3;
BA_ "GenSigSendType" SG_ 803 FLRObj20_LatPosVar 1;
BA_ "GenSigStartValue" SG_ 803 FLRObj20_LatPosVar 255;
BA_ "GenSigSendType" SG_ 803 FLRObj20_LatExtLeft 1;
BA_ "GenSigStartValue" SG_ 803 FLRObj20_LatExtLeft 127;
BA_ "GenSigSendType" SG_ 803 FLRObj20_Height 1;
BA_ "GenSigStartValue" SG_ 803 FLRObj20_Height 15;
BA_ "GenSigSendType" SG_ 803 FLRObj20_LatAccVar 1;
BA_ "GenSigStartValue" SG_ 803 FLRObj20_LatAccVar 255;
BA_ "GenSigSendType" SG_ 803 FLRObj20_LatVel 1;
BA_ "GenSigStartValue" SG_ 803 FLRObj20_LatVel 8191;
BA_ "GenSigSendType" SG_ 803 FLRObj20_ObjID 1;
BA_ "GenSigStartValue" SG_ 803 FLRObj20_ObjID 63;
BA_ "GenSigSendType" SG_ 803 FLRObj20_LifeTime 1;
BA_ "GenSigStartValue" SG_ 803 FLRObj20_LifeTime 65535;
BA_ "GenSigSendType" SG_ 803 FLRObj20_LongExtFront 1;
BA_ "GenSigStartValue" SG_ 803 FLRObj20_LongExtFront 1023;
BA_ "GenSigSendType" SG_ 803 FLRObj20_Counter 1;
BA_ "GenSigStartValue" SG_ 803 FLRObj20_Counter 255;
BA_ "GenSigSendType" SG_ 803 FLRObj20_CoastIndex 1;
BA_ "GenSigStartValue" SG_ 803 FLRObj20_CoastIndex 31;
BA_ "GenSigSendType" SG_ 803 FLRObj20_LongExtBack 1;
BA_ "GenSigStartValue" SG_ 803 FLRObj20_LongExtBack 1023;
BA_ "GenSigSendType" SG_ 803 FLRObj20_LongExtFrVar 1;
BA_ "GenSigStartValue" SG_ 803 FLRObj20_LongExtFrVar 255;
BA_ "GenSigSendType" SG_ 803 FLRObj20_LatAcc 1;
BA_ "GenSigStartValue" SG_ 803 FLRObj20_LatAcc 511;
BA_ "GenSigSendType" SG_ 803 FLRObj20_ObjDynClass 1;
BA_ "GenSigStartValue" SG_ 803 FLRObj20_ObjDynClass 3;
BA_ "GenSigSendType" SG_ 803 FLRObj20_LongPos 1;
BA_ "GenSigStartValue" SG_ 803 FLRObj20_LongPos 8191;
BA_ "GenSigSendType" SG_ 803 FLRObj20_ObstacleConfRestricted 1;
BA_ "GenSigStartValue" SG_ 803 FLRObj20_ObstacleConfRestricted 127;
BA_ "GenSigSendType" SG_ 803 FLRObj20_ObjDynClassRestricted 1;
BA_ "GenSigStartValue" SG_ 803 FLRObj20_ObjDynClassRestricted 3;
BA_ "GenSigSendType" SG_ 803 FLRObj20_LongVel 1;
BA_ "GenSigStartValue" SG_ 803 FLRObj20_LongVel 8191;
BA_ "GenSigSendType" SG_ 803 FLRObj20_TrackStatus 1;
BA_ "GenSigStartValue" SG_ 803 FLRObj20_TrackStatus 7;
BA_ "GenSigSendType" SG_ 803 FLRObj20_LatExtRtVar 1;
BA_ "GenSigStartValue" SG_ 803 FLRObj20_LatExtRtVar 255;
BA_ "GenSigSendType" SG_ 803 FLRObj20_CRC 1;
BA_ "GenSigStartValue" SG_ 803 FLRObj20_CRC 65535;
BA_ "E2EDataId" SG_ 803 FLRObj20_CRC 137;
BA_ "E2EDataLength" SG_ 803 FLRObj20_CRC 320;
BA_ "E2EProfile" SG_ 803 FLRObj20_CRC "P05";
BA_ "GenSigSendType" SG_ 803 FLRObj20_HeadingVar 1;
BA_ "GenSigStartValue" SG_ 803 FLRObj20_HeadingVar 255;
BA_ "GenSigSendType" SG_ 803 FLRObj20_TimeStamp 1;
BA_ "GenSigStartValue" SG_ 803 FLRObj20_TimeStamp 65535;
BA_ "GenSigSendType" SG_ 803 FLRObj20_LongAccVar 1;
BA_ "GenSigStartValue" SG_ 803 FLRObj20_LongAccVar 255;
BA_ "GenSigSendType" SG_ 803 FLRObj20_ObstacleConf 1;
BA_ "GenSigStartValue" SG_ 803 FLRObj20_ObstacleConf 127;
BA_ "GenSigSendType" SG_ 803 FLRObj20_ObjClassConf 1;
BA_ "GenSigStartValue" SG_ 803 FLRObj20_ObjClassConf 127;
BA_ "GenSigSendType" SG_ 803 FLRObj20_LongPosVar 1;
BA_ "GenSigStartValue" SG_ 803 FLRObj20_LongPosVar 255;
BA_ "GenSigSendType" SG_ 803 FLRObj20_LatPos 1;
BA_ "GenSigStartValue" SG_ 803 FLRObj20_LatPos 8191;
BA_ "GenSigSendType" SG_ 803 FLRObj20_LatVelVar 1;
BA_ "GenSigStartValue" SG_ 803 FLRObj20_LatVelVar 255;
BA_ "GenSigSendType" SG_ 802 FLRObj19_LongVelVar 1;
BA_ "GenSigStartValue" SG_ 802 FLRObj19_LongVelVar 255;
BA_ "GenSigSendType" SG_ 802 FLRObj19_LatPosVar 1;
BA_ "GenSigStartValue" SG_ 802 FLRObj19_LatPosVar 255;
BA_ "GenSigSendType" SG_ 802 FLRObj19_LatVelVar 1;
BA_ "GenSigStartValue" SG_ 802 FLRObj19_LatVelVar 255;
BA_ "GenSigSendType" SG_ 802 FLRObj19_TrackStatus 1;
BA_ "GenSigStartValue" SG_ 802 FLRObj19_TrackStatus 7;
BA_ "GenSigSendType" SG_ 802 FLRObj19_ObjClassConf 1;
BA_ "GenSigStartValue" SG_ 802 FLRObj19_ObjClassConf 127;
BA_ "GenSigSendType" SG_ 802 FLRObj19_LatExtLeft 1;
BA_ "GenSigStartValue" SG_ 802 FLRObj19_LatExtLeft 127;
BA_ "GenSigSendType" SG_ 802 FLRObj19_LongAccVar 1;
BA_ "GenSigStartValue" SG_ 802 FLRObj19_LongAccVar 255;
BA_ "GenSigSendType" SG_ 802 FLRObj19_ExistConf 1;
BA_ "GenSigStartValue" SG_ 802 FLRObj19_ExistConf 127;
BA_ "GenSigSendType" SG_ 802 FLRObj19_ObjClass 1;
BA_ "GenSigStartValue" SG_ 802 FLRObj19_ObjClass 15;
BA_ "GenSigSendType" SG_ 802 FLRObj19_CRC 1;
BA_ "GenSigStartValue" SG_ 802 FLRObj19_CRC 65535;
BA_ "E2EDataId" SG_ 802 FLRObj19_CRC 136;
BA_ "E2EDataLength" SG_ 802 FLRObj19_CRC 320;
BA_ "E2EProfile" SG_ 802 FLRObj19_CRC "P05";
BA_ "GenSigSendType" SG_ 802 FLRObj19_LongExtFront 1;
BA_ "GenSigStartValue" SG_ 802 FLRObj19_LongExtFront 1023;
BA_ "GenSigSendType" SG_ 802 FLRObj19_ObstacleConf 1;
BA_ "GenSigStartValue" SG_ 802 FLRObj19_ObstacleConf 127;
BA_ "GenSigSendType" SG_ 802 FLRObj19_LatExtRtVar 1;
BA_ "GenSigStartValue" SG_ 802 FLRObj19_LatExtRtVar 255;
BA_ "GenSigSendType" SG_ 802 FLRObj19_CoastIndex 1;
BA_ "GenSigStartValue" SG_ 802 FLRObj19_CoastIndex 31;
BA_ "GenSigSendType" SG_ 802 FLRObj19_LongVel 1;
BA_ "GenSigStartValue" SG_ 802 FLRObj19_LongVel 8191;
BA_ "GenSigSendType" SG_ 802 FLRObj19_LongExtBack 1;
BA_ "GenSigStartValue" SG_ 802 FLRObj19_LongExtBack 1023;
BA_ "GenSigSendType" SG_ 802 FLRObj19_LifeTime 1;
BA_ "GenSigStartValue" SG_ 802 FLRObj19_LifeTime 65535;
BA_ "GenSigSendType" SG_ 802 FLRObj19_ObstacleConfRestricted 1;
BA_ "GenSigStartValue" SG_ 802 FLRObj19_ObstacleConfRestricted 127;
BA_ "GenSigSendType" SG_ 802 FLRObj19_LatVel 1;
BA_ "GenSigStartValue" SG_ 802 FLRObj19_LatVel 8191;
BA_ "GenSigSendType" SG_ 802 FLRObj19_LatAccVar 1;
BA_ "GenSigStartValue" SG_ 802 FLRObj19_LatAccVar 255;
BA_ "GenSigSendType" SG_ 802 FLRObj19_LongPos 1;
BA_ "GenSigStartValue" SG_ 802 FLRObj19_LongPos 8191;
BA_ "GenSigSendType" SG_ 802 FLRObj19_Counter 1;
BA_ "GenSigStartValue" SG_ 802 FLRObj19_Counter 255;
BA_ "GenSigSendType" SG_ 802 FLRObj19_ObjDynClass 1;
BA_ "GenSigStartValue" SG_ 802 FLRObj19_ObjDynClass 3;
BA_ "GenSigSendType" SG_ 802 FLRObj19_LongPosVar 1;
BA_ "GenSigStartValue" SG_ 802 FLRObj19_LongPosVar 255;
BA_ "GenSigSendType" SG_ 802 FLRObj19_ObjDynClassRestricted 1;
BA_ "GenSigStartValue" SG_ 802 FLRObj19_ObjDynClassRestricted 3;
BA_ "GenSigSendType" SG_ 802 FLRObj19_ObjID 1;
BA_ "GenSigStartValue" SG_ 802 FLRObj19_ObjID 63;
BA_ "GenSigSendType" SG_ 802 FLRObj19_Height 1;
BA_ "GenSigStartValue" SG_ 802 FLRObj19_Height 15;
BA_ "GenSigSendType" SG_ 802 FLRObj19_LatAcc 1;
BA_ "GenSigStartValue" SG_ 802 FLRObj19_LatAcc 511;
BA_ "GenSigSendType" SG_ 802 FLRObj19_LatExtRight 1;
BA_ "GenSigStartValue" SG_ 802 FLRObj19_LatExtRight 127;
BA_ "GenSigSendType" SG_ 802 FLRObj19_LongExtFrVar 1;
BA_ "GenSigStartValue" SG_ 802 FLRObj19_LongExtFrVar 255;
BA_ "GenSigSendType" SG_ 802 FLRObj19_AsilLvl 1;
BA_ "GenSigStartValue" SG_ 802 FLRObj19_AsilLvl 3;
BA_ "GenSigSendType" SG_ 802 FLRObj19_LongExtBkVar 1;
BA_ "GenSigStartValue" SG_ 802 FLRObj19_LongExtBkVar 255;
BA_ "GenSigSendType" SG_ 802 FLRObj19_LatPos 1;
BA_ "GenSigStartValue" SG_ 802 FLRObj19_LatPos 8191;
BA_ "GenSigSendType" SG_ 802 FLRObj19_Heading 1;
BA_ "GenSigStartValue" SG_ 802 FLRObj19_Heading 2047;
BA_ "GenSigSendType" SG_ 802 FLRObj19_TimeStamp 1;
BA_ "GenSigStartValue" SG_ 802 FLRObj19_TimeStamp 65535;
BA_ "GenSigSendType" SG_ 802 FLRObj19_HeadingVar 1;
BA_ "GenSigStartValue" SG_ 802 FLRObj19_HeadingVar 255;
BA_ "GenSigSendType" SG_ 802 FLRObj19_LongAcc 1;
BA_ "GenSigStartValue" SG_ 802 FLRObj19_LongAcc 511;
BA_ "GenSigSendType" SG_ 802 FLRObj19_LatExtLeftVar 1;
BA_ "GenSigStartValue" SG_ 802 FLRObj19_LatExtLeftVar 255;
BA_ "GenSigSendType" SG_ 801 FLRObj18_LatVel 1;
BA_ "GenSigStartValue" SG_ 801 FLRObj18_LatVel 8191;
BA_ "GenSigSendType" SG_ 801 FLRObj18_AsilLvl 1;
BA_ "GenSigStartValue" SG_ 801 FLRObj18_AsilLvl 3;
BA_ "GenSigSendType" SG_ 801 FLRObj18_ObjDynClassRestricted 1;
BA_ "GenSigStartValue" SG_ 801 FLRObj18_ObjDynClassRestricted 3;
BA_ "GenSigSendType" SG_ 801 FLRObj18_TimeStamp 1;
BA_ "GenSigStartValue" SG_ 801 FLRObj18_TimeStamp 65535;
BA_ "GenSigSendType" SG_ 801 FLRObj18_Height 1;
BA_ "GenSigStartValue" SG_ 801 FLRObj18_Height 15;
BA_ "GenSigSendType" SG_ 801 FLRObj18_LongExtBkVar 1;
BA_ "GenSigStartValue" SG_ 801 FLRObj18_LongExtBkVar 255;
BA_ "GenSigSendType" SG_ 801 FLRObj18_CRC 1;
BA_ "GenSigStartValue" SG_ 801 FLRObj18_CRC 65535;
BA_ "E2EDataId" SG_ 801 FLRObj18_CRC 135;
BA_ "E2EDataLength" SG_ 801 FLRObj18_CRC 320;
BA_ "E2EProfile" SG_ 801 FLRObj18_CRC "P05";
BA_ "GenSigSendType" SG_ 801 FLRObj18_LongExtFrVar 1;
BA_ "GenSigStartValue" SG_ 801 FLRObj18_LongExtFrVar 255;
BA_ "GenSigSendType" SG_ 801 FLRObj18_LongPos 1;
BA_ "GenSigStartValue" SG_ 801 FLRObj18_LongPos 8191;
BA_ "GenSigSendType" SG_ 801 FLRObj18_TrackStatus 1;
BA_ "GenSigStartValue" SG_ 801 FLRObj18_TrackStatus 7;
BA_ "GenSigSendType" SG_ 801 FLRObj18_LatAccVar 1;
BA_ "GenSigStartValue" SG_ 801 FLRObj18_LatAccVar 255;
BA_ "GenSigSendType" SG_ 801 FLRObj18_LongExtBack 1;
BA_ "GenSigStartValue" SG_ 801 FLRObj18_LongExtBack 1023;
BA_ "GenSigSendType" SG_ 801 FLRObj18_ObjClassConf 1;
BA_ "GenSigStartValue" SG_ 801 FLRObj18_ObjClassConf 127;
BA_ "GenSigSendType" SG_ 801 FLRObj18_ObjID 1;
BA_ "GenSigStartValue" SG_ 801 FLRObj18_ObjID 63;
BA_ "GenSigSendType" SG_ 801 FLRObj18_LongExtFront 1;
BA_ "GenSigStartValue" SG_ 801 FLRObj18_LongExtFront 1023;
BA_ "GenSigSendType" SG_ 801 FLRObj18_LongAccVar 1;
BA_ "GenSigStartValue" SG_ 801 FLRObj18_LongAccVar 255;
BA_ "GenSigSendType" SG_ 801 FLRObj18_Heading 1;
BA_ "GenSigStartValue" SG_ 801 FLRObj18_Heading 2047;
BA_ "GenSigSendType" SG_ 801 FLRObj18_Counter 1;
BA_ "GenSigStartValue" SG_ 801 FLRObj18_Counter 255;
BA_ "GenSigSendType" SG_ 801 FLRObj18_LatExtLeftVar 1;
BA_ "GenSigStartValue" SG_ 801 FLRObj18_LatExtLeftVar 255;
BA_ "GenSigSendType" SG_ 801 FLRObj18_LatExtLeft 1;
BA_ "GenSigStartValue" SG_ 801 FLRObj18_LatExtLeft 127;
BA_ "GenSigSendType" SG_ 801 FLRObj18_LongVel 1;
BA_ "GenSigStartValue" SG_ 801 FLRObj18_LongVel 8191;
BA_ "GenSigSendType" SG_ 801 FLRObj18_LifeTime 1;
BA_ "GenSigStartValue" SG_ 801 FLRObj18_LifeTime 65535;
BA_ "GenSigSendType" SG_ 801 FLRObj18_LongPosVar 1;
BA_ "GenSigStartValue" SG_ 801 FLRObj18_LongPosVar 255;
BA_ "GenSigSendType" SG_ 801 FLRObj18_ObstacleConf 1;
BA_ "GenSigStartValue" SG_ 801 FLRObj18_ObstacleConf 127;
BA_ "GenSigSendType" SG_ 801 FLRObj18_LatExtRight 1;
BA_ "GenSigStartValue" SG_ 801 FLRObj18_LatExtRight 127;
BA_ "GenSigSendType" SG_ 801 FLRObj18_LongAcc 1;
BA_ "GenSigStartValue" SG_ 801 FLRObj18_LongAcc 511;
BA_ "GenSigSendType" SG_ 801 FLRObj18_ObstacleConfRestricted 1;
BA_ "GenSigStartValue" SG_ 801 FLRObj18_ObstacleConfRestricted 127;
BA_ "GenSigSendType" SG_ 801 FLRObj18_LatPos 1;
BA_ "GenSigStartValue" SG_ 801 FLRObj18_LatPos 8191;
BA_ "GenSigSendType" SG_ 801 FLRObj18_LatPosVar 1;
BA_ "GenSigStartValue" SG_ 801 FLRObj18_LatPosVar 255;
BA_ "GenSigSendType" SG_ 801 FLRObj18_LongVelVar 1;
BA_ "GenSigStartValue" SG_ 801 FLRObj18_LongVelVar 255;
BA_ "GenSigSendType" SG_ 801 FLRObj18_CoastIndex 1;
BA_ "GenSigStartValue" SG_ 801 FLRObj18_CoastIndex 31;
BA_ "GenSigSendType" SG_ 801 FLRObj18_LatAcc 1;
BA_ "GenSigStartValue" SG_ 801 FLRObj18_LatAcc 511;
BA_ "GenSigSendType" SG_ 801 FLRObj18_ExistConf 1;
BA_ "GenSigStartValue" SG_ 801 FLRObj18_ExistConf 127;
BA_ "GenSigSendType" SG_ 801 FLRObj18_LatVelVar 1;
BA_ "GenSigStartValue" SG_ 801 FLRObj18_LatVelVar 255;
BA_ "GenSigSendType" SG_ 801 FLRObj18_HeadingVar 1;
BA_ "GenSigStartValue" SG_ 801 FLRObj18_HeadingVar 255;
BA_ "GenSigSendType" SG_ 801 FLRObj18_ObjDynClass 1;
BA_ "GenSigStartValue" SG_ 801 FLRObj18_ObjDynClass 3;
BA_ "GenSigSendType" SG_ 801 FLRObj18_LatExtRtVar 1;
BA_ "GenSigStartValue" SG_ 801 FLRObj18_LatExtRtVar 255;
BA_ "GenSigSendType" SG_ 801 FLRObj18_ObjClass 1;
BA_ "GenSigStartValue" SG_ 801 FLRObj18_ObjClass 15;
BA_ "GenSigSendType" SG_ 800 FLRObj17_LatAccVar 1;
BA_ "GenSigStartValue" SG_ 800 FLRObj17_LatAccVar 255;
BA_ "GenSigSendType" SG_ 800 FLRObj17_ObstacleConf 1;
BA_ "GenSigStartValue" SG_ 800 FLRObj17_ObstacleConf 127;
BA_ "GenSigSendType" SG_ 800 FLRObj17_LifeTime 1;
BA_ "GenSigStartValue" SG_ 800 FLRObj17_LifeTime 65535;
BA_ "GenSigSendType" SG_ 800 FLRObj17_LongExtFrVar 1;
BA_ "GenSigStartValue" SG_ 800 FLRObj17_LongExtFrVar 255;
BA_ "GenSigSendType" SG_ 800 FLRObj17_LongAcc 1;
BA_ "GenSigStartValue" SG_ 800 FLRObj17_LongAcc 511;
BA_ "GenSigSendType" SG_ 800 FLRObj17_LongAccVar 1;
BA_ "GenSigStartValue" SG_ 800 FLRObj17_LongAccVar 255;
BA_ "GenSigSendType" SG_ 800 FLRObj17_LongExtBack 1;
BA_ "GenSigStartValue" SG_ 800 FLRObj17_LongExtBack 1023;
BA_ "GenSigSendType" SG_ 800 FLRObj17_LongVel 1;
BA_ "GenSigStartValue" SG_ 800 FLRObj17_LongVel 8191;
BA_ "GenSigSendType" SG_ 800 FLRObj17_LongPosVar 1;
BA_ "GenSigStartValue" SG_ 800 FLRObj17_LongPosVar 255;
BA_ "GenSigSendType" SG_ 800 FLRObj17_ObjDynClass 1;
BA_ "GenSigStartValue" SG_ 800 FLRObj17_ObjDynClass 3;
BA_ "GenSigSendType" SG_ 800 FLRObj17_LatAcc 1;
BA_ "GenSigStartValue" SG_ 800 FLRObj17_LatAcc 511;
BA_ "GenSigSendType" SG_ 800 FLRObj17_ObjDynClassRestricted 1;
BA_ "GenSigStartValue" SG_ 800 FLRObj17_ObjDynClassRestricted 3;
BA_ "GenSigSendType" SG_ 800 FLRObj17_CRC 1;
BA_ "GenSigStartValue" SG_ 800 FLRObj17_CRC 65535;
BA_ "E2EDataId" SG_ 800 FLRObj17_CRC 134;
BA_ "E2EDataLength" SG_ 800 FLRObj17_CRC 320;
BA_ "E2EProfile" SG_ 800 FLRObj17_CRC "P05";
BA_ "GenSigSendType" SG_ 800 FLRObj17_HeadingVar 1;
BA_ "GenSigStartValue" SG_ 800 FLRObj17_HeadingVar 255;
BA_ "GenSigSendType" SG_ 800 FLRObj17_Heading 1;
BA_ "GenSigStartValue" SG_ 800 FLRObj17_Heading 2047;
BA_ "GenSigSendType" SG_ 800 FLRObj17_ObstacleConfRestricted 1;
BA_ "GenSigStartValue" SG_ 800 FLRObj17_ObstacleConfRestricted 127;
BA_ "GenSigSendType" SG_ 800 FLRObj17_ExistConf 1;
BA_ "GenSigStartValue" SG_ 800 FLRObj17_ExistConf 127;
BA_ "GenSigSendType" SG_ 800 FLRObj17_TrackStatus 1;
BA_ "GenSigStartValue" SG_ 800 FLRObj17_TrackStatus 7;
BA_ "GenSigSendType" SG_ 800 FLRObj17_LongPos 1;
BA_ "GenSigStartValue" SG_ 800 FLRObj17_LongPos 8191;
BA_ "GenSigSendType" SG_ 800 FLRObj17_LongExtBkVar 1;
BA_ "GenSigStartValue" SG_ 800 FLRObj17_LongExtBkVar 255;
BA_ "GenSigSendType" SG_ 800 FLRObj17_LatPos 1;
BA_ "GenSigStartValue" SG_ 800 FLRObj17_LatPos 8191;
BA_ "GenSigSendType" SG_ 800 FLRObj17_CoastIndex 1;
BA_ "GenSigStartValue" SG_ 800 FLRObj17_CoastIndex 31;
BA_ "GenSigSendType" SG_ 800 FLRObj17_ObjClass 1;
BA_ "GenSigStartValue" SG_ 800 FLRObj17_ObjClass 15;
BA_ "GenSigSendType" SG_ 800 FLRObj17_LatPosVar 1;
BA_ "GenSigStartValue" SG_ 800 FLRObj17_LatPosVar 255;
BA_ "GenSigSendType" SG_ 800 FLRObj17_LongVelVar 1;
BA_ "GenSigStartValue" SG_ 800 FLRObj17_LongVelVar 255;
BA_ "GenSigSendType" SG_ 800 FLRObj17_LatExtLeft 1;
BA_ "GenSigStartValue" SG_ 800 FLRObj17_LatExtLeft 127;
BA_ "GenSigSendType" SG_ 800 FLRObj17_Height 1;
BA_ "GenSigStartValue" SG_ 800 FLRObj17_Height 15;
BA_ "GenSigSendType" SG_ 800 FLRObj17_LatVelVar 1;
BA_ "GenSigStartValue" SG_ 800 FLRObj17_LatVelVar 255;
BA_ "GenSigSendType" SG_ 800 FLRObj17_LatVel 1;
BA_ "GenSigStartValue" SG_ 800 FLRObj17_LatVel 8191;
BA_ "GenSigSendType" SG_ 800 FLRObj17_Counter 1;
BA_ "GenSigStartValue" SG_ 800 FLRObj17_Counter 255;
BA_ "GenSigSendType" SG_ 800 FLRObj17_LatExtRtVar 1;
BA_ "GenSigStartValue" SG_ 800 FLRObj17_LatExtRtVar 255;
BA_ "GenSigSendType" SG_ 800 FLRObj17_AsilLvl 1;
BA_ "GenSigStartValue" SG_ 800 FLRObj17_AsilLvl 3;
BA_ "GenSigSendType" SG_ 800 FLRObj17_ObjClassConf 1;
BA_ "GenSigStartValue" SG_ 800 FLRObj17_ObjClassConf 127;
BA_ "GenSigSendType" SG_ 800 FLRObj17_LongExtFront 1;
BA_ "GenSigStartValue" SG_ 800 FLRObj17_LongExtFront 1023;
BA_ "GenSigSendType" SG_ 800 FLRObj17_TimeStamp 1;
BA_ "GenSigStartValue" SG_ 800 FLRObj17_TimeStamp 65535;
BA_ "GenSigSendType" SG_ 800 FLRObj17_LatExtLeftVar 1;
BA_ "GenSigStartValue" SG_ 800 FLRObj17_LatExtLeftVar 255;
BA_ "GenSigSendType" SG_ 800 FLRObj17_ObjID 1;
BA_ "GenSigStartValue" SG_ 800 FLRObj17_ObjID 63;
BA_ "GenSigSendType" SG_ 800 FLRObj17_LatExtRight 1;
BA_ "GenSigStartValue" SG_ 800 FLRObj17_LatExtRight 127;
BA_ "GenSigSendType" SG_ 799 FLRObj16_ObstacleConfRestricted 1;
BA_ "GenSigStartValue" SG_ 799 FLRObj16_ObstacleConfRestricted 127;
BA_ "GenSigSendType" SG_ 799 FLRObj16_LongExtFrVar 1;
BA_ "GenSigStartValue" SG_ 799 FLRObj16_LongExtFrVar 255;
BA_ "GenSigSendType" SG_ 799 FLRObj16_LatVelVar 1;
BA_ "GenSigStartValue" SG_ 799 FLRObj16_LatVelVar 255;
BA_ "GenSigSendType" SG_ 799 FLRObj16_TimeStamp 1;
BA_ "GenSigStartValue" SG_ 799 FLRObj16_TimeStamp 65535;
BA_ "GenSigSendType" SG_ 799 FLRObj16_LongPosVar 1;
BA_ "GenSigStartValue" SG_ 799 FLRObj16_LongPosVar 255;
BA_ "GenSigSendType" SG_ 799 FLRObj16_LifeTime 1;
BA_ "GenSigStartValue" SG_ 799 FLRObj16_LifeTime 65535;
BA_ "GenSigSendType" SG_ 799 FLRObj16_LatAccVar 1;
BA_ "GenSigStartValue" SG_ 799 FLRObj16_LatAccVar 255;
BA_ "GenSigSendType" SG_ 799 FLRObj16_ObjDynClass 1;
BA_ "GenSigStartValue" SG_ 799 FLRObj16_ObjDynClass 3;
BA_ "GenSigSendType" SG_ 799 FLRObj16_ObjClass 1;
BA_ "GenSigStartValue" SG_ 799 FLRObj16_ObjClass 15;
BA_ "GenSigSendType" SG_ 799 FLRObj16_ObjID 1;
BA_ "GenSigStartValue" SG_ 799 FLRObj16_ObjID 63;
BA_ "GenSigSendType" SG_ 799 FLRObj16_LatAcc 1;
BA_ "GenSigStartValue" SG_ 799 FLRObj16_LatAcc 511;
BA_ "GenSigSendType" SG_ 799 FLRObj16_LongPos 1;
BA_ "GenSigStartValue" SG_ 799 FLRObj16_LongPos 8191;
BA_ "GenSigSendType" SG_ 799 FLRObj16_LatPosVar 1;
BA_ "GenSigStartValue" SG_ 799 FLRObj16_LatPosVar 255;
BA_ "GenSigSendType" SG_ 799 FLRObj16_HeadingVar 1;
BA_ "GenSigStartValue" SG_ 799 FLRObj16_HeadingVar 255;
BA_ "GenSigSendType" SG_ 799 FLRObj16_LatPos 1;
BA_ "GenSigStartValue" SG_ 799 FLRObj16_LatPos 8191;
BA_ "GenSigSendType" SG_ 799 FLRObj16_LongExtBack 1;
BA_ "GenSigStartValue" SG_ 799 FLRObj16_LongExtBack 1023;
BA_ "GenSigSendType" SG_ 799 FLRObj16_ExistConf 1;
BA_ "GenSigStartValue" SG_ 799 FLRObj16_ExistConf 127;
BA_ "GenSigSendType" SG_ 799 FLRObj16_LongExtFront 1;
BA_ "GenSigStartValue" SG_ 799 FLRObj16_LongExtFront 1023;
BA_ "GenSigSendType" SG_ 799 FLRObj16_Counter 1;
BA_ "GenSigStartValue" SG_ 799 FLRObj16_Counter 255;
BA_ "GenSigSendType" SG_ 799 FLRObj16_Height 1;
BA_ "GenSigStartValue" SG_ 799 FLRObj16_Height 15;
BA_ "GenSigSendType" SG_ 799 FLRObj16_Heading 1;
BA_ "GenSigStartValue" SG_ 799 FLRObj16_Heading 2047;
BA_ "GenSigSendType" SG_ 799 FLRObj16_LongAcc 1;
BA_ "GenSigStartValue" SG_ 799 FLRObj16_LongAcc 511;
BA_ "GenSigSendType" SG_ 799 FLRObj16_CRC 1;
BA_ "GenSigStartValue" SG_ 799 FLRObj16_CRC 65535;
BA_ "E2EDataId" SG_ 799 FLRObj16_CRC 133;
BA_ "E2EDataLength" SG_ 799 FLRObj16_CRC 320;
BA_ "E2EProfile" SG_ 799 FLRObj16_CRC "P05";
BA_ "GenSigSendType" SG_ 799 FLRObj16_LatExtRight 1;
BA_ "GenSigStartValue" SG_ 799 FLRObj16_LatExtRight 127;
BA_ "GenSigSendType" SG_ 799 FLRObj16_LatVel 1;
BA_ "GenSigStartValue" SG_ 799 FLRObj16_LatVel 8191;
BA_ "GenSigSendType" SG_ 799 FLRObj16_LongAccVar 1;
BA_ "GenSigStartValue" SG_ 799 FLRObj16_LongAccVar 255;
BA_ "GenSigSendType" SG_ 799 FLRObj16_LatExtLeft 1;
BA_ "GenSigStartValue" SG_ 799 FLRObj16_LatExtLeft 127;
BA_ "GenSigSendType" SG_ 799 FLRObj16_TrackStatus 1;
BA_ "GenSigStartValue" SG_ 799 FLRObj16_TrackStatus 7;
BA_ "GenSigSendType" SG_ 799 FLRObj16_ObjDynClassRestricted 1;
BA_ "GenSigStartValue" SG_ 799 FLRObj16_ObjDynClassRestricted 3;
BA_ "GenSigSendType" SG_ 799 FLRObj16_LatExtLeftVar 1;
BA_ "GenSigStartValue" SG_ 799 FLRObj16_LatExtLeftVar 255;
BA_ "GenSigSendType" SG_ 799 FLRObj16_AsilLvl 1;
BA_ "GenSigStartValue" SG_ 799 FLRObj16_AsilLvl 3;
BA_ "GenSigSendType" SG_ 799 FLRObj16_CoastIndex 1;
BA_ "GenSigStartValue" SG_ 799 FLRObj16_CoastIndex 31;
BA_ "GenSigSendType" SG_ 799 FLRObj16_LongVel 1;
BA_ "GenSigStartValue" SG_ 799 FLRObj16_LongVel 8191;
BA_ "GenSigSendType" SG_ 799 FLRObj16_ObstacleConf 1;
BA_ "GenSigStartValue" SG_ 799 FLRObj16_ObstacleConf 127;
BA_ "GenSigSendType" SG_ 799 FLRObj16_ObjClassConf 1;
BA_ "GenSigStartValue" SG_ 799 FLRObj16_ObjClassConf 127;
BA_ "GenSigSendType" SG_ 799 FLRObj16_LatExtRtVar 1;
BA_ "GenSigStartValue" SG_ 799 FLRObj16_LatExtRtVar 255;
BA_ "GenSigSendType" SG_ 799 FLRObj16_LongExtBkVar 1;
BA_ "GenSigStartValue" SG_ 799 FLRObj16_LongExtBkVar 255;
BA_ "GenSigSendType" SG_ 799 FLRObj16_LongVelVar 1;
BA_ "GenSigStartValue" SG_ 799 FLRObj16_LongVelVar 255;
BA_ "GenSigSendType" SG_ 798 FLRObj15_LatAccVar 1;
BA_ "GenSigStartValue" SG_ 798 FLRObj15_LatAccVar 255;
BA_ "GenSigSendType" SG_ 798 FLRObj15_Counter 1;
BA_ "GenSigStartValue" SG_ 798 FLRObj15_Counter 255;
BA_ "GenSigSendType" SG_ 798 FLRObj15_LongExtBack 1;
BA_ "GenSigStartValue" SG_ 798 FLRObj15_LongExtBack 1023;
BA_ "GenSigSendType" SG_ 798 FLRObj15_ObstacleConf 1;
BA_ "GenSigStartValue" SG_ 798 FLRObj15_ObstacleConf 127;
BA_ "GenSigSendType" SG_ 798 FLRObj15_CoastIndex 1;
BA_ "GenSigStartValue" SG_ 798 FLRObj15_CoastIndex 31;
BA_ "GenSigSendType" SG_ 798 FLRObj15_ObjDynClass 1;
BA_ "GenSigStartValue" SG_ 798 FLRObj15_ObjDynClass 3;
BA_ "GenSigSendType" SG_ 798 FLRObj15_HeadingVar 1;
BA_ "GenSigStartValue" SG_ 798 FLRObj15_HeadingVar 255;
BA_ "GenSigSendType" SG_ 798 FLRObj15_LatAcc 1;
BA_ "GenSigStartValue" SG_ 798 FLRObj15_LatAcc 511;
BA_ "GenSigSendType" SG_ 798 FLRObj15_LatExtLeftVar 1;
BA_ "GenSigStartValue" SG_ 798 FLRObj15_LatExtLeftVar 255;
BA_ "GenSigSendType" SG_ 798 FLRObj15_LongExtFrVar 1;
BA_ "GenSigStartValue" SG_ 798 FLRObj15_LongExtFrVar 255;
BA_ "GenSigSendType" SG_ 798 FLRObj15_LatExtLeft 1;
BA_ "GenSigStartValue" SG_ 798 FLRObj15_LatExtLeft 127;
BA_ "GenSigSendType" SG_ 798 FLRObj15_LatPosVar 1;
BA_ "GenSigStartValue" SG_ 798 FLRObj15_LatPosVar 255;
BA_ "GenSigSendType" SG_ 798 FLRObj15_LongExtFront 1;
BA_ "GenSigStartValue" SG_ 798 FLRObj15_LongExtFront 1023;
BA_ "GenSigSendType" SG_ 798 FLRObj15_Height 1;
BA_ "GenSigStartValue" SG_ 798 FLRObj15_Height 15;
BA_ "GenSigSendType" SG_ 798 FLRObj15_ObjClassConf 1;
BA_ "GenSigStartValue" SG_ 798 FLRObj15_ObjClassConf 127;
BA_ "GenSigSendType" SG_ 798 FLRObj15_LatExtRight 1;
BA_ "GenSigStartValue" SG_ 798 FLRObj15_LatExtRight 127;
BA_ "GenSigSendType" SG_ 798 FLRObj15_LongPosVar 1;
BA_ "GenSigStartValue" SG_ 798 FLRObj15_LongPosVar 255;
BA_ "GenSigSendType" SG_ 798 FLRObj15_ObstacleConfRestricted 1;
BA_ "GenSigStartValue" SG_ 798 FLRObj15_ObstacleConfRestricted 127;
BA_ "GenSigSendType" SG_ 798 FLRObj15_LongExtBkVar 1;
BA_ "GenSigStartValue" SG_ 798 FLRObj15_LongExtBkVar 255;
BA_ "GenSigSendType" SG_ 798 FLRObj15_LatExtRtVar 1;
BA_ "GenSigStartValue" SG_ 798 FLRObj15_LatExtRtVar 255;
BA_ "GenSigSendType" SG_ 798 FLRObj15_TrackStatus 1;
BA_ "GenSigStartValue" SG_ 798 FLRObj15_TrackStatus 7;
BA_ "GenSigSendType" SG_ 798 FLRObj15_ObjClass 1;
BA_ "GenSigStartValue" SG_ 798 FLRObj15_ObjClass 15;
BA_ "GenSigSendType" SG_ 798 FLRObj15_LatVelVar 1;
BA_ "GenSigStartValue" SG_ 798 FLRObj15_LatVelVar 255;
BA_ "GenSigSendType" SG_ 798 FLRObj15_LongAcc 1;
BA_ "GenSigStartValue" SG_ 798 FLRObj15_LongAcc 511;
BA_ "GenSigSendType" SG_ 798 FLRObj15_ObjDynClassRestricted 1;
BA_ "GenSigStartValue" SG_ 798 FLRObj15_ObjDynClassRestricted 3;
BA_ "GenSigSendType" SG_ 798 FLRObj15_Heading 1;
BA_ "GenSigStartValue" SG_ 798 FLRObj15_Heading 2047;
BA_ "GenSigSendType" SG_ 798 FLRObj15_LongVelVar 1;
BA_ "GenSigStartValue" SG_ 798 FLRObj15_LongVelVar 255;
BA_ "GenSigSendType" SG_ 798 FLRObj15_LatPos 1;
BA_ "GenSigStartValue" SG_ 798 FLRObj15_LatPos 8191;
BA_ "GenSigSendType" SG_ 798 FLRObj15_LongPos 1;
BA_ "GenSigStartValue" SG_ 798 FLRObj15_LongPos 8191;
BA_ "GenSigSendType" SG_ 798 FLRObj15_AsilLvl 1;
BA_ "GenSigStartValue" SG_ 798 FLRObj15_AsilLvl 3;
BA_ "GenSigSendType" SG_ 798 FLRObj15_ObjID 1;
BA_ "GenSigStartValue" SG_ 798 FLRObj15_ObjID 63;
BA_ "GenSigSendType" SG_ 798 FLRObj15_LongVel 1;
BA_ "GenSigStartValue" SG_ 798 FLRObj15_LongVel 8191;
BA_ "GenSigSendType" SG_ 798 FLRObj15_ExistConf 1;
BA_ "GenSigStartValue" SG_ 798 FLRObj15_ExistConf 127;
BA_ "GenSigSendType" SG_ 798 FLRObj15_LifeTime 1;
BA_ "GenSigStartValue" SG_ 798 FLRObj15_LifeTime 65535;
BA_ "GenSigSendType" SG_ 798 FLRObj15_TimeStamp 1;
BA_ "GenSigStartValue" SG_ 798 FLRObj15_TimeStamp 65535;
BA_ "GenSigSendType" SG_ 798 FLRObj15_LatVel 1;
BA_ "GenSigStartValue" SG_ 798 FLRObj15_LatVel 8191;
BA_ "GenSigSendType" SG_ 798 FLRObj15_LongAccVar 1;
BA_ "GenSigStartValue" SG_ 798 FLRObj15_LongAccVar 255;
BA_ "GenSigSendType" SG_ 798 FLRObj15_CRC 1;
BA_ "GenSigStartValue" SG_ 798 FLRObj15_CRC 65535;
BA_ "E2EDataId" SG_ 798 FLRObj15_CRC 132;
BA_ "E2EDataLength" SG_ 798 FLRObj15_CRC 320;
BA_ "E2EProfile" SG_ 798 FLRObj15_CRC "P05";
BA_REL_ "GenSigFirstTimeoutTime" BU_SG_REL_ DACU SG_ 1507 HUA_SN_Byte2 24000;
BA_REL_ "GenSigTimeoutTime" BU_SG_REL_ DACU SG_ 1507 HUA_SN_Byte2 6000;
BA_REL_ "GenSigFirstTimeoutTime" BU_SG_REL_ DACU SG_ 1507 HUA_SNPN_Byte3 24000;
BA_REL_ "GenSigTimeoutTime" BU_SG_REL_ DACU SG_ 1507 HUA_SNPN_Byte3 6000;
BA_REL_ "GenSigFirstTimeoutTime" BU_SG_REL_ DACU SG_ 1507 DiagInfoHUA 24000;
BA_REL_ "GenSigTimeoutTime" BU_SG_REL_ DACU SG_ 1507 DiagInfoHUA 6000;
BA_REL_ "GenSigFirstTimeoutTime" BU_SG_REL_ DACU SG_ 1507 HUA_SNPN_Byte2 24000;
BA_REL_ "GenSigTimeoutTime" BU_SG_REL_ DACU SG_ 1507 HUA_SNPN_Byte2 6000;
BA_REL_ "GenSigFirstTimeoutTime" BU_SG_REL_ DACU SG_ 1507 HUA_SN_Byte0 24000;
BA_REL_ "GenSigTimeoutTime" BU_SG_REL_ DACU SG_ 1507 HUA_SN_Byte0 6000;
BA_REL_ "GenSigFirstTimeoutTime" BU_SG_REL_ DACU SG_ 1507 HUA_SN_Byte3 24000;
BA_REL_ "GenSigTimeoutTime" BU_SG_REL_ DACU SG_ 1507 HUA_SN_Byte3 6000;
BA_REL_ "GenSigFirstTimeoutTime" BU_SG_REL_ DACU SG_ 1507 HUA_SNPN_Byte1 24000;
BA_REL_ "GenSigTimeoutTime" BU_SG_REL_ DACU SG_ 1507 HUA_SNPN_Byte1 6000;
BA_REL_ "GenSigFirstTimeoutTime" BU_SG_REL_ DACU SG_ 1507 HUA_SN_Byte1 24000;
BA_REL_ "GenSigTimeoutTime" BU_SG_REL_ DACU SG_ 1507 HUA_SN_Byte1 6000;
BA_REL_ "GenSigFirstTimeoutTime" BU_SG_REL_ DACU SG_ 1507 HUA_SNPN_Byte0 24000;
BA_REL_ "GenSigTimeoutTime" BU_SG_REL_ DACU SG_ 1507 HUA_SNPN_Byte0 6000;
BA_REL_ "GenSigFirstTimeoutTime" BU_SG_REL_ DACU SG_ 1507 HUA_SNPN_Byte4 24000;
BA_REL_ "GenSigTimeoutTime" BU_SG_REL_ DACU SG_ 1507 HUA_SNPN_Byte4 6000;
BA_REL_ "GenSigFirstTimeoutTime" BU_SG_REL_ DACU SG_ 1553 FLRSwVersion_Substring1 60000;
BA_REL_ "GenSigTimeoutTime" BU_SG_REL_ DACU SG_ 1553 FLRSwVersion_Substring1 60000;
BA_REL_ "GenSigFirstTimeoutTime" BU_SG_REL_ DACU SG_ 1553 FLRSwVersion_Substring3 60000;
BA_REL_ "GenSigTimeoutTime" BU_SG_REL_ DACU SG_ 1553 FLRSwVersion_Substring3 60000;
BA_REL_ "GenSigFirstTimeoutTime" BU_SG_REL_ DACU SG_ 1553 FLRSwVersion_Substring5 60000;
BA_REL_ "GenSigTimeoutTime" BU_SG_REL_ DACU SG_ 1553 FLRSwVersion_Substring5 60000;
BA_REL_ "GenSigFirstTimeoutTime" BU_SG_REL_ DACU SG_ 1553 FLRSwVersion_Substring2 60000;
BA_REL_ "GenSigTimeoutTime" BU_SG_REL_ DACU SG_ 1553 FLRSwVersion_Substring2 60000;
BA_REL_ "GenSigFirstTimeoutTime" BU_SG_REL_ DACU SG_ 1553 FLRSwVersion_Substring6 60000;
BA_REL_ "GenSigTimeoutTime" BU_SG_REL_ DACU SG_ 1553 FLRSwVersion_Substring6 60000;
BA_REL_ "GenSigFirstTimeoutTime" BU_SG_REL_ DACU SG_ 1553 FLRSwVersion_Substring7 60000;
BA_REL_ "GenSigTimeoutTime" BU_SG_REL_ DACU SG_ 1553 FLRSwVersion_Substring7 60000;
BA_REL_ "GenSigFirstTimeoutTime" BU_SG_REL_ DACU SG_ 1553 FLRSwVersion_Substring4 60000;
BA_REL_ "GenSigTimeoutTime" BU_SG_REL_ DACU SG_ 1553 FLRSwVersion_Substring4 60000;
BA_REL_ "GenSigFirstTimeoutTime" BU_SG_REL_ DACU SG_ 1553 FLRSwVersion_Substring0 60000;
BA_REL_ "GenSigTimeoutTime" BU_SG_REL_ DACU SG_ 1553 FLRSwVersion_Substring0 60000;
BA_REL_ "GenSigFirstTimeoutTime" BU_SG_REL_ DACU SG_ 859 RightRoadBoundary_Curvature 3000;
BA_REL_ "GenSigTimeoutTime" BU_SG_REL_ DACU SG_ 859 RightRoadBoundary_Curvature 100;
BA_REL_ "GenSigFirstTimeoutTime" BU_SG_REL_ DACU SG_ 859 RightRoadBoundary_LatDistVar 3000;
BA_REL_ "GenSigTimeoutTime" BU_SG_REL_ DACU SG_ 859 RightRoadBoundary_LatDistVar 100;
BA_REL_ "GenSigFirstTimeoutTime" BU_SG_REL_ DACU SG_ 859 RightRoadBoundary_Type 3000;
BA_REL_ "GenSigTimeoutTime" BU_SG_REL_ DACU SG_ 859 RightRoadBoundary_Type 100;
BA_REL_ "GenSigFirstTimeoutTime" BU_SG_REL_ DACU SG_ 859 RightRoadBoundary_CRC 3000;
BA_REL_ "GenSigTimeoutTime" BU_SG_REL_ DACU SG_ 859 RightRoadBoundary_CRC 100;
BA_REL_ "GenSigFirstTimeoutTime" BU_SG_REL_ DACU SG_ 859 RightRoadBoundary_LifeTime 3000;
BA_REL_ "GenSigTimeoutTime" BU_SG_REL_ DACU SG_ 859 RightRoadBoundary_LifeTime 100;
BA_REL_ "GenSigFirstTimeoutTime" BU_SG_REL_ DACU SG_ 859 RightRoadBoundary_TrackStatus 3000;
BA_REL_ "GenSigTimeoutTime" BU_SG_REL_ DACU SG_ 859 RightRoadBoundary_TrackStatus 100;
BA_REL_ "GenSigFirstTimeoutTime" BU_SG_REL_ DACU SG_ 859 RightRoadBoundary_HeadingAngle 3000;
BA_REL_ "GenSigTimeoutTime" BU_SG_REL_ DACU SG_ 859 RightRoadBoundary_HeadingAngle 100;
BA_REL_ "GenSigFirstTimeoutTime" BU_SG_REL_ DACU SG_ 859 RightRoadBoundary_Counter 3000;
BA_REL_ "GenSigTimeoutTime" BU_SG_REL_ DACU SG_ 859 RightRoadBoundary_Counter 100;
BA_REL_ "GenSigFirstTimeoutTime" BU_SG_REL_ DACU SG_ 859 RightRoadBoundary_LatDist 3000;
BA_REL_ "GenSigTimeoutTime" BU_SG_REL_ DACU SG_ 859 RightRoadBoundary_LatDist 100;
BA_REL_ "GenSigFirstTimeoutTime" BU_SG_REL_ DACU SG_ 859 RightRoadBoundary_TimeStamp 3000;
BA_REL_ "GenSigTimeoutTime" BU_SG_REL_ DACU SG_ 859 RightRoadBoundary_TimeStamp 100;
BA_REL_ "GenSigFirstTimeoutTime" BU_SG_REL_ DACU SG_ 859 RightRoadBoundary_CoastIndex 3000;
BA_REL_ "GenSigTimeoutTime" BU_SG_REL_ DACU SG_ 859 RightRoadBoundary_CoastIndex 100;
BA_REL_ "GenSigFirstTimeoutTime" BU_SG_REL_ DACU SG_ 859 RightRoadBoundary_Confidence 3000;
BA_REL_ "GenSigTimeoutTime" BU_SG_REL_ DACU SG_ 859 RightRoadBoundary_Confidence 100;
BA_REL_ "GenSigFirstTimeoutTime" BU_SG_REL_ DACU SG_ 859 RightRoadBoundary_CurvatureRate 3000;
BA_REL_ "GenSigTimeoutTime" BU_SG_REL_ DACU SG_ 859 RightRoadBoundary_CurvatureRate 100;
BA_REL_ "GenSigFirstTimeoutTime" BU_SG_REL_ DACU SG_ 859 RightRoadBoundary_DxStart 3000;
BA_REL_ "GenSigTimeoutTime" BU_SG_REL_ DACU SG_ 859 RightRoadBoundary_DxStart 100;
BA_REL_ "GenSigFirstTimeoutTime" BU_SG_REL_ DACU SG_ 859 RightRoadBoundary_DxEnd 3000;
BA_REL_ "GenSigTimeoutTime" BU_SG_REL_ DACU SG_ 859 RightRoadBoundary_DxEnd 100;
BA_REL_ "GenSigFirstTimeoutTime" BU_SG_REL_ DACU SG_ 806 FLRObj23_ObjClassConf 3000;
BA_REL_ "GenSigTimeoutTime" BU_SG_REL_ DACU SG_ 806 FLRObj23_ObjClassConf 100;
BA_REL_ "GenSigFirstTimeoutTime" BU_SG_REL_ DACU SG_ 806 FLRObj23_LongPosVar 3000;
BA_REL_ "GenSigTimeoutTime" BU_SG_REL_ DACU SG_ 806 FLRObj23_LongPosVar 100;
BA_REL_ "GenSigFirstTimeoutTime" BU_SG_REL_ DACU SG_ 806 FLRObj23_LongAccVar 3000;
BA_REL_ "GenSigTimeoutTime" BU_SG_REL_ DACU SG_ 806 FLRObj23_LongAccVar 100;
BA_REL_ "GenSigFirstTimeoutTime" BU_SG_REL_ DACU SG_ 806 FLRObj23_TrackStatus 3000;
BA_REL_ "GenSigTimeoutTime" BU_SG_REL_ DACU SG_ 806 FLRObj23_TrackStatus 100;
BA_REL_ "GenSigFirstTimeoutTime" BU_SG_REL_ DACU SG_ 806 FLRObj23_ObjID 3000;
BA_REL_ "GenSigTimeoutTime" BU_SG_REL_ DACU SG_ 806 FLRObj23_ObjID 100;
BA_REL_ "GenSigFirstTimeoutTime" BU_SG_REL_ DACU SG_ 806 FLRObj23_ObjDynClassRestricted 3000;
BA_REL_ "GenSigTimeoutTime" BU_SG_REL_ DACU SG_ 806 FLRObj23_ObjDynClassRestricted 100;
BA_REL_ "GenSigFirstTimeoutTime" BU_SG_REL_ DACU SG_ 806 FLRObj23_LatExtRtVar 3000;
BA_REL_ "GenSigTimeoutTime" BU_SG_REL_ DACU SG_ 806 FLRObj23_LatExtRtVar 100;
BA_REL_ "GenSigFirstTimeoutTime" BU_SG_REL_ DACU SG_ 806 FLRObj23_ExistConf 3000;
BA_REL_ "GenSigTimeoutTime" BU_SG_REL_ DACU SG_ 806 FLRObj23_ExistConf 100;
BA_REL_ "GenSigFirstTimeoutTime" BU_SG_REL_ DACU SG_ 806 FLRObj23_HeadingVar 3000;
BA_REL_ "GenSigTimeoutTime" BU_SG_REL_ DACU SG_ 806 FLRObj23_HeadingVar 100;
BA_REL_ "GenSigFirstTimeoutTime" BU_SG_REL_ DACU SG_ 806 FLRObj23_LongExtFront 3000;
BA_REL_ "GenSigTimeoutTime" BU_SG_REL_ DACU SG_ 806 FLRObj23_LongExtFront 100;
BA_REL_ "GenSigFirstTimeoutTime" BU_SG_REL_ DACU SG_ 806 FLRObj23_Counter 3000;
BA_REL_ "GenSigTimeoutTime" BU_SG_REL_ DACU SG_ 806 FLRObj23_Counter 100;
BA_REL_ "GenSigFirstTimeoutTime" BU_SG_REL_ DACU SG_ 806 FLRObj23_LatExtLeft 3000;
BA_REL_ "GenSigTimeoutTime" BU_SG_REL_ DACU SG_ 806 FLRObj23_LatExtLeft 100;
BA_REL_ "GenSigFirstTimeoutTime" BU_SG_REL_ DACU SG_ 806 FLRObj23_ObstacleConfRestricted 3000;
BA_REL_ "GenSigTimeoutTime" BU_SG_REL_ DACU SG_ 806 FLRObj23_ObstacleConfRestricted 100;
BA_REL_ "GenSigFirstTimeoutTime" BU_SG_REL_ DACU SG_ 806 FLRObj23_LatExtRight 3000;
BA_REL_ "GenSigTimeoutTime" BU_SG_REL_ DACU SG_ 806 FLRObj23_LatExtRight 100;
BA_REL_ "GenSigFirstTimeoutTime" BU_SG_REL_ DACU SG_ 806 FLRObj23_LatVelVar 3000;
BA_REL_ "GenSigTimeoutTime" BU_SG_REL_ DACU SG_ 806 FLRObj23_LatVelVar 100;
BA_REL_ "GenSigFirstTimeoutTime" BU_SG_REL_ DACU SG_ 806 FLRObj23_LongExtBack 3000;
BA_REL_ "GenSigTimeoutTime" BU_SG_REL_ DACU SG_ 806 FLRObj23_LongExtBack 100;
BA_REL_ "GenSigFirstTimeoutTime" BU_SG_REL_ DACU SG_ 806 FLRObj23_LongVel 3000;
BA_REL_ "GenSigTimeoutTime" BU_SG_REL_ DACU SG_ 806 FLRObj23_LongVel 100;
BA_REL_ "GenSigFirstTimeoutTime" BU_SG_REL_ DACU SG_ 806 FLRObj23_LatPosVar 3000;
BA_REL_ "GenSigTimeoutTime" BU_SG_REL_ DACU SG_ 806 FLRObj23_LatPosVar 100;
BA_REL_ "GenSigFirstTimeoutTime" BU_SG_REL_ DACU SG_ 806 FLRObj23_LatAcc 3000;
BA_REL_ "GenSigTimeoutTime" BU_SG_REL_ DACU SG_ 806 FLRObj23_LatAcc 100;
BA_REL_ "GenSigFirstTimeoutTime" BU_SG_REL_ DACU SG_ 806 FLRObj23_ObstacleConf 3000;
BA_REL_ "GenSigTimeoutTime" BU_SG_REL_ DACU SG_ 806 FLRObj23_ObstacleConf 100;
BA_REL_ "GenSigFirstTimeoutTime" BU_SG_REL_ DACU SG_ 806 FLRObj23_LatPos 3000;
BA_REL_ "GenSigTimeoutTime" BU_SG_REL_ DACU SG_ 806 FLRObj23_LatPos 100;
BA_REL_ "GenSigFirstTimeoutTime" BU_SG_REL_ DACU SG_ 806 FLRObj23_LatVel 3000;
BA_REL_ "GenSigTimeoutTime" BU_SG_REL_ DACU SG_ 806 FLRObj23_LatVel 100;
BA_REL_ "GenSigFirstTimeoutTime" BU_SG_REL_ DACU SG_ 806 FLRObj23_TimeStamp 3000;
BA_REL_ "GenSigTimeoutTime" BU_SG_REL_ DACU SG_ 806 FLRObj23_TimeStamp 100;
BA_REL_ "GenSigFirstTimeoutTime" BU_SG_REL_ DACU SG_ 806 FLRObj23_Heading 3000;
BA_REL_ "GenSigTimeoutTime" BU_SG_REL_ DACU SG_ 806 FLRObj23_Heading 100;
BA_REL_ "GenSigFirstTimeoutTime" BU_SG_REL_ DACU SG_ 806 FLRObj23_CRC 3000;
BA_REL_ "GenSigTimeoutTime" BU_SG_REL_ DACU SG_ 806 FLRObj23_CRC 100;
BA_REL_ "GenSigFirstTimeoutTime" BU_SG_REL_ DACU SG_ 806 FLRObj23_ObjDynClass 3000;
BA_REL_ "GenSigTimeoutTime" BU_SG_REL_ DACU SG_ 806 FLRObj23_ObjDynClass 100;
BA_REL_ "GenSigFirstTimeoutTime" BU_SG_REL_ DACU SG_ 806 FLRObj23_Height 3000;
BA_REL_ "GenSigTimeoutTime" BU_SG_REL_ DACU SG_ 806 FLRObj23_Height 100;
BA_REL_ "GenSigFirstTimeoutTime" BU_SG_REL_ DACU SG_ 806 FLRObj23_LongExtBkVar 3000;
BA_REL_ "GenSigTimeoutTime" BU_SG_REL_ DACU SG_ 806 FLRObj23_LongExtBkVar 100;
BA_REL_ "GenSigFirstTimeoutTime" BU_SG_REL_ DACU SG_ 806 FLRObj23_CoastIndex 3000;
BA_REL_ "GenSigTimeoutTime" BU_SG_REL_ DACU SG_ 806 FLRObj23_CoastIndex 100;
BA_REL_ "GenSigFirstTimeoutTime" BU_SG_REL_ DACU SG_ 806 FLRObj23_LifeTime 3000;
BA_REL_ "GenSigTimeoutTime" BU_SG_REL_ DACU SG_ 806 FLRObj23_LifeTime 100;
BA_REL_ "GenSigFirstTimeoutTime" BU_SG_REL_ DACU SG_ 806 FLRObj23_LongPos 3000;
BA_REL_ "GenSigTimeoutTime" BU_SG_REL_ DACU SG_ 806 FLRObj23_LongPos 100;
BA_REL_ "GenSigFirstTimeoutTime" BU_SG_REL_ DACU SG_ 806 FLRObj23_LongVelVar 3000;
BA_REL_ "GenSigTimeoutTime" BU_SG_REL_ DACU SG_ 806 FLRObj23_LongVelVar 100;
BA_REL_ "GenSigFirstTimeoutTime" BU_SG_REL_ DACU SG_ 806 FLRObj23_LatAccVar 3000;
BA_REL_ "GenSigTimeoutTime" BU_SG_REL_ DACU SG_ 806 FLRObj23_LatAccVar 100;
BA_REL_ "GenSigFirstTimeoutTime" BU_SG_REL_ DACU SG_ 806 FLRObj23_LongExtFrVar 3000;
BA_REL_ "GenSigTimeoutTime" BU_SG_REL_ DACU SG_ 806 FLRObj23_LongExtFrVar 100;
BA_REL_ "GenSigFirstTimeoutTime" BU_SG_REL_ DACU SG_ 806 FLRObj23_AsilLvl 3000;
BA_REL_ "GenSigTimeoutTime" BU_SG_REL_ DACU SG_ 806 FLRObj23_AsilLvl 100;
BA_REL_ "GenSigFirstTimeoutTime" BU_SG_REL_ DACU SG_ 806 FLRObj23_LongAcc 3000;
BA_REL_ "GenSigTimeoutTime" BU_SG_REL_ DACU SG_ 806 FLRObj23_LongAcc 100;
BA_REL_ "GenSigFirstTimeoutTime" BU_SG_REL_ DACU SG_ 806 FLRObj23_LatExtLeftVar 3000;
BA_REL_ "GenSigTimeoutTime" BU_SG_REL_ DACU SG_ 806 FLRObj23_LatExtLeftVar 100;
BA_REL_ "GenSigFirstTimeoutTime" BU_SG_REL_ DACU SG_ 806 FLRObj23_ObjClass 3000;
BA_REL_ "GenSigTimeoutTime" BU_SG_REL_ DACU SG_ 806 FLRObj23_ObjClass 100;
BA_REL_ "GenSigFirstTimeoutTime" BU_SG_REL_ DACU SG_ 805 FLRObj22_TimeStamp 3000;
BA_REL_ "GenSigTimeoutTime" BU_SG_REL_ DACU SG_ 805 FLRObj22_TimeStamp 100;
BA_REL_ "GenSigFirstTimeoutTime" BU_SG_REL_ DACU SG_ 805 FLRObj22_LatAcc 3000;
BA_REL_ "GenSigTimeoutTime" BU_SG_REL_ DACU SG_ 805 FLRObj22_LatAcc 100;
BA_REL_ "GenSigFirstTimeoutTime" BU_SG_REL_ DACU SG_ 805 FLRObj22_LatAccVar 3000;
BA_REL_ "GenSigTimeoutTime" BU_SG_REL_ DACU SG_ 805 FLRObj22_LatAccVar 100;
BA_REL_ "GenSigFirstTimeoutTime" BU_SG_REL_ DACU SG_ 805 FLRObj22_LongPosVar 3000;
BA_REL_ "GenSigTimeoutTime" BU_SG_REL_ DACU SG_ 805 FLRObj22_LongPosVar 100;
BA_REL_ "GenSigFirstTimeoutTime" BU_SG_REL_ DACU SG_ 805 FLRObj22_ExistConf 3000;
BA_REL_ "GenSigTimeoutTime" BU_SG_REL_ DACU SG_ 805 FLRObj22_ExistConf 100;
BA_REL_ "GenSigFirstTimeoutTime" BU_SG_REL_ DACU SG_ 805 FLRObj22_LongVel 3000;
BA_REL_ "GenSigTimeoutTime" BU_SG_REL_ DACU SG_ 805 FLRObj22_LongVel 100;
BA_REL_ "GenSigFirstTimeoutTime" BU_SG_REL_ DACU SG_ 805 FLRObj22_ObjID 3000;
BA_REL_ "GenSigTimeoutTime" BU_SG_REL_ DACU SG_ 805 FLRObj22_ObjID 100;
BA_REL_ "GenSigFirstTimeoutTime" BU_SG_REL_ DACU SG_ 805 FLRObj22_Counter 3000;
BA_REL_ "GenSigTimeoutTime" BU_SG_REL_ DACU SG_ 805 FLRObj22_Counter 100;
BA_REL_ "GenSigFirstTimeoutTime" BU_SG_REL_ DACU SG_ 805 FLRObj22_LongVelVar 3000;
BA_REL_ "GenSigTimeoutTime" BU_SG_REL_ DACU SG_ 805 FLRObj22_LongVelVar 100;
BA_REL_ "GenSigFirstTimeoutTime" BU_SG_REL_ DACU SG_ 805 FLRObj22_LongAccVar 3000;
BA_REL_ "GenSigTimeoutTime" BU_SG_REL_ DACU SG_ 805 FLRObj22_LongAccVar 100;
BA_REL_ "GenSigFirstTimeoutTime" BU_SG_REL_ DACU SG_ 805 FLRObj22_LongExtBkVar 3000;
BA_REL_ "GenSigTimeoutTime" BU_SG_REL_ DACU SG_ 805 FLRObj22_LongExtBkVar 100;
BA_REL_ "GenSigFirstTimeoutTime" BU_SG_REL_ DACU SG_ 805 FLRObj22_LatVelVar 3000;
BA_REL_ "GenSigTimeoutTime" BU_SG_REL_ DACU SG_ 805 FLRObj22_LatVelVar 100;
BA_REL_ "GenSigFirstTimeoutTime" BU_SG_REL_ DACU SG_ 805 FLRObj22_LatExtRtVar 3000;
BA_REL_ "GenSigTimeoutTime" BU_SG_REL_ DACU SG_ 805 FLRObj22_LatExtRtVar 100;
BA_REL_ "GenSigFirstTimeoutTime" BU_SG_REL_ DACU SG_ 805 FLRObj22_ObjDynClassRestricted 3000;
BA_REL_ "GenSigTimeoutTime" BU_SG_REL_ DACU SG_ 805 FLRObj22_ObjDynClassRestricted 100;
BA_REL_ "GenSigFirstTimeoutTime" BU_SG_REL_ DACU SG_ 805 FLRObj22_LongAcc 3000;
BA_REL_ "GenSigTimeoutTime" BU_SG_REL_ DACU SG_ 805 FLRObj22_LongAcc 100;
BA_REL_ "GenSigFirstTimeoutTime" BU_SG_REL_ DACU SG_ 805 FLRObj22_AsilLvl 3000;
BA_REL_ "GenSigTimeoutTime" BU_SG_REL_ DACU SG_ 805 FLRObj22_AsilLvl 100;
BA_REL_ "GenSigFirstTimeoutTime" BU_SG_REL_ DACU SG_ 805 FLRObj22_LongExtFront 3000;
BA_REL_ "GenSigTimeoutTime" BU_SG_REL_ DACU SG_ 805 FLRObj22_LongExtFront 100;
BA_REL_ "GenSigFirstTimeoutTime" BU_SG_REL_ DACU SG_ 805 FLRObj22_HeadingVar 3000;
BA_REL_ "GenSigTimeoutTime" BU_SG_REL_ DACU SG_ 805 FLRObj22_HeadingVar 100;
BA_REL_ "GenSigFirstTimeoutTime" BU_SG_REL_ DACU SG_ 805 FLRObj22_CRC 3000;
BA_REL_ "GenSigTimeoutTime" BU_SG_REL_ DACU SG_ 805 FLRObj22_CRC 100;
BA_REL_ "GenSigFirstTimeoutTime" BU_SG_REL_ DACU SG_ 805 FLRObj22_LatVel 3000;
BA_REL_ "GenSigTimeoutTime" BU_SG_REL_ DACU SG_ 805 FLRObj22_LatVel 100;
BA_REL_ "GenSigFirstTimeoutTime" BU_SG_REL_ DACU SG_ 805 FLRObj22_CoastIndex 3000;
BA_REL_ "GenSigTimeoutTime" BU_SG_REL_ DACU SG_ 805 FLRObj22_CoastIndex 100;
BA_REL_ "GenSigFirstTimeoutTime" BU_SG_REL_ DACU SG_ 805 FLRObj22_Heading 3000;
BA_REL_ "GenSigTimeoutTime" BU_SG_REL_ DACU SG_ 805 FLRObj22_Heading 100;
BA_REL_ "GenSigFirstTimeoutTime" BU_SG_REL_ DACU SG_ 805 FLRObj22_LifeTime 3000;
BA_REL_ "GenSigTimeoutTime" BU_SG_REL_ DACU SG_ 805 FLRObj22_LifeTime 100;
BA_REL_ "GenSigFirstTimeoutTime" BU_SG_REL_ DACU SG_ 805 FLRObj22_LatPosVar 3000;
BA_REL_ "GenSigTimeoutTime" BU_SG_REL_ DACU SG_ 805 FLRObj22_LatPosVar 100;
BA_REL_ "GenSigFirstTimeoutTime" BU_SG_REL_ DACU SG_ 805 FLRObj22_ObstacleConfRestricted 3000;
BA_REL_ "GenSigTimeoutTime" BU_SG_REL_ DACU SG_ 805 FLRObj22_ObstacleConfRestricted 100;
BA_REL_ "GenSigFirstTimeoutTime" BU_SG_REL_ DACU SG_ 805 FLRObj22_LatPos 3000;
BA_REL_ "GenSigTimeoutTime" BU_SG_REL_ DACU SG_ 805 FLRObj22_LatPos 100;
BA_REL_ "GenSigFirstTimeoutTime" BU_SG_REL_ DACU SG_ 805 FLRObj22_Height 3000;
BA_REL_ "GenSigTimeoutTime" BU_SG_REL_ DACU SG_ 805 FLRObj22_Height 100;
BA_REL_ "GenSigFirstTimeoutTime" BU_SG_REL_ DACU SG_ 805 FLRObj22_LongPos 3000;
BA_REL_ "GenSigTimeoutTime" BU_SG_REL_ DACU SG_ 805 FLRObj22_LongPos 100;
BA_REL_ "GenSigFirstTimeoutTime" BU_SG_REL_ DACU SG_ 805 FLRObj22_ObjClassConf 3000;
BA_REL_ "GenSigTimeoutTime" BU_SG_REL_ DACU SG_ 805 FLRObj22_ObjClassConf 100;
BA_REL_ "GenSigFirstTimeoutTime" BU_SG_REL_ DACU SG_ 805 FLRObj22_TrackStatus 3000;
BA_REL_ "GenSigTimeoutTime" BU_SG_REL_ DACU SG_ 805 FLRObj22_TrackStatus 100;
BA_REL_ "GenSigFirstTimeoutTime" BU_SG_REL_ DACU SG_ 805 FLRObj22_ObjClass 3000;
BA_REL_ "GenSigTimeoutTime" BU_SG_REL_ DACU SG_ 805 FLRObj22_ObjClass 100;
BA_REL_ "GenSigFirstTimeoutTime" BU_SG_REL_ DACU SG_ 805 FLRObj22_LongExtFrVar 3000;
BA_REL_ "GenSigTimeoutTime" BU_SG_REL_ DACU SG_ 805 FLRObj22_LongExtFrVar 100;
BA_REL_ "GenSigFirstTimeoutTime" BU_SG_REL_ DACU SG_ 805 FLRObj22_LongExtBack 3000;
BA_REL_ "GenSigTimeoutTime" BU_SG_REL_ DACU SG_ 805 FLRObj22_LongExtBack 100;
BA_REL_ "GenSigFirstTimeoutTime" BU_SG_REL_ DACU SG_ 805 FLRObj22_ObstacleConf 3000;
BA_REL_ "GenSigTimeoutTime" BU_SG_REL_ DACU SG_ 805 FLRObj22_ObstacleConf 100;
BA_REL_ "GenSigFirstTimeoutTime" BU_SG_REL_ DACU SG_ 805 FLRObj22_LatExtLeftVar 3000;
BA_REL_ "GenSigTimeoutTime" BU_SG_REL_ DACU SG_ 805 FLRObj22_LatExtLeftVar 100;
BA_REL_ "GenSigFirstTimeoutTime" BU_SG_REL_ DACU SG_ 805 FLRObj22_LatExtLeft 3000;
BA_REL_ "GenSigTimeoutTime" BU_SG_REL_ DACU SG_ 805 FLRObj22_LatExtLeft 100;
BA_REL_ "GenSigFirstTimeoutTime" BU_SG_REL_ DACU SG_ 805 FLRObj22_LatExtRight 3000;
BA_REL_ "GenSigTimeoutTime" BU_SG_REL_ DACU SG_ 805 FLRObj22_LatExtRight 100;
BA_REL_ "GenSigFirstTimeoutTime" BU_SG_REL_ DACU SG_ 805 FLRObj22_ObjDynClass 3000;
BA_REL_ "GenSigTimeoutTime" BU_SG_REL_ DACU SG_ 805 FLRObj22_ObjDynClass 100;
BA_REL_ "GenSigFirstTimeoutTime" BU_SG_REL_ DACU SG_ 804 FLRObj21_LatAccVar 3000;
BA_REL_ "GenSigTimeoutTime" BU_SG_REL_ DACU SG_ 804 FLRObj21_LatAccVar 100;
BA_REL_ "GenSigFirstTimeoutTime" BU_SG_REL_ DACU SG_ 804 FLRObj21_TrackStatus 3000;
BA_REL_ "GenSigTimeoutTime" BU_SG_REL_ DACU SG_ 804 FLRObj21_TrackStatus 100;
BA_REL_ "GenSigFirstTimeoutTime" BU_SG_REL_ DACU SG_ 804 FLRObj21_LongPos 3000;
BA_REL_ "GenSigTimeoutTime" BU_SG_REL_ DACU SG_ 804 FLRObj21_LongPos 100;
BA_REL_ "GenSigFirstTimeoutTime" BU_SG_REL_ DACU SG_ 804 FLRObj21_LongAcc 3000;
BA_REL_ "GenSigTimeoutTime" BU_SG_REL_ DACU SG_ 804 FLRObj21_LongAcc 100;
BA_REL_ "GenSigFirstTimeoutTime" BU_SG_REL_ DACU SG_ 804 FLRObj21_Height 3000;
BA_REL_ "GenSigTimeoutTime" BU_SG_REL_ DACU SG_ 804 FLRObj21_Height 100;
BA_REL_ "GenSigFirstTimeoutTime" BU_SG_REL_ DACU SG_ 804 FLRObj21_LatVel 3000;
BA_REL_ "GenSigTimeoutTime" BU_SG_REL_ DACU SG_ 804 FLRObj21_LatVel 100;
BA_REL_ "GenSigFirstTimeoutTime" BU_SG_REL_ DACU SG_ 804 FLRObj21_LatPos 3000;
BA_REL_ "GenSigTimeoutTime" BU_SG_REL_ DACU SG_ 804 FLRObj21_LatPos 100;
BA_REL_ "GenSigFirstTimeoutTime" BU_SG_REL_ DACU SG_ 804 FLRObj21_LatExtRtVar 3000;
BA_REL_ "GenSigTimeoutTime" BU_SG_REL_ DACU SG_ 804 FLRObj21_LatExtRtVar 100;
BA_REL_ "GenSigFirstTimeoutTime" BU_SG_REL_ DACU SG_ 804 FLRObj21_ObstacleConfRestricted 3000;
BA_REL_ "GenSigTimeoutTime" BU_SG_REL_ DACU SG_ 804 FLRObj21_ObstacleConfRestricted 100;
BA_REL_ "GenSigFirstTimeoutTime" BU_SG_REL_ DACU SG_ 804 FLRObj21_ObstacleConf 3000;
BA_REL_ "GenSigTimeoutTime" BU_SG_REL_ DACU SG_ 804 FLRObj21_ObstacleConf 100;
BA_REL_ "GenSigFirstTimeoutTime" BU_SG_REL_ DACU SG_ 804 FLRObj21_LongExtBack 3000;
BA_REL_ "GenSigTimeoutTime" BU_SG_REL_ DACU SG_ 804 FLRObj21_LongExtBack 100;
BA_REL_ "GenSigFirstTimeoutTime" BU_SG_REL_ DACU SG_ 804 FLRObj21_LongAccVar 3000;
BA_REL_ "GenSigTimeoutTime" BU_SG_REL_ DACU SG_ 804 FLRObj21_LongAccVar 100;
BA_REL_ "GenSigFirstTimeoutTime" BU_SG_REL_ DACU SG_ 804 FLRObj21_ObjClass 3000;
BA_REL_ "GenSigTimeoutTime" BU_SG_REL_ DACU SG_ 804 FLRObj21_ObjClass 100;
BA_REL_ "GenSigFirstTimeoutTime" BU_SG_REL_ DACU SG_ 804 FLRObj21_ObjClassConf 3000;
BA_REL_ "GenSigTimeoutTime" BU_SG_REL_ DACU SG_ 804 FLRObj21_ObjClassConf 100;
BA_REL_ "GenSigFirstTimeoutTime" BU_SG_REL_ DACU SG_ 804 FLRObj21_LongExtBkVar 3000;
BA_REL_ "GenSigTimeoutTime" BU_SG_REL_ DACU SG_ 804 FLRObj21_LongExtBkVar 100;
BA_REL_ "GenSigFirstTimeoutTime" BU_SG_REL_ DACU SG_ 804 FLRObj21_LatPosVar 3000;
BA_REL_ "GenSigTimeoutTime" BU_SG_REL_ DACU SG_ 804 FLRObj21_LatPosVar 100;
BA_REL_ "GenSigFirstTimeoutTime" BU_SG_REL_ DACU SG_ 804 FLRObj21_LongVelVar 3000;
BA_REL_ "GenSigTimeoutTime" BU_SG_REL_ DACU SG_ 804 FLRObj21_LongVelVar 100;
BA_REL_ "GenSigFirstTimeoutTime" BU_SG_REL_ DACU SG_ 804 FLRObj21_LongPosVar 3000;
BA_REL_ "GenSigTimeoutTime" BU_SG_REL_ DACU SG_ 804 FLRObj21_LongPosVar 100;
BA_REL_ "GenSigFirstTimeoutTime" BU_SG_REL_ DACU SG_ 804 FLRObj21_LatExtRight 3000;
BA_REL_ "GenSigTimeoutTime" BU_SG_REL_ DACU SG_ 804 FLRObj21_LatExtRight 100;
BA_REL_ "GenSigFirstTimeoutTime" BU_SG_REL_ DACU SG_ 804 FLRObj21_ObjID 3000;
BA_REL_ "GenSigTimeoutTime" BU_SG_REL_ DACU SG_ 804 FLRObj21_ObjID 100;
BA_REL_ "GenSigFirstTimeoutTime" BU_SG_REL_ DACU SG_ 804 FLRObj21_CoastIndex 3000;
BA_REL_ "GenSigTimeoutTime" BU_SG_REL_ DACU SG_ 804 FLRObj21_CoastIndex 100;
BA_REL_ "GenSigFirstTimeoutTime" BU_SG_REL_ DACU SG_ 804 FLRObj21_AsilLvl 3000;
BA_REL_ "GenSigTimeoutTime" BU_SG_REL_ DACU SG_ 804 FLRObj21_AsilLvl 100;
BA_REL_ "GenSigFirstTimeoutTime" BU_SG_REL_ DACU SG_ 804 FLRObj21_LatAcc 3000;
BA_REL_ "GenSigTimeoutTime" BU_SG_REL_ DACU SG_ 804 FLRObj21_LatAcc 100;
BA_REL_ "GenSigFirstTimeoutTime" BU_SG_REL_ DACU SG_ 804 FLRObj21_LatVelVar 3000;
BA_REL_ "GenSigTimeoutTime" BU_SG_REL_ DACU SG_ 804 FLRObj21_LatVelVar 100;
BA_REL_ "GenSigFirstTimeoutTime" BU_SG_REL_ DACU SG_ 804 FLRObj21_TimeStamp 3000;
BA_REL_ "GenSigTimeoutTime" BU_SG_REL_ DACU SG_ 804 FLRObj21_TimeStamp 100;
BA_REL_ "GenSigFirstTimeoutTime" BU_SG_REL_ DACU SG_ 804 FLRObj21_ExistConf 3000;
BA_REL_ "GenSigTimeoutTime" BU_SG_REL_ DACU SG_ 804 FLRObj21_ExistConf 100;
BA_REL_ "GenSigFirstTimeoutTime" BU_SG_REL_ DACU SG_ 804 FLRObj21_ObjDynClassRestricted 3000;
BA_REL_ "GenSigTimeoutTime" BU_SG_REL_ DACU SG_ 804 FLRObj21_ObjDynClassRestricted 100;
BA_REL_ "GenSigFirstTimeoutTime" BU_SG_REL_ DACU SG_ 804 FLRObj21_LongExtFrVar 3000;
BA_REL_ "GenSigTimeoutTime" BU_SG_REL_ DACU SG_ 804 FLRObj21_LongExtFrVar 100;
BA_REL_ "GenSigFirstTimeoutTime" BU_SG_REL_ DACU SG_ 804 FLRObj21_LongVel 3000;
BA_REL_ "GenSigTimeoutTime" BU_SG_REL_ DACU SG_ 804 FLRObj21_LongVel 100;
BA_REL_ "GenSigFirstTimeoutTime" BU_SG_REL_ DACU SG_ 804 FLRObj21_ObjDynClass 3000;
BA_REL_ "GenSigTimeoutTime" BU_SG_REL_ DACU SG_ 804 FLRObj21_ObjDynClass 100;
BA_REL_ "GenSigFirstTimeoutTime" BU_SG_REL_ DACU SG_ 804 FLRObj21_Counter 3000;
BA_REL_ "GenSigTimeoutTime" BU_SG_REL_ DACU SG_ 804 FLRObj21_Counter 100;
BA_REL_ "GenSigFirstTimeoutTime" BU_SG_REL_ DACU SG_ 804 FLRObj21_LifeTime 3000;
BA_REL_ "GenSigTimeoutTime" BU_SG_REL_ DACU SG_ 804 FLRObj21_LifeTime 100;
BA_REL_ "GenSigFirstTimeoutTime" BU_SG_REL_ DACU SG_ 804 FLRObj21_LongExtFront 3000;
BA_REL_ "GenSigTimeoutTime" BU_SG_REL_ DACU SG_ 804 FLRObj21_LongExtFront 100;
BA_REL_ "GenSigFirstTimeoutTime" BU_SG_REL_ DACU SG_ 804 FLRObj21_LatExtLeft 3000;
BA_REL_ "GenSigTimeoutTime" BU_SG_REL_ DACU SG_ 804 FLRObj21_LatExtLeft 100;
BA_REL_ "GenSigFirstTimeoutTime" BU_SG_REL_ DACU SG_ 804 FLRObj21_LatExtLeftVar 3000;
BA_REL_ "GenSigTimeoutTime" BU_SG_REL_ DACU SG_ 804 FLRObj21_LatExtLeftVar 100;
BA_REL_ "GenSigFirstTimeoutTime" BU_SG_REL_ DACU SG_ 804 FLRObj21_HeadingVar 3000;
BA_REL_ "GenSigTimeoutTime" BU_SG_REL_ DACU SG_ 804 FLRObj21_HeadingVar 100;
BA_REL_ "GenSigFirstTimeoutTime" BU_SG_REL_ DACU SG_ 804 FLRObj21_Heading 3000;
BA_REL_ "GenSigTimeoutTime" BU_SG_REL_ DACU SG_ 804 FLRObj21_Heading 100;
BA_REL_ "GenSigFirstTimeoutTime" BU_SG_REL_ DACU SG_ 804 FLRObj21_CRC 3000;
BA_REL_ "GenSigTimeoutTime" BU_SG_REL_ DACU SG_ 804 FLRObj21_CRC 100;
BA_REL_ "GenSigFirstTimeoutTime" BU_SG_REL_ DACU SG_ 803 FLRObj20_ExistConf 3000;
BA_REL_ "GenSigTimeoutTime" BU_SG_REL_ DACU SG_ 803 FLRObj20_ExistConf 100;
BA_REL_ "GenSigFirstTimeoutTime" BU_SG_REL_ DACU SG_ 803 FLRObj20_ObjClass 3000;
BA_REL_ "GenSigTimeoutTime" BU_SG_REL_ DACU SG_ 803 FLRObj20_ObjClass 100;
BA_REL_ "GenSigFirstTimeoutTime" BU_SG_REL_ DACU SG_ 803 FLRObj20_LongVelVar 3000;
BA_REL_ "GenSigTimeoutTime" BU_SG_REL_ DACU SG_ 803 FLRObj20_LongVelVar 100;
BA_REL_ "GenSigFirstTimeoutTime" BU_SG_REL_ DACU SG_ 803 FLRObj20_LongExtBkVar 3000;
BA_REL_ "GenSigTimeoutTime" BU_SG_REL_ DACU SG_ 803 FLRObj20_LongExtBkVar 100;
BA_REL_ "GenSigFirstTimeoutTime" BU_SG_REL_ DACU SG_ 803 FLRObj20_Heading 3000;
BA_REL_ "GenSigTimeoutTime" BU_SG_REL_ DACU SG_ 803 FLRObj20_Heading 100;
BA_REL_ "GenSigFirstTimeoutTime" BU_SG_REL_ DACU SG_ 803 FLRObj20_LatExtRight 3000;
BA_REL_ "GenSigTimeoutTime" BU_SG_REL_ DACU SG_ 803 FLRObj20_LatExtRight 100;
BA_REL_ "GenSigFirstTimeoutTime" BU_SG_REL_ DACU SG_ 803 FLRObj20_LongAcc 3000;
BA_REL_ "GenSigTimeoutTime" BU_SG_REL_ DACU SG_ 803 FLRObj20_LongAcc 100;
BA_REL_ "GenSigFirstTimeoutTime" BU_SG_REL_ DACU SG_ 803 FLRObj20_LatExtLeftVar 3000;
BA_REL_ "GenSigTimeoutTime" BU_SG_REL_ DACU SG_ 803 FLRObj20_LatExtLeftVar 100;
BA_REL_ "GenSigFirstTimeoutTime" BU_SG_REL_ DACU SG_ 803 FLRObj20_AsilLvl 3000;
BA_REL_ "GenSigTimeoutTime" BU_SG_REL_ DACU SG_ 803 FLRObj20_AsilLvl 100;
BA_REL_ "GenSigFirstTimeoutTime" BU_SG_REL_ DACU SG_ 803 FLRObj20_LatPosVar 3000;
BA_REL_ "GenSigTimeoutTime" BU_SG_REL_ DACU SG_ 803 FLRObj20_LatPosVar 100;
BA_REL_ "GenSigFirstTimeoutTime" BU_SG_REL_ DACU SG_ 803 FLRObj20_LatExtLeft 3000;
BA_REL_ "GenSigTimeoutTime" BU_SG_REL_ DACU SG_ 803 FLRObj20_LatExtLeft 100;
BA_REL_ "GenSigFirstTimeoutTime" BU_SG_REL_ DACU SG_ 803 FLRObj20_Height 3000;
BA_REL_ "GenSigTimeoutTime" BU_SG_REL_ DACU SG_ 803 FLRObj20_Height 100;
BA_REL_ "GenSigFirstTimeoutTime" BU_SG_REL_ DACU SG_ 803 FLRObj20_LatAccVar 3000;
BA_REL_ "GenSigTimeoutTime" BU_SG_REL_ DACU SG_ 803 FLRObj20_LatAccVar 100;
BA_REL_ "GenSigFirstTimeoutTime" BU_SG_REL_ DACU SG_ 803 FLRObj20_LatVel 3000;
BA_REL_ "GenSigTimeoutTime" BU_SG_REL_ DACU SG_ 803 FLRObj20_LatVel 100;
BA_REL_ "GenSigFirstTimeoutTime" BU_SG_REL_ DACU SG_ 803 FLRObj20_ObjID 3000;
BA_REL_ "GenSigTimeoutTime" BU_SG_REL_ DACU SG_ 803 FLRObj20_ObjID 100;
BA_REL_ "GenSigFirstTimeoutTime" BU_SG_REL_ DACU SG_ 803 FLRObj20_LifeTime 3000;
BA_REL_ "GenSigTimeoutTime" BU_SG_REL_ DACU SG_ 803 FLRObj20_LifeTime 100;
BA_REL_ "GenSigFirstTimeoutTime" BU_SG_REL_ DACU SG_ 803 FLRObj20_LongExtFront 3000;
BA_REL_ "GenSigTimeoutTime" BU_SG_REL_ DACU SG_ 803 FLRObj20_LongExtFront 100;
BA_REL_ "GenSigFirstTimeoutTime" BU_SG_REL_ DACU SG_ 803 FLRObj20_Counter 3000;
BA_REL_ "GenSigTimeoutTime" BU_SG_REL_ DACU SG_ 803 FLRObj20_Counter 100;
BA_REL_ "GenSigFirstTimeoutTime" BU_SG_REL_ DACU SG_ 803 FLRObj20_CoastIndex 3000;
BA_REL_ "GenSigTimeoutTime" BU_SG_REL_ DACU SG_ 803 FLRObj20_CoastIndex 100;
BA_REL_ "GenSigFirstTimeoutTime" BU_SG_REL_ DACU SG_ 803 FLRObj20_LongExtBack 3000;
BA_REL_ "GenSigTimeoutTime" BU_SG_REL_ DACU SG_ 803 FLRObj20_LongExtBack 100;
BA_REL_ "GenSigFirstTimeoutTime" BU_SG_REL_ DACU SG_ 803 FLRObj20_LongExtFrVar 3000;
BA_REL_ "GenSigTimeoutTime" BU_SG_REL_ DACU SG_ 803 FLRObj20_LongExtFrVar 100;
BA_REL_ "GenSigFirstTimeoutTime" BU_SG_REL_ DACU SG_ 803 FLRObj20_LatAcc 3000;
BA_REL_ "GenSigTimeoutTime" BU_SG_REL_ DACU SG_ 803 FLRObj20_LatAcc 100;
BA_REL_ "GenSigFirstTimeoutTime" BU_SG_REL_ DACU SG_ 803 FLRObj20_ObjDynClass 3000;
BA_REL_ "GenSigTimeoutTime" BU_SG_REL_ DACU SG_ 803 FLRObj20_ObjDynClass 100;
BA_REL_ "GenSigFirstTimeoutTime" BU_SG_REL_ DACU SG_ 803 FLRObj20_LongPos 3000;
BA_REL_ "GenSigTimeoutTime" BU_SG_REL_ DACU SG_ 803 FLRObj20_LongPos 100;
BA_REL_ "GenSigFirstTimeoutTime" BU_SG_REL_ DACU SG_ 803 FLRObj20_ObstacleConfRestricted 3000;
BA_REL_ "GenSigTimeoutTime" BU_SG_REL_ DACU SG_ 803 FLRObj20_ObstacleConfRestricted 100;
BA_REL_ "GenSigFirstTimeoutTime" BU_SG_REL_ DACU SG_ 803 FLRObj20_ObjDynClassRestricted 3000;
BA_REL_ "GenSigTimeoutTime" BU_SG_REL_ DACU SG_ 803 FLRObj20_ObjDynClassRestricted 100;
BA_REL_ "GenSigFirstTimeoutTime" BU_SG_REL_ DACU SG_ 803 FLRObj20_LongVel 3000;
BA_REL_ "GenSigTimeoutTime" BU_SG_REL_ DACU SG_ 803 FLRObj20_LongVel 100;
BA_REL_ "GenSigFirstTimeoutTime" BU_SG_REL_ DACU SG_ 803 FLRObj20_TrackStatus 3000;
BA_REL_ "GenSigTimeoutTime" BU_SG_REL_ DACU SG_ 803 FLRObj20_TrackStatus 100;
BA_REL_ "GenSigFirstTimeoutTime" BU_SG_REL_ DACU SG_ 803 FLRObj20_LatExtRtVar 3000;
BA_REL_ "GenSigTimeoutTime" BU_SG_REL_ DACU SG_ 803 FLRObj20_LatExtRtVar 100;
BA_REL_ "GenSigFirstTimeoutTime" BU_SG_REL_ DACU SG_ 803 FLRObj20_CRC 3000;
BA_REL_ "GenSigTimeoutTime" BU_SG_REL_ DACU SG_ 803 FLRObj20_CRC 100;
BA_REL_ "GenSigFirstTimeoutTime" BU_SG_REL_ DACU SG_ 803 FLRObj20_HeadingVar 3000;
BA_REL_ "GenSigTimeoutTime" BU_SG_REL_ DACU SG_ 803 FLRObj20_HeadingVar 100;
BA_REL_ "GenSigFirstTimeoutTime" BU_SG_REL_ DACU SG_ 803 FLRObj20_TimeStamp 3000;
BA_REL_ "GenSigTimeoutTime" BU_SG_REL_ DACU SG_ 803 FLRObj20_TimeStamp 100;
BA_REL_ "GenSigFirstTimeoutTime" BU_SG_REL_ DACU SG_ 803 FLRObj20_LongAccVar 3000;
BA_REL_ "GenSigTimeoutTime" BU_SG_REL_ DACU SG_ 803 FLRObj20_LongAccVar 100;
BA_REL_ "GenSigFirstTimeoutTime" BU_SG_REL_ DACU SG_ 803 FLRObj20_ObstacleConf 3000;
BA_REL_ "GenSigTimeoutTime" BU_SG_REL_ DACU SG_ 803 FLRObj20_ObstacleConf 100;
BA_REL_ "GenSigFirstTimeoutTime" BU_SG_REL_ DACU SG_ 803 FLRObj20_ObjClassConf 3000;
BA_REL_ "GenSigTimeoutTime" BU_SG_REL_ DACU SG_ 803 FLRObj20_ObjClassConf 100;
BA_REL_ "GenSigFirstTimeoutTime" BU_SG_REL_ DACU SG_ 803 FLRObj20_LongPosVar 3000;
BA_REL_ "GenSigTimeoutTime" BU_SG_REL_ DACU SG_ 803 FLRObj20_LongPosVar 100;
BA_REL_ "GenSigFirstTimeoutTime" BU_SG_REL_ DACU SG_ 803 FLRObj20_LatPos 3000;
BA_REL_ "GenSigTimeoutTime" BU_SG_REL_ DACU SG_ 803 FLRObj20_LatPos 100;
BA_REL_ "GenSigFirstTimeoutTime" BU_SG_REL_ DACU SG_ 803 FLRObj20_LatVelVar 3000;
BA_REL_ "GenSigTimeoutTime" BU_SG_REL_ DACU SG_ 803 FLRObj20_LatVelVar 100;
BA_REL_ "GenSigFirstTimeoutTime" BU_SG_REL_ DACU SG_ 802 FLRObj19_LongVelVar 3000;
BA_REL_ "GenSigTimeoutTime" BU_SG_REL_ DACU SG_ 802 FLRObj19_LongVelVar 100;
BA_REL_ "GenSigFirstTimeoutTime" BU_SG_REL_ DACU SG_ 802 FLRObj19_LatPosVar 3000;
BA_REL_ "GenSigTimeoutTime" BU_SG_REL_ DACU SG_ 802 FLRObj19_LatPosVar 100;
BA_REL_ "GenSigFirstTimeoutTime" BU_SG_REL_ DACU SG_ 802 FLRObj19_LatVelVar 3000;
BA_REL_ "GenSigTimeoutTime" BU_SG_REL_ DACU SG_ 802 FLRObj19_LatVelVar 100;
BA_REL_ "GenSigFirstTimeoutTime" BU_SG_REL_ DACU SG_ 802 FLRObj19_TrackStatus 3000;
BA_REL_ "GenSigTimeoutTime" BU_SG_REL_ DACU SG_ 802 FLRObj19_TrackStatus 100;
BA_REL_ "GenSigFirstTimeoutTime" BU_SG_REL_ DACU SG_ 802 FLRObj19_ObjClassConf 3000;
BA_REL_ "GenSigTimeoutTime" BU_SG_REL_ DACU SG_ 802 FLRObj19_ObjClassConf 100;
BA_REL_ "GenSigFirstTimeoutTime" BU_SG_REL_ DACU SG_ 802 FLRObj19_LatExtLeft 3000;
BA_REL_ "GenSigTimeoutTime" BU_SG_REL_ DACU SG_ 802 FLRObj19_LatExtLeft 100;
BA_REL_ "GenSigFirstTimeoutTime" BU_SG_REL_ DACU SG_ 802 FLRObj19_LongAccVar 3000;
BA_REL_ "GenSigTimeoutTime" BU_SG_REL_ DACU SG_ 802 FLRObj19_LongAccVar 100;
BA_REL_ "GenSigFirstTimeoutTime" BU_SG_REL_ DACU SG_ 802 FLRObj19_ExistConf 3000;
BA_REL_ "GenSigTimeoutTime" BU_SG_REL_ DACU SG_ 802 FLRObj19_ExistConf 100;
BA_REL_ "GenSigFirstTimeoutTime" BU_SG_REL_ DACU SG_ 802 FLRObj19_ObjClass 3000;
BA_REL_ "GenSigTimeoutTime" BU_SG_REL_ DACU SG_ 802 FLRObj19_ObjClass 100;
BA_REL_ "GenSigFirstTimeoutTime" BU_SG_REL_ DACU SG_ 802 FLRObj19_CRC 3000;
BA_REL_ "GenSigTimeoutTime" BU_SG_REL_ DACU SG_ 802 FLRObj19_CRC 100;
BA_REL_ "GenSigFirstTimeoutTime" BU_SG_REL_ DACU SG_ 802 FLRObj19_LongExtFront 3000;
BA_REL_ "GenSigTimeoutTime" BU_SG_REL_ DACU SG_ 802 FLRObj19_LongExtFront 100;
BA_REL_ "GenSigFirstTimeoutTime" BU_SG_REL_ DACU SG_ 802 FLRObj19_ObstacleConf 3000;
BA_REL_ "GenSigTimeoutTime" BU_SG_REL_ DACU SG_ 802 FLRObj19_ObstacleConf 100;
BA_REL_ "GenSigFirstTimeoutTime" BU_SG_REL_ DACU SG_ 802 FLRObj19_LatExtRtVar 3000;
BA_REL_ "GenSigTimeoutTime" BU_SG_REL_ DACU SG_ 802 FLRObj19_LatExtRtVar 100;
BA_REL_ "GenSigFirstTimeoutTime" BU_SG_REL_ DACU SG_ 802 FLRObj19_CoastIndex 3000;
BA_REL_ "GenSigTimeoutTime" BU_SG_REL_ DACU SG_ 802 FLRObj19_CoastIndex 100;
BA_REL_ "GenSigFirstTimeoutTime" BU_SG_REL_ DACU SG_ 802 FLRObj19_LongVel 3000;
BA_REL_ "GenSigTimeoutTime" BU_SG_REL_ DACU SG_ 802 FLRObj19_LongVel 100;
BA_REL_ "GenSigFirstTimeoutTime" BU_SG_REL_ DACU SG_ 802 FLRObj19_LongExtBack 3000;
BA_REL_ "GenSigTimeoutTime" BU_SG_REL_ DACU SG_ 802 FLRObj19_LongExtBack 100;
BA_REL_ "GenSigFirstTimeoutTime" BU_SG_REL_ DACU SG_ 802 FLRObj19_LifeTime 3000;
BA_REL_ "GenSigTimeoutTime" BU_SG_REL_ DACU SG_ 802 FLRObj19_LifeTime 100;
BA_REL_ "GenSigFirstTimeoutTime" BU_SG_REL_ DACU SG_ 802 FLRObj19_ObstacleConfRestricted 3000;
BA_REL_ "GenSigTimeoutTime" BU_SG_REL_ DACU SG_ 802 FLRObj19_ObstacleConfRestricted 100;
BA_REL_ "GenSigFirstTimeoutTime" BU_SG_REL_ DACU SG_ 802 FLRObj19_LatVel 3000;
BA_REL_ "GenSigTimeoutTime" BU_SG_REL_ DACU SG_ 802 FLRObj19_LatVel 100;
BA_REL_ "GenSigFirstTimeoutTime" BU_SG_REL_ DACU SG_ 802 FLRObj19_LatAccVar 3000;
BA_REL_ "GenSigTimeoutTime" BU_SG_REL_ DACU SG_ 802 FLRObj19_LatAccVar 100;
BA_REL_ "GenSigFirstTimeoutTime" BU_SG_REL_ DACU SG_ 802 FLRObj19_LongPos 3000;
BA_REL_ "GenSigTimeoutTime" BU_SG_REL_ DACU SG_ 802 FLRObj19_LongPos 100;
BA_REL_ "GenSigFirstTimeoutTime" BU_SG_REL_ DACU SG_ 802 FLRObj19_Counter 3000;
BA_REL_ "GenSigTimeoutTime" BU_SG_REL_ DACU SG_ 802 FLRObj19_Counter 100;
BA_REL_ "GenSigFirstTimeoutTime" BU_SG_REL_ DACU SG_ 802 FLRObj19_ObjDynClass 3000;
BA_REL_ "GenSigTimeoutTime" BU_SG_REL_ DACU SG_ 802 FLRObj19_ObjDynClass 100;
BA_REL_ "GenSigFirstTimeoutTime" BU_SG_REL_ DACU SG_ 802 FLRObj19_LongPosVar 3000;
BA_REL_ "GenSigTimeoutTime" BU_SG_REL_ DACU SG_ 802 FLRObj19_LongPosVar 100;
BA_REL_ "GenSigFirstTimeoutTime" BU_SG_REL_ DACU SG_ 802 FLRObj19_ObjDynClassRestricted 3000;
BA_REL_ "GenSigTimeoutTime" BU_SG_REL_ DACU SG_ 802 FLRObj19_ObjDynClassRestricted 100;
BA_REL_ "GenSigFirstTimeoutTime" BU_SG_REL_ DACU SG_ 802 FLRObj19_ObjID 3000;
BA_REL_ "GenSigTimeoutTime" BU_SG_REL_ DACU SG_ 802 FLRObj19_ObjID 100;
BA_REL_ "GenSigFirstTimeoutTime" BU_SG_REL_ DACU SG_ 802 FLRObj19_Height 3000;
BA_REL_ "GenSigTimeoutTime" BU_SG_REL_ DACU SG_ 802 FLRObj19_Height 100;
BA_REL_ "GenSigFirstTimeoutTime" BU_SG_REL_ DACU SG_ 802 FLRObj19_LatAcc 3000;
BA_REL_ "GenSigTimeoutTime" BU_SG_REL_ DACU SG_ 802 FLRObj19_LatAcc 100;
BA_REL_ "GenSigFirstTimeoutTime" BU_SG_REL_ DACU SG_ 802 FLRObj19_LatExtRight 3000;
BA_REL_ "GenSigTimeoutTime" BU_SG_REL_ DACU SG_ 802 FLRObj19_LatExtRight 100;
BA_REL_ "GenSigFirstTimeoutTime" BU_SG_REL_ DACU SG_ 802 FLRObj19_LongExtFrVar 3000;
BA_REL_ "GenSigTimeoutTime" BU_SG_REL_ DACU SG_ 802 FLRObj19_LongExtFrVar 100;
BA_REL_ "GenSigFirstTimeoutTime" BU_SG_REL_ DACU SG_ 802 FLRObj19_AsilLvl 3000;
BA_REL_ "GenSigTimeoutTime" BU_SG_REL_ DACU SG_ 802 FLRObj19_AsilLvl 100;
BA_REL_ "GenSigFirstTimeoutTime" BU_SG_REL_ DACU SG_ 802 FLRObj19_LongExtBkVar 3000;
BA_REL_ "GenSigTimeoutTime" BU_SG_REL_ DACU SG_ 802 FLRObj19_LongExtBkVar 100;
BA_REL_ "GenSigFirstTimeoutTime" BU_SG_REL_ DACU SG_ 802 FLRObj19_LatPos 3000;
BA_REL_ "GenSigTimeoutTime" BU_SG_REL_ DACU SG_ 802 FLRObj19_LatPos 100;
BA_REL_ "GenSigFirstTimeoutTime" BU_SG_REL_ DACU SG_ 802 FLRObj19_Heading 3000;
BA_REL_ "GenSigTimeoutTime" BU_SG_REL_ DACU SG_ 802 FLRObj19_Heading 100;
BA_REL_ "GenSigFirstTimeoutTime" BU_SG_REL_ DACU SG_ 802 FLRObj19_TimeStamp 3000;
BA_REL_ "GenSigTimeoutTime" BU_SG_REL_ DACU SG_ 802 FLRObj19_TimeStamp 100;
BA_REL_ "GenSigFirstTimeoutTime" BU_SG_REL_ DACU SG_ 802 FLRObj19_HeadingVar 3000;
BA_REL_ "GenSigTimeoutTime" BU_SG_REL_ DACU SG_ 802 FLRObj19_HeadingVar 100;
BA_REL_ "GenSigFirstTimeoutTime" BU_SG_REL_ DACU SG_ 802 FLRObj19_LongAcc 3000;
BA_REL_ "GenSigTimeoutTime" BU_SG_REL_ DACU SG_ 802 FLRObj19_LongAcc 100;
BA_REL_ "GenSigFirstTimeoutTime" BU_SG_REL_ DACU SG_ 802 FLRObj19_LatExtLeftVar 3000;
BA_REL_ "GenSigTimeoutTime" BU_SG_REL_ DACU SG_ 802 FLRObj19_LatExtLeftVar 100;
BA_REL_ "GenSigFirstTimeoutTime" BU_SG_REL_ DACU SG_ 801 FLRObj18_LatVel 3000;
BA_REL_ "GenSigTimeoutTime" BU_SG_REL_ DACU SG_ 801 FLRObj18_LatVel 100;
BA_REL_ "GenSigFirstTimeoutTime" BU_SG_REL_ DACU SG_ 801 FLRObj18_AsilLvl 3000;
BA_REL_ "GenSigTimeoutTime" BU_SG_REL_ DACU SG_ 801 FLRObj18_AsilLvl 100;
BA_REL_ "GenSigFirstTimeoutTime" BU_SG_REL_ DACU SG_ 801 FLRObj18_ObjDynClassRestricted 3000;
BA_REL_ "GenSigTimeoutTime" BU_SG_REL_ DACU SG_ 801 FLRObj18_ObjDynClassRestricted 100;
BA_REL_ "GenSigFirstTimeoutTime" BU_SG_REL_ DACU SG_ 801 FLRObj18_TimeStamp 3000;
BA_REL_ "GenSigTimeoutTime" BU_SG_REL_ DACU SG_ 801 FLRObj18_TimeStamp 100;
BA_REL_ "GenSigFirstTimeoutTime" BU_SG_REL_ DACU SG_ 801 FLRObj18_Height 3000;
BA_REL_ "GenSigTimeoutTime" BU_SG_REL_ DACU SG_ 801 FLRObj18_Height 100;
BA_REL_ "GenSigFirstTimeoutTime" BU_SG_REL_ DACU SG_ 801 FLRObj18_LongExtBkVar 3000;
BA_REL_ "GenSigTimeoutTime" BU_SG_REL_ DACU SG_ 801 FLRObj18_LongExtBkVar 100;
BA_REL_ "GenSigFirstTimeoutTime" BU_SG_REL_ DACU SG_ 801 FLRObj18_CRC 3000;
BA_REL_ "GenSigTimeoutTime" BU_SG_REL_ DACU SG_ 801 FLRObj18_CRC 100;
BA_REL_ "GenSigFirstTimeoutTime" BU_SG_REL_ DACU SG_ 801 FLRObj18_LongExtFrVar 3000;
BA_REL_ "GenSigTimeoutTime" BU_SG_REL_ DACU SG_ 801 FLRObj18_LongExtFrVar 100;
BA_REL_ "GenSigFirstTimeoutTime" BU_SG_REL_ DACU SG_ 801 FLRObj18_LongPos 3000;
BA_REL_ "GenSigTimeoutTime" BU_SG_REL_ DACU SG_ 801 FLRObj18_LongPos 100;
BA_REL_ "GenSigFirstTimeoutTime" BU_SG_REL_ DACU SG_ 801 FLRObj18_TrackStatus 3000;
BA_REL_ "GenSigTimeoutTime" BU_SG_REL_ DACU SG_ 801 FLRObj18_TrackStatus 100;
BA_REL_ "GenSigFirstTimeoutTime" BU_SG_REL_ DACU SG_ 801 FLRObj18_LatAccVar 3000;
BA_REL_ "GenSigTimeoutTime" BU_SG_REL_ DACU SG_ 801 FLRObj18_LatAccVar 100;
BA_REL_ "GenSigFirstTimeoutTime" BU_SG_REL_ DACU SG_ 801 FLRObj18_LongExtBack 3000;
BA_REL_ "GenSigTimeoutTime" BU_SG_REL_ DACU SG_ 801 FLRObj18_LongExtBack 100;
BA_REL_ "GenSigFirstTimeoutTime" BU_SG_REL_ DACU SG_ 801 FLRObj18_ObjClassConf 3000;
BA_REL_ "GenSigTimeoutTime" BU_SG_REL_ DACU SG_ 801 FLRObj18_ObjClassConf 100;
BA_REL_ "GenSigFirstTimeoutTime" BU_SG_REL_ DACU SG_ 801 FLRObj18_ObjID 3000;
BA_REL_ "GenSigTimeoutTime" BU_SG_REL_ DACU SG_ 801 FLRObj18_ObjID 100;
BA_REL_ "GenSigFirstTimeoutTime" BU_SG_REL_ DACU SG_ 801 FLRObj18_LongExtFront 3000;
BA_REL_ "GenSigTimeoutTime" BU_SG_REL_ DACU SG_ 801 FLRObj18_LongExtFront 100;
BA_REL_ "GenSigFirstTimeoutTime" BU_SG_REL_ DACU SG_ 801 FLRObj18_LongAccVar 3000;
BA_REL_ "GenSigTimeoutTime" BU_SG_REL_ DACU SG_ 801 FLRObj18_LongAccVar 100;
BA_REL_ "GenSigFirstTimeoutTime" BU_SG_REL_ DACU SG_ 801 FLRObj18_Heading 3000;
BA_REL_ "GenSigTimeoutTime" BU_SG_REL_ DACU SG_ 801 FLRObj18_Heading 100;
BA_REL_ "GenSigFirstTimeoutTime" BU_SG_REL_ DACU SG_ 801 FLRObj18_Counter 3000;
BA_REL_ "GenSigTimeoutTime" BU_SG_REL_ DACU SG_ 801 FLRObj18_Counter 100;
BA_REL_ "GenSigFirstTimeoutTime" BU_SG_REL_ DACU SG_ 801 FLRObj18_LatExtLeftVar 3000;
BA_REL_ "GenSigTimeoutTime" BU_SG_REL_ DACU SG_ 801 FLRObj18_LatExtLeftVar 100;
BA_REL_ "GenSigFirstTimeoutTime" BU_SG_REL_ DACU SG_ 801 FLRObj18_LatExtLeft 3000;
BA_REL_ "GenSigTimeoutTime" BU_SG_REL_ DACU SG_ 801 FLRObj18_LatExtLeft 100;
BA_REL_ "GenSigFirstTimeoutTime" BU_SG_REL_ DACU SG_ 801 FLRObj18_LongVel 3000;
BA_REL_ "GenSigTimeoutTime" BU_SG_REL_ DACU SG_ 801 FLRObj18_LongVel 100;
BA_REL_ "GenSigFirstTimeoutTime" BU_SG_REL_ DACU SG_ 801 FLRObj18_LifeTime 3000;
BA_REL_ "GenSigTimeoutTime" BU_SG_REL_ DACU SG_ 801 FLRObj18_LifeTime 100;
BA_REL_ "GenSigFirstTimeoutTime" BU_SG_REL_ DACU SG_ 801 FLRObj18_LongPosVar 3000;
BA_REL_ "GenSigTimeoutTime" BU_SG_REL_ DACU SG_ 801 FLRObj18_LongPosVar 100;
BA_REL_ "GenSigFirstTimeoutTime" BU_SG_REL_ DACU SG_ 801 FLRObj18_ObstacleConf 3000;
BA_REL_ "GenSigTimeoutTime" BU_SG_REL_ DACU SG_ 801 FLRObj18_ObstacleConf 100;
BA_REL_ "GenSigFirstTimeoutTime" BU_SG_REL_ DACU SG_ 801 FLRObj18_LatExtRight 3000;
BA_REL_ "GenSigTimeoutTime" BU_SG_REL_ DACU SG_ 801 FLRObj18_LatExtRight 100;
BA_REL_ "GenSigFirstTimeoutTime" BU_SG_REL_ DACU SG_ 801 FLRObj18_LongAcc 3000;
BA_REL_ "GenSigTimeoutTime" BU_SG_REL_ DACU SG_ 801 FLRObj18_LongAcc 100;
BA_REL_ "GenSigFirstTimeoutTime" BU_SG_REL_ DACU SG_ 801 FLRObj18_ObstacleConfRestricted 3000;
BA_REL_ "GenSigTimeoutTime" BU_SG_REL_ DACU SG_ 801 FLRObj18_ObstacleConfRestricted 100;
BA_REL_ "GenSigFirstTimeoutTime" BU_SG_REL_ DACU SG_ 801 FLRObj18_LatPos 3000;
BA_REL_ "GenSigTimeoutTime" BU_SG_REL_ DACU SG_ 801 FLRObj18_LatPos 100;
BA_REL_ "GenSigFirstTimeoutTime" BU_SG_REL_ DACU SG_ 801 FLRObj18_LatPosVar 3000;
BA_REL_ "GenSigTimeoutTime" BU_SG_REL_ DACU SG_ 801 FLRObj18_LatPosVar 100;
BA_REL_ "GenSigFirstTimeoutTime" BU_SG_REL_ DACU SG_ 801 FLRObj18_LongVelVar 3000;
BA_REL_ "GenSigTimeoutTime" BU_SG_REL_ DACU SG_ 801 FLRObj18_LongVelVar 100;
BA_REL_ "GenSigFirstTimeoutTime" BU_SG_REL_ DACU SG_ 801 FLRObj18_CoastIndex 3000;
BA_REL_ "GenSigTimeoutTime" BU_SG_REL_ DACU SG_ 801 FLRObj18_CoastIndex 100;
BA_REL_ "GenSigFirstTimeoutTime" BU_SG_REL_ DACU SG_ 801 FLRObj18_LatAcc 3000;
BA_REL_ "GenSigTimeoutTime" BU_SG_REL_ DACU SG_ 801 FLRObj18_LatAcc 100;
BA_REL_ "GenSigFirstTimeoutTime" BU_SG_REL_ DACU SG_ 801 FLRObj18_ExistConf 3000;
BA_REL_ "GenSigTimeoutTime" BU_SG_REL_ DACU SG_ 801 FLRObj18_ExistConf 100;
BA_REL_ "GenSigFirstTimeoutTime" BU_SG_REL_ DACU SG_ 801 FLRObj18_LatVelVar 3000;
BA_REL_ "GenSigTimeoutTime" BU_SG_REL_ DACU SG_ 801 FLRObj18_LatVelVar 100;
BA_REL_ "GenSigFirstTimeoutTime" BU_SG_REL_ DACU SG_ 801 FLRObj18_HeadingVar 3000;
BA_REL_ "GenSigTimeoutTime" BU_SG_REL_ DACU SG_ 801 FLRObj18_HeadingVar 100;
BA_REL_ "GenSigFirstTimeoutTime" BU_SG_REL_ DACU SG_ 801 FLRObj18_ObjDynClass 3000;
BA_REL_ "GenSigTimeoutTime" BU_SG_REL_ DACU SG_ 801 FLRObj18_ObjDynClass 100;
BA_REL_ "GenSigFirstTimeoutTime" BU_SG_REL_ DACU SG_ 801 FLRObj18_LatExtRtVar 3000;
BA_REL_ "GenSigTimeoutTime" BU_SG_REL_ DACU SG_ 801 FLRObj18_LatExtRtVar 100;
BA_REL_ "GenSigFirstTimeoutTime" BU_SG_REL_ DACU SG_ 801 FLRObj18_ObjClass 3000;
BA_REL_ "GenSigTimeoutTime" BU_SG_REL_ DACU SG_ 801 FLRObj18_ObjClass 100;
BA_REL_ "GenSigFirstTimeoutTime" BU_SG_REL_ DACU SG_ 800 FLRObj17_LatAccVar 3000;
BA_REL_ "GenSigTimeoutTime" BU_SG_REL_ DACU SG_ 800 FLRObj17_LatAccVar 100;
BA_REL_ "GenSigFirstTimeoutTime" BU_SG_REL_ DACU SG_ 800 FLRObj17_ObstacleConf 3000;
BA_REL_ "GenSigTimeoutTime" BU_SG_REL_ DACU SG_ 800 FLRObj17_ObstacleConf 100;
BA_REL_ "GenSigFirstTimeoutTime" BU_SG_REL_ DACU SG_ 800 FLRObj17_LifeTime 3000;
BA_REL_ "GenSigTimeoutTime" BU_SG_REL_ DACU SG_ 800 FLRObj17_LifeTime 100;
BA_REL_ "GenSigFirstTimeoutTime" BU_SG_REL_ DACU SG_ 800 FLRObj17_LongExtFrVar 3000;
BA_REL_ "GenSigTimeoutTime" BU_SG_REL_ DACU SG_ 800 FLRObj17_LongExtFrVar 100;
BA_REL_ "GenSigFirstTimeoutTime" BU_SG_REL_ DACU SG_ 800 FLRObj17_LongAcc 3000;
BA_REL_ "GenSigTimeoutTime" BU_SG_REL_ DACU SG_ 800 FLRObj17_LongAcc 100;
BA_REL_ "GenSigFirstTimeoutTime" BU_SG_REL_ DACU SG_ 800 FLRObj17_LongAccVar 3000;
BA_REL_ "GenSigTimeoutTime" BU_SG_REL_ DACU SG_ 800 FLRObj17_LongAccVar 100;
BA_REL_ "GenSigFirstTimeoutTime" BU_SG_REL_ DACU SG_ 800 FLRObj17_LongExtBack 3000;
BA_REL_ "GenSigTimeoutTime" BU_SG_REL_ DACU SG_ 800 FLRObj17_LongExtBack 100;
BA_REL_ "GenSigFirstTimeoutTime" BU_SG_REL_ DACU SG_ 800 FLRObj17_LongVel 3000;
BA_REL_ "GenSigTimeoutTime" BU_SG_REL_ DACU SG_ 800 FLRObj17_LongVel 100;
BA_REL_ "GenSigFirstTimeoutTime" BU_SG_REL_ DACU SG_ 800 FLRObj17_LongPosVar 3000;
BA_REL_ "GenSigTimeoutTime" BU_SG_REL_ DACU SG_ 800 FLRObj17_LongPosVar 100;
BA_REL_ "GenSigFirstTimeoutTime" BU_SG_REL_ DACU SG_ 800 FLRObj17_ObjDynClass 3000;
BA_REL_ "GenSigTimeoutTime" BU_SG_REL_ DACU SG_ 800 FLRObj17_ObjDynClass 100;
BA_REL_ "GenSigFirstTimeoutTime" BU_SG_REL_ DACU SG_ 800 FLRObj17_LatAcc 3000;
BA_REL_ "GenSigTimeoutTime" BU_SG_REL_ DACU SG_ 800 FLRObj17_LatAcc 100;
BA_REL_ "GenSigFirstTimeoutTime" BU_SG_REL_ DACU SG_ 800 FLRObj17_ObjDynClassRestricted 3000;
BA_REL_ "GenSigTimeoutTime" BU_SG_REL_ DACU SG_ 800 FLRObj17_ObjDynClassRestricted 100;
BA_REL_ "GenSigFirstTimeoutTime" BU_SG_REL_ DACU SG_ 800 FLRObj17_CRC 3000;
BA_REL_ "GenSigTimeoutTime" BU_SG_REL_ DACU SG_ 800 FLRObj17_CRC 100;
BA_REL_ "GenSigFirstTimeoutTime" BU_SG_REL_ DACU SG_ 800 FLRObj17_HeadingVar 3000;
BA_REL_ "GenSigTimeoutTime" BU_SG_REL_ DACU SG_ 800 FLRObj17_HeadingVar 100;
BA_REL_ "GenSigFirstTimeoutTime" BU_SG_REL_ DACU SG_ 800 FLRObj17_Heading 3000;
BA_REL_ "GenSigTimeoutTime" BU_SG_REL_ DACU SG_ 800 FLRObj17_Heading 100;
BA_REL_ "GenSigFirstTimeoutTime" BU_SG_REL_ DACU SG_ 800 FLRObj17_ObstacleConfRestricted 3000;
BA_REL_ "GenSigTimeoutTime" BU_SG_REL_ DACU SG_ 800 FLRObj17_ObstacleConfRestricted 100;
BA_REL_ "GenSigFirstTimeoutTime" BU_SG_REL_ DACU SG_ 800 FLRObj17_ExistConf 3000;
BA_REL_ "GenSigTimeoutTime" BU_SG_REL_ DACU SG_ 800 FLRObj17_ExistConf 100;
BA_REL_ "GenSigFirstTimeoutTime" BU_SG_REL_ DACU SG_ 800 FLRObj17_TrackStatus 3000;
BA_REL_ "GenSigTimeoutTime" BU_SG_REL_ DACU SG_ 800 FLRObj17_TrackStatus 100;
BA_REL_ "GenSigFirstTimeoutTime" BU_SG_REL_ DACU SG_ 800 FLRObj17_LongPos 3000;
BA_REL_ "GenSigTimeoutTime" BU_SG_REL_ DACU SG_ 800 FLRObj17_LongPos 100;
BA_REL_ "GenSigFirstTimeoutTime" BU_SG_REL_ DACU SG_ 800 FLRObj17_LongExtBkVar 3000;
BA_REL_ "GenSigTimeoutTime" BU_SG_REL_ DACU SG_ 800 FLRObj17_LongExtBkVar 100;
BA_REL_ "GenSigFirstTimeoutTime" BU_SG_REL_ DACU SG_ 800 FLRObj17_LatPos 3000;
BA_REL_ "GenSigTimeoutTime" BU_SG_REL_ DACU SG_ 800 FLRObj17_LatPos 100;
BA_REL_ "GenSigFirstTimeoutTime" BU_SG_REL_ DACU SG_ 800 FLRObj17_CoastIndex 3000;
BA_REL_ "GenSigTimeoutTime" BU_SG_REL_ DACU SG_ 800 FLRObj17_CoastIndex 100;
BA_REL_ "GenSigFirstTimeoutTime" BU_SG_REL_ DACU SG_ 800 FLRObj17_ObjClass 3000;
BA_REL_ "GenSigTimeoutTime" BU_SG_REL_ DACU SG_ 800 FLRObj17_ObjClass 100;
BA_REL_ "GenSigFirstTimeoutTime" BU_SG_REL_ DACU SG_ 800 FLRObj17_LatPosVar 3000;
BA_REL_ "GenSigTimeoutTime" BU_SG_REL_ DACU SG_ 800 FLRObj17_LatPosVar 100;
BA_REL_ "GenSigFirstTimeoutTime" BU_SG_REL_ DACU SG_ 800 FLRObj17_LongVelVar 3000;
BA_REL_ "GenSigTimeoutTime" BU_SG_REL_ DACU SG_ 800 FLRObj17_LongVelVar 100;
BA_REL_ "GenSigFirstTimeoutTime" BU_SG_REL_ DACU SG_ 800 FLRObj17_LatExtLeft 3000;
BA_REL_ "GenSigTimeoutTime" BU_SG_REL_ DACU SG_ 800 FLRObj17_LatExtLeft 100;
BA_REL_ "GenSigFirstTimeoutTime" BU_SG_REL_ DACU SG_ 800 FLRObj17_Height 3000;
BA_REL_ "GenSigTimeoutTime" BU_SG_REL_ DACU SG_ 800 FLRObj17_Height 100;
BA_REL_ "GenSigFirstTimeoutTime" BU_SG_REL_ DACU SG_ 800 FLRObj17_LatVelVar 3000;
BA_REL_ "GenSigTimeoutTime" BU_SG_REL_ DACU SG_ 800 FLRObj17_LatVelVar 100;
BA_REL_ "GenSigFirstTimeoutTime" BU_SG_REL_ DACU SG_ 800 FLRObj17_LatVel 3000;
BA_REL_ "GenSigTimeoutTime" BU_SG_REL_ DACU SG_ 800 FLRObj17_LatVel 100;
BA_REL_ "GenSigFirstTimeoutTime" BU_SG_REL_ DACU SG_ 800 FLRObj17_Counter 3000;
BA_REL_ "GenSigTimeoutTime" BU_SG_REL_ DACU SG_ 800 FLRObj17_Counter 100;
BA_REL_ "GenSigFirstTimeoutTime" BU_SG_REL_ DACU SG_ 800 FLRObj17_LatExtRtVar 3000;
BA_REL_ "GenSigTimeoutTime" BU_SG_REL_ DACU SG_ 800 FLRObj17_LatExtRtVar 100;
BA_REL_ "GenSigFirstTimeoutTime" BU_SG_REL_ DACU SG_ 800 FLRObj17_AsilLvl 3000;
BA_REL_ "GenSigTimeoutTime" BU_SG_REL_ DACU SG_ 800 FLRObj17_AsilLvl 100;
BA_REL_ "GenSigFirstTimeoutTime" BU_SG_REL_ DACU SG_ 800 FLRObj17_ObjClassConf 3000;
BA_REL_ "GenSigTimeoutTime" BU_SG_REL_ DACU SG_ 800 FLRObj17_ObjClassConf 100;
BA_REL_ "GenSigFirstTimeoutTime" BU_SG_REL_ DACU SG_ 800 FLRObj17_LongExtFront 3000;
BA_REL_ "GenSigTimeoutTime" BU_SG_REL_ DACU SG_ 800 FLRObj17_LongExtFront 100;
BA_REL_ "GenSigFirstTimeoutTime" BU_SG_REL_ DACU SG_ 800 FLRObj17_TimeStamp 3000;
BA_REL_ "GenSigTimeoutTime" BU_SG_REL_ DACU SG_ 800 FLRObj17_TimeStamp 100;
BA_REL_ "GenSigFirstTimeoutTime" BU_SG_REL_ DACU SG_ 800 FLRObj17_LatExtLeftVar 3000;
BA_REL_ "GenSigTimeoutTime" BU_SG_REL_ DACU SG_ 800 FLRObj17_LatExtLeftVar 100;
BA_REL_ "GenSigFirstTimeoutTime" BU_SG_REL_ DACU SG_ 800 FLRObj17_ObjID 3000;
BA_REL_ "GenSigTimeoutTime" BU_SG_REL_ DACU SG_ 800 FLRObj17_ObjID 100;
BA_REL_ "GenSigFirstTimeoutTime" BU_SG_REL_ DACU SG_ 800 FLRObj17_LatExtRight 3000;
BA_REL_ "GenSigTimeoutTime" BU_SG_REL_ DACU SG_ 800 FLRObj17_LatExtRight 100;
BA_REL_ "GenSigFirstTimeoutTime" BU_SG_REL_ DACU SG_ 799 FLRObj16_ObstacleConfRestricted 3000;
BA_REL_ "GenSigTimeoutTime" BU_SG_REL_ DACU SG_ 799 FLRObj16_ObstacleConfRestricted 100;
BA_REL_ "GenSigFirstTimeoutTime" BU_SG_REL_ DACU SG_ 799 FLRObj16_LongExtFrVar 3000;
BA_REL_ "GenSigTimeoutTime" BU_SG_REL_ DACU SG_ 799 FLRObj16_LongExtFrVar 100;
BA_REL_ "GenSigFirstTimeoutTime" BU_SG_REL_ DACU SG_ 799 FLRObj16_LatVelVar 3000;
BA_REL_ "GenSigTimeoutTime" BU_SG_REL_ DACU SG_ 799 FLRObj16_LatVelVar 100;
BA_REL_ "GenSigFirstTimeoutTime" BU_SG_REL_ DACU SG_ 799 FLRObj16_TimeStamp 3000;
BA_REL_ "GenSigTimeoutTime" BU_SG_REL_ DACU SG_ 799 FLRObj16_TimeStamp 100;
BA_REL_ "GenSigFirstTimeoutTime" BU_SG_REL_ DACU SG_ 799 FLRObj16_LongPosVar 3000;
BA_REL_ "GenSigTimeoutTime" BU_SG_REL_ DACU SG_ 799 FLRObj16_LongPosVar 100;
BA_REL_ "GenSigFirstTimeoutTime" BU_SG_REL_ DACU SG_ 799 FLRObj16_LifeTime 3000;
BA_REL_ "GenSigTimeoutTime" BU_SG_REL_ DACU SG_ 799 FLRObj16_LifeTime 100;
BA_REL_ "GenSigFirstTimeoutTime" BU_SG_REL_ DACU SG_ 799 FLRObj16_LatAccVar 3000;
BA_REL_ "GenSigTimeoutTime" BU_SG_REL_ DACU SG_ 799 FLRObj16_LatAccVar 100;
BA_REL_ "GenSigFirstTimeoutTime" BU_SG_REL_ DACU SG_ 799 FLRObj16_ObjDynClass 3000;
BA_REL_ "GenSigTimeoutTime" BU_SG_REL_ DACU SG_ 799 FLRObj16_ObjDynClass 100;
BA_REL_ "GenSigFirstTimeoutTime" BU_SG_REL_ DACU SG_ 799 FLRObj16_ObjClass 3000;
BA_REL_ "GenSigTimeoutTime" BU_SG_REL_ DACU SG_ 799 FLRObj16_ObjClass 100;
BA_REL_ "GenSigFirstTimeoutTime" BU_SG_REL_ DACU SG_ 799 FLRObj16_ObjID 3000;
BA_REL_ "GenSigTimeoutTime" BU_SG_REL_ DACU SG_ 799 FLRObj16_ObjID 100;
BA_REL_ "GenSigFirstTimeoutTime" BU_SG_REL_ DACU SG_ 799 FLRObj16_LatAcc 3000;
BA_REL_ "GenSigTimeoutTime" BU_SG_REL_ DACU SG_ 799 FLRObj16_LatAcc 100;
BA_REL_ "GenSigFirstTimeoutTime" BU_SG_REL_ DACU SG_ 799 FLRObj16_LongPos 3000;
BA_REL_ "GenSigTimeoutTime" BU_SG_REL_ DACU SG_ 799 FLRObj16_LongPos 100;
BA_REL_ "GenSigFirstTimeoutTime" BU_SG_REL_ DACU SG_ 799 FLRObj16_LatPosVar 3000;
BA_REL_ "GenSigTimeoutTime" BU_SG_REL_ DACU SG_ 799 FLRObj16_LatPosVar 100;
BA_REL_ "GenSigFirstTimeoutTime" BU_SG_REL_ DACU SG_ 799 FLRObj16_HeadingVar 3000;
BA_REL_ "GenSigTimeoutTime" BU_SG_REL_ DACU SG_ 799 FLRObj16_HeadingVar 100;
BA_REL_ "GenSigFirstTimeoutTime" BU_SG_REL_ DACU SG_ 799 FLRObj16_LatPos 3000;
BA_REL_ "GenSigTimeoutTime" BU_SG_REL_ DACU SG_ 799 FLRObj16_LatPos 100;
BA_REL_ "GenSigFirstTimeoutTime" BU_SG_REL_ DACU SG_ 799 FLRObj16_LongExtBack 3000;
BA_REL_ "GenSigTimeoutTime" BU_SG_REL_ DACU SG_ 799 FLRObj16_LongExtBack 100;
BA_REL_ "GenSigFirstTimeoutTime" BU_SG_REL_ DACU SG_ 799 FLRObj16_ExistConf 3000;
BA_REL_ "GenSigTimeoutTime" BU_SG_REL_ DACU SG_ 799 FLRObj16_ExistConf 100;
BA_REL_ "GenSigFirstTimeoutTime" BU_SG_REL_ DACU SG_ 799 FLRObj16_LongExtFront 3000;
BA_REL_ "GenSigTimeoutTime" BU_SG_REL_ DACU SG_ 799 FLRObj16_LongExtFront 100;
BA_REL_ "GenSigFirstTimeoutTime" BU_SG_REL_ DACU SG_ 799 FLRObj16_Counter 3000;
BA_REL_ "GenSigTimeoutTime" BU_SG_REL_ DACU SG_ 799 FLRObj16_Counter 100;
BA_REL_ "GenSigFirstTimeoutTime" BU_SG_REL_ DACU SG_ 799 FLRObj16_Height 3000;
BA_REL_ "GenSigTimeoutTime" BU_SG_REL_ DACU SG_ 799 FLRObj16_Height 100;
BA_REL_ "GenSigFirstTimeoutTime" BU_SG_REL_ DACU SG_ 799 FLRObj16_Heading 3000;
BA_REL_ "GenSigTimeoutTime" BU_SG_REL_ DACU SG_ 799 FLRObj16_Heading 100;
BA_REL_ "GenSigFirstTimeoutTime" BU_SG_REL_ DACU SG_ 799 FLRObj16_LongAcc 3000;
BA_REL_ "GenSigTimeoutTime" BU_SG_REL_ DACU SG_ 799 FLRObj16_LongAcc 100;
BA_REL_ "GenSigFirstTimeoutTime" BU_SG_REL_ DACU SG_ 799 FLRObj16_CRC 3000;
BA_REL_ "GenSigTimeoutTime" BU_SG_REL_ DACU SG_ 799 FLRObj16_CRC 100;
BA_REL_ "GenSigFirstTimeoutTime" BU_SG_REL_ DACU SG_ 799 FLRObj16_LatExtRight 3000;
BA_REL_ "GenSigTimeoutTime" BU_SG_REL_ DACU SG_ 799 FLRObj16_LatExtRight 100;
BA_REL_ "GenSigFirstTimeoutTime" BU_SG_REL_ DACU SG_ 799 FLRObj16_LatVel 3000;
BA_REL_ "GenSigTimeoutTime" BU_SG_REL_ DACU SG_ 799 FLRObj16_LatVel 100;
BA_REL_ "GenSigFirstTimeoutTime" BU_SG_REL_ DACU SG_ 799 FLRObj16_LongAccVar 3000;
BA_REL_ "GenSigTimeoutTime" BU_SG_REL_ DACU SG_ 799 FLRObj16_LongAccVar 100;
BA_REL_ "GenSigFirstTimeoutTime" BU_SG_REL_ DACU SG_ 799 FLRObj16_LatExtLeft 3000;
BA_REL_ "GenSigTimeoutTime" BU_SG_REL_ DACU SG_ 799 FLRObj16_LatExtLeft 100;
BA_REL_ "GenSigFirstTimeoutTime" BU_SG_REL_ DACU SG_ 799 FLRObj16_TrackStatus 3000;
BA_REL_ "GenSigTimeoutTime" BU_SG_REL_ DACU SG_ 799 FLRObj16_TrackStatus 100;
BA_REL_ "GenSigFirstTimeoutTime" BU_SG_REL_ DACU SG_ 799 FLRObj16_ObjDynClassRestricted 3000;
BA_REL_ "GenSigTimeoutTime" BU_SG_REL_ DACU SG_ 799 FLRObj16_ObjDynClassRestricted 100;
BA_REL_ "GenSigFirstTimeoutTime" BU_SG_REL_ DACU SG_ 799 FLRObj16_LatExtLeftVar 3000;
BA_REL_ "GenSigTimeoutTime" BU_SG_REL_ DACU SG_ 799 FLRObj16_LatExtLeftVar 100;
BA_REL_ "GenSigFirstTimeoutTime" BU_SG_REL_ DACU SG_ 799 FLRObj16_AsilLvl 3000;
BA_REL_ "GenSigTimeoutTime" BU_SG_REL_ DACU SG_ 799 FLRObj16_AsilLvl 100;
BA_REL_ "GenSigFirstTimeoutTime" BU_SG_REL_ DACU SG_ 799 FLRObj16_CoastIndex 3000;
BA_REL_ "GenSigTimeoutTime" BU_SG_REL_ DACU SG_ 799 FLRObj16_CoastIndex 100;
BA_REL_ "GenSigFirstTimeoutTime" BU_SG_REL_ DACU SG_ 799 FLRObj16_LongVel 3000;
BA_REL_ "GenSigTimeoutTime" BU_SG_REL_ DACU SG_ 799 FLRObj16_LongVel 100;
BA_REL_ "GenSigFirstTimeoutTime" BU_SG_REL_ DACU SG_ 799 FLRObj16_ObstacleConf 3000;
BA_REL_ "GenSigTimeoutTime" BU_SG_REL_ DACU SG_ 799 FLRObj16_ObstacleConf 100;
BA_REL_ "GenSigFirstTimeoutTime" BU_SG_REL_ DACU SG_ 799 FLRObj16_ObjClassConf 3000;
BA_REL_ "GenSigTimeoutTime" BU_SG_REL_ DACU SG_ 799 FLRObj16_ObjClassConf 100;
BA_REL_ "GenSigFirstTimeoutTime" BU_SG_REL_ DACU SG_ 799 FLRObj16_LatExtRtVar 3000;
BA_REL_ "GenSigTimeoutTime" BU_SG_REL_ DACU SG_ 799 FLRObj16_LatExtRtVar 100;
BA_REL_ "GenSigFirstTimeoutTime" BU_SG_REL_ DACU SG_ 799 FLRObj16_LongExtBkVar 3000;
BA_REL_ "GenSigTimeoutTime" BU_SG_REL_ DACU SG_ 799 FLRObj16_LongExtBkVar 100;
BA_REL_ "GenSigFirstTimeoutTime" BU_SG_REL_ DACU SG_ 799 FLRObj16_LongVelVar 3000;
BA_REL_ "GenSigTimeoutTime" BU_SG_REL_ DACU SG_ 799 FLRObj16_LongVelVar 100;
BA_REL_ "GenSigFirstTimeoutTime" BU_SG_REL_ DACU SG_ 798 FLRObj15_LatAccVar 3000;
BA_REL_ "GenSigTimeoutTime" BU_SG_REL_ DACU SG_ 798 FLRObj15_LatAccVar 100;
BA_REL_ "GenSigFirstTimeoutTime" BU_SG_REL_ DACU SG_ 798 FLRObj15_Counter 3000;
BA_REL_ "GenSigTimeoutTime" BU_SG_REL_ DACU SG_ 798 FLRObj15_Counter 100;
BA_REL_ "GenSigFirstTimeoutTime" BU_SG_REL_ DACU SG_ 798 FLRObj15_LongExtBack 3000;
BA_REL_ "GenSigTimeoutTime" BU_SG_REL_ DACU SG_ 798 FLRObj15_LongExtBack 100;
BA_REL_ "GenSigFirstTimeoutTime" BU_SG_REL_ DACU SG_ 798 FLRObj15_ObstacleConf 3000;
BA_REL_ "GenSigTimeoutTime" BU_SG_REL_ DACU SG_ 798 FLRObj15_ObstacleConf 100;
BA_REL_ "GenSigFirstTimeoutTime" BU_SG_REL_ DACU SG_ 798 FLRObj15_CoastIndex 3000;
BA_REL_ "GenSigTimeoutTime" BU_SG_REL_ DACU SG_ 798 FLRObj15_CoastIndex 100;
BA_REL_ "GenSigFirstTimeoutTime" BU_SG_REL_ DACU SG_ 798 FLRObj15_ObjDynClass 3000;
BA_REL_ "GenSigTimeoutTime" BU_SG_REL_ DACU SG_ 798 FLRObj15_ObjDynClass 100;
BA_REL_ "GenSigFirstTimeoutTime" BU_SG_REL_ DACU SG_ 798 FLRObj15_HeadingVar 3000;
BA_REL_ "GenSigTimeoutTime" BU_SG_REL_ DACU SG_ 798 FLRObj15_HeadingVar 100;
BA_REL_ "GenSigFirstTimeoutTime" BU_SG_REL_ DACU SG_ 798 FLRObj15_LatAcc 3000;
BA_REL_ "GenSigTimeoutTime" BU_SG_REL_ DACU SG_ 798 FLRObj15_LatAcc 100;
BA_REL_ "GenSigFirstTimeoutTime" BU_SG_REL_ DACU SG_ 798 FLRObj15_LatExtLeftVar 3000;
BA_REL_ "GenSigTimeoutTime" BU_SG_REL_ DACU SG_ 798 FLRObj15_LatExtLeftVar 100;
BA_REL_ "GenSigFirstTimeoutTime" BU_SG_REL_ DACU SG_ 798 FLRObj15_LongExtFrVar 3000;
BA_REL_ "GenSigTimeoutTime" BU_SG_REL_ DACU SG_ 798 FLRObj15_LongExtFrVar 100;
BA_REL_ "GenSigFirstTimeoutTime" BU_SG_REL_ DACU SG_ 798 FLRObj15_LatExtLeft 3000;
BA_REL_ "GenSigTimeoutTime" BU_SG_REL_ DACU SG_ 798 FLRObj15_LatExtLeft 100;
BA_REL_ "GenSigFirstTimeoutTime" BU_SG_REL_ DACU SG_ 798 FLRObj15_LatPosVar 3000;
BA_REL_ "GenSigTimeoutTime" BU_SG_REL_ DACU SG_ 798 FLRObj15_LatPosVar 100;
BA_REL_ "GenSigFirstTimeoutTime" BU_SG_REL_ DACU SG_ 798 FLRObj15_LongExtFront 3000;
BA_REL_ "GenSigTimeoutTime" BU_SG_REL_ DACU SG_ 798 FLRObj15_LongExtFront 100;
BA_REL_ "GenSigFirstTimeoutTime" BU_SG_REL_ DACU SG_ 798 FLRObj15_Height 3000;
BA_REL_ "GenSigTimeoutTime" BU_SG_REL_ DACU SG_ 798 FLRObj15_Height 100;
BA_REL_ "GenSigFirstTimeoutTime" BU_SG_REL_ DACU SG_ 798 FLRObj15_ObjClassConf 3000;
BA_REL_ "GenSigTimeoutTime" BU_SG_REL_ DACU SG_ 798 FLRObj15_ObjClassConf 100;
BA_REL_ "GenSigFirstTimeoutTime" BU_SG_REL_ DACU SG_ 798 FLRObj15_LatExtRight 3000;
BA_REL_ "GenSigTimeoutTime" BU_SG_REL_ DACU SG_ 798 FLRObj15_LatExtRight 100;
BA_REL_ "GenSigFirstTimeoutTime" BU_SG_REL_ DACU SG_ 798 FLRObj15_LongPosVar 3000;
BA_REL_ "GenSigTimeoutTime" BU_SG_REL_ DACU SG_ 798 FLRObj15_LongPosVar 100;
BA_REL_ "GenSigFirstTimeoutTime" BU_SG_REL_ DACU SG_ 798 FLRObj15_ObstacleConfRestricted 3000;
BA_REL_ "GenSigTimeoutTime" BU_SG_REL_ DACU SG_ 798 FLRObj15_ObstacleConfRestricted 100;
BA_REL_ "GenSigFirstTimeoutTime" BU_SG_REL_ DACU SG_ 798 FLRObj15_LongExtBkVar 3000;
BA_REL_ "GenSigTimeoutTime" BU_SG_REL_ DACU SG_ 798 FLRObj15_LongExtBkVar 100;
BA_REL_ "GenSigFirstTimeoutTime" BU_SG_REL_ DACU SG_ 798 FLRObj15_LatExtRtVar 3000;
BA_REL_ "GenSigTimeoutTime" BU_SG_REL_ DACU SG_ 798 FLRObj15_LatExtRtVar 100;
BA_REL_ "GenSigFirstTimeoutTime" BU_SG_REL_ DACU SG_ 798 FLRObj15_TrackStatus 3000;
BA_REL_ "GenSigTimeoutTime" BU_SG_REL_ DACU SG_ 798 FLRObj15_TrackStatus 100;
BA_REL_ "GenSigFirstTimeoutTime" BU_SG_REL_ DACU SG_ 798 FLRObj15_ObjClass 3000;
BA_REL_ "GenSigTimeoutTime" BU_SG_REL_ DACU SG_ 798 FLRObj15_ObjClass 100;
BA_REL_ "GenSigFirstTimeoutTime" BU_SG_REL_ DACU SG_ 798 FLRObj15_LatVelVar 3000;
BA_REL_ "GenSigTimeoutTime" BU_SG_REL_ DACU SG_ 798 FLRObj15_LatVelVar 100;
BA_REL_ "GenSigFirstTimeoutTime" BU_SG_REL_ DACU SG_ 798 FLRObj15_LongAcc 3000;
BA_REL_ "GenSigTimeoutTime" BU_SG_REL_ DACU SG_ 798 FLRObj15_LongAcc 100;
BA_REL_ "GenSigFirstTimeoutTime" BU_SG_REL_ DACU SG_ 798 FLRObj15_ObjDynClassRestricted 3000;
BA_REL_ "GenSigTimeoutTime" BU_SG_REL_ DACU SG_ 798 FLRObj15_ObjDynClassRestricted 100;
BA_REL_ "GenSigFirstTimeoutTime" BU_SG_REL_ DACU SG_ 798 FLRObj15_Heading 3000;
BA_REL_ "GenSigTimeoutTime" BU_SG_REL_ DACU SG_ 798 FLRObj15_Heading 100;
BA_REL_ "GenSigFirstTimeoutTime" BU_SG_REL_ DACU SG_ 798 FLRObj15_LongVelVar 3000;
BA_REL_ "GenSigTimeoutTime" BU_SG_REL_ DACU SG_ 798 FLRObj15_LongVelVar 100;
BA_REL_ "GenSigFirstTimeoutTime" BU_SG_REL_ DACU SG_ 798 FLRObj15_LatPos 3000;
BA_REL_ "GenSigTimeoutTime" BU_SG_REL_ DACU SG_ 798 FLRObj15_LatPos 100;
BA_REL_ "GenSigFirstTimeoutTime" BU_SG_REL_ DACU SG_ 798 FLRObj15_LongPos 3000;
BA_REL_ "GenSigTimeoutTime" BU_SG_REL_ DACU SG_ 798 FLRObj15_LongPos 100;
BA_REL_ "GenSigFirstTimeoutTime" BU_SG_REL_ DACU SG_ 798 FLRObj15_AsilLvl 3000;
BA_REL_ "GenSigTimeoutTime" BU_SG_REL_ DACU SG_ 798 FLRObj15_AsilLvl 100;
BA_REL_ "GenSigFirstTimeoutTime" BU_SG_REL_ DACU SG_ 798 FLRObj15_ObjID 3000;
BA_REL_ "GenSigTimeoutTime" BU_SG_REL_ DACU SG_ 798 FLRObj15_ObjID 100;
BA_REL_ "GenSigFirstTimeoutTime" BU_SG_REL_ DACU SG_ 798 FLRObj15_LongVel 3000;
BA_REL_ "GenSigTimeoutTime" BU_SG_REL_ DACU SG_ 798 FLRObj15_LongVel 100;
BA_REL_ "GenSigFirstTimeoutTime" BU_SG_REL_ DACU SG_ 798 FLRObj15_ExistConf 3000;
BA_REL_ "GenSigTimeoutTime" BU_SG_REL_ DACU SG_ 798 FLRObj15_ExistConf 100;
BA_REL_ "GenSigFirstTimeoutTime" BU_SG_REL_ DACU SG_ 798 FLRObj15_LifeTime 3000;
BA_REL_ "GenSigTimeoutTime" BU_SG_REL_ DACU SG_ 798 FLRObj15_LifeTime 100;
BA_REL_ "GenSigFirstTimeoutTime" BU_SG_REL_ DACU SG_ 798 FLRObj15_TimeStamp 3000;
BA_REL_ "GenSigTimeoutTime" BU_SG_REL_ DACU SG_ 798 FLRObj15_TimeStamp 100;
BA_REL_ "GenSigFirstTimeoutTime" BU_SG_REL_ DACU SG_ 798 FLRObj15_LatVel 3000;
BA_REL_ "GenSigTimeoutTime" BU_SG_REL_ DACU SG_ 798 FLRObj15_LatVel 100;
BA_REL_ "GenSigFirstTimeoutTime" BU_SG_REL_ DACU SG_ 798 FLRObj15_LongAccVar 3000;
BA_REL_ "GenSigTimeoutTime" BU_SG_REL_ DACU SG_ 798 FLRObj15_LongAccVar 100;
BA_REL_ "GenSigFirstTimeoutTime" BU_SG_REL_ DACU SG_ 798 FLRObj15_CRC 3000;
BA_REL_ "GenSigTimeoutTime" BU_SG_REL_ DACU SG_ 798 FLRObj15_CRC 100;
VAL_ 859 RightRoadBoundary_Type 7 "RaisedEdgeType_NotAvailable" 6 "RaisedEdgeType_Error" 5 "RaisedEdgeType_Spare2" 4 "RaisedEdgeType_Spare1" 3 "RaisedEdgeType_Barrier" 2 "RaisedEdgeType_NonElevatedBoundary" 1 "RaisedEdgeType_ElevatedBoundary" 0 "RaisedEdgeType_Unknown" ;
VAL_ 859 RightRoadBoundary_TrackStatus 7 "TrackStatus_NotAvailable" 6 "TrackStatus_Error" 5 "TrackStatus_Spare3" 4 "TrackStatus_Spare2" 3 "TrackStatus_Spare1" 2 "TrackStatus_Invalid" 1 "TrackStatus_Predicted" 0 "TrackStatus_Tracked" ;
VAL_ 806 FLRObj23_TrackStatus 7 "TrackStatus_NotAvailable" 6 "TrackStatus_Error" 5 "TrackStatus_Spare3" 4 "TrackStatus_Spare2" 3 "TrackStatus_Spare1" 2 "TrackStatus_Invalid" 1 "TrackStatus_Predicted" 0 "TrackStatus_Tracked" ;
VAL_ 806 FLRObj23_ObjDynClassRestricted 3 "ObjDynClass_Error" 2 "ObjDynClass_Movable" 1 "ObjDynClass_Stationary" 0 "ObjDynClass_Reserved" ;
VAL_ 806 FLRObj23_ObjDynClass 3 "ObjDynClass_Error" 2 "ObjDynClass_Movable" 1 "ObjDynClass_Stationary" 0 "ObjDynClass_Reserved" ;
VAL_ 806 FLRObj23_AsilLvl 3 "AsilLvl_NotAvailable" 2 "AsilLvl_Spare" 1 "AsilLvl_Asil" 0 "AsilLvl_QM" ;
VAL_ 806 FLRObj23_ObjClass 15 "ObjClassFLR_NotAvailable" 14 "ObjClassFLR_Error" 13 "ObjClassFLR_Spare4" 12 "ObjClassFLR_MoisObject" 11 "ObjClassFLR_Motorcycle" 10 "ObjClassFLR_Bicycle" 9 "ObjClassFLR_UnidentifiedMovableObject" 8 "ObjClassFLR_UnidentifiedVRU" 7 "ObjClassFLR_UnidentifiedVehicle" 6 "ObjClassFLR_StaticObject" 5 "ObjClassFLR_Pedestrian" 4 "ObjClassFLR_2Wheeler" 3 "ObjClassFLR_HeavyVehicle" 2 "ObjClassFLR_Car" 1 "ObjClassFLR_Obstacle" 0 "ObjClassFLR_Undetermined" ;
VAL_ 805 FLRObj22_ObjDynClassRestricted 3 "ObjDynClass_Error" 2 "ObjDynClass_Movable" 1 "ObjDynClass_Stationary" 0 "ObjDynClass_Reserved" ;
VAL_ 805 FLRObj22_AsilLvl 3 "AsilLvl_NotAvailable" 2 "AsilLvl_Spare" 1 "AsilLvl_Asil" 0 "AsilLvl_QM" ;
VAL_ 805 FLRObj22_TrackStatus 7 "TrackStatus_NotAvailable" 6 "TrackStatus_Error" 5 "TrackStatus_Spare3" 4 "TrackStatus_Spare2" 3 "TrackStatus_Spare1" 2 "TrackStatus_Invalid" 1 "TrackStatus_Predicted" 0 "TrackStatus_Tracked" ;
VAL_ 805 FLRObj22_ObjClass 15 "ObjClassFLR_NotAvailable" 14 "ObjClassFLR_Error" 13 "ObjClassFLR_Spare4" 12 "ObjClassFLR_MoisObject" 11 "ObjClassFLR_Motorcycle" 10 "ObjClassFLR_Bicycle" 9 "ObjClassFLR_UnidentifiedMovableObject" 8 "ObjClassFLR_UnidentifiedVRU" 7 "ObjClassFLR_UnidentifiedVehicle" 6 "ObjClassFLR_StaticObject" 5 "ObjClassFLR_Pedestrian" 4 "ObjClassFLR_2Wheeler" 3 "ObjClassFLR_HeavyVehicle" 2 "ObjClassFLR_Car" 1 "ObjClassFLR_Obstacle" 0 "ObjClassFLR_Undetermined" ;
VAL_ 805 FLRObj22_ObjDynClass 3 "ObjDynClass_Error" 2 "ObjDynClass_Movable" 1 "ObjDynClass_Stationary" 0 "ObjDynClass_Reserved" ;
VAL_ 804 FLRObj21_TrackStatus 7 "TrackStatus_NotAvailable" 6 "TrackStatus_Error" 5 "TrackStatus_Spare3" 4 "TrackStatus_Spare2" 3 "TrackStatus_Spare1" 2 "TrackStatus_Invalid" 1 "TrackStatus_Predicted" 0 "TrackStatus_Tracked" ;
VAL_ 804 FLRObj21_ObjClass 15 "ObjClassFLR_NotAvailable" 14 "ObjClassFLR_Error" 13 "ObjClassFLR_Spare4" 12 "ObjClassFLR_MoisObject" 11 "ObjClassFLR_Motorcycle" 10 "ObjClassFLR_Bicycle" 9 "ObjClassFLR_UnidentifiedMovableObject" 8 "ObjClassFLR_UnidentifiedVRU" 7 "ObjClassFLR_UnidentifiedVehicle" 6 "ObjClassFLR_StaticObject" 5 "ObjClassFLR_Pedestrian" 4 "ObjClassFLR_2Wheeler" 3 "ObjClassFLR_HeavyVehicle" 2 "ObjClassFLR_Car" 1 "ObjClassFLR_Obstacle" 0 "ObjClassFLR_Undetermined" ;
VAL_ 804 FLRObj21_AsilLvl 3 "AsilLvl_NotAvailable" 2 "AsilLvl_Spare" 1 "AsilLvl_Asil" 0 "AsilLvl_QM" ;
VAL_ 804 FLRObj21_ObjDynClassRestricted 3 "ObjDynClass_Error" 2 "ObjDynClass_Movable" 1 "ObjDynClass_Stationary" 0 "ObjDynClass_Reserved" ;
VAL_ 804 FLRObj21_ObjDynClass 3 "ObjDynClass_Error" 2 "ObjDynClass_Movable" 1 "ObjDynClass_Stationary" 0 "ObjDynClass_Reserved" ;
VAL_ 803 FLRObj20_ObjClass 15 "ObjClassFLR_NotAvailable" 14 "ObjClassFLR_Error" 13 "ObjClassFLR_Spare4" 12 "ObjClassFLR_MoisObject" 11 "ObjClassFLR_Motorcycle" 10 "ObjClassFLR_Bicycle" 9 "ObjClassFLR_UnidentifiedMovableObject" 8 "ObjClassFLR_UnidentifiedVRU" 7 "ObjClassFLR_UnidentifiedVehicle" 6 "ObjClassFLR_StaticObject" 5 "ObjClassFLR_Pedestrian" 4 "ObjClassFLR_2Wheeler" 3 "ObjClassFLR_HeavyVehicle" 2 "ObjClassFLR_Car" 1 "ObjClassFLR_Obstacle" 0 "ObjClassFLR_Undetermined" ;
VAL_ 803 FLRObj20_AsilLvl 3 "AsilLvl_NotAvailable" 2 "AsilLvl_Spare" 1 "AsilLvl_Asil" 0 "AsilLvl_QM" ;
VAL_ 803 FLRObj20_ObjDynClass 3 "ObjDynClass_Error" 2 "ObjDynClass_Movable" 1 "ObjDynClass_Stationary" 0 "ObjDynClass_Reserved" ;
VAL_ 803 FLRObj20_ObjDynClassRestricted 3 "ObjDynClass_Error" 2 "ObjDynClass_Movable" 1 "ObjDynClass_Stationary" 0 "ObjDynClass_Reserved" ;
VAL_ 803 FLRObj20_TrackStatus 7 "TrackStatus_NotAvailable" 6 "TrackStatus_Error" 5 "TrackStatus_Spare3" 4 "TrackStatus_Spare2" 3 "TrackStatus_Spare1" 2 "TrackStatus_Invalid" 1 "TrackStatus_Predicted" 0 "TrackStatus_Tracked" ;
VAL_ 802 FLRObj19_TrackStatus 7 "TrackStatus_NotAvailable" 6 "TrackStatus_Error" 5 "TrackStatus_Spare3" 4 "TrackStatus_Spare2" 3 "TrackStatus_Spare1" 2 "TrackStatus_Invalid" 1 "TrackStatus_Predicted" 0 "TrackStatus_Tracked" ;
VAL_ 802 FLRObj19_ObjClass 15 "ObjClassFLR_NotAvailable" 14 "ObjClassFLR_Error" 13 "ObjClassFLR_Spare4" 12 "ObjClassFLR_MoisObject" 11 "ObjClassFLR_Motorcycle" 10 "ObjClassFLR_Bicycle" 9 "ObjClassFLR_UnidentifiedMovableObject" 8 "ObjClassFLR_UnidentifiedVRU" 7 "ObjClassFLR_UnidentifiedVehicle" 6 "ObjClassFLR_StaticObject" 5 "ObjClassFLR_Pedestrian" 4 "ObjClassFLR_2Wheeler" 3 "ObjClassFLR_HeavyVehicle" 2 "ObjClassFLR_Car" 1 "ObjClassFLR_Obstacle" 0 "ObjClassFLR_Undetermined" ;
VAL_ 802 FLRObj19_ObjDynClass 3 "ObjDynClass_Error" 2 "ObjDynClass_Movable" 1 "ObjDynClass_Stationary" 0 "ObjDynClass_Reserved" ;
VAL_ 802 FLRObj19_ObjDynClassRestricted 3 "ObjDynClass_Error" 2 "ObjDynClass_Movable" 1 "ObjDynClass_Stationary" 0 "ObjDynClass_Reserved" ;
VAL_ 802 FLRObj19_AsilLvl 3 "AsilLvl_NotAvailable" 2 "AsilLvl_Spare" 1 "AsilLvl_Asil" 0 "AsilLvl_QM" ;
VAL_ 801 FLRObj18_AsilLvl 3 "AsilLvl_NotAvailable" 2 "AsilLvl_Spare" 1 "AsilLvl_Asil" 0 "AsilLvl_QM" ;
VAL_ 801 FLRObj18_ObjDynClassRestricted 3 "ObjDynClass_Error" 2 "ObjDynClass_Movable" 1 "ObjDynClass_Stationary" 0 "ObjDynClass_Reserved" ;
VAL_ 801 FLRObj18_TrackStatus 7 "TrackStatus_NotAvailable" 6 "TrackStatus_Error" 5 "TrackStatus_Spare3" 4 "TrackStatus_Spare2" 3 "TrackStatus_Spare1" 2 "TrackStatus_Invalid" 1 "TrackStatus_Predicted" 0 "TrackStatus_Tracked" ;
VAL_ 801 FLRObj18_ObjDynClass 3 "ObjDynClass_Error" 2 "ObjDynClass_Movable" 1 "ObjDynClass_Stationary" 0 "ObjDynClass_Reserved" ;
VAL_ 801 FLRObj18_ObjClass 15 "ObjClassFLR_NotAvailable" 14 "ObjClassFLR_Error" 13 "ObjClassFLR_Spare4" 12 "ObjClassFLR_MoisObject" 11 "ObjClassFLR_Motorcycle" 10 "ObjClassFLR_Bicycle" 9 "ObjClassFLR_UnidentifiedMovableObject" 8 "ObjClassFLR_UnidentifiedVRU" 7 "ObjClassFLR_UnidentifiedVehicle" 6 "ObjClassFLR_StaticObject" 5 "ObjClassFLR_Pedestrian" 4 "ObjClassFLR_2Wheeler" 3 "ObjClassFLR_HeavyVehicle" 2 "ObjClassFLR_Car" 1 "ObjClassFLR_Obstacle" 0 "ObjClassFLR_Undetermined" ;
VAL_ 800 FLRObj17_ObjDynClass 3 "ObjDynClass_Error" 2 "ObjDynClass_Movable" 1 "ObjDynClass_Stationary" 0 "ObjDynClass_Reserved" ;
VAL_ 800 FLRObj17_ObjDynClassRestricted 3 "ObjDynClass_Error" 2 "ObjDynClass_Movable" 1 "ObjDynClass_Stationary" 0 "ObjDynClass_Reserved" ;
VAL_ 800 FLRObj17_TrackStatus 7 "TrackStatus_NotAvailable" 6 "TrackStatus_Error" 5 "TrackStatus_Spare3" 4 "TrackStatus_Spare2" 3 "TrackStatus_Spare1" 2 "TrackStatus_Invalid" 1 "TrackStatus_Predicted" 0 "TrackStatus_Tracked" ;
VAL_ 800 FLRObj17_ObjClass 15 "ObjClassFLR_NotAvailable" 14 "ObjClassFLR_Error" 13 "ObjClassFLR_Spare4" 12 "ObjClassFLR_MoisObject" 11 "ObjClassFLR_Motorcycle" 10 "ObjClassFLR_Bicycle" 9 "ObjClassFLR_UnidentifiedMovableObject" 8 "ObjClassFLR_UnidentifiedVRU" 7 "ObjClassFLR_UnidentifiedVehicle" 6 "ObjClassFLR_StaticObject" 5 "ObjClassFLR_Pedestrian" 4 "ObjClassFLR_2Wheeler" 3 "ObjClassFLR_HeavyVehicle" 2 "ObjClassFLR_Car" 1 "ObjClassFLR_Obstacle" 0 "ObjClassFLR_Undetermined" ;
VAL_ 800 FLRObj17_AsilLvl 3 "AsilLvl_NotAvailable" 2 "AsilLvl_Spare" 1 "AsilLvl_Asil" 0 "AsilLvl_QM" ;
VAL_ 799 FLRObj16_ObjDynClass 3 "ObjDynClass_Error" 2 "ObjDynClass_Movable" 1 "ObjDynClass_Stationary" 0 "ObjDynClass_Reserved" ;
VAL_ 799 FLRObj16_ObjClass 15 "ObjClassFLR_NotAvailable" 14 "ObjClassFLR_Error" 13 "ObjClassFLR_Spare4" 12 "ObjClassFLR_MoisObject" 11 "ObjClassFLR_Motorcycle" 10 "ObjClassFLR_Bicycle" 9 "ObjClassFLR_UnidentifiedMovableObject" 8 "ObjClassFLR_UnidentifiedVRU" 7 "ObjClassFLR_UnidentifiedVehicle" 6 "ObjClassFLR_StaticObject" 5 "ObjClassFLR_Pedestrian" 4 "ObjClassFLR_2Wheeler" 3 "ObjClassFLR_HeavyVehicle" 2 "ObjClassFLR_Car" 1 "ObjClassFLR_Obstacle" 0 "ObjClassFLR_Undetermined" ;
VAL_ 799 FLRObj16_TrackStatus 7 "TrackStatus_NotAvailable" 6 "TrackStatus_Error" 5 "TrackStatus_Spare3" 4 "TrackStatus_Spare2" 3 "TrackStatus_Spare1" 2 "TrackStatus_Invalid" 1 "TrackStatus_Predicted" 0 "TrackStatus_Tracked" ;
VAL_ 799 FLRObj16_ObjDynClassRestricted 3 "ObjDynClass_Error" 2 "ObjDynClass_Movable" 1 "ObjDynClass_Stationary" 0 "ObjDynClass_Reserved" ;
VAL_ 799 FLRObj16_AsilLvl 3 "AsilLvl_NotAvailable" 2 "AsilLvl_Spare" 1 "AsilLvl_Asil" 0 "AsilLvl_QM" ;
VAL_ 798 FLRObj15_ObjDynClass 3 "ObjDynClass_Error" 2 "ObjDynClass_Movable" 1 "ObjDynClass_Stationary" 0 "ObjDynClass_Reserved" ;
VAL_ 798 FLRObj15_TrackStatus 7 "TrackStatus_NotAvailable" 6 "TrackStatus_Error" 5 "TrackStatus_Spare3" 4 "TrackStatus_Spare2" 3 "TrackStatus_Spare1" 2 "TrackStatus_Invalid" 1 "TrackStatus_Predicted" 0 "TrackStatus_Tracked" ;
VAL_ 798 FLRObj15_ObjClass 15 "ObjClassFLR_NotAvailable" 14 "ObjClassFLR_Error" 13 "ObjClassFLR_Spare4" 12 "ObjClassFLR_MoisObject" 11 "ObjClassFLR_Motorcycle" 10 "ObjClassFLR_Bicycle" 9 "ObjClassFLR_UnidentifiedMovableObject" 8 "ObjClassFLR_UnidentifiedVRU" 7 "ObjClassFLR_UnidentifiedVehicle" 6 "ObjClassFLR_StaticObject" 5 "ObjClassFLR_Pedestrian" 4 "ObjClassFLR_2Wheeler" 3 "ObjClassFLR_HeavyVehicle" 2 "ObjClassFLR_Car" 1 "ObjClassFLR_Obstacle" 0 "ObjClassFLR_Undetermined" ;
VAL_ 798 FLRObj15_ObjDynClassRestricted 3 "ObjDynClass_Error" 2 "ObjDynClass_Movable" 1 "ObjDynClass_Stationary" 0 "ObjDynClass_Reserved" ;
VAL_ 798 FLRObj15_AsilLvl 3 "AsilLvl_NotAvailable" 2 "AsilLvl_Spare" 1 "AsilLvl_Asil" 0 "AsilLvl_QM" ;
SIG_GROUP_ 1507 HUA_SN_sg 1 : HUA_SN_Byte2 HUA_SN_Byte0 HUA_SN_Byte3 HUA_SN_Byte1;
SIG_GROUP_ 1507 HUA_SNPN_sg 1 : HUA_SNPN_Byte3 HUA_SNPN_Byte2 HUA_SNPN_Byte1 HUA_SNPN_Byte0 HUA_SNPN_Byte4;
SIG_GROUP_ 1553 FLRSwVersion_sg 1 : FLRSwVersion_Substring1 FLRSwVersion_Substring3 FLRSwVersion_Substring5 FLRSwVersion_Substring2 FLRSwVersion_Substring6 FLRSwVersion_Substring7 FLRSwVersion_Substring4 FLRSwVersion_Substring0;
SIG_GROUP_ 859 RightRoadBoundary_sg 1 : RightRoadBoundary_Curvature RightRoadBoundary_LatDistVar RightRoadBoundary_Type RightRoadBoundary_CRC RightRoadBoundary_LifeTime RightRoadBoundary_TrackStatus RightRoadBoundary_HeadingAngle RightRoadBoundary_Counter RightRoadBoundary_LatDist RightRoadBoundary_TimeStamp RightRoadBoundary_CoastIndex RightRoadBoundary_Confidence RightRoadBoundary_CurvatureRate RightRoadBoundary_DxStart RightRoadBoundary_DxEnd;
SIG_GROUP_ 806 FLRObj23_sg 1 : FLRObj23_ObjClassConf FLRObj23_LongPosVar FLRObj23_LongAccVar FLRObj23_TrackStatus FLRObj23_ObjID FLRObj23_ObjDynClassRestricted FLRObj23_LatExtRtVar FLRObj23_ExistConf FLRObj23_HeadingVar FLRObj23_LongExtFront FLRObj23_Counter FLRObj23_LatExtLeft FLRObj23_ObstacleConfRestricted FLRObj23_LatExtRight FLRObj23_LatVelVar FLRObj23_LongExtBack FLRObj23_LongVel FLRObj23_LatPosVar FLRObj23_LatAcc FLRObj23_ObstacleConf FLRObj23_LatPos FLRObj23_LatVel FLRObj23_TimeStamp FLRObj23_Heading FLRObj23_CRC FLRObj23_ObjDynClass FLRObj23_Height FLRObj23_LongExtBkVar FLRObj23_CoastIndex FLRObj23_LifeTime FLRObj23_LongPos FLRObj23_LongVelVar FLRObj23_LatAccVar FLRObj23_LongExtFrVar FLRObj23_AsilLvl FLRObj23_LongAcc FLRObj23_LatExtLeftVar FLRObj23_ObjClass;
SIG_GROUP_ 805 FLRObj22_sg 1 : FLRObj22_TimeStamp FLRObj22_LatAcc FLRObj22_LatAccVar FLRObj22_LongPosVar FLRObj22_ExistConf FLRObj22_LongVel FLRObj22_ObjID FLRObj22_Counter FLRObj22_LongVelVar FLRObj22_LongAccVar FLRObj22_LongExtBkVar FLRObj22_LatVelVar FLRObj22_LatExtRtVar FLRObj22_ObjDynClassRestricted FLRObj22_LongAcc FLRObj22_AsilLvl FLRObj22_LongExtFront FLRObj22_HeadingVar FLRObj22_CRC FLRObj22_LatVel FLRObj22_CoastIndex FLRObj22_Heading FLRObj22_LifeTime FLRObj22_LatPosVar FLRObj22_ObstacleConfRestricted FLRObj22_LatPos FLRObj22_Height FLRObj22_LongPos FLRObj22_ObjClassConf FLRObj22_TrackStatus FLRObj22_ObjClass FLRObj22_LongExtFrVar FLRObj22_LongExtBack FLRObj22_ObstacleConf FLRObj22_LatExtLeftVar FLRObj22_LatExtLeft FLRObj22_LatExtRight FLRObj22_ObjDynClass;
SIG_GROUP_ 804 FLRObj21_sg 1 : FLRObj21_LatAccVar FLRObj21_TrackStatus FLRObj21_LongPos FLRObj21_LongAcc FLRObj21_Height FLRObj21_LatVel FLRObj21_LatPos FLRObj21_LatExtRtVar FLRObj21_ObstacleConfRestricted FLRObj21_ObstacleConf FLRObj21_LongExtBack FLRObj21_LongAccVar FLRObj21_ObjClass FLRObj21_ObjClassConf FLRObj21_LongExtBkVar FLRObj21_LatPosVar FLRObj21_LongVelVar FLRObj21_LongPosVar FLRObj21_LatExtRight FLRObj21_ObjID FLRObj21_CoastIndex FLRObj21_AsilLvl FLRObj21_LatAcc FLRObj21_LatVelVar FLRObj21_TimeStamp FLRObj21_ExistConf FLRObj21_ObjDynClassRestricted FLRObj21_LongExtFrVar FLRObj21_LongVel FLRObj21_ObjDynClass FLRObj21_Counter FLRObj21_LifeTime FLRObj21_LongExtFront FLRObj21_LatExtLeft FLRObj21_LatExtLeftVar FLRObj21_HeadingVar FLRObj21_Heading FLRObj21_CRC;
SIG_GROUP_ 803 FLRObj20_sg 1 : FLRObj20_ExistConf FLRObj20_ObjClass FLRObj20_LongVelVar FLRObj20_LongExtBkVar FLRObj20_Heading FLRObj20_LatExtRight FLRObj20_LongAcc FLRObj20_LatExtLeftVar FLRObj20_AsilLvl FLRObj20_LatPosVar FLRObj20_LatExtLeft FLRObj20_Height FLRObj20_LatAccVar FLRObj20_LatVel FLRObj20_ObjID FLRObj20_LifeTime FLRObj20_LongExtFront FLRObj20_Counter FLRObj20_CoastIndex FLRObj20_LongExtBack FLRObj20_LongExtFrVar FLRObj20_LatAcc FLRObj20_ObjDynClass FLRObj20_LongPos FLRObj20_ObstacleConfRestricted FLRObj20_ObjDynClassRestricted FLRObj20_LongVel FLRObj20_TrackStatus FLRObj20_LatExtRtVar FLRObj20_CRC FLRObj20_HeadingVar FLRObj20_TimeStamp FLRObj20_LongAccVar FLRObj20_ObstacleConf FLRObj20_ObjClassConf FLRObj20_LongPosVar FLRObj20_LatPos FLRObj20_LatVelVar;
SIG_GROUP_ 802 FLRObj19_sg 1 : FLRObj19_LongVelVar FLRObj19_LatPosVar FLRObj19_LatVelVar FLRObj19_TrackStatus FLRObj19_ObjClassConf FLRObj19_LatExtLeft FLRObj19_LongAccVar FLRObj19_ExistConf FLRObj19_ObjClass FLRObj19_CRC FLRObj19_LongExtFront FLRObj19_ObstacleConf FLRObj19_LatExtRtVar FLRObj19_CoastIndex FLRObj19_LongVel FLRObj19_LongExtBack FLRObj19_LifeTime FLRObj19_ObstacleConfRestricted FLRObj19_LatVel FLRObj19_LatAccVar FLRObj19_LongPos FLRObj19_Counter FLRObj19_ObjDynClass FLRObj19_LongPosVar FLRObj19_ObjDynClassRestricted FLRObj19_ObjID FLRObj19_Height FLRObj19_LatAcc FLRObj19_LatExtRight FLRObj19_LongExtFrVar FLRObj19_AsilLvl FLRObj19_LongExtBkVar FLRObj19_LatPos FLRObj19_Heading FLRObj19_TimeStamp FLRObj19_HeadingVar FLRObj19_LongAcc FLRObj19_LatExtLeftVar;
SIG_GROUP_ 801 FLRObj18_sg 1 : FLRObj18_LatVel FLRObj18_AsilLvl FLRObj18_ObjDynClassRestricted FLRObj18_TimeStamp FLRObj18_Height FLRObj18_LongExtBkVar FLRObj18_CRC FLRObj18_LongExtFrVar FLRObj18_LongPos FLRObj18_TrackStatus FLRObj18_LatAccVar FLRObj18_LongExtBack FLRObj18_ObjClassConf FLRObj18_ObjID FLRObj18_LongExtFront FLRObj18_LongAccVar FLRObj18_Heading FLRObj18_Counter FLRObj18_LatExtLeftVar FLRObj18_LatExtLeft FLRObj18_LongVel FLRObj18_LifeTime FLRObj18_LongPosVar FLRObj18_ObstacleConf FLRObj18_LatExtRight FLRObj18_LongAcc FLRObj18_ObstacleConfRestricted FLRObj18_LatPos FLRObj18_LatPosVar FLRObj18_LongVelVar FLRObj18_CoastIndex FLRObj18_LatAcc FLRObj18_ExistConf FLRObj18_LatVelVar FLRObj18_HeadingVar FLRObj18_ObjDynClass FLRObj18_LatExtRtVar FLRObj18_ObjClass;
SIG_GROUP_ 800 FLRObj17_sg 1 : FLRObj17_LatAccVar FLRObj17_ObstacleConf FLRObj17_LifeTime FLRObj17_LongExtFrVar FLRObj17_LongAcc FLRObj17_LongAccVar FLRObj17_LongExtBack FLRObj17_LongVel FLRObj17_LongPosVar FLRObj17_ObjDynClass FLRObj17_LatAcc FLRObj17_ObjDynClassRestricted FLRObj17_CRC FLRObj17_HeadingVar FLRObj17_Heading FLRObj17_ObstacleConfRestricted FLRObj17_ExistConf FLRObj17_TrackStatus FLRObj17_LongPos FLRObj17_LongExtBkVar FLRObj17_LatPos FLRObj17_CoastIndex FLRObj17_ObjClass FLRObj17_LatPosVar FLRObj17_LongVelVar FLRObj17_LatExtLeft FLRObj17_Height FLRObj17_LatVelVar FLRObj17_LatVel FLRObj17_Counter FLRObj17_LatExtRtVar FLRObj17_AsilLvl FLRObj17_ObjClassConf FLRObj17_LongExtFront FLRObj17_TimeStamp FLRObj17_LatExtLeftVar FLRObj17_ObjID FLRObj17_LatExtRight;
SIG_GROUP_ 799 FLRObj16_sg 1 : FLRObj16_ObstacleConfRestricted FLRObj16_LongExtFrVar FLRObj16_LatVelVar FLRObj16_TimeStamp FLRObj16_LongPosVar FLRObj16_LifeTime FLRObj16_LatAccVar FLRObj16_ObjDynClass FLRObj16_ObjClass FLRObj16_ObjID FLRObj16_LatAcc FLRObj16_LongPos FLRObj16_LatPosVar FLRObj16_HeadingVar FLRObj16_LatPos FLRObj16_LongExtBack FLRObj16_ExistConf FLRObj16_LongExtFront FLRObj16_Counter FLRObj16_Height FLRObj16_Heading FLRObj16_LongAcc FLRObj16_CRC FLRObj16_LatExtRight FLRObj16_LatVel FLRObj16_LongAccVar FLRObj16_LatExtLeft FLRObj16_TrackStatus FLRObj16_ObjDynClassRestricted FLRObj16_LatExtLeftVar FLRObj16_AsilLvl FLRObj16_CoastIndex FLRObj16_LongVel FLRObj16_ObstacleConf FLRObj16_ObjClassConf FLRObj16_LatExtRtVar FLRObj16_LongExtBkVar FLRObj16_LongVelVar;
SIG_GROUP_ 798 FLRObj15_sg 1 : FLRObj15_LatAccVar FLRObj15_Counter FLRObj15_LongExtBack FLRObj15_ObstacleConf FLRObj15_CoastIndex FLRObj15_ObjDynClass FLRObj15_HeadingVar FLRObj15_LatAcc FLRObj15_LatExtLeftVar FLRObj15_LongExtFrVar FLRObj15_LatExtLeft FLRObj15_LatPosVar FLRObj15_LongExtFront FLRObj15_Height FLRObj15_ObjClassConf FLRObj15_LatExtRight FLRObj15_LongPosVar FLRObj15_ObstacleConfRestricted FLRObj15_LongExtBkVar FLRObj15_LatExtRtVar FLRObj15_TrackStatus FLRObj15_ObjClass FLRObj15_LatVelVar FLRObj15_LongAcc FLRObj15_ObjDynClassRestricted FLRObj15_Heading FLRObj15_LongVelVar FLRObj15_LatPos FLRObj15_LongPos FLRObj15_AsilLvl FLRObj15_ObjID FLRObj15_LongVel FLRObj15_ExistConf FLRObj15_LifeTime FLRObj15_TimeStamp FLRObj15_LatVel FLRObj15_LongAccVar FLRObj15_CRC;
