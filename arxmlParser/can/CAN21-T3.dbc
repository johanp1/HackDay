VERSION ""

NS_ :

BS_:

BU_: FLC2 DACU

BO_ 797 FLCObject13_Vic2: 48 FLC2
 SG_ FLCObject13_AnglRightCorner : 199|10@1+ (0.005,-1.57) [-1.57|3.545] "rad"  VCM
 SG_ FLCObject13_TimeStamp : 48|16@1+ (0.1,0) [0|6553.5] "ms"  VCM
 SG_ FLCObject13_ExistConf : 257|7@1+ (0.01,0) [0|1.27] "NotApplicable"  VCM
 SG_ FLCObject13_ScaleChange : 219|10@1+ (0.002,0) [0|2.046] "NotApplicable"  VCM
 SG_ FLCObject13_DstRightVar : 80|8@1+ (0.4,0) [0|102] "NotApplicable"  VCM
 SG_ FLCObject13_BrakeLight : 345|3@1+ (1,0) [0|0] ""  VCM
 SG_ FLCObject13_LifeTime : 64|16@1+ (0.1,0) [0|6553.5] "s"  VCM
 SG_ FLCObject13_DstLeftVar : 112|8@1+ (0.4,0) [0|102] "NotApplicable"  VCM
 SG_ FLCObject13_DistLeftCorner : 152|12@1+ (0.05,0) [0|204.75] "m"  VCM
 SG_ FLCObject13_ObjDynClass : 326|2@1+ (1,0) [0|0] ""  VCM
 SG_ FLCObject13_LongAcc : 239|9@1+ (0.08,-20) [-20|20.88] "m_per_s_squared"  VCM
 SG_ FLCObject13_AngRightVar : 136|8@1+ (1E-005,0) [0|0.00255] "NotApplicable"  VCM
 SG_ FLCObject13_AnglFarCorner : 229|10@1+ (0.005,-1.57) [-1.57|3.545] "rad"  VCM
 SG_ FLCObject13_LatAcc : 248|9@1+ (0.08,-20) [-20|20.88] "m_per_s_squared"  VCM
 SG_ FLCObject13_TurnIndication : 333|3@1+ (1,0) [0|0] ""  VCM
 SG_ FLCObject13_Counter : 16|8@1+ (1,0) [0|255] "Count"  VCM
 SG_ FLCObject13_Heading : 188|11@1+ (0.005818,-4.71) [-4.71|7.199446] "rad"  VCM
 SG_ FLCObject13_HeadingVar : 104|8@1+ (0.1,0) [0|25.5] "NotApplicable"  VCM
 SG_ FLCObject13_DstFarVar : 24|8@1+ (0.4,0) [0|102] "NotApplicable"  VCM
 SG_ FLCObject13_LongPosVar : 144|8@1+ (0.4,0) [0|102] "NotApplicable"  VCM
 SG_ FLCObject13_Height : 96|8@1+ (0.02,0) [0|5.1] "m"  VCM
 SG_ FLCObject13_TargetToLine : 342|3@1+ (1,0) [0|0] ""  VCM
 SG_ FLCObject13_LatVel : 277|13@1+ (0.032,-80) [-80|182.112] "m_per_s"  VCM
 SG_ FLCObject13_CoastIndex : 328|5@1+ (1,0) [0|31] "NotApplicable"  VCM
 SG_ FLCObject13_LatPosVar : 40|8@1+ (0.1,0) [0|25.5] "NotApplicable"  VCM
 SG_ FLCObject13_DistFarCorner : 176|12@1+ (0.05,0) [0|204.75] "m"  VCM
 SG_ FLCObject13_LongPos : 290|13@1+ (0.05,-180) [-180|229.55] "m"  VCM
 SG_ FLCObject13_ObjClass : 316|4@1+ (1,0) [0|0] ""  VCM
 SG_ FLCObject13_LatPos : 264|13@1+ (0.05,-180) [-180|229.55] "m"  VCM
 SG_ FLCObject13_LongVelVar : 88|8@1+ (0.4,0) [0|102] "NotApplicable"  VCM
 SG_ FLCObject13_DistRightCorner : 164|12@1+ (0.05,0) [0|204.75] "m"  VCM
 SG_ FLCObject13_TrackStatus : 339|3@1+ (1,0) [0|0] ""  VCM
 SG_ FLCObject13_CRC : 0|16@1+ (1,0) [0|65535] "NotApplicable"  VCM
 SG_ FLCObject13_AngFarVar : 128|8@1+ (1E-005,0) [0|0.00255] "NotApplicable"  VCM
 SG_ FLCObject13_LatVelVar : 32|8@1+ (0.1,0) [0|25.5] "NotApplicable"  VCM
 SG_ FLCObject13_AnglLeftCorner : 209|10@1+ (0.005,-1.57) [-1.57|3.545] "rad"  VCM
 SG_ FLCObject13_LongVel : 303|13@1+ (0.032,-80) [-80|182.112] "m_per_s"  VCM
 SG_ FLCObject13_AngLeftVar : 120|8@1+ (1E-005,0) [0|0.00255] "NotApplicable"  VCM
 SG_ FLCObject13_ReliabilityConf : 336|3@1+ (1,0) [0|0] ""  VCM
 SG_ FLCObject13_ObjID : 320|6@1+ (1,0) [0|63] "NotApplicable"  VCM

BO_ 796 FLCObject12_Vic2: 48 FLC2
 SG_ FLCObject12_TimeStamp : 48|16@1+ (0.1,0) [0|6553.5] "ms"  VCM
 SG_ FLCObject12_AnglRightCorner : 199|10@1+ (0.005,-1.57) [-1.57|3.545] "rad"  VCM
 SG_ FLCObject12_AnglLeftCorner : 209|10@1+ (0.005,-1.57) [-1.57|3.545] "rad"  VCM
 SG_ FLCObject12_AngRightVar : 136|8@1+ (1E-005,0) [0|0.00255] "NotApplicable"  VCM
 SG_ FLCObject12_ScaleChange : 219|10@1+ (0.002,0) [0|2.046] "NotApplicable"  VCM
 SG_ FLCObject12_CRC : 0|16@1+ (1,0) [0|65535] "NotApplicable"  VCM
 SG_ FLCObject12_AnglFarCorner : 229|10@1+ (0.005,-1.57) [-1.57|3.545] "rad"  VCM
 SG_ FLCObject12_LatPos : 264|13@1+ (0.05,-180) [-180|229.55] "m"  VCM
 SG_ FLCObject12_DistLeftCorner : 152|12@1+ (0.05,0) [0|204.75] "m"  VCM
 SG_ FLCObject12_LongVel : 303|13@1+ (0.032,-80) [-80|182.112] "m_per_s"  VCM
 SG_ FLCObject12_BrakeLight : 345|3@1+ (1,0) [0|0] ""  VCM
 SG_ FLCObject12_Heading : 188|11@1+ (0.005818,-4.71) [-4.71|7.199446] "rad"  VCM
 SG_ FLCObject12_ObjDynClass : 326|2@1+ (1,0) [0|0] ""  VCM
 SG_ FLCObject12_TurnIndication : 333|3@1+ (1,0) [0|0] ""  VCM
 SG_ FLCObject12_LatVelVar : 32|8@1+ (0.1,0) [0|25.5] "NotApplicable"  VCM
 SG_ FLCObject12_LongVelVar : 88|8@1+ (0.4,0) [0|102] "NotApplicable"  VCM
 SG_ FLCObject12_LatPosVar : 40|8@1+ (0.1,0) [0|25.5] "NotApplicable"  VCM
 SG_ FLCObject12_LatAcc : 248|9@1+ (0.08,-20) [-20|20.88] "m_per_s_squared"  VCM
 SG_ FLCObject12_LongAcc : 239|9@1+ (0.08,-20) [-20|20.88] "m_per_s_squared"  VCM
 SG_ FLCObject12_DistFarCorner : 176|12@1+ (0.05,0) [0|204.75] "m"  VCM
 SG_ FLCObject12_DistRightCorner : 164|12@1+ (0.05,0) [0|204.75] "m"  VCM
 SG_ FLCObject12_AngLeftVar : 120|8@1+ (1E-005,0) [0|0.00255] "NotApplicable"  VCM
 SG_ FLCObject12_LongPosVar : 144|8@1+ (0.4,0) [0|102] "NotApplicable"  VCM
 SG_ FLCObject12_TrackStatus : 339|3@1+ (1,0) [0|0] ""  VCM
 SG_ FLCObject12_TargetToLine : 342|3@1+ (1,0) [0|0] ""  VCM
 SG_ FLCObject12_ObjID : 320|6@1+ (1,0) [0|63] "NotApplicable"  VCM
 SG_ FLCObject12_DstFarVar : 24|8@1+ (0.4,0) [0|102] "NotApplicable"  VCM
 SG_ FLCObject12_ReliabilityConf : 336|3@1+ (1,0) [0|0] ""  VCM
 SG_ FLCObject12_ObjClass : 316|4@1+ (1,0) [0|0] ""  VCM
 SG_ FLCObject12_ExistConf : 257|7@1+ (0.01,0) [0|1.27] "NotApplicable"  VCM
 SG_ FLCObject12_LongPos : 290|13@1+ (0.05,-180) [-180|229.55] "m"  VCM
 SG_ FLCObject12_Height : 96|8@1+ (0.02,0) [0|5.1] "m"  VCM
 SG_ FLCObject12_Counter : 16|8@1+ (1,0) [0|255] "Count"  VCM
 SG_ FLCObject12_LifeTime : 64|16@1+ (0.1,0) [0|6553.5] "s"  VCM
 SG_ FLCObject12_DstLeftVar : 112|8@1+ (0.4,0) [0|102] "NotApplicable"  VCM
 SG_ FLCObject12_DstRightVar : 80|8@1+ (0.4,0) [0|102] "NotApplicable"  VCM
 SG_ FLCObject12_CoastIndex : 328|5@1+ (1,0) [0|31] "NotApplicable"  VCM
 SG_ FLCObject12_AngFarVar : 128|8@1+ (1E-005,0) [0|0.00255] "NotApplicable"  VCM
 SG_ FLCObject12_LatVel : 277|13@1+ (0.032,-80) [-80|182.112] "m_per_s"  VCM
 SG_ FLCObject12_HeadingVar : 104|8@1+ (0.1,0) [0|25.5] "NotApplicable"  VCM

BO_ 795 FLCObject11_Vic2: 48 FLC2
 SG_ FLCObject11_ReliabilityConf : 336|3@1+ (1,0) [0|0] ""  VCM
 SG_ FLCObject11_ObjID : 320|6@1+ (1,0) [0|63] "NotApplicable"  VCM
 SG_ FLCObject11_LongPosVar : 144|8@1+ (0.4,0) [0|102] "NotApplicable"  VCM
 SG_ FLCObject11_LatVelVar : 32|8@1+ (0.1,0) [0|25.5] "NotApplicable"  VCM
 SG_ FLCObject11_LongPos : 290|13@1+ (0.05,-180) [-180|229.55] "m"  VCM
 SG_ FLCObject11_LongVel : 303|13@1+ (0.032,-80) [-80|182.112] "m_per_s"  VCM
 SG_ FLCObject11_LongAcc : 239|9@1+ (0.08,-20) [-20|20.88] "m_per_s_squared"  VCM
 SG_ FLCObject11_TimeStamp : 48|16@1+ (0.1,0) [0|6553.5] "ms"  VCM
 SG_ FLCObject11_AnglRightCorner : 199|10@1+ (0.005,-1.57) [-1.57|3.545] "rad"  VCM
 SG_ FLCObject11_LatVel : 277|13@1+ (0.032,-80) [-80|182.112] "m_per_s"  VCM
 SG_ FLCObject11_CoastIndex : 328|5@1+ (1,0) [0|31] "NotApplicable"  VCM
 SG_ FLCObject11_TurnIndication : 333|3@1+ (1,0) [0|0] ""  VCM
 SG_ FLCObject11_AngFarVar : 128|8@1+ (1E-005,0) [0|0.00255] "NotApplicable"  VCM
 SG_ FLCObject11_AnglFarCorner : 229|10@1+ (0.005,-1.57) [-1.57|3.545] "rad"  VCM
 SG_ FLCObject11_DstRightVar : 80|8@1+ (0.4,0) [0|102] "NotApplicable"  VCM
 SG_ FLCObject11_LatAcc : 248|9@1+ (0.08,-20) [-20|20.88] "m_per_s_squared"  VCM
 SG_ FLCObject11_CRC : 0|16@1+ (1,0) [0|65535] "NotApplicable"  VCM
 SG_ FLCObject11_LatPosVar : 40|8@1+ (0.1,0) [0|25.5] "NotApplicable"  VCM
 SG_ FLCObject11_ObjClass : 316|4@1+ (1,0) [0|0] ""  VCM
 SG_ FLCObject11_DistRightCorner : 164|12@1+ (0.05,0) [0|204.75] "m"  VCM
 SG_ FLCObject11_ScaleChange : 219|10@1+ (0.002,0) [0|2.046] "NotApplicable"  VCM
 SG_ FLCObject11_DstFarVar : 24|8@1+ (0.4,0) [0|102] "NotApplicable"  VCM
 SG_ FLCObject11_ObjDynClass : 326|2@1+ (1,0) [0|0] ""  VCM
 SG_ FLCObject11_DstLeftVar : 112|8@1+ (0.4,0) [0|102] "NotApplicable"  VCM
 SG_ FLCObject11_TrackStatus : 339|3@1+ (1,0) [0|0] ""  VCM
 SG_ FLCObject11_LifeTime : 64|16@1+ (0.1,0) [0|6553.5] "s"  VCM
 SG_ FLCObject11_Heading : 188|11@1+ (0.005818,-4.71) [-4.71|7.199446] "rad"  VCM
 SG_ FLCObject11_BrakeLight : 345|3@1+ (1,0) [0|0] ""  VCM
 SG_ FLCObject11_AngRightVar : 136|8@1+ (1E-005,0) [0|0.00255] "NotApplicable"  VCM
 SG_ FLCObject11_DistFarCorner : 176|12@1+ (0.05,0) [0|204.75] "m"  VCM
 SG_ FLCObject11_LongVelVar : 88|8@1+ (0.4,0) [0|102] "NotApplicable"  VCM
 SG_ FLCObject11_HeadingVar : 104|8@1+ (0.1,0) [0|25.5] "NotApplicable"  VCM
 SG_ FLCObject11_Height : 96|8@1+ (0.02,0) [0|5.1] "m"  VCM
 SG_ FLCObject11_AnglLeftCorner : 209|10@1+ (0.005,-1.57) [-1.57|3.545] "rad"  VCM
 SG_ FLCObject11_DistLeftCorner : 152|12@1+ (0.05,0) [0|204.75] "m"  VCM
 SG_ FLCObject11_AngLeftVar : 120|8@1+ (1E-005,0) [0|0.00255] "NotApplicable"  VCM
 SG_ FLCObject11_ExistConf : 257|7@1+ (0.01,0) [0|1.27] "NotApplicable"  VCM
 SG_ FLCObject11_TargetToLine : 342|3@1+ (1,0) [0|0] ""  VCM
 SG_ FLCObject11_Counter : 16|8@1+ (1,0) [0|255] "Count"  VCM
 SG_ FLCObject11_LatPos : 264|13@1+ (0.05,-180) [-180|229.55] "m"  VCM

BO_ 794 FLCObject10_Vic2: 48 FLC2
 SG_ FLCObject10_LatAcc : 248|9@1+ (0.08,-20) [-20|20.88] "m_per_s_squared"  VCM
 SG_ FLCObject10_AnglRightCorner : 199|10@1+ (0.005,-1.57) [-1.57|3.545] "rad"  VCM
 SG_ FLCObject10_TrackStatus : 339|3@1+ (1,0) [0|0] ""  VCM
 SG_ FLCObject10_AnglFarCorner : 229|10@1+ (0.005,-1.57) [-1.57|3.545] "rad"  VCM
 SG_ FLCObject10_ObjClass : 316|4@1+ (1,0) [0|0] ""  VCM
 SG_ FLCObject10_CoastIndex : 328|5@1+ (1,0) [0|31] "NotApplicable"  VCM
 SG_ FLCObject10_LatPosVar : 40|8@1+ (0.1,0) [0|25.5] "NotApplicable"  VCM
 SG_ FLCObject10_Height : 96|8@1+ (0.02,0) [0|5.1] "m"  VCM
 SG_ FLCObject10_ScaleChange : 219|10@1+ (0.002,0) [0|2.046] "NotApplicable"  VCM
 SG_ FLCObject10_DistLeftCorner : 152|12@1+ (0.05,0) [0|204.75] "m"  VCM
 SG_ FLCObject10_Counter : 16|8@1+ (1,0) [0|255] "Count"  VCM
 SG_ FLCObject10_DistRightCorner : 164|12@1+ (0.05,0) [0|204.75] "m"  VCM
 SG_ FLCObject10_DstFarVar : 24|8@1+ (0.4,0) [0|102] "NotApplicable"  VCM
 SG_ FLCObject10_DistFarCorner : 176|12@1+ (0.05,0) [0|204.75] "m"  VCM
 SG_ FLCObject10_AnglLeftCorner : 209|10@1+ (0.005,-1.57) [-1.57|3.545] "rad"  VCM
 SG_ FLCObject10_BrakeLight : 345|3@1+ (1,0) [0|0] ""  VCM
 SG_ FLCObject10_LatPos : 264|13@1+ (0.05,-180) [-180|229.55] "m"  VCM
 SG_ FLCObject10_LatVelVar : 32|8@1+ (0.1,0) [0|25.5] "NotApplicable"  VCM
 SG_ FLCObject10_LongVelVar : 88|8@1+ (0.4,0) [0|102] "NotApplicable"  VCM
 SG_ FLCObject10_HeadingVar : 104|8@1+ (0.1,0) [0|25.5] "NotApplicable"  VCM
 SG_ FLCObject10_AngFarVar : 128|8@1+ (1E-005,0) [0|0.00255] "NotApplicable"  VCM
 SG_ FLCObject10_Heading : 188|11@1+ (0.005818,-4.71) [-4.71|7.199446] "rad"  VCM
 SG_ FLCObject10_ObjID : 320|6@1+ (1,0) [0|63] "NotApplicable"  VCM
 SG_ FLCObject10_TimeStamp : 48|16@1+ (0.1,0) [0|6553.5] "ms"  VCM
 SG_ FLCObject10_LongAcc : 239|9@1+ (0.08,-20) [-20|20.88] "m_per_s_squared"  VCM
 SG_ FLCObject10_LongVel : 303|13@1+ (0.032,-80) [-80|182.112] "m_per_s"  VCM
 SG_ FLCObject10_AngLeftVar : 120|8@1+ (1E-005,0) [0|0.00255] "NotApplicable"  VCM
 SG_ FLCObject10_LifeTime : 64|16@1+ (0.1,0) [0|6553.5] "s"  VCM
 SG_ FLCObject10_LongPosVar : 144|8@1+ (0.4,0) [0|102] "NotApplicable"  VCM
 SG_ FLCObject10_ReliabilityConf : 336|3@1+ (1,0) [0|0] ""  VCM
 SG_ FLCObject10_TurnIndication : 333|3@1+ (1,0) [0|0] ""  VCM
 SG_ FLCObject10_CRC : 0|16@1+ (1,0) [0|65535] "NotApplicable"  VCM
 SG_ FLCObject10_DstLeftVar : 112|8@1+ (0.4,0) [0|102] "NotApplicable"  VCM
 SG_ FLCObject10_AngRightVar : 136|8@1+ (1E-005,0) [0|0.00255] "NotApplicable"  VCM
 SG_ FLCObject10_TargetToLine : 342|3@1+ (1,0) [0|0] ""  VCM
 SG_ FLCObject10_ObjDynClass : 326|2@1+ (1,0) [0|0] ""  VCM
 SG_ FLCObject10_LatVel : 277|13@1+ (0.032,-80) [-80|182.112] "m_per_s"  VCM
 SG_ FLCObject10_LongPos : 290|13@1+ (0.05,-180) [-180|229.55] "m"  VCM
 SG_ FLCObject10_ExistConf : 257|7@1+ (0.01,0) [0|1.27] "NotApplicable"  VCM
 SG_ FLCObject10_DstRightVar : 80|8@1+ (0.4,0) [0|102] "NotApplicable"  VCM

BO_ 793 FLCObject09_Vic2: 48 FLC2
 SG_ FLCObject09_CoastIndex : 328|5@1+ (1,0) [0|31] "NotApplicable"  VCM
 SG_ FLCObject09_DstRightVar : 80|8@1+ (0.4,0) [0|102] "NotApplicable"  VCM
 SG_ FLCObject09_LatAcc : 248|9@1+ (0.08,-20) [-20|20.88] "m_per_s_squared"  VCM
 SG_ FLCObject09_AngLeftVar : 120|8@1+ (1E-005,0) [0|0.00255] "NotApplicable"  VCM
 SG_ FLCObject09_ExistConf : 257|7@1+ (0.01,0) [0|1.27] "NotApplicable"  VCM
 SG_ FLCObject09_DistFarCorner : 176|12@1+ (0.05,0) [0|204.75] "m"  VCM
 SG_ FLCObject09_AnglRightCorner : 199|10@1+ (0.005,-1.57) [-1.57|3.545] "rad"  VCM
 SG_ FLCObject09_AnglFarCorner : 229|10@1+ (0.005,-1.57) [-1.57|3.545] "rad"  VCM
 SG_ FLCObject09_HeadingVar : 104|8@1+ (0.1,0) [0|25.5] "NotApplicable"  VCM
 SG_ FLCObject09_LongPos : 290|13@1+ (0.05,-180) [-180|229.55] "m"  VCM
 SG_ FLCObject09_DistRightCorner : 164|12@1+ (0.05,0) [0|204.75] "m"  VCM
 SG_ FLCObject09_TrackStatus : 339|3@1+ (1,0) [0|0] ""  VCM
 SG_ FLCObject09_DstFarVar : 24|8@1+ (0.4,0) [0|102] "NotApplicable"  VCM
 SG_ FLCObject09_LifeTime : 64|16@1+ (0.1,0) [0|6553.5] "s"  VCM
 SG_ FLCObject09_TimeStamp : 48|16@1+ (0.1,0) [0|6553.5] "ms"  VCM
 SG_ FLCObject09_DstLeftVar : 112|8@1+ (0.4,0) [0|102] "NotApplicable"  VCM
 SG_ FLCObject09_LatPos : 264|13@1+ (0.05,-180) [-180|229.55] "m"  VCM
 SG_ FLCObject09_CRC : 0|16@1+ (1,0) [0|65535] "NotApplicable"  VCM
 SG_ FLCObject09_Heading : 188|11@1+ (0.005818,-4.71) [-4.71|7.199446] "rad"  VCM
 SG_ FLCObject09_LongVelVar : 88|8@1+ (0.4,0) [0|102] "NotApplicable"  VCM
 SG_ FLCObject09_AngRightVar : 136|8@1+ (1E-005,0) [0|0.00255] "NotApplicable"  VCM
 SG_ FLCObject09_ObjClass : 316|4@1+ (1,0) [0|0] ""  VCM
 SG_ FLCObject09_LongAcc : 239|9@1+ (0.08,-20) [-20|20.88] "m_per_s_squared"  VCM
 SG_ FLCObject09_ScaleChange : 219|10@1+ (0.002,0) [0|2.046] "NotApplicable"  VCM
 SG_ FLCObject09_LongVel : 303|13@1+ (0.032,-80) [-80|182.112] "m_per_s"  VCM
 SG_ FLCObject09_LongPosVar : 144|8@1+ (0.4,0) [0|102] "NotApplicable"  VCM
 SG_ FLCObject09_DistLeftCorner : 152|12@1+ (0.05,0) [0|204.75] "m"  VCM
 SG_ FLCObject09_ObjID : 320|6@1+ (1,0) [0|63] "NotApplicable"  VCM
 SG_ FLCObject09_LatPosVar : 40|8@1+ (0.1,0) [0|25.5] "NotApplicable"  VCM
 SG_ FLCObject09_BrakeLight : 345|3@1+ (1,0) [0|0] ""  VCM
 SG_ FLCObject09_Counter : 16|8@1+ (1,0) [0|255] "Count"  VCM
 SG_ FLCObject09_Height : 96|8@1+ (0.02,0) [0|5.1] "m"  VCM
 SG_ FLCObject09_TargetToLine : 342|3@1+ (1,0) [0|0] ""  VCM
 SG_ FLCObject09_ReliabilityConf : 336|3@1+ (1,0) [0|0] ""  VCM
 SG_ FLCObject09_AngFarVar : 128|8@1+ (1E-005,0) [0|0.00255] "NotApplicable"  VCM
 SG_ FLCObject09_LatVelVar : 32|8@1+ (0.1,0) [0|25.5] "NotApplicable"  VCM
 SG_ FLCObject09_LatVel : 277|13@1+ (0.032,-80) [-80|182.112] "m_per_s"  VCM
 SG_ FLCObject09_TurnIndication : 333|3@1+ (1,0) [0|0] ""  VCM
 SG_ FLCObject09_ObjDynClass : 326|2@1+ (1,0) [0|0] ""  VCM
 SG_ FLCObject09_AnglLeftCorner : 209|10@1+ (0.005,-1.57) [-1.57|3.545] "rad"  VCM

BO_ 792 FLCObject08_Vic2: 48 FLC2
 SG_ FLCObject08_LifeTime : 64|16@1+ (0.1,0) [0|6553.5] "s"  VCM
 SG_ FLCObject08_LatVelVar : 32|8@1+ (0.1,0) [0|25.5] "NotApplicable"  VCM
 SG_ FLCObject08_AngLeftVar : 120|8@1+ (1E-005,0) [0|0.00255] "NotApplicable"  VCM
 SG_ FLCObject08_LatPos : 264|13@1+ (0.05,-180) [-180|229.55] "m"  VCM
 SG_ FLCObject08_AnglRightCorner : 199|10@1+ (0.005,-1.57) [-1.57|3.545] "rad"  VCM
 SG_ FLCObject08_DistRightCorner : 164|12@1+ (0.05,0) [0|204.75] "m"  VCM
 SG_ FLCObject08_LongPos : 290|13@1+ (0.05,-180) [-180|229.55] "m"  VCM
 SG_ FLCObject08_ObjClass : 316|4@1+ (1,0) [0|0] ""  VCM
 SG_ FLCObject08_TurnIndication : 333|3@1+ (1,0) [0|0] ""  VCM
 SG_ FLCObject08_DstFarVar : 24|8@1+ (0.4,0) [0|102] "NotApplicable"  VCM
 SG_ FLCObject08_TrackStatus : 339|3@1+ (1,0) [0|0] ""  VCM
 SG_ FLCObject08_DstRightVar : 80|8@1+ (0.4,0) [0|102] "NotApplicable"  VCM
 SG_ FLCObject08_LatAcc : 248|9@1+ (0.08,-20) [-20|20.88] "m_per_s_squared"  VCM
 SG_ FLCObject08_AngRightVar : 136|8@1+ (1E-005,0) [0|0.00255] "NotApplicable"  VCM
 SG_ FLCObject08_ScaleChange : 219|10@1+ (0.002,0) [0|2.046] "NotApplicable"  VCM
 SG_ FLCObject08_ObjDynClass : 326|2@1+ (1,0) [0|0] ""  VCM
 SG_ FLCObject08_BrakeLight : 345|3@1+ (1,0) [0|0] ""  VCM
 SG_ FLCObject08_Counter : 16|8@1+ (1,0) [0|255] "Count"  VCM
 SG_ FLCObject08_TargetToLine : 342|3@1+ (1,0) [0|0] ""  VCM
 SG_ FLCObject08_DstLeftVar : 112|8@1+ (0.4,0) [0|102] "NotApplicable"  VCM
 SG_ FLCObject08_ReliabilityConf : 336|3@1+ (1,0) [0|0] ""  VCM
 SG_ FLCObject08_ObjID : 320|6@1+ (1,0) [0|63] "NotApplicable"  VCM
 SG_ FLCObject08_AngFarVar : 128|8@1+ (1E-005,0) [0|0.00255] "NotApplicable"  VCM
 SG_ FLCObject08_HeadingVar : 104|8@1+ (0.1,0) [0|25.5] "NotApplicable"  VCM
 SG_ FLCObject08_LongVel : 303|13@1+ (0.032,-80) [-80|182.112] "m_per_s"  VCM
 SG_ FLCObject08_CRC : 0|16@1+ (1,0) [0|65535] "NotApplicable"  VCM
 SG_ FLCObject08_LongPosVar : 144|8@1+ (0.4,0) [0|102] "NotApplicable"  VCM
 SG_ FLCObject08_AnglFarCorner : 229|10@1+ (0.005,-1.57) [-1.57|3.545] "rad"  VCM
 SG_ FLCObject08_LatPosVar : 40|8@1+ (0.1,0) [0|25.5] "NotApplicable"  VCM
 SG_ FLCObject08_CoastIndex : 328|5@1+ (1,0) [0|31] "NotApplicable"  VCM
 SG_ FLCObject08_TimeStamp : 48|16@1+ (0.1,0) [0|6553.5] "ms"  VCM
 SG_ FLCObject08_DistFarCorner : 176|12@1+ (0.05,0) [0|204.75] "m"  VCM
 SG_ FLCObject08_ExistConf : 257|7@1+ (0.01,0) [0|1.27] "NotApplicable"  VCM
 SG_ FLCObject08_Heading : 188|11@1+ (0.005818,-4.71) [-4.71|7.199446] "rad"  VCM
 SG_ FLCObject08_Height : 96|8@1+ (0.02,0) [0|5.1] "m"  VCM
 SG_ FLCObject08_AnglLeftCorner : 209|10@1+ (0.005,-1.57) [-1.57|3.545] "rad"  VCM
 SG_ FLCObject08_LatVel : 277|13@1+ (0.032,-80) [-80|182.112] "m_per_s"  VCM
 SG_ FLCObject08_DistLeftCorner : 152|12@1+ (0.05,0) [0|204.75] "m"  VCM
 SG_ FLCObject08_LongAcc : 239|9@1+ (0.08,-20) [-20|20.88] "m_per_s_squared"  VCM
 SG_ FLCObject08_LongVelVar : 88|8@1+ (0.4,0) [0|102] "NotApplicable"  VCM

BO_ 791 FLCObject07_Vic2: 48 FLC2
 SG_ FLCObject07_Counter : 16|8@1+ (1,0) [0|255] "Count"  VCM
 SG_ FLCObject07_TargetToLine : 342|3@1+ (1,0) [0|0] ""  VCM
 SG_ FLCObject07_LongPosVar : 144|8@1+ (0.4,0) [0|102] "NotApplicable"  VCM
 SG_ FLCObject07_DistFarCorner : 176|12@1+ (0.05,0) [0|204.75] "m"  VCM
 SG_ FLCObject07_AngLeftVar : 120|8@1+ (1E-005,0) [0|0.00255] "NotApplicable"  VCM
 SG_ FLCObject07_AngRightVar : 136|8@1+ (1E-005,0) [0|0.00255] "NotApplicable"  VCM
 SG_ FLCObject07_LatVel : 277|13@1+ (0.032,-80) [-80|182.112] "m_per_s"  VCM
 SG_ FLCObject07_HeadingVar : 104|8@1+ (0.1,0) [0|25.5] "NotApplicable"  VCM
 SG_ FLCObject07_TurnIndication : 333|3@1+ (1,0) [0|0] ""  VCM
 SG_ FLCObject07_LatVelVar : 32|8@1+ (0.1,0) [0|25.5] "NotApplicable"  VCM
 SG_ FLCObject07_CoastIndex : 328|5@1+ (1,0) [0|31] "NotApplicable"  VCM
 SG_ FLCObject07_ObjClass : 316|4@1+ (1,0) [0|0] ""  VCM
 SG_ FLCObject07_LatAcc : 248|9@1+ (0.08,-20) [-20|20.88] "m_per_s_squared"  VCM
 SG_ FLCObject07_DstRightVar : 80|8@1+ (0.4,0) [0|102] "NotApplicable"  VCM
 SG_ FLCObject07_LongVel : 303|13@1+ (0.032,-80) [-80|182.112] "m_per_s"  VCM
 SG_ FLCObject07_AnglRightCorner : 199|10@1+ (0.005,-1.57) [-1.57|3.545] "rad"  VCM
 SG_ FLCObject07_ObjDynClass : 326|2@1+ (1,0) [0|0] ""  VCM
 SG_ FLCObject07_AnglLeftCorner : 209|10@1+ (0.005,-1.57) [-1.57|3.545] "rad"  VCM
 SG_ FLCObject07_Heading : 188|11@1+ (0.005818,-4.71) [-4.71|7.199446] "rad"  VCM
 SG_ FLCObject07_ExistConf : 257|7@1+ (0.01,0) [0|1.27] "NotApplicable"  VCM
 SG_ FLCObject07_TimeStamp : 48|16@1+ (0.1,0) [0|6553.5] "ms"  VCM
 SG_ FLCObject07_DstLeftVar : 112|8@1+ (0.4,0) [0|102] "NotApplicable"  VCM
 SG_ FLCObject07_DstFarVar : 24|8@1+ (0.4,0) [0|102] "NotApplicable"  VCM
 SG_ FLCObject07_Height : 96|8@1+ (0.02,0) [0|5.1] "m"  VCM
 SG_ FLCObject07_DistRightCorner : 164|12@1+ (0.05,0) [0|204.75] "m"  VCM
 SG_ FLCObject07_ReliabilityConf : 336|3@1+ (1,0) [0|0] ""  VCM
 SG_ FLCObject07_LongPos : 290|13@1+ (0.05,-180) [-180|229.55] "m"  VCM
 SG_ FLCObject07_LatPosVar : 40|8@1+ (0.1,0) [0|25.5] "NotApplicable"  VCM
 SG_ FLCObject07_AnglFarCorner : 229|10@1+ (0.005,-1.57) [-1.57|3.545] "rad"  VCM
 SG_ FLCObject07_ObjID : 320|6@1+ (1,0) [0|63] "NotApplicable"  VCM
 SG_ FLCObject07_ScaleChange : 219|10@1+ (0.002,0) [0|2.046] "NotApplicable"  VCM
 SG_ FLCObject07_AngFarVar : 128|8@1+ (1E-005,0) [0|0.00255] "NotApplicable"  VCM
 SG_ FLCObject07_LatPos : 264|13@1+ (0.05,-180) [-180|229.55] "m"  VCM
 SG_ FLCObject07_TrackStatus : 339|3@1+ (1,0) [0|0] ""  VCM
 SG_ FLCObject07_LongVelVar : 88|8@1+ (0.4,0) [0|102] "NotApplicable"  VCM
 SG_ FLCObject07_DistLeftCorner : 152|12@1+ (0.05,0) [0|204.75] "m"  VCM
 SG_ FLCObject07_CRC : 0|16@1+ (1,0) [0|65535] "NotApplicable"  VCM
 SG_ FLCObject07_LongAcc : 239|9@1+ (0.08,-20) [-20|20.88] "m_per_s_squared"  VCM
 SG_ FLCObject07_LifeTime : 64|16@1+ (0.1,0) [0|6553.5] "s"  VCM
 SG_ FLCObject07_BrakeLight : 345|3@1+ (1,0) [0|0] ""  VCM

BO_ 790 FLCObject06_Vic2: 48 FLC2
 SG_ FLCObject06_LatPosVar : 40|8@1+ (0.1,0) [0|25.5] "NotApplicable"  VCM
 SG_ FLCObject06_CoastIndex : 328|5@1+ (1,0) [0|31] "NotApplicable"  VCM
 SG_ FLCObject06_LifeTime : 64|16@1+ (0.1,0) [0|6553.5] "s"  VCM
 SG_ FLCObject06_DistLeftCorner : 152|12@1+ (0.05,0) [0|204.75] "m"  VCM
 SG_ FLCObject06_LongAcc : 239|9@1+ (0.08,-20) [-20|20.88] "m_per_s_squared"  VCM
 SG_ FLCObject06_ObjClass : 316|4@1+ (1,0) [0|0] ""  VCM
 SG_ FLCObject06_ObjID : 320|6@1+ (1,0) [0|63] "NotApplicable"  VCM
 SG_ FLCObject06_LongPosVar : 144|8@1+ (0.4,0) [0|102] "NotApplicable"  VCM
 SG_ FLCObject06_TrackStatus : 339|3@1+ (1,0) [0|0] ""  VCM
 SG_ FLCObject06_AngFarVar : 128|8@1+ (1E-005,0) [0|0.00255] "NotApplicable"  VCM
 SG_ FLCObject06_DstLeftVar : 112|8@1+ (0.4,0) [0|102] "NotApplicable"  VCM
 SG_ FLCObject06_LongVelVar : 88|8@1+ (0.4,0) [0|102] "NotApplicable"  VCM
 SG_ FLCObject06_BrakeLight : 345|3@1+ (1,0) [0|0] ""  VCM
 SG_ FLCObject06_HeadingVar : 104|8@1+ (0.1,0) [0|25.5] "NotApplicable"  VCM
 SG_ FLCObject06_TimeStamp : 48|16@1+ (0.1,0) [0|6553.5] "ms"  VCM
 SG_ FLCObject06_ExistConf : 257|7@1+ (0.01,0) [0|1.27] "NotApplicable"  VCM
 SG_ FLCObject06_CRC : 0|16@1+ (1,0) [0|65535] "NotApplicable"  VCM
 SG_ FLCObject06_DistFarCorner : 176|12@1+ (0.05,0) [0|204.75] "m"  VCM
 SG_ FLCObject06_LongPos : 290|13@1+ (0.05,-180) [-180|229.55] "m"  VCM
 SG_ FLCObject06_AnglFarCorner : 229|10@1+ (0.005,-1.57) [-1.57|3.545] "rad"  VCM
 SG_ FLCObject06_LatVelVar : 32|8@1+ (0.1,0) [0|25.5] "NotApplicable"  VCM
 SG_ FLCObject06_DstRightVar : 80|8@1+ (0.4,0) [0|102] "NotApplicable"  VCM
 SG_ FLCObject06_AngLeftVar : 120|8@1+ (1E-005,0) [0|0.00255] "NotApplicable"  VCM
 SG_ FLCObject06_TurnIndication : 333|3@1+ (1,0) [0|0] ""  VCM
 SG_ FLCObject06_LongVel : 303|13@1+ (0.032,-80) [-80|182.112] "m_per_s"  VCM
 SG_ FLCObject06_AnglLeftCorner : 209|10@1+ (0.005,-1.57) [-1.57|3.545] "rad"  VCM
 SG_ FLCObject06_Height : 96|8@1+ (0.02,0) [0|5.1] "m"  VCM
 SG_ FLCObject06_LatPos : 264|13@1+ (0.05,-180) [-180|229.55] "m"  VCM
 SG_ FLCObject06_AngRightVar : 136|8@1+ (1E-005,0) [0|0.00255] "NotApplicable"  VCM
 SG_ FLCObject06_TargetToLine : 342|3@1+ (1,0) [0|0] ""  VCM
 SG_ FLCObject06_LatAcc : 248|9@1+ (0.08,-20) [-20|20.88] "m_per_s_squared"  VCM
 SG_ FLCObject06_ReliabilityConf : 336|3@1+ (1,0) [0|0] ""  VCM
 SG_ FLCObject06_Counter : 16|8@1+ (1,0) [0|255] "Count"  VCM
 SG_ FLCObject06_Heading : 188|11@1+ (0.005818,-4.71) [-4.71|7.199446] "rad"  VCM
 SG_ FLCObject06_ScaleChange : 219|10@1+ (0.002,0) [0|2.046] "NotApplicable"  VCM
 SG_ FLCObject06_DstFarVar : 24|8@1+ (0.4,0) [0|102] "NotApplicable"  VCM
 SG_ FLCObject06_DistRightCorner : 164|12@1+ (0.05,0) [0|204.75] "m"  VCM
 SG_ FLCObject06_AnglRightCorner : 199|10@1+ (0.005,-1.57) [-1.57|3.545] "rad"  VCM
 SG_ FLCObject06_LatVel : 277|13@1+ (0.032,-80) [-80|182.112] "m_per_s"  VCM
 SG_ FLCObject06_ObjDynClass : 326|2@1+ (1,0) [0|0] ""  VCM

BO_ 789 FLCObject05_Vic2: 48 FLC2
 SG_ FLCObject05_LongVelVar : 88|8@1+ (0.4,0) [0|102] "NotApplicable"  VCM
 SG_ FLCObject05_TurnIndication : 333|3@1+ (1,0) [0|0] ""  VCM
 SG_ FLCObject05_BrakeLight : 345|3@1+ (1,0) [0|0] ""  VCM
 SG_ FLCObject05_DistRightCorner : 164|12@1+ (0.05,0) [0|204.75] "m"  VCM
 SG_ FLCObject05_DstFarVar : 24|8@1+ (0.4,0) [0|102] "NotApplicable"  VCM
 SG_ FLCObject05_DstLeftVar : 112|8@1+ (0.4,0) [0|102] "NotApplicable"  VCM
 SG_ FLCObject05_AngFarVar : 128|8@1+ (1E-005,0) [0|0.00255] "NotApplicable"  VCM
 SG_ FLCObject05_AnglFarCorner : 229|10@1+ (0.005,-1.57) [-1.57|3.545] "rad"  VCM
 SG_ FLCObject05_LongVel : 303|13@1+ (0.032,-80) [-80|182.112] "m_per_s"  VCM
 SG_ FLCObject05_Counter : 16|8@1+ (1,0) [0|255] "Count"  VCM
 SG_ FLCObject05_LatAcc : 248|9@1+ (0.08,-20) [-20|20.88] "m_per_s_squared"  VCM
 SG_ FLCObject05_AnglRightCorner : 199|10@1+ (0.005,-1.57) [-1.57|3.545] "rad"  VCM
 SG_ FLCObject05_ReliabilityConf : 336|3@1+ (1,0) [0|0] ""  VCM
 SG_ FLCObject05_Heading : 188|11@1+ (0.005818,-4.71) [-4.71|7.199446] "rad"  VCM
 SG_ FLCObject05_CoastIndex : 328|5@1+ (1,0) [0|31] "NotApplicable"  VCM
 SG_ FLCObject05_LongAcc : 239|9@1+ (0.08,-20) [-20|20.88] "m_per_s_squared"  VCM
 SG_ FLCObject05_LatVel : 277|13@1+ (0.032,-80) [-80|182.112] "m_per_s"  VCM
 SG_ FLCObject05_ScaleChange : 219|10@1+ (0.002,0) [0|2.046] "NotApplicable"  VCM
 SG_ FLCObject05_HeadingVar : 104|8@1+ (0.1,0) [0|25.5] "NotApplicable"  VCM
 SG_ FLCObject05_LifeTime : 64|16@1+ (0.1,0) [0|6553.5] "s"  VCM
 SG_ FLCObject05_LongPosVar : 144|8@1+ (0.4,0) [0|102] "NotApplicable"  VCM
 SG_ FLCObject05_DistLeftCorner : 152|12@1+ (0.05,0) [0|204.75] "m"  VCM
 SG_ FLCObject05_TrackStatus : 339|3@1+ (1,0) [0|0] ""  VCM
 SG_ FLCObject05_LatPosVar : 40|8@1+ (0.1,0) [0|25.5] "NotApplicable"  VCM
 SG_ FLCObject05_AngLeftVar : 120|8@1+ (1E-005,0) [0|0.00255] "NotApplicable"  VCM
 SG_ FLCObject05_ExistConf : 257|7@1+ (0.01,0) [0|1.27] "NotApplicable"  VCM
 SG_ FLCObject05_DstRightVar : 80|8@1+ (0.4,0) [0|102] "NotApplicable"  VCM
 SG_ FLCObject05_AnglLeftCorner : 209|10@1+ (0.005,-1.57) [-1.57|3.545] "rad"  VCM
 SG_ FLCObject05_ObjDynClass : 326|2@1+ (1,0) [0|0] ""  VCM
 SG_ FLCObject05_DistFarCorner : 176|12@1+ (0.05,0) [0|204.75] "m"  VCM
 SG_ FLCObject05_ObjClass : 316|4@1+ (1,0) [0|0] ""  VCM
 SG_ FLCObject05_TimeStamp : 48|16@1+ (0.1,0) [0|6553.5] "ms"  VCM
 SG_ FLCObject05_LatVelVar : 32|8@1+ (0.1,0) [0|25.5] "NotApplicable"  VCM
 SG_ FLCObject05_LatPos : 264|13@1+ (0.05,-180) [-180|229.55] "m"  VCM
 SG_ FLCObject05_LongPos : 290|13@1+ (0.05,-180) [-180|229.55] "m"  VCM
 SG_ FLCObject05_TargetToLine : 342|3@1+ (1,0) [0|0] ""  VCM
 SG_ FLCObject05_CRC : 0|16@1+ (1,0) [0|65535] "NotApplicable"  VCM
 SG_ FLCObject05_Height : 96|8@1+ (0.02,0) [0|5.1] "m"  VCM
 SG_ FLCObject05_ObjID : 320|6@1+ (1,0) [0|63] "NotApplicable"  VCM
 SG_ FLCObject05_AngRightVar : 136|8@1+ (1E-005,0) [0|0.00255] "NotApplicable"  VCM

BA_DEF_ BO_  "GenMsgStartDelayTime" INT 0 0;
BA_DEF_ BO_  "GenMsgDelayTime" INT 0 0;
BA_DEF_ BO_  "GenMsgCycleTime" INT 0 0;
BA_DEF_ BO_  "GenMsgSendType" ENUM  "Cyclic","NotUsed","NotUsed","NotUsed","NotUsed","NotUsed","NotUsed","IfActive","NoMsgSendType","NotUsed";
BA_DEF_ SG_  "GenSigStartValue" INT 0 0;
BA_DEF_ SG_  "GenSigCycleTimeActive" INT 0 0;
BA_DEF_ SG_  "GenSigCycleTime" INT 0 0;
BA_DEF_ SG_  "GenSigSendType" ENUM  "Cyclic","OnWrite","OnWriteWithRepetition","OnChange","OnChangeWithRepetition","IfActive","IfActiveWithRepetition","NoSigSendType","NotUsed","NotUsed","NotUsed","NotUsed","NotUsed";
BA_DEF_ BO_  "VFrameFormat" ENUM  "StandardCAN","ExtendedCAN","reserved","J1939PG","reserved","reserved","reserved","reserved","reserved","reserved","reserved","reserved","reserved","reserved","StandardCAN_FD","ExtendedCAN_FD";
BA_DEF_ SG_  "SigType" ENUM  "Default","Range","RangeSigned","ASCII","Discrete","Control","ReferencePGN","DTC","StringDelimiter","StringLength","StringLengthControl";
BA_DEF_ SG_  "SeToolVersion_SIGNAL" STRING ;
BA_DEF_ SG_  "SeToolUniqueID_SIGNAL" STRING ;
BA_DEF_ SG_  "SeToolName_SIGNAL" STRING ;
BA_DEF_ SG_  "SeToolItemID_SIGNAL" STRING ;
BA_DEF_ SG_  "SeToolAncestorID_SIGNAL" STRING ;
BA_DEF_ SG_  "NeedsUpdateBit" ENUM  "No","Yes";
BA_DEF_ SG_  "GenSigILSupport" ENUM  "Yes","No";
BA_DEF_ BO_  "GenMsgILSupport" ENUM  "No","Yes";
BA_DEF_ SG_  "E2EProfile" STRING ;
BA_DEF_ SG_  "E2EDataLength" INT 0 65535;
BA_DEF_ SG_  "E2EDataId" INT 0 65535;
BA_DEF_ BO_  "DiagUUDTResponse" ENUM  "No","Yes";
BA_DEF_ BO_  "DiagState" ENUM  "No","Yes";
BA_DEF_ BO_  "DiagResponse" ENUM  "No","Yes";
BA_DEF_ BO_  "DiagRequest" ENUM  "No","Yes";
BA_DEF_ BO_  "DiagConnection" HEX 0 65535;
BA_DEF_ BO_  "CanTpFcFrameId" HEX 0 2147483647;
BA_DEF_ BO_  "CanTpBs" INT 0 255;
BA_DEF_ BO_  "CANFD_BRS" ENUM  "0","1";
BA_DEF_REL_ BU_SG_REL_  "GenSigTimeoutTime" INT 0 65535;
BA_DEF_REL_ BU_SG_REL_  "GenSigFirstTimeoutTime" INT 0 65535;
BA_DEF_DEF_  "GenMsgStartDelayTime" 0;
BA_DEF_DEF_  "GenMsgDelayTime" 0;
BA_DEF_DEF_  "GenMsgCycleTime" 0;
BA_DEF_DEF_  "GenMsgSendType" "Cyclic";
BA_DEF_DEF_  "GenSigStartValue" 0;
BA_DEF_DEF_  "GenSigCycleTimeActive" 0;
BA_DEF_DEF_  "GenSigCycleTime" 0;
BA_DEF_DEF_  "GenSigSendType" "Cyclic";
BA_DEF_DEF_  "VFrameFormat" "ExtendedCAN";
BA_DEF_DEF_  "SigType" "Default";
BA_DEF_DEF_  "SeToolVersion_SIGNAL" "";
BA_DEF_DEF_  "SeToolUniqueID_SIGNAL" "";
BA_DEF_DEF_  "SeToolName_SIGNAL" "";
BA_DEF_DEF_  "SeToolItemID_SIGNAL" "";
BA_DEF_DEF_  "SeToolAncestorID_SIGNAL" "";
BA_DEF_DEF_  "NeedsUpdateBit" "No";
BA_DEF_DEF_  "GenSigILSupport" "Yes";
BA_DEF_DEF_  "GenMsgILSupport" "Yes";
BA_DEF_DEF_  "E2EProfile" "none";
BA_DEF_DEF_  "E2EDataLength" 0;
BA_DEF_DEF_  "E2EDataId" 0;
BA_DEF_DEF_  "DiagUUDTResponse" "No";
BA_DEF_DEF_  "DiagState" "No";
BA_DEF_DEF_  "DiagResponse" "No";
BA_DEF_DEF_  "DiagRequest" "No";
BA_DEF_DEF_  "DiagConnection" 0;
BA_DEF_DEF_  "CanTpFcFrameId" 2147483647;
BA_DEF_DEF_  "CanTpBs" 255;
BA_DEF_DEF_  "CANFD_BRS" "0";
BA_DEF_DEF_REL_ "GenSigTimeoutTime" 0;
BA_DEF_DEF_REL_ "GenSigFirstTimeoutTime" 0;
BA_ "CANFD_BRS" BO_ 797 1;
BA_ "GenMsgSendType" BO_ 797 8;
BA_ "VFrameFormat" BO_ 797 14;
BA_ "CANFD_BRS" BO_ 796 1;
BA_ "GenMsgSendType" BO_ 796 8;
BA_ "VFrameFormat" BO_ 796 14;
BA_ "CANFD_BRS" BO_ 795 1;
BA_ "GenMsgSendType" BO_ 795 8;
BA_ "VFrameFormat" BO_ 795 14;
BA_ "CANFD_BRS" BO_ 794 1;
BA_ "GenMsgSendType" BO_ 794 8;
BA_ "VFrameFormat" BO_ 794 14;
BA_ "CANFD_BRS" BO_ 793 1;
BA_ "GenMsgSendType" BO_ 793 8;
BA_ "VFrameFormat" BO_ 793 14;
BA_ "CANFD_BRS" BO_ 792 1;
BA_ "GenMsgSendType" BO_ 792 8;
BA_ "VFrameFormat" BO_ 792 14;
BA_ "CANFD_BRS" BO_ 791 1;
BA_ "GenMsgSendType" BO_ 791 8;
BA_ "VFrameFormat" BO_ 791 14;
BA_ "CANFD_BRS" BO_ 790 1;
BA_ "GenMsgSendType" BO_ 790 8;
BA_ "VFrameFormat" BO_ 790 14;
BA_ "CANFD_BRS" BO_ 789 1;
BA_ "GenMsgSendType" BO_ 789 8;
BA_ "VFrameFormat" BO_ 789 14;
BA_ "GenSigSendType" SG_ 797 FLCObject13_AnglRightCorner 1;
BA_ "GenSigStartValue" SG_ 797 FLCObject13_AnglRightCorner 1023;
BA_ "GenSigSendType" SG_ 797 FLCObject13_TimeStamp 1;
BA_ "GenSigStartValue" SG_ 797 FLCObject13_TimeStamp 65535;
BA_ "GenSigSendType" SG_ 797 FLCObject13_ExistConf 1;
BA_ "GenSigStartValue" SG_ 797 FLCObject13_ExistConf 127;
BA_ "GenSigSendType" SG_ 797 FLCObject13_ScaleChange 1;
BA_ "GenSigStartValue" SG_ 797 FLCObject13_ScaleChange 1023;
BA_ "GenSigSendType" SG_ 797 FLCObject13_DstRightVar 1;
BA_ "GenSigStartValue" SG_ 797 FLCObject13_DstRightVar 255;
BA_ "GenSigSendType" SG_ 797 FLCObject13_BrakeLight 1;
BA_ "GenSigStartValue" SG_ 797 FLCObject13_BrakeLight 7;
BA_ "GenSigSendType" SG_ 797 FLCObject13_LifeTime 1;
BA_ "GenSigStartValue" SG_ 797 FLCObject13_LifeTime 65535;
BA_ "GenSigSendType" SG_ 797 FLCObject13_DstLeftVar 1;
BA_ "GenSigStartValue" SG_ 797 FLCObject13_DstLeftVar 255;
BA_ "GenSigSendType" SG_ 797 FLCObject13_DistLeftCorner 1;
BA_ "GenSigStartValue" SG_ 797 FLCObject13_DistLeftCorner 4095;
BA_ "GenSigSendType" SG_ 797 FLCObject13_ObjDynClass 1;
BA_ "GenSigStartValue" SG_ 797 FLCObject13_ObjDynClass 3;
BA_ "GenSigSendType" SG_ 797 FLCObject13_LongAcc 1;
BA_ "GenSigStartValue" SG_ 797 FLCObject13_LongAcc 511;
BA_ "GenSigSendType" SG_ 797 FLCObject13_AngRightVar 1;
BA_ "GenSigStartValue" SG_ 797 FLCObject13_AngRightVar 255;
BA_ "GenSigSendType" SG_ 797 FLCObject13_AnglFarCorner 1;
BA_ "GenSigStartValue" SG_ 797 FLCObject13_AnglFarCorner 1023;
BA_ "GenSigSendType" SG_ 797 FLCObject13_LatAcc 1;
BA_ "GenSigStartValue" SG_ 797 FLCObject13_LatAcc 511;
BA_ "GenSigSendType" SG_ 797 FLCObject13_TurnIndication 1;
BA_ "GenSigStartValue" SG_ 797 FLCObject13_TurnIndication 7;
BA_ "GenSigSendType" SG_ 797 FLCObject13_Counter 1;
BA_ "GenSigStartValue" SG_ 797 FLCObject13_Counter 255;
BA_ "GenSigSendType" SG_ 797 FLCObject13_Heading 1;
BA_ "GenSigStartValue" SG_ 797 FLCObject13_Heading 2047;
BA_ "GenSigSendType" SG_ 797 FLCObject13_HeadingVar 1;
BA_ "GenSigStartValue" SG_ 797 FLCObject13_HeadingVar 255;
BA_ "GenSigSendType" SG_ 797 FLCObject13_DstFarVar 1;
BA_ "GenSigStartValue" SG_ 797 FLCObject13_DstFarVar 255;
BA_ "GenSigSendType" SG_ 797 FLCObject13_LongPosVar 1;
BA_ "GenSigStartValue" SG_ 797 FLCObject13_LongPosVar 255;
BA_ "GenSigSendType" SG_ 797 FLCObject13_Height 1;
BA_ "GenSigStartValue" SG_ 797 FLCObject13_Height 255;
BA_ "GenSigSendType" SG_ 797 FLCObject13_TargetToLine 1;
BA_ "GenSigStartValue" SG_ 797 FLCObject13_TargetToLine 7;
BA_ "GenSigSendType" SG_ 797 FLCObject13_LatVel 1;
BA_ "GenSigStartValue" SG_ 797 FLCObject13_LatVel 8191;
BA_ "GenSigSendType" SG_ 797 FLCObject13_CoastIndex 1;
BA_ "GenSigStartValue" SG_ 797 FLCObject13_CoastIndex 31;
BA_ "GenSigSendType" SG_ 797 FLCObject13_LatPosVar 1;
BA_ "GenSigStartValue" SG_ 797 FLCObject13_LatPosVar 255;
BA_ "GenSigSendType" SG_ 797 FLCObject13_DistFarCorner 1;
BA_ "GenSigStartValue" SG_ 797 FLCObject13_DistFarCorner 4095;
BA_ "GenSigSendType" SG_ 797 FLCObject13_LongPos 1;
BA_ "GenSigStartValue" SG_ 797 FLCObject13_LongPos 8191;
BA_ "GenSigSendType" SG_ 797 FLCObject13_ObjClass 1;
BA_ "GenSigStartValue" SG_ 797 FLCObject13_ObjClass 15;
BA_ "GenSigSendType" SG_ 797 FLCObject13_LatPos 1;
BA_ "GenSigStartValue" SG_ 797 FLCObject13_LatPos 8191;
BA_ "GenSigSendType" SG_ 797 FLCObject13_LongVelVar 1;
BA_ "GenSigStartValue" SG_ 797 FLCObject13_LongVelVar 255;
BA_ "GenSigSendType" SG_ 797 FLCObject13_DistRightCorner 1;
BA_ "GenSigStartValue" SG_ 797 FLCObject13_DistRightCorner 4095;
BA_ "GenSigSendType" SG_ 797 FLCObject13_TrackStatus 1;
BA_ "GenSigStartValue" SG_ 797 FLCObject13_TrackStatus 7;
BA_ "GenSigSendType" SG_ 797 FLCObject13_CRC 1;
BA_ "GenSigStartValue" SG_ 797 FLCObject13_CRC 65535;
BA_ "E2EDataId" SG_ 797 FLCObject13_CRC 118;
BA_ "E2EDataLength" SG_ 797 FLCObject13_CRC 352;
BA_ "E2EProfile" SG_ 797 FLCObject13_CRC "P05";
BA_ "GenSigSendType" SG_ 797 FLCObject13_AngFarVar 1;
BA_ "GenSigStartValue" SG_ 797 FLCObject13_AngFarVar 255;
BA_ "GenSigSendType" SG_ 797 FLCObject13_LatVelVar 1;
BA_ "GenSigStartValue" SG_ 797 FLCObject13_LatVelVar 255;
BA_ "GenSigSendType" SG_ 797 FLCObject13_AnglLeftCorner 1;
BA_ "GenSigStartValue" SG_ 797 FLCObject13_AnglLeftCorner 1023;
BA_ "GenSigSendType" SG_ 797 FLCObject13_LongVel 1;
BA_ "GenSigStartValue" SG_ 797 FLCObject13_LongVel 8191;
BA_ "GenSigSendType" SG_ 797 FLCObject13_AngLeftVar 1;
BA_ "GenSigStartValue" SG_ 797 FLCObject13_AngLeftVar 255;
BA_ "GenSigSendType" SG_ 797 FLCObject13_ReliabilityConf 1;
BA_ "GenSigStartValue" SG_ 797 FLCObject13_ReliabilityConf 7;
BA_ "GenSigSendType" SG_ 797 FLCObject13_ObjID 1;
BA_ "GenSigStartValue" SG_ 797 FLCObject13_ObjID 63;
BA_ "GenSigSendType" SG_ 796 FLCObject12_TimeStamp 1;
BA_ "GenSigStartValue" SG_ 796 FLCObject12_TimeStamp 65535;
BA_ "GenSigSendType" SG_ 796 FLCObject12_AnglRightCorner 1;
BA_ "GenSigStartValue" SG_ 796 FLCObject12_AnglRightCorner 1023;
BA_ "GenSigSendType" SG_ 796 FLCObject12_AnglLeftCorner 1;
BA_ "GenSigStartValue" SG_ 796 FLCObject12_AnglLeftCorner 1023;
BA_ "GenSigSendType" SG_ 796 FLCObject12_AngRightVar 1;
BA_ "GenSigStartValue" SG_ 796 FLCObject12_AngRightVar 255;
BA_ "GenSigSendType" SG_ 796 FLCObject12_ScaleChange 1;
BA_ "GenSigStartValue" SG_ 796 FLCObject12_ScaleChange 1023;
BA_ "GenSigSendType" SG_ 796 FLCObject12_CRC 1;
BA_ "GenSigStartValue" SG_ 796 FLCObject12_CRC 65535;
BA_ "E2EDataId" SG_ 796 FLCObject12_CRC 117;
BA_ "E2EDataLength" SG_ 796 FLCObject12_CRC 352;
BA_ "E2EProfile" SG_ 796 FLCObject12_CRC "P05";
BA_ "GenSigSendType" SG_ 796 FLCObject12_AnglFarCorner 1;
BA_ "GenSigStartValue" SG_ 796 FLCObject12_AnglFarCorner 1023;
BA_ "GenSigSendType" SG_ 796 FLCObject12_LatPos 1;
BA_ "GenSigStartValue" SG_ 796 FLCObject12_LatPos 8191;
BA_ "GenSigSendType" SG_ 796 FLCObject12_DistLeftCorner 1;
BA_ "GenSigStartValue" SG_ 796 FLCObject12_DistLeftCorner 4095;
BA_ "GenSigSendType" SG_ 796 FLCObject12_LongVel 1;
BA_ "GenSigStartValue" SG_ 796 FLCObject12_LongVel 8191;
BA_ "GenSigSendType" SG_ 796 FLCObject12_BrakeLight 1;
BA_ "GenSigStartValue" SG_ 796 FLCObject12_BrakeLight 7;
BA_ "GenSigSendType" SG_ 796 FLCObject12_Heading 1;
BA_ "GenSigStartValue" SG_ 796 FLCObject12_Heading 2047;
BA_ "GenSigSendType" SG_ 796 FLCObject12_ObjDynClass 1;
BA_ "GenSigStartValue" SG_ 796 FLCObject12_ObjDynClass 3;
BA_ "GenSigSendType" SG_ 796 FLCObject12_TurnIndication 1;
BA_ "GenSigStartValue" SG_ 796 FLCObject12_TurnIndication 7;
BA_ "GenSigSendType" SG_ 796 FLCObject12_LatVelVar 1;
BA_ "GenSigStartValue" SG_ 796 FLCObject12_LatVelVar 255;
BA_ "GenSigSendType" SG_ 796 FLCObject12_LongVelVar 1;
BA_ "GenSigStartValue" SG_ 796 FLCObject12_LongVelVar 255;
BA_ "GenSigSendType" SG_ 796 FLCObject12_LatPosVar 1;
BA_ "GenSigStartValue" SG_ 796 FLCObject12_LatPosVar 255;
BA_ "GenSigSendType" SG_ 796 FLCObject12_LatAcc 1;
BA_ "GenSigStartValue" SG_ 796 FLCObject12_LatAcc 511;
BA_ "GenSigSendType" SG_ 796 FLCObject12_LongAcc 1;
BA_ "GenSigStartValue" SG_ 796 FLCObject12_LongAcc 511;
BA_ "GenSigSendType" SG_ 796 FLCObject12_DistFarCorner 1;
BA_ "GenSigStartValue" SG_ 796 FLCObject12_DistFarCorner 4095;
BA_ "GenSigSendType" SG_ 796 FLCObject12_DistRightCorner 1;
BA_ "GenSigStartValue" SG_ 796 FLCObject12_DistRightCorner 4095;
BA_ "GenSigSendType" SG_ 796 FLCObject12_AngLeftVar 1;
BA_ "GenSigStartValue" SG_ 796 FLCObject12_AngLeftVar 255;
BA_ "GenSigSendType" SG_ 796 FLCObject12_LongPosVar 1;
BA_ "GenSigStartValue" SG_ 796 FLCObject12_LongPosVar 255;
BA_ "GenSigSendType" SG_ 796 FLCObject12_TrackStatus 1;
BA_ "GenSigStartValue" SG_ 796 FLCObject12_TrackStatus 7;
BA_ "GenSigSendType" SG_ 796 FLCObject12_TargetToLine 1;
BA_ "GenSigStartValue" SG_ 796 FLCObject12_TargetToLine 7;
BA_ "GenSigSendType" SG_ 796 FLCObject12_ObjID 1;
BA_ "GenSigStartValue" SG_ 796 FLCObject12_ObjID 63;
BA_ "GenSigSendType" SG_ 796 FLCObject12_DstFarVar 1;
BA_ "GenSigStartValue" SG_ 796 FLCObject12_DstFarVar 255;
BA_ "GenSigSendType" SG_ 796 FLCObject12_ReliabilityConf 1;
BA_ "GenSigStartValue" SG_ 796 FLCObject12_ReliabilityConf 7;
BA_ "GenSigSendType" SG_ 796 FLCObject12_ObjClass 1;
BA_ "GenSigStartValue" SG_ 796 FLCObject12_ObjClass 15;
BA_ "GenSigSendType" SG_ 796 FLCObject12_ExistConf 1;
BA_ "GenSigStartValue" SG_ 796 FLCObject12_ExistConf 127;
BA_ "GenSigSendType" SG_ 796 FLCObject12_LongPos 1;
BA_ "GenSigStartValue" SG_ 796 FLCObject12_LongPos 8191;
BA_ "GenSigSendType" SG_ 796 FLCObject12_Height 1;
BA_ "GenSigStartValue" SG_ 796 FLCObject12_Height 255;
BA_ "GenSigSendType" SG_ 796 FLCObject12_Counter 1;
BA_ "GenSigStartValue" SG_ 796 FLCObject12_Counter 255;
BA_ "GenSigSendType" SG_ 796 FLCObject12_LifeTime 1;
BA_ "GenSigStartValue" SG_ 796 FLCObject12_LifeTime 65535;
BA_ "GenSigSendType" SG_ 796 FLCObject12_DstLeftVar 1;
BA_ "GenSigStartValue" SG_ 796 FLCObject12_DstLeftVar 255;
BA_ "GenSigSendType" SG_ 796 FLCObject12_DstRightVar 1;
BA_ "GenSigStartValue" SG_ 796 FLCObject12_DstRightVar 255;
BA_ "GenSigSendType" SG_ 796 FLCObject12_CoastIndex 1;
BA_ "GenSigStartValue" SG_ 796 FLCObject12_CoastIndex 31;
BA_ "GenSigSendType" SG_ 796 FLCObject12_AngFarVar 1;
BA_ "GenSigStartValue" SG_ 796 FLCObject12_AngFarVar 255;
BA_ "GenSigSendType" SG_ 796 FLCObject12_LatVel 1;
BA_ "GenSigStartValue" SG_ 796 FLCObject12_LatVel 8191;
BA_ "GenSigSendType" SG_ 796 FLCObject12_HeadingVar 1;
BA_ "GenSigStartValue" SG_ 796 FLCObject12_HeadingVar 255;
BA_ "GenSigSendType" SG_ 795 FLCObject11_ReliabilityConf 1;
BA_ "GenSigStartValue" SG_ 795 FLCObject11_ReliabilityConf 7;
BA_ "GenSigSendType" SG_ 795 FLCObject11_ObjID 1;
BA_ "GenSigStartValue" SG_ 795 FLCObject11_ObjID 63;
BA_ "GenSigSendType" SG_ 795 FLCObject11_LongPosVar 1;
BA_ "GenSigStartValue" SG_ 795 FLCObject11_LongPosVar 255;
BA_ "GenSigSendType" SG_ 795 FLCObject11_LatVelVar 1;
BA_ "GenSigStartValue" SG_ 795 FLCObject11_LatVelVar 255;
BA_ "GenSigSendType" SG_ 795 FLCObject11_LongPos 1;
BA_ "GenSigStartValue" SG_ 795 FLCObject11_LongPos 8191;
BA_ "GenSigSendType" SG_ 795 FLCObject11_LongVel 1;
BA_ "GenSigStartValue" SG_ 795 FLCObject11_LongVel 8191;
BA_ "GenSigSendType" SG_ 795 FLCObject11_LongAcc 1;
BA_ "GenSigStartValue" SG_ 795 FLCObject11_LongAcc 511;
BA_ "GenSigSendType" SG_ 795 FLCObject11_TimeStamp 1;
BA_ "GenSigStartValue" SG_ 795 FLCObject11_TimeStamp 65535;
BA_ "GenSigSendType" SG_ 795 FLCObject11_AnglRightCorner 1;
BA_ "GenSigStartValue" SG_ 795 FLCObject11_AnglRightCorner 1023;
BA_ "GenSigSendType" SG_ 795 FLCObject11_LatVel 1;
BA_ "GenSigStartValue" SG_ 795 FLCObject11_LatVel 8191;
BA_ "GenSigSendType" SG_ 795 FLCObject11_CoastIndex 1;
BA_ "GenSigStartValue" SG_ 795 FLCObject11_CoastIndex 31;
BA_ "GenSigSendType" SG_ 795 FLCObject11_TurnIndication 1;
BA_ "GenSigStartValue" SG_ 795 FLCObject11_TurnIndication 7;
BA_ "GenSigSendType" SG_ 795 FLCObject11_AngFarVar 1;
BA_ "GenSigStartValue" SG_ 795 FLCObject11_AngFarVar 255;
BA_ "GenSigSendType" SG_ 795 FLCObject11_AnglFarCorner 1;
BA_ "GenSigStartValue" SG_ 795 FLCObject11_AnglFarCorner 1023;
BA_ "GenSigSendType" SG_ 795 FLCObject11_DstRightVar 1;
BA_ "GenSigStartValue" SG_ 795 FLCObject11_DstRightVar 255;
BA_ "GenSigSendType" SG_ 795 FLCObject11_LatAcc 1;
BA_ "GenSigStartValue" SG_ 795 FLCObject11_LatAcc 511;
BA_ "GenSigSendType" SG_ 795 FLCObject11_CRC 1;
BA_ "GenSigStartValue" SG_ 795 FLCObject11_CRC 65535;
BA_ "E2EDataId" SG_ 795 FLCObject11_CRC 86;
BA_ "E2EDataLength" SG_ 795 FLCObject11_CRC 352;
BA_ "E2EProfile" SG_ 795 FLCObject11_CRC "P05";
BA_ "GenSigSendType" SG_ 795 FLCObject11_LatPosVar 1;
BA_ "GenSigStartValue" SG_ 795 FLCObject11_LatPosVar 255;
BA_ "GenSigSendType" SG_ 795 FLCObject11_ObjClass 1;
BA_ "GenSigStartValue" SG_ 795 FLCObject11_ObjClass 15;
BA_ "GenSigSendType" SG_ 795 FLCObject11_DistRightCorner 1;
BA_ "GenSigStartValue" SG_ 795 FLCObject11_DistRightCorner 4095;
BA_ "GenSigSendType" SG_ 795 FLCObject11_ScaleChange 1;
BA_ "GenSigStartValue" SG_ 795 FLCObject11_ScaleChange 1023;
BA_ "GenSigSendType" SG_ 795 FLCObject11_DstFarVar 1;
BA_ "GenSigStartValue" SG_ 795 FLCObject11_DstFarVar 255;
BA_ "GenSigSendType" SG_ 795 FLCObject11_ObjDynClass 1;
BA_ "GenSigStartValue" SG_ 795 FLCObject11_ObjDynClass 3;
BA_ "GenSigSendType" SG_ 795 FLCObject11_DstLeftVar 1;
BA_ "GenSigStartValue" SG_ 795 FLCObject11_DstLeftVar 255;
BA_ "GenSigSendType" SG_ 795 FLCObject11_TrackStatus 1;
BA_ "GenSigStartValue" SG_ 795 FLCObject11_TrackStatus 7;
BA_ "GenSigSendType" SG_ 795 FLCObject11_LifeTime 1;
BA_ "GenSigStartValue" SG_ 795 FLCObject11_LifeTime 65535;
BA_ "GenSigSendType" SG_ 795 FLCObject11_Heading 1;
BA_ "GenSigStartValue" SG_ 795 FLCObject11_Heading 2047;
BA_ "GenSigSendType" SG_ 795 FLCObject11_BrakeLight 1;
BA_ "GenSigStartValue" SG_ 795 FLCObject11_BrakeLight 7;
BA_ "GenSigSendType" SG_ 795 FLCObject11_AngRightVar 1;
BA_ "GenSigStartValue" SG_ 795 FLCObject11_AngRightVar 255;
BA_ "GenSigSendType" SG_ 795 FLCObject11_DistFarCorner 1;
BA_ "GenSigStartValue" SG_ 795 FLCObject11_DistFarCorner 4095;
BA_ "GenSigSendType" SG_ 795 FLCObject11_LongVelVar 1;
BA_ "GenSigStartValue" SG_ 795 FLCObject11_LongVelVar 255;
BA_ "GenSigSendType" SG_ 795 FLCObject11_HeadingVar 1;
BA_ "GenSigStartValue" SG_ 795 FLCObject11_HeadingVar 255;
BA_ "GenSigSendType" SG_ 795 FLCObject11_Height 1;
BA_ "GenSigStartValue" SG_ 795 FLCObject11_Height 255;
BA_ "GenSigSendType" SG_ 795 FLCObject11_AnglLeftCorner 1;
BA_ "GenSigStartValue" SG_ 795 FLCObject11_AnglLeftCorner 1023;
BA_ "GenSigSendType" SG_ 795 FLCObject11_DistLeftCorner 1;
BA_ "GenSigStartValue" SG_ 795 FLCObject11_DistLeftCorner 4095;
BA_ "GenSigSendType" SG_ 795 FLCObject11_AngLeftVar 1;
BA_ "GenSigStartValue" SG_ 795 FLCObject11_AngLeftVar 255;
BA_ "GenSigSendType" SG_ 795 FLCObject11_ExistConf 1;
BA_ "GenSigStartValue" SG_ 795 FLCObject11_ExistConf 127;
BA_ "GenSigSendType" SG_ 795 FLCObject11_TargetToLine 1;
BA_ "GenSigStartValue" SG_ 795 FLCObject11_TargetToLine 7;
BA_ "GenSigSendType" SG_ 795 FLCObject11_Counter 1;
BA_ "GenSigStartValue" SG_ 795 FLCObject11_Counter 255;
BA_ "GenSigSendType" SG_ 795 FLCObject11_LatPos 1;
BA_ "GenSigStartValue" SG_ 795 FLCObject11_LatPos 8191;
BA_ "GenSigSendType" SG_ 794 FLCObject10_LatAcc 1;
BA_ "GenSigStartValue" SG_ 794 FLCObject10_LatAcc 511;
BA_ "GenSigSendType" SG_ 794 FLCObject10_AnglRightCorner 1;
BA_ "GenSigStartValue" SG_ 794 FLCObject10_AnglRightCorner 1023;
BA_ "GenSigSendType" SG_ 794 FLCObject10_TrackStatus 1;
BA_ "GenSigStartValue" SG_ 794 FLCObject10_TrackStatus 7;
BA_ "GenSigSendType" SG_ 794 FLCObject10_AnglFarCorner 1;
BA_ "GenSigStartValue" SG_ 794 FLCObject10_AnglFarCorner 1023;
BA_ "GenSigSendType" SG_ 794 FLCObject10_ObjClass 1;
BA_ "GenSigStartValue" SG_ 794 FLCObject10_ObjClass 15;
BA_ "GenSigSendType" SG_ 794 FLCObject10_CoastIndex 1;
BA_ "GenSigStartValue" SG_ 794 FLCObject10_CoastIndex 31;
BA_ "GenSigSendType" SG_ 794 FLCObject10_LatPosVar 1;
BA_ "GenSigStartValue" SG_ 794 FLCObject10_LatPosVar 255;
BA_ "GenSigSendType" SG_ 794 FLCObject10_Height 1;
BA_ "GenSigStartValue" SG_ 794 FLCObject10_Height 255;
BA_ "GenSigSendType" SG_ 794 FLCObject10_ScaleChange 1;
BA_ "GenSigStartValue" SG_ 794 FLCObject10_ScaleChange 1023;
BA_ "GenSigSendType" SG_ 794 FLCObject10_DistLeftCorner 1;
BA_ "GenSigStartValue" SG_ 794 FLCObject10_DistLeftCorner 4095;
BA_ "GenSigSendType" SG_ 794 FLCObject10_Counter 1;
BA_ "GenSigStartValue" SG_ 794 FLCObject10_Counter 255;
BA_ "GenSigSendType" SG_ 794 FLCObject10_DistRightCorner 1;
BA_ "GenSigStartValue" SG_ 794 FLCObject10_DistRightCorner 4095;
BA_ "GenSigSendType" SG_ 794 FLCObject10_DstFarVar 1;
BA_ "GenSigStartValue" SG_ 794 FLCObject10_DstFarVar 255;
BA_ "GenSigSendType" SG_ 794 FLCObject10_DistFarCorner 1;
BA_ "GenSigStartValue" SG_ 794 FLCObject10_DistFarCorner 4095;
BA_ "GenSigSendType" SG_ 794 FLCObject10_AnglLeftCorner 1;
BA_ "GenSigStartValue" SG_ 794 FLCObject10_AnglLeftCorner 1023;
BA_ "GenSigSendType" SG_ 794 FLCObject10_BrakeLight 1;
BA_ "GenSigStartValue" SG_ 794 FLCObject10_BrakeLight 7;
BA_ "GenSigSendType" SG_ 794 FLCObject10_LatPos 1;
BA_ "GenSigStartValue" SG_ 794 FLCObject10_LatPos 8191;
BA_ "GenSigSendType" SG_ 794 FLCObject10_LatVelVar 1;
BA_ "GenSigStartValue" SG_ 794 FLCObject10_LatVelVar 255;
BA_ "GenSigSendType" SG_ 794 FLCObject10_LongVelVar 1;
BA_ "GenSigStartValue" SG_ 794 FLCObject10_LongVelVar 255;
BA_ "GenSigSendType" SG_ 794 FLCObject10_HeadingVar 1;
BA_ "GenSigStartValue" SG_ 794 FLCObject10_HeadingVar 255;
BA_ "GenSigSendType" SG_ 794 FLCObject10_AngFarVar 1;
BA_ "GenSigStartValue" SG_ 794 FLCObject10_AngFarVar 255;
BA_ "GenSigSendType" SG_ 794 FLCObject10_Heading 1;
BA_ "GenSigStartValue" SG_ 794 FLCObject10_Heading 2047;
BA_ "GenSigSendType" SG_ 794 FLCObject10_ObjID 1;
BA_ "GenSigStartValue" SG_ 794 FLCObject10_ObjID 63;
BA_ "GenSigSendType" SG_ 794 FLCObject10_TimeStamp 1;
BA_ "GenSigStartValue" SG_ 794 FLCObject10_TimeStamp 65535;
BA_ "GenSigSendType" SG_ 794 FLCObject10_LongAcc 1;
BA_ "GenSigStartValue" SG_ 794 FLCObject10_LongAcc 511;
BA_ "GenSigSendType" SG_ 794 FLCObject10_LongVel 1;
BA_ "GenSigStartValue" SG_ 794 FLCObject10_LongVel 8191;
BA_ "GenSigSendType" SG_ 794 FLCObject10_AngLeftVar 1;
BA_ "GenSigStartValue" SG_ 794 FLCObject10_AngLeftVar 255;
BA_ "GenSigSendType" SG_ 794 FLCObject10_LifeTime 1;
BA_ "GenSigStartValue" SG_ 794 FLCObject10_LifeTime 65535;
BA_ "GenSigSendType" SG_ 794 FLCObject10_LongPosVar 1;
BA_ "GenSigStartValue" SG_ 794 FLCObject10_LongPosVar 255;
BA_ "GenSigSendType" SG_ 794 FLCObject10_ReliabilityConf 1;
BA_ "GenSigStartValue" SG_ 794 FLCObject10_ReliabilityConf 7;
BA_ "GenSigSendType" SG_ 794 FLCObject10_TurnIndication 1;
BA_ "GenSigStartValue" SG_ 794 FLCObject10_TurnIndication 7;
BA_ "GenSigSendType" SG_ 794 FLCObject10_CRC 1;
BA_ "GenSigStartValue" SG_ 794 FLCObject10_CRC 65535;
BA_ "E2EDataId" SG_ 794 FLCObject10_CRC 85;
BA_ "E2EDataLength" SG_ 794 FLCObject10_CRC 352;
BA_ "E2EProfile" SG_ 794 FLCObject10_CRC "P05";
BA_ "GenSigSendType" SG_ 794 FLCObject10_DstLeftVar 1;
BA_ "GenSigStartValue" SG_ 794 FLCObject10_DstLeftVar 255;
BA_ "GenSigSendType" SG_ 794 FLCObject10_AngRightVar 1;
BA_ "GenSigStartValue" SG_ 794 FLCObject10_AngRightVar 255;
BA_ "GenSigSendType" SG_ 794 FLCObject10_TargetToLine 1;
BA_ "GenSigStartValue" SG_ 794 FLCObject10_TargetToLine 7;
BA_ "GenSigSendType" SG_ 794 FLCObject10_ObjDynClass 1;
BA_ "GenSigStartValue" SG_ 794 FLCObject10_ObjDynClass 3;
BA_ "GenSigSendType" SG_ 794 FLCObject10_LatVel 1;
BA_ "GenSigStartValue" SG_ 794 FLCObject10_LatVel 8191;
BA_ "GenSigSendType" SG_ 794 FLCObject10_LongPos 1;
BA_ "GenSigStartValue" SG_ 794 FLCObject10_LongPos 8191;
BA_ "GenSigSendType" SG_ 794 FLCObject10_ExistConf 1;
BA_ "GenSigStartValue" SG_ 794 FLCObject10_ExistConf 127;
BA_ "GenSigSendType" SG_ 794 FLCObject10_DstRightVar 1;
BA_ "GenSigStartValue" SG_ 794 FLCObject10_DstRightVar 255;
BA_ "GenSigSendType" SG_ 793 FLCObject09_CoastIndex 1;
BA_ "GenSigStartValue" SG_ 793 FLCObject09_CoastIndex 31;
BA_ "GenSigSendType" SG_ 793 FLCObject09_DstRightVar 1;
BA_ "GenSigStartValue" SG_ 793 FLCObject09_DstRightVar 255;
BA_ "GenSigSendType" SG_ 793 FLCObject09_LatAcc 1;
BA_ "GenSigStartValue" SG_ 793 FLCObject09_LatAcc 511;
BA_ "GenSigSendType" SG_ 793 FLCObject09_AngLeftVar 1;
BA_ "GenSigStartValue" SG_ 793 FLCObject09_AngLeftVar 255;
BA_ "GenSigSendType" SG_ 793 FLCObject09_ExistConf 1;
BA_ "GenSigStartValue" SG_ 793 FLCObject09_ExistConf 127;
BA_ "GenSigSendType" SG_ 793 FLCObject09_DistFarCorner 1;
BA_ "GenSigStartValue" SG_ 793 FLCObject09_DistFarCorner 4095;
BA_ "GenSigSendType" SG_ 793 FLCObject09_AnglRightCorner 1;
BA_ "GenSigStartValue" SG_ 793 FLCObject09_AnglRightCorner 1023;
BA_ "GenSigSendType" SG_ 793 FLCObject09_AnglFarCorner 1;
BA_ "GenSigStartValue" SG_ 793 FLCObject09_AnglFarCorner 1023;
BA_ "GenSigSendType" SG_ 793 FLCObject09_HeadingVar 1;
BA_ "GenSigStartValue" SG_ 793 FLCObject09_HeadingVar 255;
BA_ "GenSigSendType" SG_ 793 FLCObject09_LongPos 1;
BA_ "GenSigStartValue" SG_ 793 FLCObject09_LongPos 8191;
BA_ "GenSigSendType" SG_ 793 FLCObject09_DistRightCorner 1;
BA_ "GenSigStartValue" SG_ 793 FLCObject09_DistRightCorner 4095;
BA_ "GenSigSendType" SG_ 793 FLCObject09_TrackStatus 1;
BA_ "GenSigStartValue" SG_ 793 FLCObject09_TrackStatus 7;
BA_ "GenSigSendType" SG_ 793 FLCObject09_DstFarVar 1;
BA_ "GenSigStartValue" SG_ 793 FLCObject09_DstFarVar 255;
BA_ "GenSigSendType" SG_ 793 FLCObject09_LifeTime 1;
BA_ "GenSigStartValue" SG_ 793 FLCObject09_LifeTime 65535;
BA_ "GenSigSendType" SG_ 793 FLCObject09_TimeStamp 1;
BA_ "GenSigStartValue" SG_ 793 FLCObject09_TimeStamp 65535;
BA_ "GenSigSendType" SG_ 793 FLCObject09_DstLeftVar 1;
BA_ "GenSigStartValue" SG_ 793 FLCObject09_DstLeftVar 255;
BA_ "GenSigSendType" SG_ 793 FLCObject09_LatPos 1;
BA_ "GenSigStartValue" SG_ 793 FLCObject09_LatPos 8191;
BA_ "GenSigSendType" SG_ 793 FLCObject09_CRC 1;
BA_ "GenSigStartValue" SG_ 793 FLCObject09_CRC 65535;
BA_ "E2EDataId" SG_ 793 FLCObject09_CRC 84;
BA_ "E2EDataLength" SG_ 793 FLCObject09_CRC 352;
BA_ "E2EProfile" SG_ 793 FLCObject09_CRC "P05";
BA_ "GenSigSendType" SG_ 793 FLCObject09_Heading 1;
BA_ "GenSigStartValue" SG_ 793 FLCObject09_Heading 2047;
BA_ "GenSigSendType" SG_ 793 FLCObject09_LongVelVar 1;
BA_ "GenSigStartValue" SG_ 793 FLCObject09_LongVelVar 255;
BA_ "GenSigSendType" SG_ 793 FLCObject09_AngRightVar 1;
BA_ "GenSigStartValue" SG_ 793 FLCObject09_AngRightVar 255;
BA_ "GenSigSendType" SG_ 793 FLCObject09_ObjClass 1;
BA_ "GenSigStartValue" SG_ 793 FLCObject09_ObjClass 15;
BA_ "GenSigSendType" SG_ 793 FLCObject09_LongAcc 1;
BA_ "GenSigStartValue" SG_ 793 FLCObject09_LongAcc 511;
BA_ "GenSigSendType" SG_ 793 FLCObject09_ScaleChange 1;
BA_ "GenSigStartValue" SG_ 793 FLCObject09_ScaleChange 1023;
BA_ "GenSigSendType" SG_ 793 FLCObject09_LongVel 1;
BA_ "GenSigStartValue" SG_ 793 FLCObject09_LongVel 8191;
BA_ "GenSigSendType" SG_ 793 FLCObject09_LongPosVar 1;
BA_ "GenSigStartValue" SG_ 793 FLCObject09_LongPosVar 255;
BA_ "GenSigSendType" SG_ 793 FLCObject09_DistLeftCorner 1;
BA_ "GenSigStartValue" SG_ 793 FLCObject09_DistLeftCorner 4095;
BA_ "GenSigSendType" SG_ 793 FLCObject09_ObjID 1;
BA_ "GenSigStartValue" SG_ 793 FLCObject09_ObjID 63;
BA_ "GenSigSendType" SG_ 793 FLCObject09_LatPosVar 1;
BA_ "GenSigStartValue" SG_ 793 FLCObject09_LatPosVar 255;
BA_ "GenSigSendType" SG_ 793 FLCObject09_BrakeLight 1;
BA_ "GenSigStartValue" SG_ 793 FLCObject09_BrakeLight 7;
BA_ "GenSigSendType" SG_ 793 FLCObject09_Counter 1;
BA_ "GenSigStartValue" SG_ 793 FLCObject09_Counter 255;
BA_ "GenSigSendType" SG_ 793 FLCObject09_Height 1;
BA_ "GenSigStartValue" SG_ 793 FLCObject09_Height 255;
BA_ "GenSigSendType" SG_ 793 FLCObject09_TargetToLine 1;
BA_ "GenSigStartValue" SG_ 793 FLCObject09_TargetToLine 7;
BA_ "GenSigSendType" SG_ 793 FLCObject09_ReliabilityConf 1;
BA_ "GenSigStartValue" SG_ 793 FLCObject09_ReliabilityConf 7;
BA_ "GenSigSendType" SG_ 793 FLCObject09_AngFarVar 1;
BA_ "GenSigStartValue" SG_ 793 FLCObject09_AngFarVar 255;
BA_ "GenSigSendType" SG_ 793 FLCObject09_LatVelVar 1;
BA_ "GenSigStartValue" SG_ 793 FLCObject09_LatVelVar 255;
BA_ "GenSigSendType" SG_ 793 FLCObject09_LatVel 1;
BA_ "GenSigStartValue" SG_ 793 FLCObject09_LatVel 8191;
BA_ "GenSigSendType" SG_ 793 FLCObject09_TurnIndication 1;
BA_ "GenSigStartValue" SG_ 793 FLCObject09_TurnIndication 7;
BA_ "GenSigSendType" SG_ 793 FLCObject09_ObjDynClass 1;
BA_ "GenSigStartValue" SG_ 793 FLCObject09_ObjDynClass 3;
BA_ "GenSigSendType" SG_ 793 FLCObject09_AnglLeftCorner 1;
BA_ "GenSigStartValue" SG_ 793 FLCObject09_AnglLeftCorner 1023;
BA_ "GenSigSendType" SG_ 792 FLCObject08_LifeTime 1;
BA_ "GenSigStartValue" SG_ 792 FLCObject08_LifeTime 65535;
BA_ "GenSigSendType" SG_ 792 FLCObject08_LatVelVar 1;
BA_ "GenSigStartValue" SG_ 792 FLCObject08_LatVelVar 255;
BA_ "GenSigSendType" SG_ 792 FLCObject08_AngLeftVar 1;
BA_ "GenSigStartValue" SG_ 792 FLCObject08_AngLeftVar 255;
BA_ "GenSigSendType" SG_ 792 FLCObject08_LatPos 1;
BA_ "GenSigStartValue" SG_ 792 FLCObject08_LatPos 8191;
BA_ "GenSigSendType" SG_ 792 FLCObject08_AnglRightCorner 1;
BA_ "GenSigStartValue" SG_ 792 FLCObject08_AnglRightCorner 1023;
BA_ "GenSigSendType" SG_ 792 FLCObject08_DistRightCorner 1;
BA_ "GenSigStartValue" SG_ 792 FLCObject08_DistRightCorner 4095;
BA_ "GenSigSendType" SG_ 792 FLCObject08_LongPos 1;
BA_ "GenSigStartValue" SG_ 792 FLCObject08_LongPos 8191;
BA_ "GenSigSendType" SG_ 792 FLCObject08_ObjClass 1;
BA_ "GenSigStartValue" SG_ 792 FLCObject08_ObjClass 15;
BA_ "GenSigSendType" SG_ 792 FLCObject08_TurnIndication 1;
BA_ "GenSigStartValue" SG_ 792 FLCObject08_TurnIndication 7;
BA_ "GenSigSendType" SG_ 792 FLCObject08_DstFarVar 1;
BA_ "GenSigStartValue" SG_ 792 FLCObject08_DstFarVar 255;
BA_ "GenSigSendType" SG_ 792 FLCObject08_TrackStatus 1;
BA_ "GenSigStartValue" SG_ 792 FLCObject08_TrackStatus 7;
BA_ "GenSigSendType" SG_ 792 FLCObject08_DstRightVar 1;
BA_ "GenSigStartValue" SG_ 792 FLCObject08_DstRightVar 255;
BA_ "GenSigSendType" SG_ 792 FLCObject08_LatAcc 1;
BA_ "GenSigStartValue" SG_ 792 FLCObject08_LatAcc 511;
BA_ "GenSigSendType" SG_ 792 FLCObject08_AngRightVar 1;
BA_ "GenSigStartValue" SG_ 792 FLCObject08_AngRightVar 255;
BA_ "GenSigSendType" SG_ 792 FLCObject08_ScaleChange 1;
BA_ "GenSigStartValue" SG_ 792 FLCObject08_ScaleChange 1023;
BA_ "GenSigSendType" SG_ 792 FLCObject08_ObjDynClass 1;
BA_ "GenSigStartValue" SG_ 792 FLCObject08_ObjDynClass 3;
BA_ "GenSigSendType" SG_ 792 FLCObject08_BrakeLight 1;
BA_ "GenSigStartValue" SG_ 792 FLCObject08_BrakeLight 7;
BA_ "GenSigSendType" SG_ 792 FLCObject08_Counter 1;
BA_ "GenSigStartValue" SG_ 792 FLCObject08_Counter 255;
BA_ "GenSigSendType" SG_ 792 FLCObject08_TargetToLine 1;
BA_ "GenSigStartValue" SG_ 792 FLCObject08_TargetToLine 7;
BA_ "GenSigSendType" SG_ 792 FLCObject08_DstLeftVar 1;
BA_ "GenSigStartValue" SG_ 792 FLCObject08_DstLeftVar 255;
BA_ "GenSigSendType" SG_ 792 FLCObject08_ReliabilityConf 1;
BA_ "GenSigStartValue" SG_ 792 FLCObject08_ReliabilityConf 7;
BA_ "GenSigSendType" SG_ 792 FLCObject08_ObjID 1;
BA_ "GenSigStartValue" SG_ 792 FLCObject08_ObjID 63;
BA_ "GenSigSendType" SG_ 792 FLCObject08_AngFarVar 1;
BA_ "GenSigStartValue" SG_ 792 FLCObject08_AngFarVar 255;
BA_ "GenSigSendType" SG_ 792 FLCObject08_HeadingVar 1;
BA_ "GenSigStartValue" SG_ 792 FLCObject08_HeadingVar 255;
BA_ "GenSigSendType" SG_ 792 FLCObject08_LongVel 1;
BA_ "GenSigStartValue" SG_ 792 FLCObject08_LongVel 8191;
BA_ "GenSigSendType" SG_ 792 FLCObject08_CRC 1;
BA_ "GenSigStartValue" SG_ 792 FLCObject08_CRC 65535;
BA_ "E2EDataId" SG_ 792 FLCObject08_CRC 83;
BA_ "E2EDataLength" SG_ 792 FLCObject08_CRC 352;
BA_ "E2EProfile" SG_ 792 FLCObject08_CRC "P05";
BA_ "GenSigSendType" SG_ 792 FLCObject08_LongPosVar 1;
BA_ "GenSigStartValue" SG_ 792 FLCObject08_LongPosVar 255;
BA_ "GenSigSendType" SG_ 792 FLCObject08_AnglFarCorner 1;
BA_ "GenSigStartValue" SG_ 792 FLCObject08_AnglFarCorner 1023;
BA_ "GenSigSendType" SG_ 792 FLCObject08_LatPosVar 1;
BA_ "GenSigStartValue" SG_ 792 FLCObject08_LatPosVar 255;
BA_ "GenSigSendType" SG_ 792 FLCObject08_CoastIndex 1;
BA_ "GenSigStartValue" SG_ 792 FLCObject08_CoastIndex 31;
BA_ "GenSigSendType" SG_ 792 FLCObject08_TimeStamp 1;
BA_ "GenSigStartValue" SG_ 792 FLCObject08_TimeStamp 65535;
BA_ "GenSigSendType" SG_ 792 FLCObject08_DistFarCorner 1;
BA_ "GenSigStartValue" SG_ 792 FLCObject08_DistFarCorner 4095;
BA_ "GenSigSendType" SG_ 792 FLCObject08_ExistConf 1;
BA_ "GenSigStartValue" SG_ 792 FLCObject08_ExistConf 127;
BA_ "GenSigSendType" SG_ 792 FLCObject08_Heading 1;
BA_ "GenSigStartValue" SG_ 792 FLCObject08_Heading 2047;
BA_ "GenSigSendType" SG_ 792 FLCObject08_Height 1;
BA_ "GenSigStartValue" SG_ 792 FLCObject08_Height 255;
BA_ "GenSigSendType" SG_ 792 FLCObject08_AnglLeftCorner 1;
BA_ "GenSigStartValue" SG_ 792 FLCObject08_AnglLeftCorner 1023;
BA_ "GenSigSendType" SG_ 792 FLCObject08_LatVel 1;
BA_ "GenSigStartValue" SG_ 792 FLCObject08_LatVel 8191;
BA_ "GenSigSendType" SG_ 792 FLCObject08_DistLeftCorner 1;
BA_ "GenSigStartValue" SG_ 792 FLCObject08_DistLeftCorner 4095;
BA_ "GenSigSendType" SG_ 792 FLCObject08_LongAcc 1;
BA_ "GenSigStartValue" SG_ 792 FLCObject08_LongAcc 511;
BA_ "GenSigSendType" SG_ 792 FLCObject08_LongVelVar 1;
BA_ "GenSigStartValue" SG_ 792 FLCObject08_LongVelVar 255;
BA_ "GenSigSendType" SG_ 791 FLCObject07_Counter 1;
BA_ "GenSigStartValue" SG_ 791 FLCObject07_Counter 255;
BA_ "GenSigSendType" SG_ 791 FLCObject07_TargetToLine 1;
BA_ "GenSigStartValue" SG_ 791 FLCObject07_TargetToLine 7;
BA_ "GenSigSendType" SG_ 791 FLCObject07_LongPosVar 1;
BA_ "GenSigStartValue" SG_ 791 FLCObject07_LongPosVar 255;
BA_ "GenSigSendType" SG_ 791 FLCObject07_DistFarCorner 1;
BA_ "GenSigStartValue" SG_ 791 FLCObject07_DistFarCorner 4095;
BA_ "GenSigSendType" SG_ 791 FLCObject07_AngLeftVar 1;
BA_ "GenSigStartValue" SG_ 791 FLCObject07_AngLeftVar 255;
BA_ "GenSigSendType" SG_ 791 FLCObject07_AngRightVar 1;
BA_ "GenSigStartValue" SG_ 791 FLCObject07_AngRightVar 255;
BA_ "GenSigSendType" SG_ 791 FLCObject07_LatVel 1;
BA_ "GenSigStartValue" SG_ 791 FLCObject07_LatVel 8191;
BA_ "GenSigSendType" SG_ 791 FLCObject07_HeadingVar 1;
BA_ "GenSigStartValue" SG_ 791 FLCObject07_HeadingVar 255;
BA_ "GenSigSendType" SG_ 791 FLCObject07_TurnIndication 1;
BA_ "GenSigStartValue" SG_ 791 FLCObject07_TurnIndication 7;
BA_ "GenSigSendType" SG_ 791 FLCObject07_LatVelVar 1;
BA_ "GenSigStartValue" SG_ 791 FLCObject07_LatVelVar 255;
BA_ "GenSigSendType" SG_ 791 FLCObject07_CoastIndex 1;
BA_ "GenSigStartValue" SG_ 791 FLCObject07_CoastIndex 31;
BA_ "GenSigSendType" SG_ 791 FLCObject07_ObjClass 1;
BA_ "GenSigStartValue" SG_ 791 FLCObject07_ObjClass 15;
BA_ "GenSigSendType" SG_ 791 FLCObject07_LatAcc 1;
BA_ "GenSigStartValue" SG_ 791 FLCObject07_LatAcc 511;
BA_ "GenSigSendType" SG_ 791 FLCObject07_DstRightVar 1;
BA_ "GenSigStartValue" SG_ 791 FLCObject07_DstRightVar 255;
BA_ "GenSigSendType" SG_ 791 FLCObject07_LongVel 1;
BA_ "GenSigStartValue" SG_ 791 FLCObject07_LongVel 8191;
BA_ "GenSigSendType" SG_ 791 FLCObject07_AnglRightCorner 1;
BA_ "GenSigStartValue" SG_ 791 FLCObject07_AnglRightCorner 1023;
BA_ "GenSigSendType" SG_ 791 FLCObject07_ObjDynClass 1;
BA_ "GenSigStartValue" SG_ 791 FLCObject07_ObjDynClass 3;
BA_ "GenSigSendType" SG_ 791 FLCObject07_AnglLeftCorner 1;
BA_ "GenSigStartValue" SG_ 791 FLCObject07_AnglLeftCorner 1023;
BA_ "GenSigSendType" SG_ 791 FLCObject07_Heading 1;
BA_ "GenSigStartValue" SG_ 791 FLCObject07_Heading 2047;
BA_ "GenSigSendType" SG_ 791 FLCObject07_ExistConf 1;
BA_ "GenSigStartValue" SG_ 791 FLCObject07_ExistConf 127;
BA_ "GenSigSendType" SG_ 791 FLCObject07_TimeStamp 1;
BA_ "GenSigStartValue" SG_ 791 FLCObject07_TimeStamp 65535;
BA_ "GenSigSendType" SG_ 791 FLCObject07_DstLeftVar 1;
BA_ "GenSigStartValue" SG_ 791 FLCObject07_DstLeftVar 255;
BA_ "GenSigSendType" SG_ 791 FLCObject07_DstFarVar 1;
BA_ "GenSigStartValue" SG_ 791 FLCObject07_DstFarVar 255;
BA_ "GenSigSendType" SG_ 791 FLCObject07_Height 1;
BA_ "GenSigStartValue" SG_ 791 FLCObject07_Height 255;
BA_ "GenSigSendType" SG_ 791 FLCObject07_DistRightCorner 1;
BA_ "GenSigStartValue" SG_ 791 FLCObject07_DistRightCorner 4095;
BA_ "GenSigSendType" SG_ 791 FLCObject07_ReliabilityConf 1;
BA_ "GenSigStartValue" SG_ 791 FLCObject07_ReliabilityConf 7;
BA_ "GenSigSendType" SG_ 791 FLCObject07_LongPos 1;
BA_ "GenSigStartValue" SG_ 791 FLCObject07_LongPos 8191;
BA_ "GenSigSendType" SG_ 791 FLCObject07_LatPosVar 1;
BA_ "GenSigStartValue" SG_ 791 FLCObject07_LatPosVar 255;
BA_ "GenSigSendType" SG_ 791 FLCObject07_AnglFarCorner 1;
BA_ "GenSigStartValue" SG_ 791 FLCObject07_AnglFarCorner 1023;
BA_ "GenSigSendType" SG_ 791 FLCObject07_ObjID 1;
BA_ "GenSigStartValue" SG_ 791 FLCObject07_ObjID 63;
BA_ "GenSigSendType" SG_ 791 FLCObject07_ScaleChange 1;
BA_ "GenSigStartValue" SG_ 791 FLCObject07_ScaleChange 1023;
BA_ "GenSigSendType" SG_ 791 FLCObject07_AngFarVar 1;
BA_ "GenSigStartValue" SG_ 791 FLCObject07_AngFarVar 255;
BA_ "GenSigSendType" SG_ 791 FLCObject07_LatPos 1;
BA_ "GenSigStartValue" SG_ 791 FLCObject07_LatPos 8191;
BA_ "GenSigSendType" SG_ 791 FLCObject07_TrackStatus 1;
BA_ "GenSigStartValue" SG_ 791 FLCObject07_TrackStatus 7;
BA_ "GenSigSendType" SG_ 791 FLCObject07_LongVelVar 1;
BA_ "GenSigStartValue" SG_ 791 FLCObject07_LongVelVar 255;
BA_ "GenSigSendType" SG_ 791 FLCObject07_DistLeftCorner 1;
BA_ "GenSigStartValue" SG_ 791 FLCObject07_DistLeftCorner 4095;
BA_ "GenSigSendType" SG_ 791 FLCObject07_CRC 1;
BA_ "GenSigStartValue" SG_ 791 FLCObject07_CRC 65535;
BA_ "E2EDataId" SG_ 791 FLCObject07_CRC 82;
BA_ "E2EDataLength" SG_ 791 FLCObject07_CRC 352;
BA_ "E2EProfile" SG_ 791 FLCObject07_CRC "P05";
BA_ "GenSigSendType" SG_ 791 FLCObject07_LongAcc 1;
BA_ "GenSigStartValue" SG_ 791 FLCObject07_LongAcc 511;
BA_ "GenSigSendType" SG_ 791 FLCObject07_LifeTime 1;
BA_ "GenSigStartValue" SG_ 791 FLCObject07_LifeTime 65535;
BA_ "GenSigSendType" SG_ 791 FLCObject07_BrakeLight 1;
BA_ "GenSigStartValue" SG_ 791 FLCObject07_BrakeLight 7;
BA_ "GenSigSendType" SG_ 790 FLCObject06_LatPosVar 1;
BA_ "GenSigStartValue" SG_ 790 FLCObject06_LatPosVar 255;
BA_ "GenSigSendType" SG_ 790 FLCObject06_CoastIndex 1;
BA_ "GenSigStartValue" SG_ 790 FLCObject06_CoastIndex 31;
BA_ "GenSigSendType" SG_ 790 FLCObject06_LifeTime 1;
BA_ "GenSigStartValue" SG_ 790 FLCObject06_LifeTime 65535;
BA_ "GenSigSendType" SG_ 790 FLCObject06_DistLeftCorner 1;
BA_ "GenSigStartValue" SG_ 790 FLCObject06_DistLeftCorner 4095;
BA_ "GenSigSendType" SG_ 790 FLCObject06_LongAcc 1;
BA_ "GenSigStartValue" SG_ 790 FLCObject06_LongAcc 511;
BA_ "GenSigSendType" SG_ 790 FLCObject06_ObjClass 1;
BA_ "GenSigStartValue" SG_ 790 FLCObject06_ObjClass 15;
BA_ "GenSigSendType" SG_ 790 FLCObject06_ObjID 1;
BA_ "GenSigStartValue" SG_ 790 FLCObject06_ObjID 63;
BA_ "GenSigSendType" SG_ 790 FLCObject06_LongPosVar 1;
BA_ "GenSigStartValue" SG_ 790 FLCObject06_LongPosVar 255;
BA_ "GenSigSendType" SG_ 790 FLCObject06_TrackStatus 1;
BA_ "GenSigStartValue" SG_ 790 FLCObject06_TrackStatus 7;
BA_ "GenSigSendType" SG_ 790 FLCObject06_AngFarVar 1;
BA_ "GenSigStartValue" SG_ 790 FLCObject06_AngFarVar 255;
BA_ "GenSigSendType" SG_ 790 FLCObject06_DstLeftVar 1;
BA_ "GenSigStartValue" SG_ 790 FLCObject06_DstLeftVar 255;
BA_ "GenSigSendType" SG_ 790 FLCObject06_LongVelVar 1;
BA_ "GenSigStartValue" SG_ 790 FLCObject06_LongVelVar 255;
BA_ "GenSigSendType" SG_ 790 FLCObject06_BrakeLight 1;
BA_ "GenSigStartValue" SG_ 790 FLCObject06_BrakeLight 7;
BA_ "GenSigSendType" SG_ 790 FLCObject06_HeadingVar 1;
BA_ "GenSigStartValue" SG_ 790 FLCObject06_HeadingVar 255;
BA_ "GenSigSendType" SG_ 790 FLCObject06_TimeStamp 1;
BA_ "GenSigStartValue" SG_ 790 FLCObject06_TimeStamp 65535;
BA_ "GenSigSendType" SG_ 790 FLCObject06_ExistConf 1;
BA_ "GenSigStartValue" SG_ 790 FLCObject06_ExistConf 127;
BA_ "GenSigSendType" SG_ 790 FLCObject06_CRC 1;
BA_ "GenSigStartValue" SG_ 790 FLCObject06_CRC 65535;
BA_ "E2EDataId" SG_ 790 FLCObject06_CRC 81;
BA_ "E2EDataLength" SG_ 790 FLCObject06_CRC 352;
BA_ "E2EProfile" SG_ 790 FLCObject06_CRC "P05";
BA_ "GenSigSendType" SG_ 790 FLCObject06_DistFarCorner 1;
BA_ "GenSigStartValue" SG_ 790 FLCObject06_DistFarCorner 4095;
BA_ "GenSigSendType" SG_ 790 FLCObject06_LongPos 1;
BA_ "GenSigStartValue" SG_ 790 FLCObject06_LongPos 8191;
BA_ "GenSigSendType" SG_ 790 FLCObject06_AnglFarCorner 1;
BA_ "GenSigStartValue" SG_ 790 FLCObject06_AnglFarCorner 1023;
BA_ "GenSigSendType" SG_ 790 FLCObject06_LatVelVar 1;
BA_ "GenSigStartValue" SG_ 790 FLCObject06_LatVelVar 255;
BA_ "GenSigSendType" SG_ 790 FLCObject06_DstRightVar 1;
BA_ "GenSigStartValue" SG_ 790 FLCObject06_DstRightVar 255;
BA_ "GenSigSendType" SG_ 790 FLCObject06_AngLeftVar 1;
BA_ "GenSigStartValue" SG_ 790 FLCObject06_AngLeftVar 255;
BA_ "GenSigSendType" SG_ 790 FLCObject06_TurnIndication 1;
BA_ "GenSigStartValue" SG_ 790 FLCObject06_TurnIndication 7;
BA_ "GenSigSendType" SG_ 790 FLCObject06_LongVel 1;
BA_ "GenSigStartValue" SG_ 790 FLCObject06_LongVel 8191;
BA_ "GenSigSendType" SG_ 790 FLCObject06_AnglLeftCorner 1;
BA_ "GenSigStartValue" SG_ 790 FLCObject06_AnglLeftCorner 1023;
BA_ "GenSigSendType" SG_ 790 FLCObject06_Height 1;
BA_ "GenSigStartValue" SG_ 790 FLCObject06_Height 255;
BA_ "GenSigSendType" SG_ 790 FLCObject06_LatPos 1;
BA_ "GenSigStartValue" SG_ 790 FLCObject06_LatPos 8191;
BA_ "GenSigSendType" SG_ 790 FLCObject06_AngRightVar 1;
BA_ "GenSigStartValue" SG_ 790 FLCObject06_AngRightVar 255;
BA_ "GenSigSendType" SG_ 790 FLCObject06_TargetToLine 1;
BA_ "GenSigStartValue" SG_ 790 FLCObject06_TargetToLine 7;
BA_ "GenSigSendType" SG_ 790 FLCObject06_LatAcc 1;
BA_ "GenSigStartValue" SG_ 790 FLCObject06_LatAcc 511;
BA_ "GenSigSendType" SG_ 790 FLCObject06_ReliabilityConf 1;
BA_ "GenSigStartValue" SG_ 790 FLCObject06_ReliabilityConf 7;
BA_ "GenSigSendType" SG_ 790 FLCObject06_Counter 1;
BA_ "GenSigStartValue" SG_ 790 FLCObject06_Counter 255;
BA_ "GenSigSendType" SG_ 790 FLCObject06_Heading 1;
BA_ "GenSigStartValue" SG_ 790 FLCObject06_Heading 2047;
BA_ "GenSigSendType" SG_ 790 FLCObject06_ScaleChange 1;
BA_ "GenSigStartValue" SG_ 790 FLCObject06_ScaleChange 1023;
BA_ "GenSigSendType" SG_ 790 FLCObject06_DstFarVar 1;
BA_ "GenSigStartValue" SG_ 790 FLCObject06_DstFarVar 255;
BA_ "GenSigSendType" SG_ 790 FLCObject06_DistRightCorner 1;
BA_ "GenSigStartValue" SG_ 790 FLCObject06_DistRightCorner 4095;
BA_ "GenSigSendType" SG_ 790 FLCObject06_AnglRightCorner 1;
BA_ "GenSigStartValue" SG_ 790 FLCObject06_AnglRightCorner 1023;
BA_ "GenSigSendType" SG_ 790 FLCObject06_LatVel 1;
BA_ "GenSigStartValue" SG_ 790 FLCObject06_LatVel 8191;
BA_ "GenSigSendType" SG_ 790 FLCObject06_ObjDynClass 1;
BA_ "GenSigStartValue" SG_ 790 FLCObject06_ObjDynClass 3;
BA_ "GenSigSendType" SG_ 789 FLCObject05_LongVelVar 1;
BA_ "GenSigStartValue" SG_ 789 FLCObject05_LongVelVar 255;
BA_ "GenSigSendType" SG_ 789 FLCObject05_TurnIndication 1;
BA_ "GenSigStartValue" SG_ 789 FLCObject05_TurnIndication 7;
BA_ "GenSigSendType" SG_ 789 FLCObject05_BrakeLight 1;
BA_ "GenSigStartValue" SG_ 789 FLCObject05_BrakeLight 7;
BA_ "GenSigSendType" SG_ 789 FLCObject05_DistRightCorner 1;
BA_ "GenSigStartValue" SG_ 789 FLCObject05_DistRightCorner 4095;
BA_ "GenSigSendType" SG_ 789 FLCObject05_DstFarVar 1;
BA_ "GenSigStartValue" SG_ 789 FLCObject05_DstFarVar 255;
BA_ "GenSigSendType" SG_ 789 FLCObject05_DstLeftVar 1;
BA_ "GenSigStartValue" SG_ 789 FLCObject05_DstLeftVar 255;
BA_ "GenSigSendType" SG_ 789 FLCObject05_AngFarVar 1;
BA_ "GenSigStartValue" SG_ 789 FLCObject05_AngFarVar 255;
BA_ "GenSigSendType" SG_ 789 FLCObject05_AnglFarCorner 1;
BA_ "GenSigStartValue" SG_ 789 FLCObject05_AnglFarCorner 1023;
BA_ "GenSigSendType" SG_ 789 FLCObject05_LongVel 1;
BA_ "GenSigStartValue" SG_ 789 FLCObject05_LongVel 8191;
BA_ "GenSigSendType" SG_ 789 FLCObject05_Counter 1;
BA_ "GenSigStartValue" SG_ 789 FLCObject05_Counter 255;
BA_ "GenSigSendType" SG_ 789 FLCObject05_LatAcc 1;
BA_ "GenSigStartValue" SG_ 789 FLCObject05_LatAcc 511;
BA_ "GenSigSendType" SG_ 789 FLCObject05_AnglRightCorner 1;
BA_ "GenSigStartValue" SG_ 789 FLCObject05_AnglRightCorner 1023;
BA_ "GenSigSendType" SG_ 789 FLCObject05_ReliabilityConf 1;
BA_ "GenSigStartValue" SG_ 789 FLCObject05_ReliabilityConf 7;
BA_ "GenSigSendType" SG_ 789 FLCObject05_Heading 1;
BA_ "GenSigStartValue" SG_ 789 FLCObject05_Heading 2047;
BA_ "GenSigSendType" SG_ 789 FLCObject05_CoastIndex 1;
BA_ "GenSigStartValue" SG_ 789 FLCObject05_CoastIndex 31;
BA_ "GenSigSendType" SG_ 789 FLCObject05_LongAcc 1;
BA_ "GenSigStartValue" SG_ 789 FLCObject05_LongAcc 511;
BA_ "GenSigSendType" SG_ 789 FLCObject05_LatVel 1;
BA_ "GenSigStartValue" SG_ 789 FLCObject05_LatVel 8191;
BA_ "GenSigSendType" SG_ 789 FLCObject05_ScaleChange 1;
BA_ "GenSigStartValue" SG_ 789 FLCObject05_ScaleChange 1023;
BA_ "GenSigSendType" SG_ 789 FLCObject05_HeadingVar 1;
BA_ "GenSigStartValue" SG_ 789 FLCObject05_HeadingVar 255;
BA_ "GenSigSendType" SG_ 789 FLCObject05_LifeTime 1;
BA_ "GenSigStartValue" SG_ 789 FLCObject05_LifeTime 65535;
BA_ "GenSigSendType" SG_ 789 FLCObject05_LongPosVar 1;
BA_ "GenSigStartValue" SG_ 789 FLCObject05_LongPosVar 255;
BA_ "GenSigSendType" SG_ 789 FLCObject05_DistLeftCorner 1;
BA_ "GenSigStartValue" SG_ 789 FLCObject05_DistLeftCorner 4095;
BA_ "GenSigSendType" SG_ 789 FLCObject05_TrackStatus 1;
BA_ "GenSigStartValue" SG_ 789 FLCObject05_TrackStatus 7;
BA_ "GenSigSendType" SG_ 789 FLCObject05_LatPosVar 1;
BA_ "GenSigStartValue" SG_ 789 FLCObject05_LatPosVar 255;
BA_ "GenSigSendType" SG_ 789 FLCObject05_AngLeftVar 1;
BA_ "GenSigStartValue" SG_ 789 FLCObject05_AngLeftVar 255;
BA_ "GenSigSendType" SG_ 789 FLCObject05_ExistConf 1;
BA_ "GenSigStartValue" SG_ 789 FLCObject05_ExistConf 127;
BA_ "GenSigSendType" SG_ 789 FLCObject05_DstRightVar 1;
BA_ "GenSigStartValue" SG_ 789 FLCObject05_DstRightVar 255;
BA_ "GenSigSendType" SG_ 789 FLCObject05_AnglLeftCorner 1;
BA_ "GenSigStartValue" SG_ 789 FLCObject05_AnglLeftCorner 1023;
BA_ "GenSigSendType" SG_ 789 FLCObject05_ObjDynClass 1;
BA_ "GenSigStartValue" SG_ 789 FLCObject05_ObjDynClass 3;
BA_ "GenSigSendType" SG_ 789 FLCObject05_DistFarCorner 1;
BA_ "GenSigStartValue" SG_ 789 FLCObject05_DistFarCorner 4095;
BA_ "GenSigSendType" SG_ 789 FLCObject05_ObjClass 1;
BA_ "GenSigStartValue" SG_ 789 FLCObject05_ObjClass 15;
BA_ "GenSigSendType" SG_ 789 FLCObject05_TimeStamp 1;
BA_ "GenSigStartValue" SG_ 789 FLCObject05_TimeStamp 65535;
BA_ "GenSigSendType" SG_ 789 FLCObject05_LatVelVar 1;
BA_ "GenSigStartValue" SG_ 789 FLCObject05_LatVelVar 255;
BA_ "GenSigSendType" SG_ 789 FLCObject05_LatPos 1;
BA_ "GenSigStartValue" SG_ 789 FLCObject05_LatPos 8191;
BA_ "GenSigSendType" SG_ 789 FLCObject05_LongPos 1;
BA_ "GenSigStartValue" SG_ 789 FLCObject05_LongPos 8191;
BA_ "GenSigSendType" SG_ 789 FLCObject05_TargetToLine 1;
BA_ "GenSigStartValue" SG_ 789 FLCObject05_TargetToLine 7;
BA_ "GenSigSendType" SG_ 789 FLCObject05_CRC 1;
BA_ "GenSigStartValue" SG_ 789 FLCObject05_CRC 65535;
BA_ "E2EDataId" SG_ 789 FLCObject05_CRC 80;
BA_ "E2EDataLength" SG_ 789 FLCObject05_CRC 352;
BA_ "E2EProfile" SG_ 789 FLCObject05_CRC "P05";
BA_ "GenSigSendType" SG_ 789 FLCObject05_Height 1;
BA_ "GenSigStartValue" SG_ 789 FLCObject05_Height 255;
BA_ "GenSigSendType" SG_ 789 FLCObject05_ObjID 1;
BA_ "GenSigStartValue" SG_ 789 FLCObject05_ObjID 63;
BA_ "GenSigSendType" SG_ 789 FLCObject05_AngRightVar 1;
BA_ "GenSigStartValue" SG_ 789 FLCObject05_AngRightVar 255;
BA_REL_ "GenSigFirstTimeoutTime" BU_SG_REL_ DACU SG_ 797 FLCObject13_AnglRightCorner 3000;
BA_REL_ "GenSigTimeoutTime" BU_SG_REL_ DACU SG_ 797 FLCObject13_AnglRightCorner 120;
BA_REL_ "GenSigFirstTimeoutTime" BU_SG_REL_ DACU SG_ 797 FLCObject13_TimeStamp 3000;
BA_REL_ "GenSigTimeoutTime" BU_SG_REL_ DACU SG_ 797 FLCObject13_TimeStamp 120;
BA_REL_ "GenSigFirstTimeoutTime" BU_SG_REL_ DACU SG_ 797 FLCObject13_ExistConf 3000;
BA_REL_ "GenSigTimeoutTime" BU_SG_REL_ DACU SG_ 797 FLCObject13_ExistConf 120;
BA_REL_ "GenSigFirstTimeoutTime" BU_SG_REL_ DACU SG_ 797 FLCObject13_ScaleChange 3000;
BA_REL_ "GenSigTimeoutTime" BU_SG_REL_ DACU SG_ 797 FLCObject13_ScaleChange 120;
BA_REL_ "GenSigFirstTimeoutTime" BU_SG_REL_ DACU SG_ 797 FLCObject13_DstRightVar 3000;
BA_REL_ "GenSigTimeoutTime" BU_SG_REL_ DACU SG_ 797 FLCObject13_DstRightVar 120;
BA_REL_ "GenSigFirstTimeoutTime" BU_SG_REL_ DACU SG_ 797 FLCObject13_BrakeLight 3000;
BA_REL_ "GenSigTimeoutTime" BU_SG_REL_ DACU SG_ 797 FLCObject13_BrakeLight 120;
BA_REL_ "GenSigFirstTimeoutTime" BU_SG_REL_ DACU SG_ 797 FLCObject13_LifeTime 3000;
BA_REL_ "GenSigTimeoutTime" BU_SG_REL_ DACU SG_ 797 FLCObject13_LifeTime 120;
BA_REL_ "GenSigFirstTimeoutTime" BU_SG_REL_ DACU SG_ 797 FLCObject13_DstLeftVar 3000;
BA_REL_ "GenSigTimeoutTime" BU_SG_REL_ DACU SG_ 797 FLCObject13_DstLeftVar 120;
BA_REL_ "GenSigFirstTimeoutTime" BU_SG_REL_ DACU SG_ 797 FLCObject13_DistLeftCorner 3000;
BA_REL_ "GenSigTimeoutTime" BU_SG_REL_ DACU SG_ 797 FLCObject13_DistLeftCorner 120;
BA_REL_ "GenSigFirstTimeoutTime" BU_SG_REL_ DACU SG_ 797 FLCObject13_ObjDynClass 3000;
BA_REL_ "GenSigTimeoutTime" BU_SG_REL_ DACU SG_ 797 FLCObject13_ObjDynClass 120;
BA_REL_ "GenSigFirstTimeoutTime" BU_SG_REL_ DACU SG_ 797 FLCObject13_LongAcc 3000;
BA_REL_ "GenSigTimeoutTime" BU_SG_REL_ DACU SG_ 797 FLCObject13_LongAcc 120;
BA_REL_ "GenSigFirstTimeoutTime" BU_SG_REL_ DACU SG_ 797 FLCObject13_AngRightVar 3000;
BA_REL_ "GenSigTimeoutTime" BU_SG_REL_ DACU SG_ 797 FLCObject13_AngRightVar 120;
BA_REL_ "GenSigFirstTimeoutTime" BU_SG_REL_ DACU SG_ 797 FLCObject13_AnglFarCorner 3000;
BA_REL_ "GenSigTimeoutTime" BU_SG_REL_ DACU SG_ 797 FLCObject13_AnglFarCorner 120;
BA_REL_ "GenSigFirstTimeoutTime" BU_SG_REL_ DACU SG_ 797 FLCObject13_LatAcc 3000;
BA_REL_ "GenSigTimeoutTime" BU_SG_REL_ DACU SG_ 797 FLCObject13_LatAcc 120;
BA_REL_ "GenSigFirstTimeoutTime" BU_SG_REL_ DACU SG_ 797 FLCObject13_TurnIndication 3000;
BA_REL_ "GenSigTimeoutTime" BU_SG_REL_ DACU SG_ 797 FLCObject13_TurnIndication 120;
BA_REL_ "GenSigFirstTimeoutTime" BU_SG_REL_ DACU SG_ 797 FLCObject13_Counter 3000;
BA_REL_ "GenSigTimeoutTime" BU_SG_REL_ DACU SG_ 797 FLCObject13_Counter 120;
BA_REL_ "GenSigFirstTimeoutTime" BU_SG_REL_ DACU SG_ 797 FLCObject13_Heading 3000;
BA_REL_ "GenSigTimeoutTime" BU_SG_REL_ DACU SG_ 797 FLCObject13_Heading 120;
BA_REL_ "GenSigFirstTimeoutTime" BU_SG_REL_ DACU SG_ 797 FLCObject13_HeadingVar 3000;
BA_REL_ "GenSigTimeoutTime" BU_SG_REL_ DACU SG_ 797 FLCObject13_HeadingVar 120;
BA_REL_ "GenSigFirstTimeoutTime" BU_SG_REL_ DACU SG_ 797 FLCObject13_DstFarVar 3000;
BA_REL_ "GenSigTimeoutTime" BU_SG_REL_ DACU SG_ 797 FLCObject13_DstFarVar 120;
BA_REL_ "GenSigFirstTimeoutTime" BU_SG_REL_ DACU SG_ 797 FLCObject13_LongPosVar 3000;
BA_REL_ "GenSigTimeoutTime" BU_SG_REL_ DACU SG_ 797 FLCObject13_LongPosVar 120;
BA_REL_ "GenSigFirstTimeoutTime" BU_SG_REL_ DACU SG_ 797 FLCObject13_Height 3000;
BA_REL_ "GenSigTimeoutTime" BU_SG_REL_ DACU SG_ 797 FLCObject13_Height 120;
BA_REL_ "GenSigFirstTimeoutTime" BU_SG_REL_ DACU SG_ 797 FLCObject13_TargetToLine 3000;
BA_REL_ "GenSigTimeoutTime" BU_SG_REL_ DACU SG_ 797 FLCObject13_TargetToLine 120;
BA_REL_ "GenSigFirstTimeoutTime" BU_SG_REL_ DACU SG_ 797 FLCObject13_LatVel 3000;
BA_REL_ "GenSigTimeoutTime" BU_SG_REL_ DACU SG_ 797 FLCObject13_LatVel 120;
BA_REL_ "GenSigFirstTimeoutTime" BU_SG_REL_ DACU SG_ 797 FLCObject13_CoastIndex 3000;
BA_REL_ "GenSigTimeoutTime" BU_SG_REL_ DACU SG_ 797 FLCObject13_CoastIndex 120;
BA_REL_ "GenSigFirstTimeoutTime" BU_SG_REL_ DACU SG_ 797 FLCObject13_LatPosVar 3000;
BA_REL_ "GenSigTimeoutTime" BU_SG_REL_ DACU SG_ 797 FLCObject13_LatPosVar 120;
BA_REL_ "GenSigFirstTimeoutTime" BU_SG_REL_ DACU SG_ 797 FLCObject13_DistFarCorner 3000;
BA_REL_ "GenSigTimeoutTime" BU_SG_REL_ DACU SG_ 797 FLCObject13_DistFarCorner 120;
BA_REL_ "GenSigFirstTimeoutTime" BU_SG_REL_ DACU SG_ 797 FLCObject13_LongPos 3000;
BA_REL_ "GenSigTimeoutTime" BU_SG_REL_ DACU SG_ 797 FLCObject13_LongPos 120;
BA_REL_ "GenSigFirstTimeoutTime" BU_SG_REL_ DACU SG_ 797 FLCObject13_ObjClass 3000;
BA_REL_ "GenSigTimeoutTime" BU_SG_REL_ DACU SG_ 797 FLCObject13_ObjClass 120;
BA_REL_ "GenSigFirstTimeoutTime" BU_SG_REL_ DACU SG_ 797 FLCObject13_LatPos 3000;
BA_REL_ "GenSigTimeoutTime" BU_SG_REL_ DACU SG_ 797 FLCObject13_LatPos 120;
BA_REL_ "GenSigFirstTimeoutTime" BU_SG_REL_ DACU SG_ 797 FLCObject13_LongVelVar 3000;
BA_REL_ "GenSigTimeoutTime" BU_SG_REL_ DACU SG_ 797 FLCObject13_LongVelVar 120;
BA_REL_ "GenSigFirstTimeoutTime" BU_SG_REL_ DACU SG_ 797 FLCObject13_DistRightCorner 3000;
BA_REL_ "GenSigTimeoutTime" BU_SG_REL_ DACU SG_ 797 FLCObject13_DistRightCorner 120;
BA_REL_ "GenSigFirstTimeoutTime" BU_SG_REL_ DACU SG_ 797 FLCObject13_TrackStatus 3000;
BA_REL_ "GenSigTimeoutTime" BU_SG_REL_ DACU SG_ 797 FLCObject13_TrackStatus 120;
BA_REL_ "GenSigFirstTimeoutTime" BU_SG_REL_ DACU SG_ 797 FLCObject13_CRC 3000;
BA_REL_ "GenSigTimeoutTime" BU_SG_REL_ DACU SG_ 797 FLCObject13_CRC 120;
BA_REL_ "GenSigFirstTimeoutTime" BU_SG_REL_ DACU SG_ 797 FLCObject13_AngFarVar 3000;
BA_REL_ "GenSigTimeoutTime" BU_SG_REL_ DACU SG_ 797 FLCObject13_AngFarVar 120;
BA_REL_ "GenSigFirstTimeoutTime" BU_SG_REL_ DACU SG_ 797 FLCObject13_LatVelVar 3000;
BA_REL_ "GenSigTimeoutTime" BU_SG_REL_ DACU SG_ 797 FLCObject13_LatVelVar 120;
BA_REL_ "GenSigFirstTimeoutTime" BU_SG_REL_ DACU SG_ 797 FLCObject13_AnglLeftCorner 3000;
BA_REL_ "GenSigTimeoutTime" BU_SG_REL_ DACU SG_ 797 FLCObject13_AnglLeftCorner 120;
BA_REL_ "GenSigFirstTimeoutTime" BU_SG_REL_ DACU SG_ 797 FLCObject13_LongVel 3000;
BA_REL_ "GenSigTimeoutTime" BU_SG_REL_ DACU SG_ 797 FLCObject13_LongVel 120;
BA_REL_ "GenSigFirstTimeoutTime" BU_SG_REL_ DACU SG_ 797 FLCObject13_AngLeftVar 3000;
BA_REL_ "GenSigTimeoutTime" BU_SG_REL_ DACU SG_ 797 FLCObject13_AngLeftVar 120;
BA_REL_ "GenSigFirstTimeoutTime" BU_SG_REL_ DACU SG_ 797 FLCObject13_ReliabilityConf 3000;
BA_REL_ "GenSigTimeoutTime" BU_SG_REL_ DACU SG_ 797 FLCObject13_ReliabilityConf 120;
BA_REL_ "GenSigFirstTimeoutTime" BU_SG_REL_ DACU SG_ 797 FLCObject13_ObjID 3000;
BA_REL_ "GenSigTimeoutTime" BU_SG_REL_ DACU SG_ 797 FLCObject13_ObjID 120;
BA_REL_ "GenSigFirstTimeoutTime" BU_SG_REL_ DACU SG_ 796 FLCObject12_TimeStamp 3000;
BA_REL_ "GenSigTimeoutTime" BU_SG_REL_ DACU SG_ 796 FLCObject12_TimeStamp 120;
BA_REL_ "GenSigFirstTimeoutTime" BU_SG_REL_ DACU SG_ 796 FLCObject12_AnglRightCorner 3000;
BA_REL_ "GenSigTimeoutTime" BU_SG_REL_ DACU SG_ 796 FLCObject12_AnglRightCorner 120;
BA_REL_ "GenSigFirstTimeoutTime" BU_SG_REL_ DACU SG_ 796 FLCObject12_AnglLeftCorner 3000;
BA_REL_ "GenSigTimeoutTime" BU_SG_REL_ DACU SG_ 796 FLCObject12_AnglLeftCorner 120;
BA_REL_ "GenSigFirstTimeoutTime" BU_SG_REL_ DACU SG_ 796 FLCObject12_AngRightVar 3000;
BA_REL_ "GenSigTimeoutTime" BU_SG_REL_ DACU SG_ 796 FLCObject12_AngRightVar 120;
BA_REL_ "GenSigFirstTimeoutTime" BU_SG_REL_ DACU SG_ 796 FLCObject12_ScaleChange 3000;
BA_REL_ "GenSigTimeoutTime" BU_SG_REL_ DACU SG_ 796 FLCObject12_ScaleChange 120;
BA_REL_ "GenSigFirstTimeoutTime" BU_SG_REL_ DACU SG_ 796 FLCObject12_CRC 3000;
BA_REL_ "GenSigTimeoutTime" BU_SG_REL_ DACU SG_ 796 FLCObject12_CRC 120;
BA_REL_ "GenSigFirstTimeoutTime" BU_SG_REL_ DACU SG_ 796 FLCObject12_AnglFarCorner 3000;
BA_REL_ "GenSigTimeoutTime" BU_SG_REL_ DACU SG_ 796 FLCObject12_AnglFarCorner 120;
BA_REL_ "GenSigFirstTimeoutTime" BU_SG_REL_ DACU SG_ 796 FLCObject12_LatPos 3000;
BA_REL_ "GenSigTimeoutTime" BU_SG_REL_ DACU SG_ 796 FLCObject12_LatPos 120;
BA_REL_ "GenSigFirstTimeoutTime" BU_SG_REL_ DACU SG_ 796 FLCObject12_DistLeftCorner 3000;
BA_REL_ "GenSigTimeoutTime" BU_SG_REL_ DACU SG_ 796 FLCObject12_DistLeftCorner 120;
BA_REL_ "GenSigFirstTimeoutTime" BU_SG_REL_ DACU SG_ 796 FLCObject12_LongVel 3000;
BA_REL_ "GenSigTimeoutTime" BU_SG_REL_ DACU SG_ 796 FLCObject12_LongVel 120;
BA_REL_ "GenSigFirstTimeoutTime" BU_SG_REL_ DACU SG_ 796 FLCObject12_BrakeLight 3000;
BA_REL_ "GenSigTimeoutTime" BU_SG_REL_ DACU SG_ 796 FLCObject12_BrakeLight 120;
BA_REL_ "GenSigFirstTimeoutTime" BU_SG_REL_ DACU SG_ 796 FLCObject12_Heading 3000;
BA_REL_ "GenSigTimeoutTime" BU_SG_REL_ DACU SG_ 796 FLCObject12_Heading 120;
BA_REL_ "GenSigFirstTimeoutTime" BU_SG_REL_ DACU SG_ 796 FLCObject12_ObjDynClass 3000;
BA_REL_ "GenSigTimeoutTime" BU_SG_REL_ DACU SG_ 796 FLCObject12_ObjDynClass 120;
BA_REL_ "GenSigFirstTimeoutTime" BU_SG_REL_ DACU SG_ 796 FLCObject12_TurnIndication 3000;
BA_REL_ "GenSigTimeoutTime" BU_SG_REL_ DACU SG_ 796 FLCObject12_TurnIndication 120;
BA_REL_ "GenSigFirstTimeoutTime" BU_SG_REL_ DACU SG_ 796 FLCObject12_LatVelVar 3000;
BA_REL_ "GenSigTimeoutTime" BU_SG_REL_ DACU SG_ 796 FLCObject12_LatVelVar 120;
BA_REL_ "GenSigFirstTimeoutTime" BU_SG_REL_ DACU SG_ 796 FLCObject12_LongVelVar 3000;
BA_REL_ "GenSigTimeoutTime" BU_SG_REL_ DACU SG_ 796 FLCObject12_LongVelVar 120;
BA_REL_ "GenSigFirstTimeoutTime" BU_SG_REL_ DACU SG_ 796 FLCObject12_LatPosVar 3000;
BA_REL_ "GenSigTimeoutTime" BU_SG_REL_ DACU SG_ 796 FLCObject12_LatPosVar 120;
BA_REL_ "GenSigFirstTimeoutTime" BU_SG_REL_ DACU SG_ 796 FLCObject12_LatAcc 3000;
BA_REL_ "GenSigTimeoutTime" BU_SG_REL_ DACU SG_ 796 FLCObject12_LatAcc 120;
BA_REL_ "GenSigFirstTimeoutTime" BU_SG_REL_ DACU SG_ 796 FLCObject12_LongAcc 3000;
BA_REL_ "GenSigTimeoutTime" BU_SG_REL_ DACU SG_ 796 FLCObject12_LongAcc 120;
BA_REL_ "GenSigFirstTimeoutTime" BU_SG_REL_ DACU SG_ 796 FLCObject12_DistFarCorner 3000;
BA_REL_ "GenSigTimeoutTime" BU_SG_REL_ DACU SG_ 796 FLCObject12_DistFarCorner 120;
BA_REL_ "GenSigFirstTimeoutTime" BU_SG_REL_ DACU SG_ 796 FLCObject12_DistRightCorner 3000;
BA_REL_ "GenSigTimeoutTime" BU_SG_REL_ DACU SG_ 796 FLCObject12_DistRightCorner 120;
BA_REL_ "GenSigFirstTimeoutTime" BU_SG_REL_ DACU SG_ 796 FLCObject12_AngLeftVar 3000;
BA_REL_ "GenSigTimeoutTime" BU_SG_REL_ DACU SG_ 796 FLCObject12_AngLeftVar 120;
BA_REL_ "GenSigFirstTimeoutTime" BU_SG_REL_ DACU SG_ 796 FLCObject12_LongPosVar 3000;
BA_REL_ "GenSigTimeoutTime" BU_SG_REL_ DACU SG_ 796 FLCObject12_LongPosVar 120;
BA_REL_ "GenSigFirstTimeoutTime" BU_SG_REL_ DACU SG_ 796 FLCObject12_TrackStatus 3000;
BA_REL_ "GenSigTimeoutTime" BU_SG_REL_ DACU SG_ 796 FLCObject12_TrackStatus 120;
BA_REL_ "GenSigFirstTimeoutTime" BU_SG_REL_ DACU SG_ 796 FLCObject12_TargetToLine 3000;
BA_REL_ "GenSigTimeoutTime" BU_SG_REL_ DACU SG_ 796 FLCObject12_TargetToLine 120;
BA_REL_ "GenSigFirstTimeoutTime" BU_SG_REL_ DACU SG_ 796 FLCObject12_ObjID 3000;
BA_REL_ "GenSigTimeoutTime" BU_SG_REL_ DACU SG_ 796 FLCObject12_ObjID 120;
BA_REL_ "GenSigFirstTimeoutTime" BU_SG_REL_ DACU SG_ 796 FLCObject12_DstFarVar 3000;
BA_REL_ "GenSigTimeoutTime" BU_SG_REL_ DACU SG_ 796 FLCObject12_DstFarVar 120;
BA_REL_ "GenSigFirstTimeoutTime" BU_SG_REL_ DACU SG_ 796 FLCObject12_ReliabilityConf 3000;
BA_REL_ "GenSigTimeoutTime" BU_SG_REL_ DACU SG_ 796 FLCObject12_ReliabilityConf 120;
BA_REL_ "GenSigFirstTimeoutTime" BU_SG_REL_ DACU SG_ 796 FLCObject12_ObjClass 3000;
BA_REL_ "GenSigTimeoutTime" BU_SG_REL_ DACU SG_ 796 FLCObject12_ObjClass 120;
BA_REL_ "GenSigFirstTimeoutTime" BU_SG_REL_ DACU SG_ 796 FLCObject12_ExistConf 3000;
BA_REL_ "GenSigTimeoutTime" BU_SG_REL_ DACU SG_ 796 FLCObject12_ExistConf 120;
BA_REL_ "GenSigFirstTimeoutTime" BU_SG_REL_ DACU SG_ 796 FLCObject12_LongPos 3000;
BA_REL_ "GenSigTimeoutTime" BU_SG_REL_ DACU SG_ 796 FLCObject12_LongPos 120;
BA_REL_ "GenSigFirstTimeoutTime" BU_SG_REL_ DACU SG_ 796 FLCObject12_Height 3000;
BA_REL_ "GenSigTimeoutTime" BU_SG_REL_ DACU SG_ 796 FLCObject12_Height 120;
BA_REL_ "GenSigFirstTimeoutTime" BU_SG_REL_ DACU SG_ 796 FLCObject12_Counter 3000;
BA_REL_ "GenSigTimeoutTime" BU_SG_REL_ DACU SG_ 796 FLCObject12_Counter 120;
BA_REL_ "GenSigFirstTimeoutTime" BU_SG_REL_ DACU SG_ 796 FLCObject12_LifeTime 3000;
BA_REL_ "GenSigTimeoutTime" BU_SG_REL_ DACU SG_ 796 FLCObject12_LifeTime 120;
BA_REL_ "GenSigFirstTimeoutTime" BU_SG_REL_ DACU SG_ 796 FLCObject12_DstLeftVar 3000;
BA_REL_ "GenSigTimeoutTime" BU_SG_REL_ DACU SG_ 796 FLCObject12_DstLeftVar 120;
BA_REL_ "GenSigFirstTimeoutTime" BU_SG_REL_ DACU SG_ 796 FLCObject12_DstRightVar 3000;
BA_REL_ "GenSigTimeoutTime" BU_SG_REL_ DACU SG_ 796 FLCObject12_DstRightVar 120;
BA_REL_ "GenSigFirstTimeoutTime" BU_SG_REL_ DACU SG_ 796 FLCObject12_CoastIndex 3000;
BA_REL_ "GenSigTimeoutTime" BU_SG_REL_ DACU SG_ 796 FLCObject12_CoastIndex 120;
BA_REL_ "GenSigFirstTimeoutTime" BU_SG_REL_ DACU SG_ 796 FLCObject12_AngFarVar 3000;
BA_REL_ "GenSigTimeoutTime" BU_SG_REL_ DACU SG_ 796 FLCObject12_AngFarVar 120;
BA_REL_ "GenSigFirstTimeoutTime" BU_SG_REL_ DACU SG_ 796 FLCObject12_LatVel 3000;
BA_REL_ "GenSigTimeoutTime" BU_SG_REL_ DACU SG_ 796 FLCObject12_LatVel 120;
BA_REL_ "GenSigFirstTimeoutTime" BU_SG_REL_ DACU SG_ 796 FLCObject12_HeadingVar 3000;
BA_REL_ "GenSigTimeoutTime" BU_SG_REL_ DACU SG_ 796 FLCObject12_HeadingVar 120;
BA_REL_ "GenSigFirstTimeoutTime" BU_SG_REL_ DACU SG_ 795 FLCObject11_ReliabilityConf 3000;
BA_REL_ "GenSigTimeoutTime" BU_SG_REL_ DACU SG_ 795 FLCObject11_ReliabilityConf 120;
BA_REL_ "GenSigFirstTimeoutTime" BU_SG_REL_ DACU SG_ 795 FLCObject11_ObjID 3000;
BA_REL_ "GenSigTimeoutTime" BU_SG_REL_ DACU SG_ 795 FLCObject11_ObjID 120;
BA_REL_ "GenSigFirstTimeoutTime" BU_SG_REL_ DACU SG_ 795 FLCObject11_LongPosVar 3000;
BA_REL_ "GenSigTimeoutTime" BU_SG_REL_ DACU SG_ 795 FLCObject11_LongPosVar 120;
BA_REL_ "GenSigFirstTimeoutTime" BU_SG_REL_ DACU SG_ 795 FLCObject11_LatVelVar 3000;
BA_REL_ "GenSigTimeoutTime" BU_SG_REL_ DACU SG_ 795 FLCObject11_LatVelVar 120;
BA_REL_ "GenSigFirstTimeoutTime" BU_SG_REL_ DACU SG_ 795 FLCObject11_LongPos 3000;
BA_REL_ "GenSigTimeoutTime" BU_SG_REL_ DACU SG_ 795 FLCObject11_LongPos 120;
BA_REL_ "GenSigFirstTimeoutTime" BU_SG_REL_ DACU SG_ 795 FLCObject11_LongVel 3000;
BA_REL_ "GenSigTimeoutTime" BU_SG_REL_ DACU SG_ 795 FLCObject11_LongVel 120;
BA_REL_ "GenSigFirstTimeoutTime" BU_SG_REL_ DACU SG_ 795 FLCObject11_LongAcc 3000;
BA_REL_ "GenSigTimeoutTime" BU_SG_REL_ DACU SG_ 795 FLCObject11_LongAcc 120;
BA_REL_ "GenSigFirstTimeoutTime" BU_SG_REL_ DACU SG_ 795 FLCObject11_TimeStamp 3000;
BA_REL_ "GenSigTimeoutTime" BU_SG_REL_ DACU SG_ 795 FLCObject11_TimeStamp 120;
BA_REL_ "GenSigFirstTimeoutTime" BU_SG_REL_ DACU SG_ 795 FLCObject11_AnglRightCorner 3000;
BA_REL_ "GenSigTimeoutTime" BU_SG_REL_ DACU SG_ 795 FLCObject11_AnglRightCorner 120;
BA_REL_ "GenSigFirstTimeoutTime" BU_SG_REL_ DACU SG_ 795 FLCObject11_LatVel 3000;
BA_REL_ "GenSigTimeoutTime" BU_SG_REL_ DACU SG_ 795 FLCObject11_LatVel 120;
BA_REL_ "GenSigFirstTimeoutTime" BU_SG_REL_ DACU SG_ 795 FLCObject11_CoastIndex 3000;
BA_REL_ "GenSigTimeoutTime" BU_SG_REL_ DACU SG_ 795 FLCObject11_CoastIndex 120;
BA_REL_ "GenSigFirstTimeoutTime" BU_SG_REL_ DACU SG_ 795 FLCObject11_TurnIndication 3000;
BA_REL_ "GenSigTimeoutTime" BU_SG_REL_ DACU SG_ 795 FLCObject11_TurnIndication 120;
BA_REL_ "GenSigFirstTimeoutTime" BU_SG_REL_ DACU SG_ 795 FLCObject11_AngFarVar 3000;
BA_REL_ "GenSigTimeoutTime" BU_SG_REL_ DACU SG_ 795 FLCObject11_AngFarVar 120;
BA_REL_ "GenSigFirstTimeoutTime" BU_SG_REL_ DACU SG_ 795 FLCObject11_AnglFarCorner 3000;
BA_REL_ "GenSigTimeoutTime" BU_SG_REL_ DACU SG_ 795 FLCObject11_AnglFarCorner 120;
BA_REL_ "GenSigFirstTimeoutTime" BU_SG_REL_ DACU SG_ 795 FLCObject11_DstRightVar 3000;
BA_REL_ "GenSigTimeoutTime" BU_SG_REL_ DACU SG_ 795 FLCObject11_DstRightVar 120;
BA_REL_ "GenSigFirstTimeoutTime" BU_SG_REL_ DACU SG_ 795 FLCObject11_LatAcc 3000;
BA_REL_ "GenSigTimeoutTime" BU_SG_REL_ DACU SG_ 795 FLCObject11_LatAcc 120;
BA_REL_ "GenSigFirstTimeoutTime" BU_SG_REL_ DACU SG_ 795 FLCObject11_CRC 3000;
BA_REL_ "GenSigTimeoutTime" BU_SG_REL_ DACU SG_ 795 FLCObject11_CRC 120;
BA_REL_ "GenSigFirstTimeoutTime" BU_SG_REL_ DACU SG_ 795 FLCObject11_LatPosVar 3000;
BA_REL_ "GenSigTimeoutTime" BU_SG_REL_ DACU SG_ 795 FLCObject11_LatPosVar 120;
BA_REL_ "GenSigFirstTimeoutTime" BU_SG_REL_ DACU SG_ 795 FLCObject11_ObjClass 3000;
BA_REL_ "GenSigTimeoutTime" BU_SG_REL_ DACU SG_ 795 FLCObject11_ObjClass 120;
BA_REL_ "GenSigFirstTimeoutTime" BU_SG_REL_ DACU SG_ 795 FLCObject11_DistRightCorner 3000;
BA_REL_ "GenSigTimeoutTime" BU_SG_REL_ DACU SG_ 795 FLCObject11_DistRightCorner 120;
BA_REL_ "GenSigFirstTimeoutTime" BU_SG_REL_ DACU SG_ 795 FLCObject11_ScaleChange 3000;
BA_REL_ "GenSigTimeoutTime" BU_SG_REL_ DACU SG_ 795 FLCObject11_ScaleChange 120;
BA_REL_ "GenSigFirstTimeoutTime" BU_SG_REL_ DACU SG_ 795 FLCObject11_DstFarVar 3000;
BA_REL_ "GenSigTimeoutTime" BU_SG_REL_ DACU SG_ 795 FLCObject11_DstFarVar 120;
BA_REL_ "GenSigFirstTimeoutTime" BU_SG_REL_ DACU SG_ 795 FLCObject11_ObjDynClass 3000;
BA_REL_ "GenSigTimeoutTime" BU_SG_REL_ DACU SG_ 795 FLCObject11_ObjDynClass 120;
BA_REL_ "GenSigFirstTimeoutTime" BU_SG_REL_ DACU SG_ 795 FLCObject11_DstLeftVar 3000;
BA_REL_ "GenSigTimeoutTime" BU_SG_REL_ DACU SG_ 795 FLCObject11_DstLeftVar 120;
BA_REL_ "GenSigFirstTimeoutTime" BU_SG_REL_ DACU SG_ 795 FLCObject11_TrackStatus 3000;
BA_REL_ "GenSigTimeoutTime" BU_SG_REL_ DACU SG_ 795 FLCObject11_TrackStatus 120;
BA_REL_ "GenSigFirstTimeoutTime" BU_SG_REL_ DACU SG_ 795 FLCObject11_LifeTime 3000;
BA_REL_ "GenSigTimeoutTime" BU_SG_REL_ DACU SG_ 795 FLCObject11_LifeTime 120;
BA_REL_ "GenSigFirstTimeoutTime" BU_SG_REL_ DACU SG_ 795 FLCObject11_Heading 3000;
BA_REL_ "GenSigTimeoutTime" BU_SG_REL_ DACU SG_ 795 FLCObject11_Heading 120;
BA_REL_ "GenSigFirstTimeoutTime" BU_SG_REL_ DACU SG_ 795 FLCObject11_BrakeLight 3000;
BA_REL_ "GenSigTimeoutTime" BU_SG_REL_ DACU SG_ 795 FLCObject11_BrakeLight 120;
BA_REL_ "GenSigFirstTimeoutTime" BU_SG_REL_ DACU SG_ 795 FLCObject11_AngRightVar 3000;
BA_REL_ "GenSigTimeoutTime" BU_SG_REL_ DACU SG_ 795 FLCObject11_AngRightVar 120;
BA_REL_ "GenSigFirstTimeoutTime" BU_SG_REL_ DACU SG_ 795 FLCObject11_DistFarCorner 3000;
BA_REL_ "GenSigTimeoutTime" BU_SG_REL_ DACU SG_ 795 FLCObject11_DistFarCorner 120;
BA_REL_ "GenSigFirstTimeoutTime" BU_SG_REL_ DACU SG_ 795 FLCObject11_LongVelVar 3000;
BA_REL_ "GenSigTimeoutTime" BU_SG_REL_ DACU SG_ 795 FLCObject11_LongVelVar 120;
BA_REL_ "GenSigFirstTimeoutTime" BU_SG_REL_ DACU SG_ 795 FLCObject11_HeadingVar 3000;
BA_REL_ "GenSigTimeoutTime" BU_SG_REL_ DACU SG_ 795 FLCObject11_HeadingVar 120;
BA_REL_ "GenSigFirstTimeoutTime" BU_SG_REL_ DACU SG_ 795 FLCObject11_Height 3000;
BA_REL_ "GenSigTimeoutTime" BU_SG_REL_ DACU SG_ 795 FLCObject11_Height 120;
BA_REL_ "GenSigFirstTimeoutTime" BU_SG_REL_ DACU SG_ 795 FLCObject11_AnglLeftCorner 3000;
BA_REL_ "GenSigTimeoutTime" BU_SG_REL_ DACU SG_ 795 FLCObject11_AnglLeftCorner 120;
BA_REL_ "GenSigFirstTimeoutTime" BU_SG_REL_ DACU SG_ 795 FLCObject11_DistLeftCorner 3000;
BA_REL_ "GenSigTimeoutTime" BU_SG_REL_ DACU SG_ 795 FLCObject11_DistLeftCorner 120;
BA_REL_ "GenSigFirstTimeoutTime" BU_SG_REL_ DACU SG_ 795 FLCObject11_AngLeftVar 3000;
BA_REL_ "GenSigTimeoutTime" BU_SG_REL_ DACU SG_ 795 FLCObject11_AngLeftVar 120;
BA_REL_ "GenSigFirstTimeoutTime" BU_SG_REL_ DACU SG_ 795 FLCObject11_ExistConf 3000;
BA_REL_ "GenSigTimeoutTime" BU_SG_REL_ DACU SG_ 795 FLCObject11_ExistConf 120;
BA_REL_ "GenSigFirstTimeoutTime" BU_SG_REL_ DACU SG_ 795 FLCObject11_TargetToLine 3000;
BA_REL_ "GenSigTimeoutTime" BU_SG_REL_ DACU SG_ 795 FLCObject11_TargetToLine 120;
BA_REL_ "GenSigFirstTimeoutTime" BU_SG_REL_ DACU SG_ 795 FLCObject11_Counter 3000;
BA_REL_ "GenSigTimeoutTime" BU_SG_REL_ DACU SG_ 795 FLCObject11_Counter 120;
BA_REL_ "GenSigFirstTimeoutTime" BU_SG_REL_ DACU SG_ 795 FLCObject11_LatPos 3000;
BA_REL_ "GenSigTimeoutTime" BU_SG_REL_ DACU SG_ 795 FLCObject11_LatPos 120;
BA_REL_ "GenSigFirstTimeoutTime" BU_SG_REL_ DACU SG_ 794 FLCObject10_LatAcc 3000;
BA_REL_ "GenSigTimeoutTime" BU_SG_REL_ DACU SG_ 794 FLCObject10_LatAcc 120;
BA_REL_ "GenSigFirstTimeoutTime" BU_SG_REL_ DACU SG_ 794 FLCObject10_AnglRightCorner 3000;
BA_REL_ "GenSigTimeoutTime" BU_SG_REL_ DACU SG_ 794 FLCObject10_AnglRightCorner 120;
BA_REL_ "GenSigFirstTimeoutTime" BU_SG_REL_ DACU SG_ 794 FLCObject10_TrackStatus 3000;
BA_REL_ "GenSigTimeoutTime" BU_SG_REL_ DACU SG_ 794 FLCObject10_TrackStatus 120;
BA_REL_ "GenSigFirstTimeoutTime" BU_SG_REL_ DACU SG_ 794 FLCObject10_AnglFarCorner 3000;
BA_REL_ "GenSigTimeoutTime" BU_SG_REL_ DACU SG_ 794 FLCObject10_AnglFarCorner 120;
BA_REL_ "GenSigFirstTimeoutTime" BU_SG_REL_ DACU SG_ 794 FLCObject10_ObjClass 3000;
BA_REL_ "GenSigTimeoutTime" BU_SG_REL_ DACU SG_ 794 FLCObject10_ObjClass 120;
BA_REL_ "GenSigFirstTimeoutTime" BU_SG_REL_ DACU SG_ 794 FLCObject10_CoastIndex 3000;
BA_REL_ "GenSigTimeoutTime" BU_SG_REL_ DACU SG_ 794 FLCObject10_CoastIndex 120;
BA_REL_ "GenSigFirstTimeoutTime" BU_SG_REL_ DACU SG_ 794 FLCObject10_LatPosVar 3000;
BA_REL_ "GenSigTimeoutTime" BU_SG_REL_ DACU SG_ 794 FLCObject10_LatPosVar 120;
BA_REL_ "GenSigFirstTimeoutTime" BU_SG_REL_ DACU SG_ 794 FLCObject10_Height 3000;
BA_REL_ "GenSigTimeoutTime" BU_SG_REL_ DACU SG_ 794 FLCObject10_Height 120;
BA_REL_ "GenSigFirstTimeoutTime" BU_SG_REL_ DACU SG_ 794 FLCObject10_ScaleChange 3000;
BA_REL_ "GenSigTimeoutTime" BU_SG_REL_ DACU SG_ 794 FLCObject10_ScaleChange 120;
BA_REL_ "GenSigFirstTimeoutTime" BU_SG_REL_ DACU SG_ 794 FLCObject10_DistLeftCorner 3000;
BA_REL_ "GenSigTimeoutTime" BU_SG_REL_ DACU SG_ 794 FLCObject10_DistLeftCorner 120;
BA_REL_ "GenSigFirstTimeoutTime" BU_SG_REL_ DACU SG_ 794 FLCObject10_Counter 3000;
BA_REL_ "GenSigTimeoutTime" BU_SG_REL_ DACU SG_ 794 FLCObject10_Counter 120;
BA_REL_ "GenSigFirstTimeoutTime" BU_SG_REL_ DACU SG_ 794 FLCObject10_DistRightCorner 3000;
BA_REL_ "GenSigTimeoutTime" BU_SG_REL_ DACU SG_ 794 FLCObject10_DistRightCorner 120;
BA_REL_ "GenSigFirstTimeoutTime" BU_SG_REL_ DACU SG_ 794 FLCObject10_DstFarVar 3000;
BA_REL_ "GenSigTimeoutTime" BU_SG_REL_ DACU SG_ 794 FLCObject10_DstFarVar 120;
BA_REL_ "GenSigFirstTimeoutTime" BU_SG_REL_ DACU SG_ 794 FLCObject10_DistFarCorner 3000;
BA_REL_ "GenSigTimeoutTime" BU_SG_REL_ DACU SG_ 794 FLCObject10_DistFarCorner 120;
BA_REL_ "GenSigFirstTimeoutTime" BU_SG_REL_ DACU SG_ 794 FLCObject10_AnglLeftCorner 3000;
BA_REL_ "GenSigTimeoutTime" BU_SG_REL_ DACU SG_ 794 FLCObject10_AnglLeftCorner 120;
BA_REL_ "GenSigFirstTimeoutTime" BU_SG_REL_ DACU SG_ 794 FLCObject10_BrakeLight 3000;
BA_REL_ "GenSigTimeoutTime" BU_SG_REL_ DACU SG_ 794 FLCObject10_BrakeLight 120;
BA_REL_ "GenSigFirstTimeoutTime" BU_SG_REL_ DACU SG_ 794 FLCObject10_LatPos 3000;
BA_REL_ "GenSigTimeoutTime" BU_SG_REL_ DACU SG_ 794 FLCObject10_LatPos 120;
BA_REL_ "GenSigFirstTimeoutTime" BU_SG_REL_ DACU SG_ 794 FLCObject10_LatVelVar 3000;
BA_REL_ "GenSigTimeoutTime" BU_SG_REL_ DACU SG_ 794 FLCObject10_LatVelVar 120;
BA_REL_ "GenSigFirstTimeoutTime" BU_SG_REL_ DACU SG_ 794 FLCObject10_LongVelVar 3000;
BA_REL_ "GenSigTimeoutTime" BU_SG_REL_ DACU SG_ 794 FLCObject10_LongVelVar 120;
BA_REL_ "GenSigFirstTimeoutTime" BU_SG_REL_ DACU SG_ 794 FLCObject10_HeadingVar 3000;
BA_REL_ "GenSigTimeoutTime" BU_SG_REL_ DACU SG_ 794 FLCObject10_HeadingVar 120;
BA_REL_ "GenSigFirstTimeoutTime" BU_SG_REL_ DACU SG_ 794 FLCObject10_AngFarVar 3000;
BA_REL_ "GenSigTimeoutTime" BU_SG_REL_ DACU SG_ 794 FLCObject10_AngFarVar 120;
BA_REL_ "GenSigFirstTimeoutTime" BU_SG_REL_ DACU SG_ 794 FLCObject10_Heading 3000;
BA_REL_ "GenSigTimeoutTime" BU_SG_REL_ DACU SG_ 794 FLCObject10_Heading 120;
BA_REL_ "GenSigFirstTimeoutTime" BU_SG_REL_ DACU SG_ 794 FLCObject10_ObjID 3000;
BA_REL_ "GenSigTimeoutTime" BU_SG_REL_ DACU SG_ 794 FLCObject10_ObjID 120;
BA_REL_ "GenSigFirstTimeoutTime" BU_SG_REL_ DACU SG_ 794 FLCObject10_TimeStamp 3000;
BA_REL_ "GenSigTimeoutTime" BU_SG_REL_ DACU SG_ 794 FLCObject10_TimeStamp 120;
BA_REL_ "GenSigFirstTimeoutTime" BU_SG_REL_ DACU SG_ 794 FLCObject10_LongAcc 3000;
BA_REL_ "GenSigTimeoutTime" BU_SG_REL_ DACU SG_ 794 FLCObject10_LongAcc 120;
BA_REL_ "GenSigFirstTimeoutTime" BU_SG_REL_ DACU SG_ 794 FLCObject10_LongVel 3000;
BA_REL_ "GenSigTimeoutTime" BU_SG_REL_ DACU SG_ 794 FLCObject10_LongVel 120;
BA_REL_ "GenSigFirstTimeoutTime" BU_SG_REL_ DACU SG_ 794 FLCObject10_AngLeftVar 3000;
BA_REL_ "GenSigTimeoutTime" BU_SG_REL_ DACU SG_ 794 FLCObject10_AngLeftVar 120;
BA_REL_ "GenSigFirstTimeoutTime" BU_SG_REL_ DACU SG_ 794 FLCObject10_LifeTime 3000;
BA_REL_ "GenSigTimeoutTime" BU_SG_REL_ DACU SG_ 794 FLCObject10_LifeTime 120;
BA_REL_ "GenSigFirstTimeoutTime" BU_SG_REL_ DACU SG_ 794 FLCObject10_LongPosVar 3000;
BA_REL_ "GenSigTimeoutTime" BU_SG_REL_ DACU SG_ 794 FLCObject10_LongPosVar 120;
BA_REL_ "GenSigFirstTimeoutTime" BU_SG_REL_ DACU SG_ 794 FLCObject10_ReliabilityConf 3000;
BA_REL_ "GenSigTimeoutTime" BU_SG_REL_ DACU SG_ 794 FLCObject10_ReliabilityConf 120;
BA_REL_ "GenSigFirstTimeoutTime" BU_SG_REL_ DACU SG_ 794 FLCObject10_TurnIndication 3000;
BA_REL_ "GenSigTimeoutTime" BU_SG_REL_ DACU SG_ 794 FLCObject10_TurnIndication 120;
BA_REL_ "GenSigFirstTimeoutTime" BU_SG_REL_ DACU SG_ 794 FLCObject10_CRC 3000;
BA_REL_ "GenSigTimeoutTime" BU_SG_REL_ DACU SG_ 794 FLCObject10_CRC 120;
BA_REL_ "GenSigFirstTimeoutTime" BU_SG_REL_ DACU SG_ 794 FLCObject10_DstLeftVar 3000;
BA_REL_ "GenSigTimeoutTime" BU_SG_REL_ DACU SG_ 794 FLCObject10_DstLeftVar 120;
BA_REL_ "GenSigFirstTimeoutTime" BU_SG_REL_ DACU SG_ 794 FLCObject10_AngRightVar 3000;
BA_REL_ "GenSigTimeoutTime" BU_SG_REL_ DACU SG_ 794 FLCObject10_AngRightVar 120;
BA_REL_ "GenSigFirstTimeoutTime" BU_SG_REL_ DACU SG_ 794 FLCObject10_TargetToLine 3000;
BA_REL_ "GenSigTimeoutTime" BU_SG_REL_ DACU SG_ 794 FLCObject10_TargetToLine 120;
BA_REL_ "GenSigFirstTimeoutTime" BU_SG_REL_ DACU SG_ 794 FLCObject10_ObjDynClass 3000;
BA_REL_ "GenSigTimeoutTime" BU_SG_REL_ DACU SG_ 794 FLCObject10_ObjDynClass 120;
BA_REL_ "GenSigFirstTimeoutTime" BU_SG_REL_ DACU SG_ 794 FLCObject10_LatVel 3000;
BA_REL_ "GenSigTimeoutTime" BU_SG_REL_ DACU SG_ 794 FLCObject10_LatVel 120;
BA_REL_ "GenSigFirstTimeoutTime" BU_SG_REL_ DACU SG_ 794 FLCObject10_LongPos 3000;
BA_REL_ "GenSigTimeoutTime" BU_SG_REL_ DACU SG_ 794 FLCObject10_LongPos 120;
BA_REL_ "GenSigFirstTimeoutTime" BU_SG_REL_ DACU SG_ 794 FLCObject10_ExistConf 3000;
BA_REL_ "GenSigTimeoutTime" BU_SG_REL_ DACU SG_ 794 FLCObject10_ExistConf 120;
BA_REL_ "GenSigFirstTimeoutTime" BU_SG_REL_ DACU SG_ 794 FLCObject10_DstRightVar 3000;
BA_REL_ "GenSigTimeoutTime" BU_SG_REL_ DACU SG_ 794 FLCObject10_DstRightVar 120;
BA_REL_ "GenSigFirstTimeoutTime" BU_SG_REL_ DACU SG_ 793 FLCObject09_CoastIndex 3000;
BA_REL_ "GenSigTimeoutTime" BU_SG_REL_ DACU SG_ 793 FLCObject09_CoastIndex 120;
BA_REL_ "GenSigFirstTimeoutTime" BU_SG_REL_ DACU SG_ 793 FLCObject09_DstRightVar 3000;
BA_REL_ "GenSigTimeoutTime" BU_SG_REL_ DACU SG_ 793 FLCObject09_DstRightVar 120;
BA_REL_ "GenSigFirstTimeoutTime" BU_SG_REL_ DACU SG_ 793 FLCObject09_LatAcc 3000;
BA_REL_ "GenSigTimeoutTime" BU_SG_REL_ DACU SG_ 793 FLCObject09_LatAcc 120;
BA_REL_ "GenSigFirstTimeoutTime" BU_SG_REL_ DACU SG_ 793 FLCObject09_AngLeftVar 3000;
BA_REL_ "GenSigTimeoutTime" BU_SG_REL_ DACU SG_ 793 FLCObject09_AngLeftVar 120;
BA_REL_ "GenSigFirstTimeoutTime" BU_SG_REL_ DACU SG_ 793 FLCObject09_ExistConf 3000;
BA_REL_ "GenSigTimeoutTime" BU_SG_REL_ DACU SG_ 793 FLCObject09_ExistConf 120;
BA_REL_ "GenSigFirstTimeoutTime" BU_SG_REL_ DACU SG_ 793 FLCObject09_DistFarCorner 3000;
BA_REL_ "GenSigTimeoutTime" BU_SG_REL_ DACU SG_ 793 FLCObject09_DistFarCorner 120;
BA_REL_ "GenSigFirstTimeoutTime" BU_SG_REL_ DACU SG_ 793 FLCObject09_AnglRightCorner 3000;
BA_REL_ "GenSigTimeoutTime" BU_SG_REL_ DACU SG_ 793 FLCObject09_AnglRightCorner 120;
BA_REL_ "GenSigFirstTimeoutTime" BU_SG_REL_ DACU SG_ 793 FLCObject09_AnglFarCorner 3000;
BA_REL_ "GenSigTimeoutTime" BU_SG_REL_ DACU SG_ 793 FLCObject09_AnglFarCorner 120;
BA_REL_ "GenSigFirstTimeoutTime" BU_SG_REL_ DACU SG_ 793 FLCObject09_HeadingVar 3000;
BA_REL_ "GenSigTimeoutTime" BU_SG_REL_ DACU SG_ 793 FLCObject09_HeadingVar 120;
BA_REL_ "GenSigFirstTimeoutTime" BU_SG_REL_ DACU SG_ 793 FLCObject09_LongPos 3000;
BA_REL_ "GenSigTimeoutTime" BU_SG_REL_ DACU SG_ 793 FLCObject09_LongPos 120;
BA_REL_ "GenSigFirstTimeoutTime" BU_SG_REL_ DACU SG_ 793 FLCObject09_DistRightCorner 3000;
BA_REL_ "GenSigTimeoutTime" BU_SG_REL_ DACU SG_ 793 FLCObject09_DistRightCorner 120;
BA_REL_ "GenSigFirstTimeoutTime" BU_SG_REL_ DACU SG_ 793 FLCObject09_TrackStatus 3000;
BA_REL_ "GenSigTimeoutTime" BU_SG_REL_ DACU SG_ 793 FLCObject09_TrackStatus 120;
BA_REL_ "GenSigFirstTimeoutTime" BU_SG_REL_ DACU SG_ 793 FLCObject09_DstFarVar 3000;
BA_REL_ "GenSigTimeoutTime" BU_SG_REL_ DACU SG_ 793 FLCObject09_DstFarVar 120;
BA_REL_ "GenSigFirstTimeoutTime" BU_SG_REL_ DACU SG_ 793 FLCObject09_LifeTime 3000;
BA_REL_ "GenSigTimeoutTime" BU_SG_REL_ DACU SG_ 793 FLCObject09_LifeTime 120;
BA_REL_ "GenSigFirstTimeoutTime" BU_SG_REL_ DACU SG_ 793 FLCObject09_TimeStamp 3000;
BA_REL_ "GenSigTimeoutTime" BU_SG_REL_ DACU SG_ 793 FLCObject09_TimeStamp 120;
BA_REL_ "GenSigFirstTimeoutTime" BU_SG_REL_ DACU SG_ 793 FLCObject09_DstLeftVar 3000;
BA_REL_ "GenSigTimeoutTime" BU_SG_REL_ DACU SG_ 793 FLCObject09_DstLeftVar 120;
BA_REL_ "GenSigFirstTimeoutTime" BU_SG_REL_ DACU SG_ 793 FLCObject09_LatPos 3000;
BA_REL_ "GenSigTimeoutTime" BU_SG_REL_ DACU SG_ 793 FLCObject09_LatPos 120;
BA_REL_ "GenSigFirstTimeoutTime" BU_SG_REL_ DACU SG_ 793 FLCObject09_CRC 3000;
BA_REL_ "GenSigTimeoutTime" BU_SG_REL_ DACU SG_ 793 FLCObject09_CRC 120;
BA_REL_ "GenSigFirstTimeoutTime" BU_SG_REL_ DACU SG_ 793 FLCObject09_Heading 3000;
BA_REL_ "GenSigTimeoutTime" BU_SG_REL_ DACU SG_ 793 FLCObject09_Heading 120;
BA_REL_ "GenSigFirstTimeoutTime" BU_SG_REL_ DACU SG_ 793 FLCObject09_LongVelVar 3000;
BA_REL_ "GenSigTimeoutTime" BU_SG_REL_ DACU SG_ 793 FLCObject09_LongVelVar 120;
BA_REL_ "GenSigFirstTimeoutTime" BU_SG_REL_ DACU SG_ 793 FLCObject09_AngRightVar 3000;
BA_REL_ "GenSigTimeoutTime" BU_SG_REL_ DACU SG_ 793 FLCObject09_AngRightVar 120;
BA_REL_ "GenSigFirstTimeoutTime" BU_SG_REL_ DACU SG_ 793 FLCObject09_ObjClass 3000;
BA_REL_ "GenSigTimeoutTime" BU_SG_REL_ DACU SG_ 793 FLCObject09_ObjClass 120;
BA_REL_ "GenSigFirstTimeoutTime" BU_SG_REL_ DACU SG_ 793 FLCObject09_LongAcc 3000;
BA_REL_ "GenSigTimeoutTime" BU_SG_REL_ DACU SG_ 793 FLCObject09_LongAcc 120;
BA_REL_ "GenSigFirstTimeoutTime" BU_SG_REL_ DACU SG_ 793 FLCObject09_ScaleChange 3000;
BA_REL_ "GenSigTimeoutTime" BU_SG_REL_ DACU SG_ 793 FLCObject09_ScaleChange 120;
BA_REL_ "GenSigFirstTimeoutTime" BU_SG_REL_ DACU SG_ 793 FLCObject09_LongVel 3000;
BA_REL_ "GenSigTimeoutTime" BU_SG_REL_ DACU SG_ 793 FLCObject09_LongVel 120;
BA_REL_ "GenSigFirstTimeoutTime" BU_SG_REL_ DACU SG_ 793 FLCObject09_LongPosVar 3000;
BA_REL_ "GenSigTimeoutTime" BU_SG_REL_ DACU SG_ 793 FLCObject09_LongPosVar 120;
BA_REL_ "GenSigFirstTimeoutTime" BU_SG_REL_ DACU SG_ 793 FLCObject09_DistLeftCorner 3000;
BA_REL_ "GenSigTimeoutTime" BU_SG_REL_ DACU SG_ 793 FLCObject09_DistLeftCorner 120;
BA_REL_ "GenSigFirstTimeoutTime" BU_SG_REL_ DACU SG_ 793 FLCObject09_ObjID 3000;
BA_REL_ "GenSigTimeoutTime" BU_SG_REL_ DACU SG_ 793 FLCObject09_ObjID 120;
BA_REL_ "GenSigFirstTimeoutTime" BU_SG_REL_ DACU SG_ 793 FLCObject09_LatPosVar 3000;
BA_REL_ "GenSigTimeoutTime" BU_SG_REL_ DACU SG_ 793 FLCObject09_LatPosVar 120;
BA_REL_ "GenSigFirstTimeoutTime" BU_SG_REL_ DACU SG_ 793 FLCObject09_BrakeLight 3000;
BA_REL_ "GenSigTimeoutTime" BU_SG_REL_ DACU SG_ 793 FLCObject09_BrakeLight 120;
BA_REL_ "GenSigFirstTimeoutTime" BU_SG_REL_ DACU SG_ 793 FLCObject09_Counter 3000;
BA_REL_ "GenSigTimeoutTime" BU_SG_REL_ DACU SG_ 793 FLCObject09_Counter 120;
BA_REL_ "GenSigFirstTimeoutTime" BU_SG_REL_ DACU SG_ 793 FLCObject09_Height 3000;
BA_REL_ "GenSigTimeoutTime" BU_SG_REL_ DACU SG_ 793 FLCObject09_Height 120;
BA_REL_ "GenSigFirstTimeoutTime" BU_SG_REL_ DACU SG_ 793 FLCObject09_TargetToLine 3000;
BA_REL_ "GenSigTimeoutTime" BU_SG_REL_ DACU SG_ 793 FLCObject09_TargetToLine 120;
BA_REL_ "GenSigFirstTimeoutTime" BU_SG_REL_ DACU SG_ 793 FLCObject09_ReliabilityConf 3000;
BA_REL_ "GenSigTimeoutTime" BU_SG_REL_ DACU SG_ 793 FLCObject09_ReliabilityConf 120;
BA_REL_ "GenSigFirstTimeoutTime" BU_SG_REL_ DACU SG_ 793 FLCObject09_AngFarVar 3000;
BA_REL_ "GenSigTimeoutTime" BU_SG_REL_ DACU SG_ 793 FLCObject09_AngFarVar 120;
BA_REL_ "GenSigFirstTimeoutTime" BU_SG_REL_ DACU SG_ 793 FLCObject09_LatVelVar 3000;
BA_REL_ "GenSigTimeoutTime" BU_SG_REL_ DACU SG_ 793 FLCObject09_LatVelVar 120;
BA_REL_ "GenSigFirstTimeoutTime" BU_SG_REL_ DACU SG_ 793 FLCObject09_LatVel 3000;
BA_REL_ "GenSigTimeoutTime" BU_SG_REL_ DACU SG_ 793 FLCObject09_LatVel 120;
BA_REL_ "GenSigFirstTimeoutTime" BU_SG_REL_ DACU SG_ 793 FLCObject09_TurnIndication 3000;
BA_REL_ "GenSigTimeoutTime" BU_SG_REL_ DACU SG_ 793 FLCObject09_TurnIndication 120;
BA_REL_ "GenSigFirstTimeoutTime" BU_SG_REL_ DACU SG_ 793 FLCObject09_ObjDynClass 3000;
BA_REL_ "GenSigTimeoutTime" BU_SG_REL_ DACU SG_ 793 FLCObject09_ObjDynClass 120;
BA_REL_ "GenSigFirstTimeoutTime" BU_SG_REL_ DACU SG_ 793 FLCObject09_AnglLeftCorner 3000;
BA_REL_ "GenSigTimeoutTime" BU_SG_REL_ DACU SG_ 793 FLCObject09_AnglLeftCorner 120;
BA_REL_ "GenSigFirstTimeoutTime" BU_SG_REL_ DACU SG_ 792 FLCObject08_LifeTime 3000;
BA_REL_ "GenSigTimeoutTime" BU_SG_REL_ DACU SG_ 792 FLCObject08_LifeTime 120;
BA_REL_ "GenSigFirstTimeoutTime" BU_SG_REL_ DACU SG_ 792 FLCObject08_LatVelVar 3000;
BA_REL_ "GenSigTimeoutTime" BU_SG_REL_ DACU SG_ 792 FLCObject08_LatVelVar 120;
BA_REL_ "GenSigFirstTimeoutTime" BU_SG_REL_ DACU SG_ 792 FLCObject08_AngLeftVar 3000;
BA_REL_ "GenSigTimeoutTime" BU_SG_REL_ DACU SG_ 792 FLCObject08_AngLeftVar 120;
BA_REL_ "GenSigFirstTimeoutTime" BU_SG_REL_ DACU SG_ 792 FLCObject08_LatPos 3000;
BA_REL_ "GenSigTimeoutTime" BU_SG_REL_ DACU SG_ 792 FLCObject08_LatPos 120;
BA_REL_ "GenSigFirstTimeoutTime" BU_SG_REL_ DACU SG_ 792 FLCObject08_AnglRightCorner 3000;
BA_REL_ "GenSigTimeoutTime" BU_SG_REL_ DACU SG_ 792 FLCObject08_AnglRightCorner 120;
BA_REL_ "GenSigFirstTimeoutTime" BU_SG_REL_ DACU SG_ 792 FLCObject08_DistRightCorner 3000;
BA_REL_ "GenSigTimeoutTime" BU_SG_REL_ DACU SG_ 792 FLCObject08_DistRightCorner 120;
BA_REL_ "GenSigFirstTimeoutTime" BU_SG_REL_ DACU SG_ 792 FLCObject08_LongPos 3000;
BA_REL_ "GenSigTimeoutTime" BU_SG_REL_ DACU SG_ 792 FLCObject08_LongPos 120;
BA_REL_ "GenSigFirstTimeoutTime" BU_SG_REL_ DACU SG_ 792 FLCObject08_ObjClass 3000;
BA_REL_ "GenSigTimeoutTime" BU_SG_REL_ DACU SG_ 792 FLCObject08_ObjClass 120;
BA_REL_ "GenSigFirstTimeoutTime" BU_SG_REL_ DACU SG_ 792 FLCObject08_TurnIndication 3000;
BA_REL_ "GenSigTimeoutTime" BU_SG_REL_ DACU SG_ 792 FLCObject08_TurnIndication 120;
BA_REL_ "GenSigFirstTimeoutTime" BU_SG_REL_ DACU SG_ 792 FLCObject08_DstFarVar 3000;
BA_REL_ "GenSigTimeoutTime" BU_SG_REL_ DACU SG_ 792 FLCObject08_DstFarVar 120;
BA_REL_ "GenSigFirstTimeoutTime" BU_SG_REL_ DACU SG_ 792 FLCObject08_TrackStatus 3000;
BA_REL_ "GenSigTimeoutTime" BU_SG_REL_ DACU SG_ 792 FLCObject08_TrackStatus 120;
BA_REL_ "GenSigFirstTimeoutTime" BU_SG_REL_ DACU SG_ 792 FLCObject08_DstRightVar 3000;
BA_REL_ "GenSigTimeoutTime" BU_SG_REL_ DACU SG_ 792 FLCObject08_DstRightVar 120;
BA_REL_ "GenSigFirstTimeoutTime" BU_SG_REL_ DACU SG_ 792 FLCObject08_LatAcc 3000;
BA_REL_ "GenSigTimeoutTime" BU_SG_REL_ DACU SG_ 792 FLCObject08_LatAcc 120;
BA_REL_ "GenSigFirstTimeoutTime" BU_SG_REL_ DACU SG_ 792 FLCObject08_AngRightVar 3000;
BA_REL_ "GenSigTimeoutTime" BU_SG_REL_ DACU SG_ 792 FLCObject08_AngRightVar 120;
BA_REL_ "GenSigFirstTimeoutTime" BU_SG_REL_ DACU SG_ 792 FLCObject08_ScaleChange 3000;
BA_REL_ "GenSigTimeoutTime" BU_SG_REL_ DACU SG_ 792 FLCObject08_ScaleChange 120;
BA_REL_ "GenSigFirstTimeoutTime" BU_SG_REL_ DACU SG_ 792 FLCObject08_ObjDynClass 3000;
BA_REL_ "GenSigTimeoutTime" BU_SG_REL_ DACU SG_ 792 FLCObject08_ObjDynClass 120;
BA_REL_ "GenSigFirstTimeoutTime" BU_SG_REL_ DACU SG_ 792 FLCObject08_BrakeLight 3000;
BA_REL_ "GenSigTimeoutTime" BU_SG_REL_ DACU SG_ 792 FLCObject08_BrakeLight 120;
BA_REL_ "GenSigFirstTimeoutTime" BU_SG_REL_ DACU SG_ 792 FLCObject08_Counter 3000;
BA_REL_ "GenSigTimeoutTime" BU_SG_REL_ DACU SG_ 792 FLCObject08_Counter 120;
BA_REL_ "GenSigFirstTimeoutTime" BU_SG_REL_ DACU SG_ 792 FLCObject08_TargetToLine 3000;
BA_REL_ "GenSigTimeoutTime" BU_SG_REL_ DACU SG_ 792 FLCObject08_TargetToLine 120;
BA_REL_ "GenSigFirstTimeoutTime" BU_SG_REL_ DACU SG_ 792 FLCObject08_DstLeftVar 3000;
BA_REL_ "GenSigTimeoutTime" BU_SG_REL_ DACU SG_ 792 FLCObject08_DstLeftVar 120;
BA_REL_ "GenSigFirstTimeoutTime" BU_SG_REL_ DACU SG_ 792 FLCObject08_ReliabilityConf 3000;
BA_REL_ "GenSigTimeoutTime" BU_SG_REL_ DACU SG_ 792 FLCObject08_ReliabilityConf 120;
BA_REL_ "GenSigFirstTimeoutTime" BU_SG_REL_ DACU SG_ 792 FLCObject08_ObjID 3000;
BA_REL_ "GenSigTimeoutTime" BU_SG_REL_ DACU SG_ 792 FLCObject08_ObjID 120;
BA_REL_ "GenSigFirstTimeoutTime" BU_SG_REL_ DACU SG_ 792 FLCObject08_AngFarVar 3000;
BA_REL_ "GenSigTimeoutTime" BU_SG_REL_ DACU SG_ 792 FLCObject08_AngFarVar 120;
BA_REL_ "GenSigFirstTimeoutTime" BU_SG_REL_ DACU SG_ 792 FLCObject08_HeadingVar 3000;
BA_REL_ "GenSigTimeoutTime" BU_SG_REL_ DACU SG_ 792 FLCObject08_HeadingVar 120;
BA_REL_ "GenSigFirstTimeoutTime" BU_SG_REL_ DACU SG_ 792 FLCObject08_LongVel 3000;
BA_REL_ "GenSigTimeoutTime" BU_SG_REL_ DACU SG_ 792 FLCObject08_LongVel 120;
BA_REL_ "GenSigFirstTimeoutTime" BU_SG_REL_ DACU SG_ 792 FLCObject08_CRC 3000;
BA_REL_ "GenSigTimeoutTime" BU_SG_REL_ DACU SG_ 792 FLCObject08_CRC 120;
BA_REL_ "GenSigFirstTimeoutTime" BU_SG_REL_ DACU SG_ 792 FLCObject08_LongPosVar 3000;
BA_REL_ "GenSigTimeoutTime" BU_SG_REL_ DACU SG_ 792 FLCObject08_LongPosVar 120;
BA_REL_ "GenSigFirstTimeoutTime" BU_SG_REL_ DACU SG_ 792 FLCObject08_AnglFarCorner 3000;
BA_REL_ "GenSigTimeoutTime" BU_SG_REL_ DACU SG_ 792 FLCObject08_AnglFarCorner 120;
BA_REL_ "GenSigFirstTimeoutTime" BU_SG_REL_ DACU SG_ 792 FLCObject08_LatPosVar 3000;
BA_REL_ "GenSigTimeoutTime" BU_SG_REL_ DACU SG_ 792 FLCObject08_LatPosVar 120;
BA_REL_ "GenSigFirstTimeoutTime" BU_SG_REL_ DACU SG_ 792 FLCObject08_CoastIndex 3000;
BA_REL_ "GenSigTimeoutTime" BU_SG_REL_ DACU SG_ 792 FLCObject08_CoastIndex 120;
BA_REL_ "GenSigFirstTimeoutTime" BU_SG_REL_ DACU SG_ 792 FLCObject08_TimeStamp 3000;
BA_REL_ "GenSigTimeoutTime" BU_SG_REL_ DACU SG_ 792 FLCObject08_TimeStamp 120;
BA_REL_ "GenSigFirstTimeoutTime" BU_SG_REL_ DACU SG_ 792 FLCObject08_DistFarCorner 3000;
BA_REL_ "GenSigTimeoutTime" BU_SG_REL_ DACU SG_ 792 FLCObject08_DistFarCorner 120;
BA_REL_ "GenSigFirstTimeoutTime" BU_SG_REL_ DACU SG_ 792 FLCObject08_ExistConf 3000;
BA_REL_ "GenSigTimeoutTime" BU_SG_REL_ DACU SG_ 792 FLCObject08_ExistConf 120;
BA_REL_ "GenSigFirstTimeoutTime" BU_SG_REL_ DACU SG_ 792 FLCObject08_Heading 3000;
BA_REL_ "GenSigTimeoutTime" BU_SG_REL_ DACU SG_ 792 FLCObject08_Heading 120;
BA_REL_ "GenSigFirstTimeoutTime" BU_SG_REL_ DACU SG_ 792 FLCObject08_Height 3000;
BA_REL_ "GenSigTimeoutTime" BU_SG_REL_ DACU SG_ 792 FLCObject08_Height 120;
BA_REL_ "GenSigFirstTimeoutTime" BU_SG_REL_ DACU SG_ 792 FLCObject08_AnglLeftCorner 3000;
BA_REL_ "GenSigTimeoutTime" BU_SG_REL_ DACU SG_ 792 FLCObject08_AnglLeftCorner 120;
BA_REL_ "GenSigFirstTimeoutTime" BU_SG_REL_ DACU SG_ 792 FLCObject08_LatVel 3000;
BA_REL_ "GenSigTimeoutTime" BU_SG_REL_ DACU SG_ 792 FLCObject08_LatVel 120;
BA_REL_ "GenSigFirstTimeoutTime" BU_SG_REL_ DACU SG_ 792 FLCObject08_DistLeftCorner 3000;
BA_REL_ "GenSigTimeoutTime" BU_SG_REL_ DACU SG_ 792 FLCObject08_DistLeftCorner 120;
BA_REL_ "GenSigFirstTimeoutTime" BU_SG_REL_ DACU SG_ 792 FLCObject08_LongAcc 3000;
BA_REL_ "GenSigTimeoutTime" BU_SG_REL_ DACU SG_ 792 FLCObject08_LongAcc 120;
BA_REL_ "GenSigFirstTimeoutTime" BU_SG_REL_ DACU SG_ 792 FLCObject08_LongVelVar 3000;
BA_REL_ "GenSigTimeoutTime" BU_SG_REL_ DACU SG_ 792 FLCObject08_LongVelVar 120;
BA_REL_ "GenSigFirstTimeoutTime" BU_SG_REL_ DACU SG_ 791 FLCObject07_Counter 3000;
BA_REL_ "GenSigTimeoutTime" BU_SG_REL_ DACU SG_ 791 FLCObject07_Counter 120;
BA_REL_ "GenSigFirstTimeoutTime" BU_SG_REL_ DACU SG_ 791 FLCObject07_TargetToLine 3000;
BA_REL_ "GenSigTimeoutTime" BU_SG_REL_ DACU SG_ 791 FLCObject07_TargetToLine 120;
BA_REL_ "GenSigFirstTimeoutTime" BU_SG_REL_ DACU SG_ 791 FLCObject07_LongPosVar 3000;
BA_REL_ "GenSigTimeoutTime" BU_SG_REL_ DACU SG_ 791 FLCObject07_LongPosVar 120;
BA_REL_ "GenSigFirstTimeoutTime" BU_SG_REL_ DACU SG_ 791 FLCObject07_DistFarCorner 3000;
BA_REL_ "GenSigTimeoutTime" BU_SG_REL_ DACU SG_ 791 FLCObject07_DistFarCorner 120;
BA_REL_ "GenSigFirstTimeoutTime" BU_SG_REL_ DACU SG_ 791 FLCObject07_AngLeftVar 3000;
BA_REL_ "GenSigTimeoutTime" BU_SG_REL_ DACU SG_ 791 FLCObject07_AngLeftVar 120;
BA_REL_ "GenSigFirstTimeoutTime" BU_SG_REL_ DACU SG_ 791 FLCObject07_AngRightVar 3000;
BA_REL_ "GenSigTimeoutTime" BU_SG_REL_ DACU SG_ 791 FLCObject07_AngRightVar 120;
BA_REL_ "GenSigFirstTimeoutTime" BU_SG_REL_ DACU SG_ 791 FLCObject07_LatVel 3000;
BA_REL_ "GenSigTimeoutTime" BU_SG_REL_ DACU SG_ 791 FLCObject07_LatVel 120;
BA_REL_ "GenSigFirstTimeoutTime" BU_SG_REL_ DACU SG_ 791 FLCObject07_HeadingVar 3000;
BA_REL_ "GenSigTimeoutTime" BU_SG_REL_ DACU SG_ 791 FLCObject07_HeadingVar 120;
BA_REL_ "GenSigFirstTimeoutTime" BU_SG_REL_ DACU SG_ 791 FLCObject07_TurnIndication 3000;
BA_REL_ "GenSigTimeoutTime" BU_SG_REL_ DACU SG_ 791 FLCObject07_TurnIndication 120;
BA_REL_ "GenSigFirstTimeoutTime" BU_SG_REL_ DACU SG_ 791 FLCObject07_LatVelVar 3000;
BA_REL_ "GenSigTimeoutTime" BU_SG_REL_ DACU SG_ 791 FLCObject07_LatVelVar 120;
BA_REL_ "GenSigFirstTimeoutTime" BU_SG_REL_ DACU SG_ 791 FLCObject07_CoastIndex 3000;
BA_REL_ "GenSigTimeoutTime" BU_SG_REL_ DACU SG_ 791 FLCObject07_CoastIndex 120;
BA_REL_ "GenSigFirstTimeoutTime" BU_SG_REL_ DACU SG_ 791 FLCObject07_ObjClass 3000;
BA_REL_ "GenSigTimeoutTime" BU_SG_REL_ DACU SG_ 791 FLCObject07_ObjClass 120;
BA_REL_ "GenSigFirstTimeoutTime" BU_SG_REL_ DACU SG_ 791 FLCObject07_LatAcc 3000;
BA_REL_ "GenSigTimeoutTime" BU_SG_REL_ DACU SG_ 791 FLCObject07_LatAcc 120;
BA_REL_ "GenSigFirstTimeoutTime" BU_SG_REL_ DACU SG_ 791 FLCObject07_DstRightVar 3000;
BA_REL_ "GenSigTimeoutTime" BU_SG_REL_ DACU SG_ 791 FLCObject07_DstRightVar 120;
BA_REL_ "GenSigFirstTimeoutTime" BU_SG_REL_ DACU SG_ 791 FLCObject07_LongVel 3000;
BA_REL_ "GenSigTimeoutTime" BU_SG_REL_ DACU SG_ 791 FLCObject07_LongVel 120;
BA_REL_ "GenSigFirstTimeoutTime" BU_SG_REL_ DACU SG_ 791 FLCObject07_AnglRightCorner 3000;
BA_REL_ "GenSigTimeoutTime" BU_SG_REL_ DACU SG_ 791 FLCObject07_AnglRightCorner 120;
BA_REL_ "GenSigFirstTimeoutTime" BU_SG_REL_ DACU SG_ 791 FLCObject07_ObjDynClass 3000;
BA_REL_ "GenSigTimeoutTime" BU_SG_REL_ DACU SG_ 791 FLCObject07_ObjDynClass 120;
BA_REL_ "GenSigFirstTimeoutTime" BU_SG_REL_ DACU SG_ 791 FLCObject07_AnglLeftCorner 3000;
BA_REL_ "GenSigTimeoutTime" BU_SG_REL_ DACU SG_ 791 FLCObject07_AnglLeftCorner 120;
BA_REL_ "GenSigFirstTimeoutTime" BU_SG_REL_ DACU SG_ 791 FLCObject07_Heading 3000;
BA_REL_ "GenSigTimeoutTime" BU_SG_REL_ DACU SG_ 791 FLCObject07_Heading 120;
BA_REL_ "GenSigFirstTimeoutTime" BU_SG_REL_ DACU SG_ 791 FLCObject07_ExistConf 3000;
BA_REL_ "GenSigTimeoutTime" BU_SG_REL_ DACU SG_ 791 FLCObject07_ExistConf 120;
BA_REL_ "GenSigFirstTimeoutTime" BU_SG_REL_ DACU SG_ 791 FLCObject07_TimeStamp 3000;
BA_REL_ "GenSigTimeoutTime" BU_SG_REL_ DACU SG_ 791 FLCObject07_TimeStamp 120;
BA_REL_ "GenSigFirstTimeoutTime" BU_SG_REL_ DACU SG_ 791 FLCObject07_DstLeftVar 3000;
BA_REL_ "GenSigTimeoutTime" BU_SG_REL_ DACU SG_ 791 FLCObject07_DstLeftVar 120;
BA_REL_ "GenSigFirstTimeoutTime" BU_SG_REL_ DACU SG_ 791 FLCObject07_DstFarVar 3000;
BA_REL_ "GenSigTimeoutTime" BU_SG_REL_ DACU SG_ 791 FLCObject07_DstFarVar 120;
BA_REL_ "GenSigFirstTimeoutTime" BU_SG_REL_ DACU SG_ 791 FLCObject07_Height 3000;
BA_REL_ "GenSigTimeoutTime" BU_SG_REL_ DACU SG_ 791 FLCObject07_Height 120;
BA_REL_ "GenSigFirstTimeoutTime" BU_SG_REL_ DACU SG_ 791 FLCObject07_DistRightCorner 3000;
BA_REL_ "GenSigTimeoutTime" BU_SG_REL_ DACU SG_ 791 FLCObject07_DistRightCorner 120;
BA_REL_ "GenSigFirstTimeoutTime" BU_SG_REL_ DACU SG_ 791 FLCObject07_ReliabilityConf 3000;
BA_REL_ "GenSigTimeoutTime" BU_SG_REL_ DACU SG_ 791 FLCObject07_ReliabilityConf 120;
BA_REL_ "GenSigFirstTimeoutTime" BU_SG_REL_ DACU SG_ 791 FLCObject07_LongPos 3000;
BA_REL_ "GenSigTimeoutTime" BU_SG_REL_ DACU SG_ 791 FLCObject07_LongPos 120;
BA_REL_ "GenSigFirstTimeoutTime" BU_SG_REL_ DACU SG_ 791 FLCObject07_LatPosVar 3000;
BA_REL_ "GenSigTimeoutTime" BU_SG_REL_ DACU SG_ 791 FLCObject07_LatPosVar 120;
BA_REL_ "GenSigFirstTimeoutTime" BU_SG_REL_ DACU SG_ 791 FLCObject07_AnglFarCorner 3000;
BA_REL_ "GenSigTimeoutTime" BU_SG_REL_ DACU SG_ 791 FLCObject07_AnglFarCorner 120;
BA_REL_ "GenSigFirstTimeoutTime" BU_SG_REL_ DACU SG_ 791 FLCObject07_ObjID 3000;
BA_REL_ "GenSigTimeoutTime" BU_SG_REL_ DACU SG_ 791 FLCObject07_ObjID 120;
BA_REL_ "GenSigFirstTimeoutTime" BU_SG_REL_ DACU SG_ 791 FLCObject07_ScaleChange 3000;
BA_REL_ "GenSigTimeoutTime" BU_SG_REL_ DACU SG_ 791 FLCObject07_ScaleChange 120;
BA_REL_ "GenSigFirstTimeoutTime" BU_SG_REL_ DACU SG_ 791 FLCObject07_AngFarVar 3000;
BA_REL_ "GenSigTimeoutTime" BU_SG_REL_ DACU SG_ 791 FLCObject07_AngFarVar 120;
BA_REL_ "GenSigFirstTimeoutTime" BU_SG_REL_ DACU SG_ 791 FLCObject07_LatPos 3000;
BA_REL_ "GenSigTimeoutTime" BU_SG_REL_ DACU SG_ 791 FLCObject07_LatPos 120;
BA_REL_ "GenSigFirstTimeoutTime" BU_SG_REL_ DACU SG_ 791 FLCObject07_TrackStatus 3000;
BA_REL_ "GenSigTimeoutTime" BU_SG_REL_ DACU SG_ 791 FLCObject07_TrackStatus 120;
BA_REL_ "GenSigFirstTimeoutTime" BU_SG_REL_ DACU SG_ 791 FLCObject07_LongVelVar 3000;
BA_REL_ "GenSigTimeoutTime" BU_SG_REL_ DACU SG_ 791 FLCObject07_LongVelVar 120;
BA_REL_ "GenSigFirstTimeoutTime" BU_SG_REL_ DACU SG_ 791 FLCObject07_DistLeftCorner 3000;
BA_REL_ "GenSigTimeoutTime" BU_SG_REL_ DACU SG_ 791 FLCObject07_DistLeftCorner 120;
BA_REL_ "GenSigFirstTimeoutTime" BU_SG_REL_ DACU SG_ 791 FLCObject07_CRC 3000;
BA_REL_ "GenSigTimeoutTime" BU_SG_REL_ DACU SG_ 791 FLCObject07_CRC 120;
BA_REL_ "GenSigFirstTimeoutTime" BU_SG_REL_ DACU SG_ 791 FLCObject07_LongAcc 3000;
BA_REL_ "GenSigTimeoutTime" BU_SG_REL_ DACU SG_ 791 FLCObject07_LongAcc 120;
BA_REL_ "GenSigFirstTimeoutTime" BU_SG_REL_ DACU SG_ 791 FLCObject07_LifeTime 3000;
BA_REL_ "GenSigTimeoutTime" BU_SG_REL_ DACU SG_ 791 FLCObject07_LifeTime 120;
BA_REL_ "GenSigFirstTimeoutTime" BU_SG_REL_ DACU SG_ 791 FLCObject07_BrakeLight 3000;
BA_REL_ "GenSigTimeoutTime" BU_SG_REL_ DACU SG_ 791 FLCObject07_BrakeLight 120;
BA_REL_ "GenSigFirstTimeoutTime" BU_SG_REL_ DACU SG_ 790 FLCObject06_LatPosVar 3000;
BA_REL_ "GenSigTimeoutTime" BU_SG_REL_ DACU SG_ 790 FLCObject06_LatPosVar 120;
BA_REL_ "GenSigFirstTimeoutTime" BU_SG_REL_ DACU SG_ 790 FLCObject06_CoastIndex 3000;
BA_REL_ "GenSigTimeoutTime" BU_SG_REL_ DACU SG_ 790 FLCObject06_CoastIndex 120;
BA_REL_ "GenSigFirstTimeoutTime" BU_SG_REL_ DACU SG_ 790 FLCObject06_LifeTime 3000;
BA_REL_ "GenSigTimeoutTime" BU_SG_REL_ DACU SG_ 790 FLCObject06_LifeTime 120;
BA_REL_ "GenSigFirstTimeoutTime" BU_SG_REL_ DACU SG_ 790 FLCObject06_DistLeftCorner 3000;
BA_REL_ "GenSigTimeoutTime" BU_SG_REL_ DACU SG_ 790 FLCObject06_DistLeftCorner 120;
BA_REL_ "GenSigFirstTimeoutTime" BU_SG_REL_ DACU SG_ 790 FLCObject06_LongAcc 3000;
BA_REL_ "GenSigTimeoutTime" BU_SG_REL_ DACU SG_ 790 FLCObject06_LongAcc 120;
BA_REL_ "GenSigFirstTimeoutTime" BU_SG_REL_ DACU SG_ 790 FLCObject06_ObjClass 3000;
BA_REL_ "GenSigTimeoutTime" BU_SG_REL_ DACU SG_ 790 FLCObject06_ObjClass 120;
BA_REL_ "GenSigFirstTimeoutTime" BU_SG_REL_ DACU SG_ 790 FLCObject06_ObjID 3000;
BA_REL_ "GenSigTimeoutTime" BU_SG_REL_ DACU SG_ 790 FLCObject06_ObjID 120;
BA_REL_ "GenSigFirstTimeoutTime" BU_SG_REL_ DACU SG_ 790 FLCObject06_LongPosVar 3000;
BA_REL_ "GenSigTimeoutTime" BU_SG_REL_ DACU SG_ 790 FLCObject06_LongPosVar 120;
BA_REL_ "GenSigFirstTimeoutTime" BU_SG_REL_ DACU SG_ 790 FLCObject06_TrackStatus 3000;
BA_REL_ "GenSigTimeoutTime" BU_SG_REL_ DACU SG_ 790 FLCObject06_TrackStatus 120;
BA_REL_ "GenSigFirstTimeoutTime" BU_SG_REL_ DACU SG_ 790 FLCObject06_AngFarVar 3000;
BA_REL_ "GenSigTimeoutTime" BU_SG_REL_ DACU SG_ 790 FLCObject06_AngFarVar 120;
BA_REL_ "GenSigFirstTimeoutTime" BU_SG_REL_ DACU SG_ 790 FLCObject06_DstLeftVar 3000;
BA_REL_ "GenSigTimeoutTime" BU_SG_REL_ DACU SG_ 790 FLCObject06_DstLeftVar 120;
BA_REL_ "GenSigFirstTimeoutTime" BU_SG_REL_ DACU SG_ 790 FLCObject06_LongVelVar 3000;
BA_REL_ "GenSigTimeoutTime" BU_SG_REL_ DACU SG_ 790 FLCObject06_LongVelVar 120;
BA_REL_ "GenSigFirstTimeoutTime" BU_SG_REL_ DACU SG_ 790 FLCObject06_BrakeLight 3000;
BA_REL_ "GenSigTimeoutTime" BU_SG_REL_ DACU SG_ 790 FLCObject06_BrakeLight 120;
BA_REL_ "GenSigFirstTimeoutTime" BU_SG_REL_ DACU SG_ 790 FLCObject06_HeadingVar 3000;
BA_REL_ "GenSigTimeoutTime" BU_SG_REL_ DACU SG_ 790 FLCObject06_HeadingVar 120;
BA_REL_ "GenSigFirstTimeoutTime" BU_SG_REL_ DACU SG_ 790 FLCObject06_TimeStamp 3000;
BA_REL_ "GenSigTimeoutTime" BU_SG_REL_ DACU SG_ 790 FLCObject06_TimeStamp 120;
BA_REL_ "GenSigFirstTimeoutTime" BU_SG_REL_ DACU SG_ 790 FLCObject06_ExistConf 3000;
BA_REL_ "GenSigTimeoutTime" BU_SG_REL_ DACU SG_ 790 FLCObject06_ExistConf 120;
BA_REL_ "GenSigFirstTimeoutTime" BU_SG_REL_ DACU SG_ 790 FLCObject06_CRC 3000;
BA_REL_ "GenSigTimeoutTime" BU_SG_REL_ DACU SG_ 790 FLCObject06_CRC 120;
BA_REL_ "GenSigFirstTimeoutTime" BU_SG_REL_ DACU SG_ 790 FLCObject06_DistFarCorner 3000;
BA_REL_ "GenSigTimeoutTime" BU_SG_REL_ DACU SG_ 790 FLCObject06_DistFarCorner 120;
BA_REL_ "GenSigFirstTimeoutTime" BU_SG_REL_ DACU SG_ 790 FLCObject06_LongPos 3000;
BA_REL_ "GenSigTimeoutTime" BU_SG_REL_ DACU SG_ 790 FLCObject06_LongPos 120;
BA_REL_ "GenSigFirstTimeoutTime" BU_SG_REL_ DACU SG_ 790 FLCObject06_AnglFarCorner 3000;
BA_REL_ "GenSigTimeoutTime" BU_SG_REL_ DACU SG_ 790 FLCObject06_AnglFarCorner 120;
BA_REL_ "GenSigFirstTimeoutTime" BU_SG_REL_ DACU SG_ 790 FLCObject06_LatVelVar 3000;
BA_REL_ "GenSigTimeoutTime" BU_SG_REL_ DACU SG_ 790 FLCObject06_LatVelVar 120;
BA_REL_ "GenSigFirstTimeoutTime" BU_SG_REL_ DACU SG_ 790 FLCObject06_DstRightVar 3000;
BA_REL_ "GenSigTimeoutTime" BU_SG_REL_ DACU SG_ 790 FLCObject06_DstRightVar 120;
BA_REL_ "GenSigFirstTimeoutTime" BU_SG_REL_ DACU SG_ 790 FLCObject06_AngLeftVar 3000;
BA_REL_ "GenSigTimeoutTime" BU_SG_REL_ DACU SG_ 790 FLCObject06_AngLeftVar 120;
BA_REL_ "GenSigFirstTimeoutTime" BU_SG_REL_ DACU SG_ 790 FLCObject06_TurnIndication 3000;
BA_REL_ "GenSigTimeoutTime" BU_SG_REL_ DACU SG_ 790 FLCObject06_TurnIndication 120;
BA_REL_ "GenSigFirstTimeoutTime" BU_SG_REL_ DACU SG_ 790 FLCObject06_LongVel 3000;
BA_REL_ "GenSigTimeoutTime" BU_SG_REL_ DACU SG_ 790 FLCObject06_LongVel 120;
BA_REL_ "GenSigFirstTimeoutTime" BU_SG_REL_ DACU SG_ 790 FLCObject06_AnglLeftCorner 3000;
BA_REL_ "GenSigTimeoutTime" BU_SG_REL_ DACU SG_ 790 FLCObject06_AnglLeftCorner 120;
BA_REL_ "GenSigFirstTimeoutTime" BU_SG_REL_ DACU SG_ 790 FLCObject06_Height 3000;
BA_REL_ "GenSigTimeoutTime" BU_SG_REL_ DACU SG_ 790 FLCObject06_Height 120;
BA_REL_ "GenSigFirstTimeoutTime" BU_SG_REL_ DACU SG_ 790 FLCObject06_LatPos 3000;
BA_REL_ "GenSigTimeoutTime" BU_SG_REL_ DACU SG_ 790 FLCObject06_LatPos 120;
BA_REL_ "GenSigFirstTimeoutTime" BU_SG_REL_ DACU SG_ 790 FLCObject06_AngRightVar 3000;
BA_REL_ "GenSigTimeoutTime" BU_SG_REL_ DACU SG_ 790 FLCObject06_AngRightVar 120;
BA_REL_ "GenSigFirstTimeoutTime" BU_SG_REL_ DACU SG_ 790 FLCObject06_TargetToLine 3000;
BA_REL_ "GenSigTimeoutTime" BU_SG_REL_ DACU SG_ 790 FLCObject06_TargetToLine 120;
BA_REL_ "GenSigFirstTimeoutTime" BU_SG_REL_ DACU SG_ 790 FLCObject06_LatAcc 3000;
BA_REL_ "GenSigTimeoutTime" BU_SG_REL_ DACU SG_ 790 FLCObject06_LatAcc 120;
BA_REL_ "GenSigFirstTimeoutTime" BU_SG_REL_ DACU SG_ 790 FLCObject06_ReliabilityConf 3000;
BA_REL_ "GenSigTimeoutTime" BU_SG_REL_ DACU SG_ 790 FLCObject06_ReliabilityConf 120;
BA_REL_ "GenSigFirstTimeoutTime" BU_SG_REL_ DACU SG_ 790 FLCObject06_Counter 3000;
BA_REL_ "GenSigTimeoutTime" BU_SG_REL_ DACU SG_ 790 FLCObject06_Counter 120;
BA_REL_ "GenSigFirstTimeoutTime" BU_SG_REL_ DACU SG_ 790 FLCObject06_Heading 3000;
BA_REL_ "GenSigTimeoutTime" BU_SG_REL_ DACU SG_ 790 FLCObject06_Heading 120;
BA_REL_ "GenSigFirstTimeoutTime" BU_SG_REL_ DACU SG_ 790 FLCObject06_ScaleChange 3000;
BA_REL_ "GenSigTimeoutTime" BU_SG_REL_ DACU SG_ 790 FLCObject06_ScaleChange 120;
BA_REL_ "GenSigFirstTimeoutTime" BU_SG_REL_ DACU SG_ 790 FLCObject06_DstFarVar 3000;
BA_REL_ "GenSigTimeoutTime" BU_SG_REL_ DACU SG_ 790 FLCObject06_DstFarVar 120;
BA_REL_ "GenSigFirstTimeoutTime" BU_SG_REL_ DACU SG_ 790 FLCObject06_DistRightCorner 3000;
BA_REL_ "GenSigTimeoutTime" BU_SG_REL_ DACU SG_ 790 FLCObject06_DistRightCorner 120;
BA_REL_ "GenSigFirstTimeoutTime" BU_SG_REL_ DACU SG_ 790 FLCObject06_AnglRightCorner 3000;
BA_REL_ "GenSigTimeoutTime" BU_SG_REL_ DACU SG_ 790 FLCObject06_AnglRightCorner 120;
BA_REL_ "GenSigFirstTimeoutTime" BU_SG_REL_ DACU SG_ 790 FLCObject06_LatVel 3000;
BA_REL_ "GenSigTimeoutTime" BU_SG_REL_ DACU SG_ 790 FLCObject06_LatVel 120;
BA_REL_ "GenSigFirstTimeoutTime" BU_SG_REL_ DACU SG_ 790 FLCObject06_ObjDynClass 3000;
BA_REL_ "GenSigTimeoutTime" BU_SG_REL_ DACU SG_ 790 FLCObject06_ObjDynClass 120;
BA_REL_ "GenSigFirstTimeoutTime" BU_SG_REL_ DACU SG_ 789 FLCObject05_LongVelVar 3000;
BA_REL_ "GenSigTimeoutTime" BU_SG_REL_ DACU SG_ 789 FLCObject05_LongVelVar 120;
BA_REL_ "GenSigFirstTimeoutTime" BU_SG_REL_ DACU SG_ 789 FLCObject05_TurnIndication 3000;
BA_REL_ "GenSigTimeoutTime" BU_SG_REL_ DACU SG_ 789 FLCObject05_TurnIndication 120;
BA_REL_ "GenSigFirstTimeoutTime" BU_SG_REL_ DACU SG_ 789 FLCObject05_BrakeLight 3000;
BA_REL_ "GenSigTimeoutTime" BU_SG_REL_ DACU SG_ 789 FLCObject05_BrakeLight 120;
BA_REL_ "GenSigFirstTimeoutTime" BU_SG_REL_ DACU SG_ 789 FLCObject05_DistRightCorner 3000;
BA_REL_ "GenSigTimeoutTime" BU_SG_REL_ DACU SG_ 789 FLCObject05_DistRightCorner 120;
BA_REL_ "GenSigFirstTimeoutTime" BU_SG_REL_ DACU SG_ 789 FLCObject05_DstFarVar 3000;
BA_REL_ "GenSigTimeoutTime" BU_SG_REL_ DACU SG_ 789 FLCObject05_DstFarVar 120;
BA_REL_ "GenSigFirstTimeoutTime" BU_SG_REL_ DACU SG_ 789 FLCObject05_DstLeftVar 3000;
BA_REL_ "GenSigTimeoutTime" BU_SG_REL_ DACU SG_ 789 FLCObject05_DstLeftVar 120;
BA_REL_ "GenSigFirstTimeoutTime" BU_SG_REL_ DACU SG_ 789 FLCObject05_AngFarVar 3000;
BA_REL_ "GenSigTimeoutTime" BU_SG_REL_ DACU SG_ 789 FLCObject05_AngFarVar 120;
BA_REL_ "GenSigFirstTimeoutTime" BU_SG_REL_ DACU SG_ 789 FLCObject05_AnglFarCorner 3000;
BA_REL_ "GenSigTimeoutTime" BU_SG_REL_ DACU SG_ 789 FLCObject05_AnglFarCorner 120;
BA_REL_ "GenSigFirstTimeoutTime" BU_SG_REL_ DACU SG_ 789 FLCObject05_LongVel 3000;
BA_REL_ "GenSigTimeoutTime" BU_SG_REL_ DACU SG_ 789 FLCObject05_LongVel 120;
BA_REL_ "GenSigFirstTimeoutTime" BU_SG_REL_ DACU SG_ 789 FLCObject05_Counter 3000;
BA_REL_ "GenSigTimeoutTime" BU_SG_REL_ DACU SG_ 789 FLCObject05_Counter 120;
BA_REL_ "GenSigFirstTimeoutTime" BU_SG_REL_ DACU SG_ 789 FLCObject05_LatAcc 3000;
BA_REL_ "GenSigTimeoutTime" BU_SG_REL_ DACU SG_ 789 FLCObject05_LatAcc 120;
BA_REL_ "GenSigFirstTimeoutTime" BU_SG_REL_ DACU SG_ 789 FLCObject05_AnglRightCorner 3000;
BA_REL_ "GenSigTimeoutTime" BU_SG_REL_ DACU SG_ 789 FLCObject05_AnglRightCorner 120;
BA_REL_ "GenSigFirstTimeoutTime" BU_SG_REL_ DACU SG_ 789 FLCObject05_ReliabilityConf 3000;
BA_REL_ "GenSigTimeoutTime" BU_SG_REL_ DACU SG_ 789 FLCObject05_ReliabilityConf 120;
BA_REL_ "GenSigFirstTimeoutTime" BU_SG_REL_ DACU SG_ 789 FLCObject05_Heading 3000;
BA_REL_ "GenSigTimeoutTime" BU_SG_REL_ DACU SG_ 789 FLCObject05_Heading 120;
BA_REL_ "GenSigFirstTimeoutTime" BU_SG_REL_ DACU SG_ 789 FLCObject05_CoastIndex 3000;
BA_REL_ "GenSigTimeoutTime" BU_SG_REL_ DACU SG_ 789 FLCObject05_CoastIndex 120;
BA_REL_ "GenSigFirstTimeoutTime" BU_SG_REL_ DACU SG_ 789 FLCObject05_LongAcc 3000;
BA_REL_ "GenSigTimeoutTime" BU_SG_REL_ DACU SG_ 789 FLCObject05_LongAcc 120;
BA_REL_ "GenSigFirstTimeoutTime" BU_SG_REL_ DACU SG_ 789 FLCObject05_LatVel 3000;
BA_REL_ "GenSigTimeoutTime" BU_SG_REL_ DACU SG_ 789 FLCObject05_LatVel 120;
BA_REL_ "GenSigFirstTimeoutTime" BU_SG_REL_ DACU SG_ 789 FLCObject05_ScaleChange 3000;
BA_REL_ "GenSigTimeoutTime" BU_SG_REL_ DACU SG_ 789 FLCObject05_ScaleChange 120;
BA_REL_ "GenSigFirstTimeoutTime" BU_SG_REL_ DACU SG_ 789 FLCObject05_HeadingVar 3000;
BA_REL_ "GenSigTimeoutTime" BU_SG_REL_ DACU SG_ 789 FLCObject05_HeadingVar 120;
BA_REL_ "GenSigFirstTimeoutTime" BU_SG_REL_ DACU SG_ 789 FLCObject05_LifeTime 3000;
BA_REL_ "GenSigTimeoutTime" BU_SG_REL_ DACU SG_ 789 FLCObject05_LifeTime 120;
BA_REL_ "GenSigFirstTimeoutTime" BU_SG_REL_ DACU SG_ 789 FLCObject05_LongPosVar 3000;
BA_REL_ "GenSigTimeoutTime" BU_SG_REL_ DACU SG_ 789 FLCObject05_LongPosVar 120;
BA_REL_ "GenSigFirstTimeoutTime" BU_SG_REL_ DACU SG_ 789 FLCObject05_DistLeftCorner 3000;
BA_REL_ "GenSigTimeoutTime" BU_SG_REL_ DACU SG_ 789 FLCObject05_DistLeftCorner 120;
BA_REL_ "GenSigFirstTimeoutTime" BU_SG_REL_ DACU SG_ 789 FLCObject05_TrackStatus 3000;
BA_REL_ "GenSigTimeoutTime" BU_SG_REL_ DACU SG_ 789 FLCObject05_TrackStatus 120;
BA_REL_ "GenSigFirstTimeoutTime" BU_SG_REL_ DACU SG_ 789 FLCObject05_LatPosVar 3000;
BA_REL_ "GenSigTimeoutTime" BU_SG_REL_ DACU SG_ 789 FLCObject05_LatPosVar 120;
BA_REL_ "GenSigFirstTimeoutTime" BU_SG_REL_ DACU SG_ 789 FLCObject05_AngLeftVar 3000;
BA_REL_ "GenSigTimeoutTime" BU_SG_REL_ DACU SG_ 789 FLCObject05_AngLeftVar 120;
BA_REL_ "GenSigFirstTimeoutTime" BU_SG_REL_ DACU SG_ 789 FLCObject05_ExistConf 3000;
BA_REL_ "GenSigTimeoutTime" BU_SG_REL_ DACU SG_ 789 FLCObject05_ExistConf 120;
BA_REL_ "GenSigFirstTimeoutTime" BU_SG_REL_ DACU SG_ 789 FLCObject05_DstRightVar 3000;
BA_REL_ "GenSigTimeoutTime" BU_SG_REL_ DACU SG_ 789 FLCObject05_DstRightVar 120;
BA_REL_ "GenSigFirstTimeoutTime" BU_SG_REL_ DACU SG_ 789 FLCObject05_AnglLeftCorner 3000;
BA_REL_ "GenSigTimeoutTime" BU_SG_REL_ DACU SG_ 789 FLCObject05_AnglLeftCorner 120;
BA_REL_ "GenSigFirstTimeoutTime" BU_SG_REL_ DACU SG_ 789 FLCObject05_ObjDynClass 3000;
BA_REL_ "GenSigTimeoutTime" BU_SG_REL_ DACU SG_ 789 FLCObject05_ObjDynClass 120;
BA_REL_ "GenSigFirstTimeoutTime" BU_SG_REL_ DACU SG_ 789 FLCObject05_DistFarCorner 3000;
BA_REL_ "GenSigTimeoutTime" BU_SG_REL_ DACU SG_ 789 FLCObject05_DistFarCorner 120;
BA_REL_ "GenSigFirstTimeoutTime" BU_SG_REL_ DACU SG_ 789 FLCObject05_ObjClass 3000;
BA_REL_ "GenSigTimeoutTime" BU_SG_REL_ DACU SG_ 789 FLCObject05_ObjClass 120;
BA_REL_ "GenSigFirstTimeoutTime" BU_SG_REL_ DACU SG_ 789 FLCObject05_TimeStamp 3000;
BA_REL_ "GenSigTimeoutTime" BU_SG_REL_ DACU SG_ 789 FLCObject05_TimeStamp 120;
BA_REL_ "GenSigFirstTimeoutTime" BU_SG_REL_ DACU SG_ 789 FLCObject05_LatVelVar 3000;
BA_REL_ "GenSigTimeoutTime" BU_SG_REL_ DACU SG_ 789 FLCObject05_LatVelVar 120;
BA_REL_ "GenSigFirstTimeoutTime" BU_SG_REL_ DACU SG_ 789 FLCObject05_LatPos 3000;
BA_REL_ "GenSigTimeoutTime" BU_SG_REL_ DACU SG_ 789 FLCObject05_LatPos 120;
BA_REL_ "GenSigFirstTimeoutTime" BU_SG_REL_ DACU SG_ 789 FLCObject05_LongPos 3000;
BA_REL_ "GenSigTimeoutTime" BU_SG_REL_ DACU SG_ 789 FLCObject05_LongPos 120;
BA_REL_ "GenSigFirstTimeoutTime" BU_SG_REL_ DACU SG_ 789 FLCObject05_TargetToLine 3000;
BA_REL_ "GenSigTimeoutTime" BU_SG_REL_ DACU SG_ 789 FLCObject05_TargetToLine 120;
BA_REL_ "GenSigFirstTimeoutTime" BU_SG_REL_ DACU SG_ 789 FLCObject05_CRC 3000;
BA_REL_ "GenSigTimeoutTime" BU_SG_REL_ DACU SG_ 789 FLCObject05_CRC 120;
BA_REL_ "GenSigFirstTimeoutTime" BU_SG_REL_ DACU SG_ 789 FLCObject05_Height 3000;
BA_REL_ "GenSigTimeoutTime" BU_SG_REL_ DACU SG_ 789 FLCObject05_Height 120;
BA_REL_ "GenSigFirstTimeoutTime" BU_SG_REL_ DACU SG_ 789 FLCObject05_ObjID 3000;
BA_REL_ "GenSigTimeoutTime" BU_SG_REL_ DACU SG_ 789 FLCObject05_ObjID 120;
BA_REL_ "GenSigFirstTimeoutTime" BU_SG_REL_ DACU SG_ 789 FLCObject05_AngRightVar 3000;
BA_REL_ "GenSigTimeoutTime" BU_SG_REL_ DACU SG_ 789 FLCObject05_AngRightVar 120;
VAL_ 797 FLCObject13_BrakeLight 7 "BrakeLight_NotAvailable" 6 "BrakeLight_Error" 5 "BrakeLight_Spare" 4 "BrakeLight_BrakeLightThree" 3 "BrakeLight_BrakeLightTwo" 2 "BrakeLight_BrakeLightOne" 1 "BrakeLight_NoBrakeLight" 0 "BrakeLight_BrakeLightUnknown" ;
VAL_ 797 FLCObject13_ObjDynClass 3 "ObjDynClass_Error" 2 "ObjDynClass_Movable" 1 "ObjDynClass_Stationary" 0 "ObjDynClass_Reserved" ;
VAL_ 797 FLCObject13_TurnIndication 7 "TurnIndication_NotAvailable" 6 "TurnIndication_Error" 5 "TurnIndication_Spare" 4 "TurnIndication_DirectionIndicatorBoth" 3 "TurnIndication_DirectionIndicatorRight" 2 "TurnIndication_DirectionIndicatorLeft" 1 "TurnIndication_NoDirectionIndicator" 0 "TurnIndication_Unknown" ;
VAL_ 797 FLCObject13_TargetToLine 7 "TargetToLine_NotAvailable" 6 "TargetToLine_Error" 5 "TargetToLine_Unknown" 4 "TargetToLine_OnTheLeftEgoLine" 3 "TargetToLine_OnTheRightEgoLine" 2 "TargetToLine_BetweenRightAndLeftEgoLine" 1 "TargetToLine_LeftSideOfTheLeftEgoLine" 0 "TargetToLine_RightSideOfTheRightEgoLine" ;
VAL_ 797 FLCObject13_ObjClass 15 "ObjClassSideS_NotAvailable" 14 "ObjClassSideS_Error" 13 "ObjClassSideS_Spare4" 12 "ObjClassSideS_Spare3" 11 "ObjClassSideS_Motorcycle" 10 "ObjClassSideS_Bicycle" 9 "ObjClassSideS_UnidentifiedMovableObject" 8 "ObjClassSideS_UnidentifiedVRU" 7 "ObjClassSideS_UnidentifiedVehicle" 6 "ObjClassSideS_StaticObject" 5 "ObjClassSideS_Pedestrian" 4 "ObjClassSideS_2Wheeler" 3 "ObjClassSideS_HeavyVehicle" 2 "ObjClassSideS_Car" 1 "ObjClassSideS_Obstacle" 0 "ObjClassSideS_Undetermined" ;
VAL_ 797 FLCObject13_TrackStatus 7 "TrackStatus_NotAvailable" 6 "TrackStatus_Error" 5 "TrackStatus_Spare3" 4 "TrackStatus_Spare2" 3 "TrackStatus_Spare1" 2 "TrackStatus_Invalid" 1 "TrackStatus_Predicted" 0 "TrackStatus_Tracked" ;
VAL_ 797 FLCObject13_ReliabilityConf 7 "ReliabilityConf_NotAvailable" 6 "ReliabilityConf_Error" 5 "ReliabilityConf_Spare2" 4 "ReliabilityConf_Spare1" 3 "ReliabilityConf_Restricted" 2 "ReliabilityConf_ASIL_B" 1 "ReliabilityConf_CNNConfirmed_ObjectShape" 0 "ReliabilityConf_ConfirmedbyGenericStream" ;
VAL_ 796 FLCObject12_BrakeLight 7 "BrakeLight_NotAvailable" 6 "BrakeLight_Error" 5 "BrakeLight_Spare" 4 "BrakeLight_BrakeLightThree" 3 "BrakeLight_BrakeLightTwo" 2 "BrakeLight_BrakeLightOne" 1 "BrakeLight_NoBrakeLight" 0 "BrakeLight_BrakeLightUnknown" ;
VAL_ 796 FLCObject12_ObjDynClass 3 "ObjDynClass_Error" 2 "ObjDynClass_Movable" 1 "ObjDynClass_Stationary" 0 "ObjDynClass_Reserved" ;
VAL_ 796 FLCObject12_TurnIndication 7 "TurnIndication_NotAvailable" 6 "TurnIndication_Error" 5 "TurnIndication_Spare" 4 "TurnIndication_DirectionIndicatorBoth" 3 "TurnIndication_DirectionIndicatorRight" 2 "TurnIndication_DirectionIndicatorLeft" 1 "TurnIndication_NoDirectionIndicator" 0 "TurnIndication_Unknown" ;
VAL_ 796 FLCObject12_TrackStatus 7 "TrackStatus_NotAvailable" 6 "TrackStatus_Error" 5 "TrackStatus_Spare3" 4 "TrackStatus_Spare2" 3 "TrackStatus_Spare1" 2 "TrackStatus_Invalid" 1 "TrackStatus_Predicted" 0 "TrackStatus_Tracked" ;
VAL_ 796 FLCObject12_TargetToLine 7 "TargetToLine_NotAvailable" 6 "TargetToLine_Error" 5 "TargetToLine_Unknown" 4 "TargetToLine_OnTheLeftEgoLine" 3 "TargetToLine_OnTheRightEgoLine" 2 "TargetToLine_BetweenRightAndLeftEgoLine" 1 "TargetToLine_LeftSideOfTheLeftEgoLine" 0 "TargetToLine_RightSideOfTheRightEgoLine" ;
VAL_ 796 FLCObject12_ReliabilityConf 7 "ReliabilityConf_NotAvailable" 6 "ReliabilityConf_Error" 5 "ReliabilityConf_Spare2" 4 "ReliabilityConf_Spare1" 3 "ReliabilityConf_Restricted" 2 "ReliabilityConf_ASIL_B" 1 "ReliabilityConf_CNNConfirmed_ObjectShape" 0 "ReliabilityConf_ConfirmedbyGenericStream" ;
VAL_ 796 FLCObject12_ObjClass 15 "ObjClassSideS_NotAvailable" 14 "ObjClassSideS_Error" 13 "ObjClassSideS_Spare4" 12 "ObjClassSideS_Spare3" 11 "ObjClassSideS_Motorcycle" 10 "ObjClassSideS_Bicycle" 9 "ObjClassSideS_UnidentifiedMovableObject" 8 "ObjClassSideS_UnidentifiedVRU" 7 "ObjClassSideS_UnidentifiedVehicle" 6 "ObjClassSideS_StaticObject" 5 "ObjClassSideS_Pedestrian" 4 "ObjClassSideS_2Wheeler" 3 "ObjClassSideS_HeavyVehicle" 2 "ObjClassSideS_Car" 1 "ObjClassSideS_Obstacle" 0 "ObjClassSideS_Undetermined" ;
VAL_ 795 FLCObject11_ReliabilityConf 7 "ReliabilityConf_NotAvailable" 6 "ReliabilityConf_Error" 5 "ReliabilityConf_Spare2" 4 "ReliabilityConf_Spare1" 3 "ReliabilityConf_Restricted" 2 "ReliabilityConf_ASIL_B" 1 "ReliabilityConf_CNNConfirmed_ObjectShape" 0 "ReliabilityConf_ConfirmedbyGenericStream" ;
VAL_ 795 FLCObject11_TurnIndication 7 "TurnIndication_NotAvailable" 6 "TurnIndication_Error" 5 "TurnIndication_Spare" 4 "TurnIndication_DirectionIndicatorBoth" 3 "TurnIndication_DirectionIndicatorRight" 2 "TurnIndication_DirectionIndicatorLeft" 1 "TurnIndication_NoDirectionIndicator" 0 "TurnIndication_Unknown" ;
VAL_ 795 FLCObject11_ObjClass 15 "ObjClassSideS_NotAvailable" 14 "ObjClassSideS_Error" 13 "ObjClassSideS_Spare4" 12 "ObjClassSideS_Spare3" 11 "ObjClassSideS_Motorcycle" 10 "ObjClassSideS_Bicycle" 9 "ObjClassSideS_UnidentifiedMovableObject" 8 "ObjClassSideS_UnidentifiedVRU" 7 "ObjClassSideS_UnidentifiedVehicle" 6 "ObjClassSideS_StaticObject" 5 "ObjClassSideS_Pedestrian" 4 "ObjClassSideS_2Wheeler" 3 "ObjClassSideS_HeavyVehicle" 2 "ObjClassSideS_Car" 1 "ObjClassSideS_Obstacle" 0 "ObjClassSideS_Undetermined" ;
VAL_ 795 FLCObject11_ObjDynClass 3 "ObjDynClass_Error" 2 "ObjDynClass_Movable" 1 "ObjDynClass_Stationary" 0 "ObjDynClass_Reserved" ;
VAL_ 795 FLCObject11_TrackStatus 7 "TrackStatus_NotAvailable" 6 "TrackStatus_Error" 5 "TrackStatus_Spare3" 4 "TrackStatus_Spare2" 3 "TrackStatus_Spare1" 2 "TrackStatus_Invalid" 1 "TrackStatus_Predicted" 0 "TrackStatus_Tracked" ;
VAL_ 795 FLCObject11_BrakeLight 7 "BrakeLight_NotAvailable" 6 "BrakeLight_Error" 5 "BrakeLight_Spare" 4 "BrakeLight_BrakeLightThree" 3 "BrakeLight_BrakeLightTwo" 2 "BrakeLight_BrakeLightOne" 1 "BrakeLight_NoBrakeLight" 0 "BrakeLight_BrakeLightUnknown" ;
VAL_ 795 FLCObject11_TargetToLine 7 "TargetToLine_NotAvailable" 6 "TargetToLine_Error" 5 "TargetToLine_Unknown" 4 "TargetToLine_OnTheLeftEgoLine" 3 "TargetToLine_OnTheRightEgoLine" 2 "TargetToLine_BetweenRightAndLeftEgoLine" 1 "TargetToLine_LeftSideOfTheLeftEgoLine" 0 "TargetToLine_RightSideOfTheRightEgoLine" ;
VAL_ 794 FLCObject10_TrackStatus 7 "TrackStatus_NotAvailable" 6 "TrackStatus_Error" 5 "TrackStatus_Spare3" 4 "TrackStatus_Spare2" 3 "TrackStatus_Spare1" 2 "TrackStatus_Invalid" 1 "TrackStatus_Predicted" 0 "TrackStatus_Tracked" ;
VAL_ 794 FLCObject10_ObjClass 15 "ObjClassSideS_NotAvailable" 14 "ObjClassSideS_Error" 13 "ObjClassSideS_Spare4" 12 "ObjClassSideS_Spare3" 11 "ObjClassSideS_Motorcycle" 10 "ObjClassSideS_Bicycle" 9 "ObjClassSideS_UnidentifiedMovableObject" 8 "ObjClassSideS_UnidentifiedVRU" 7 "ObjClassSideS_UnidentifiedVehicle" 6 "ObjClassSideS_StaticObject" 5 "ObjClassSideS_Pedestrian" 4 "ObjClassSideS_2Wheeler" 3 "ObjClassSideS_HeavyVehicle" 2 "ObjClassSideS_Car" 1 "ObjClassSideS_Obstacle" 0 "ObjClassSideS_Undetermined" ;
VAL_ 794 FLCObject10_BrakeLight 7 "BrakeLight_NotAvailable" 6 "BrakeLight_Error" 5 "BrakeLight_Spare" 4 "BrakeLight_BrakeLightThree" 3 "BrakeLight_BrakeLightTwo" 2 "BrakeLight_BrakeLightOne" 1 "BrakeLight_NoBrakeLight" 0 "BrakeLight_BrakeLightUnknown" ;
VAL_ 794 FLCObject10_ReliabilityConf 7 "ReliabilityConf_NotAvailable" 6 "ReliabilityConf_Error" 5 "ReliabilityConf_Spare2" 4 "ReliabilityConf_Spare1" 3 "ReliabilityConf_Restricted" 2 "ReliabilityConf_ASIL_B" 1 "ReliabilityConf_CNNConfirmed_ObjectShape" 0 "ReliabilityConf_ConfirmedbyGenericStream" ;
VAL_ 794 FLCObject10_TurnIndication 7 "TurnIndication_NotAvailable" 6 "TurnIndication_Error" 5 "TurnIndication_Spare" 4 "TurnIndication_DirectionIndicatorBoth" 3 "TurnIndication_DirectionIndicatorRight" 2 "TurnIndication_DirectionIndicatorLeft" 1 "TurnIndication_NoDirectionIndicator" 0 "TurnIndication_Unknown" ;
VAL_ 794 FLCObject10_TargetToLine 7 "TargetToLine_NotAvailable" 6 "TargetToLine_Error" 5 "TargetToLine_Unknown" 4 "TargetToLine_OnTheLeftEgoLine" 3 "TargetToLine_OnTheRightEgoLine" 2 "TargetToLine_BetweenRightAndLeftEgoLine" 1 "TargetToLine_LeftSideOfTheLeftEgoLine" 0 "TargetToLine_RightSideOfTheRightEgoLine" ;
VAL_ 794 FLCObject10_ObjDynClass 3 "ObjDynClass_Error" 2 "ObjDynClass_Movable" 1 "ObjDynClass_Stationary" 0 "ObjDynClass_Reserved" ;
VAL_ 793 FLCObject09_TrackStatus 7 "TrackStatus_NotAvailable" 6 "TrackStatus_Error" 5 "TrackStatus_Spare3" 4 "TrackStatus_Spare2" 3 "TrackStatus_Spare1" 2 "TrackStatus_Invalid" 1 "TrackStatus_Predicted" 0 "TrackStatus_Tracked" ;
VAL_ 793 FLCObject09_ObjClass 15 "ObjClassSideS_NotAvailable" 14 "ObjClassSideS_Error" 13 "ObjClassSideS_Spare4" 12 "ObjClassSideS_Spare3" 11 "ObjClassSideS_Motorcycle" 10 "ObjClassSideS_Bicycle" 9 "ObjClassSideS_UnidentifiedMovableObject" 8 "ObjClassSideS_UnidentifiedVRU" 7 "ObjClassSideS_UnidentifiedVehicle" 6 "ObjClassSideS_StaticObject" 5 "ObjClassSideS_Pedestrian" 4 "ObjClassSideS_2Wheeler" 3 "ObjClassSideS_HeavyVehicle" 2 "ObjClassSideS_Car" 1 "ObjClassSideS_Obstacle" 0 "ObjClassSideS_Undetermined" ;
VAL_ 793 FLCObject09_BrakeLight 7 "BrakeLight_NotAvailable" 6 "BrakeLight_Error" 5 "BrakeLight_Spare" 4 "BrakeLight_BrakeLightThree" 3 "BrakeLight_BrakeLightTwo" 2 "BrakeLight_BrakeLightOne" 1 "BrakeLight_NoBrakeLight" 0 "BrakeLight_BrakeLightUnknown" ;
VAL_ 793 FLCObject09_TargetToLine 7 "TargetToLine_NotAvailable" 6 "TargetToLine_Error" 5 "TargetToLine_Unknown" 4 "TargetToLine_OnTheLeftEgoLine" 3 "TargetToLine_OnTheRightEgoLine" 2 "TargetToLine_BetweenRightAndLeftEgoLine" 1 "TargetToLine_LeftSideOfTheLeftEgoLine" 0 "TargetToLine_RightSideOfTheRightEgoLine" ;
VAL_ 793 FLCObject09_ReliabilityConf 7 "ReliabilityConf_NotAvailable" 6 "ReliabilityConf_Error" 5 "ReliabilityConf_Spare2" 4 "ReliabilityConf_Spare1" 3 "ReliabilityConf_Restricted" 2 "ReliabilityConf_ASIL_B" 1 "ReliabilityConf_CNNConfirmed_ObjectShape" 0 "ReliabilityConf_ConfirmedbyGenericStream" ;
VAL_ 793 FLCObject09_TurnIndication 7 "TurnIndication_NotAvailable" 6 "TurnIndication_Error" 5 "TurnIndication_Spare" 4 "TurnIndication_DirectionIndicatorBoth" 3 "TurnIndication_DirectionIndicatorRight" 2 "TurnIndication_DirectionIndicatorLeft" 1 "TurnIndication_NoDirectionIndicator" 0 "TurnIndication_Unknown" ;
VAL_ 793 FLCObject09_ObjDynClass 3 "ObjDynClass_Error" 2 "ObjDynClass_Movable" 1 "ObjDynClass_Stationary" 0 "ObjDynClass_Reserved" ;
VAL_ 792 FLCObject08_ObjClass 15 "ObjClassSideS_NotAvailable" 14 "ObjClassSideS_Error" 13 "ObjClassSideS_Spare4" 12 "ObjClassSideS_Spare3" 11 "ObjClassSideS_Motorcycle" 10 "ObjClassSideS_Bicycle" 9 "ObjClassSideS_UnidentifiedMovableObject" 8 "ObjClassSideS_UnidentifiedVRU" 7 "ObjClassSideS_UnidentifiedVehicle" 6 "ObjClassSideS_StaticObject" 5 "ObjClassSideS_Pedestrian" 4 "ObjClassSideS_2Wheeler" 3 "ObjClassSideS_HeavyVehicle" 2 "ObjClassSideS_Car" 1 "ObjClassSideS_Obstacle" 0 "ObjClassSideS_Undetermined" ;
VAL_ 792 FLCObject08_TurnIndication 7 "TurnIndication_NotAvailable" 6 "TurnIndication_Error" 5 "TurnIndication_Spare" 4 "TurnIndication_DirectionIndicatorBoth" 3 "TurnIndication_DirectionIndicatorRight" 2 "TurnIndication_DirectionIndicatorLeft" 1 "TurnIndication_NoDirectionIndicator" 0 "TurnIndication_Unknown" ;
VAL_ 792 FLCObject08_TrackStatus 7 "TrackStatus_NotAvailable" 6 "TrackStatus_Error" 5 "TrackStatus_Spare3" 4 "TrackStatus_Spare2" 3 "TrackStatus_Spare1" 2 "TrackStatus_Invalid" 1 "TrackStatus_Predicted" 0 "TrackStatus_Tracked" ;
VAL_ 792 FLCObject08_ObjDynClass 3 "ObjDynClass_Error" 2 "ObjDynClass_Movable" 1 "ObjDynClass_Stationary" 0 "ObjDynClass_Reserved" ;
VAL_ 792 FLCObject08_BrakeLight 7 "BrakeLight_NotAvailable" 6 "BrakeLight_Error" 5 "BrakeLight_Spare" 4 "BrakeLight_BrakeLightThree" 3 "BrakeLight_BrakeLightTwo" 2 "BrakeLight_BrakeLightOne" 1 "BrakeLight_NoBrakeLight" 0 "BrakeLight_BrakeLightUnknown" ;
VAL_ 792 FLCObject08_TargetToLine 7 "TargetToLine_NotAvailable" 6 "TargetToLine_Error" 5 "TargetToLine_Unknown" 4 "TargetToLine_OnTheLeftEgoLine" 3 "TargetToLine_OnTheRightEgoLine" 2 "TargetToLine_BetweenRightAndLeftEgoLine" 1 "TargetToLine_LeftSideOfTheLeftEgoLine" 0 "TargetToLine_RightSideOfTheRightEgoLine" ;
VAL_ 792 FLCObject08_ReliabilityConf 7 "ReliabilityConf_NotAvailable" 6 "ReliabilityConf_Error" 5 "ReliabilityConf_Spare2" 4 "ReliabilityConf_Spare1" 3 "ReliabilityConf_Restricted" 2 "ReliabilityConf_ASIL_B" 1 "ReliabilityConf_CNNConfirmed_ObjectShape" 0 "ReliabilityConf_ConfirmedbyGenericStream" ;
VAL_ 791 FLCObject07_TargetToLine 7 "TargetToLine_NotAvailable" 6 "TargetToLine_Error" 5 "TargetToLine_Unknown" 4 "TargetToLine_OnTheLeftEgoLine" 3 "TargetToLine_OnTheRightEgoLine" 2 "TargetToLine_BetweenRightAndLeftEgoLine" 1 "TargetToLine_LeftSideOfTheLeftEgoLine" 0 "TargetToLine_RightSideOfTheRightEgoLine" ;
VAL_ 791 FLCObject07_TurnIndication 7 "TurnIndication_NotAvailable" 6 "TurnIndication_Error" 5 "TurnIndication_Spare" 4 "TurnIndication_DirectionIndicatorBoth" 3 "TurnIndication_DirectionIndicatorRight" 2 "TurnIndication_DirectionIndicatorLeft" 1 "TurnIndication_NoDirectionIndicator" 0 "TurnIndication_Unknown" ;
VAL_ 791 FLCObject07_ObjClass 15 "ObjClassSideS_NotAvailable" 14 "ObjClassSideS_Error" 13 "ObjClassSideS_Spare4" 12 "ObjClassSideS_Spare3" 11 "ObjClassSideS_Motorcycle" 10 "ObjClassSideS_Bicycle" 9 "ObjClassSideS_UnidentifiedMovableObject" 8 "ObjClassSideS_UnidentifiedVRU" 7 "ObjClassSideS_UnidentifiedVehicle" 6 "ObjClassSideS_StaticObject" 5 "ObjClassSideS_Pedestrian" 4 "ObjClassSideS_2Wheeler" 3 "ObjClassSideS_HeavyVehicle" 2 "ObjClassSideS_Car" 1 "ObjClassSideS_Obstacle" 0 "ObjClassSideS_Undetermined" ;
VAL_ 791 FLCObject07_ObjDynClass 3 "ObjDynClass_Error" 2 "ObjDynClass_Movable" 1 "ObjDynClass_Stationary" 0 "ObjDynClass_Reserved" ;
VAL_ 791 FLCObject07_ReliabilityConf 7 "ReliabilityConf_NotAvailable" 6 "ReliabilityConf_Error" 5 "ReliabilityConf_Spare2" 4 "ReliabilityConf_Spare1" 3 "ReliabilityConf_Restricted" 2 "ReliabilityConf_ASIL_B" 1 "ReliabilityConf_CNNConfirmed_ObjectShape" 0 "ReliabilityConf_ConfirmedbyGenericStream" ;
VAL_ 791 FLCObject07_TrackStatus 7 "TrackStatus_NotAvailable" 6 "TrackStatus_Error" 5 "TrackStatus_Spare3" 4 "TrackStatus_Spare2" 3 "TrackStatus_Spare1" 2 "TrackStatus_Invalid" 1 "TrackStatus_Predicted" 0 "TrackStatus_Tracked" ;
VAL_ 791 FLCObject07_BrakeLight 7 "BrakeLight_NotAvailable" 6 "BrakeLight_Error" 5 "BrakeLight_Spare" 4 "BrakeLight_BrakeLightThree" 3 "BrakeLight_BrakeLightTwo" 2 "BrakeLight_BrakeLightOne" 1 "BrakeLight_NoBrakeLight" 0 "BrakeLight_BrakeLightUnknown" ;
VAL_ 790 FLCObject06_ObjClass 15 "ObjClassSideS_NotAvailable" 14 "ObjClassSideS_Error" 13 "ObjClassSideS_Spare4" 12 "ObjClassSideS_Spare3" 11 "ObjClassSideS_Motorcycle" 10 "ObjClassSideS_Bicycle" 9 "ObjClassSideS_UnidentifiedMovableObject" 8 "ObjClassSideS_UnidentifiedVRU" 7 "ObjClassSideS_UnidentifiedVehicle" 6 "ObjClassSideS_StaticObject" 5 "ObjClassSideS_Pedestrian" 4 "ObjClassSideS_2Wheeler" 3 "ObjClassSideS_HeavyVehicle" 2 "ObjClassSideS_Car" 1 "ObjClassSideS_Obstacle" 0 "ObjClassSideS_Undetermined" ;
VAL_ 790 FLCObject06_TrackStatus 7 "TrackStatus_NotAvailable" 6 "TrackStatus_Error" 5 "TrackStatus_Spare3" 4 "TrackStatus_Spare2" 3 "TrackStatus_Spare1" 2 "TrackStatus_Invalid" 1 "TrackStatus_Predicted" 0 "TrackStatus_Tracked" ;
VAL_ 790 FLCObject06_BrakeLight 7 "BrakeLight_NotAvailable" 6 "BrakeLight_Error" 5 "BrakeLight_Spare" 4 "BrakeLight_BrakeLightThree" 3 "BrakeLight_BrakeLightTwo" 2 "BrakeLight_BrakeLightOne" 1 "BrakeLight_NoBrakeLight" 0 "BrakeLight_BrakeLightUnknown" ;
VAL_ 790 FLCObject06_TurnIndication 7 "TurnIndication_NotAvailable" 6 "TurnIndication_Error" 5 "TurnIndication_Spare" 4 "TurnIndication_DirectionIndicatorBoth" 3 "TurnIndication_DirectionIndicatorRight" 2 "TurnIndication_DirectionIndicatorLeft" 1 "TurnIndication_NoDirectionIndicator" 0 "TurnIndication_Unknown" ;
VAL_ 790 FLCObject06_TargetToLine 7 "TargetToLine_NotAvailable" 6 "TargetToLine_Error" 5 "TargetToLine_Unknown" 4 "TargetToLine_OnTheLeftEgoLine" 3 "TargetToLine_OnTheRightEgoLine" 2 "TargetToLine_BetweenRightAndLeftEgoLine" 1 "TargetToLine_LeftSideOfTheLeftEgoLine" 0 "TargetToLine_RightSideOfTheRightEgoLine" ;
VAL_ 790 FLCObject06_ReliabilityConf 7 "ReliabilityConf_NotAvailable" 6 "ReliabilityConf_Error" 5 "ReliabilityConf_Spare2" 4 "ReliabilityConf_Spare1" 3 "ReliabilityConf_Restricted" 2 "ReliabilityConf_ASIL_B" 1 "ReliabilityConf_CNNConfirmed_ObjectShape" 0 "ReliabilityConf_ConfirmedbyGenericStream" ;
VAL_ 790 FLCObject06_ObjDynClass 3 "ObjDynClass_Error" 2 "ObjDynClass_Movable" 1 "ObjDynClass_Stationary" 0 "ObjDynClass_Reserved" ;
VAL_ 789 FLCObject05_TurnIndication 7 "TurnIndication_NotAvailable" 6 "TurnIndication_Error" 5 "TurnIndication_Spare" 4 "TurnIndication_DirectionIndicatorBoth" 3 "TurnIndication_DirectionIndicatorRight" 2 "TurnIndication_DirectionIndicatorLeft" 1 "TurnIndication_NoDirectionIndicator" 0 "TurnIndication_Unknown" ;
VAL_ 789 FLCObject05_BrakeLight 7 "BrakeLight_NotAvailable" 6 "BrakeLight_Error" 5 "BrakeLight_Spare" 4 "BrakeLight_BrakeLightThree" 3 "BrakeLight_BrakeLightTwo" 2 "BrakeLight_BrakeLightOne" 1 "BrakeLight_NoBrakeLight" 0 "BrakeLight_BrakeLightUnknown" ;
VAL_ 789 FLCObject05_ReliabilityConf 7 "ReliabilityConf_NotAvailable" 6 "ReliabilityConf_Error" 5 "ReliabilityConf_Spare2" 4 "ReliabilityConf_Spare1" 3 "ReliabilityConf_Restricted" 2 "ReliabilityConf_ASIL_B" 1 "ReliabilityConf_CNNConfirmed_ObjectShape" 0 "ReliabilityConf_ConfirmedbyGenericStream" ;
VAL_ 789 FLCObject05_TrackStatus 7 "TrackStatus_NotAvailable" 6 "TrackStatus_Error" 5 "TrackStatus_Spare3" 4 "TrackStatus_Spare2" 3 "TrackStatus_Spare1" 2 "TrackStatus_Invalid" 1 "TrackStatus_Predicted" 0 "TrackStatus_Tracked" ;
VAL_ 789 FLCObject05_ObjDynClass 3 "ObjDynClass_Error" 2 "ObjDynClass_Movable" 1 "ObjDynClass_Stationary" 0 "ObjDynClass_Reserved" ;
VAL_ 789 FLCObject05_ObjClass 15 "ObjClassSideS_NotAvailable" 14 "ObjClassSideS_Error" 13 "ObjClassSideS_Spare4" 12 "ObjClassSideS_Spare3" 11 "ObjClassSideS_Motorcycle" 10 "ObjClassSideS_Bicycle" 9 "ObjClassSideS_UnidentifiedMovableObject" 8 "ObjClassSideS_UnidentifiedVRU" 7 "ObjClassSideS_UnidentifiedVehicle" 6 "ObjClassSideS_StaticObject" 5 "ObjClassSideS_Pedestrian" 4 "ObjClassSideS_2Wheeler" 3 "ObjClassSideS_HeavyVehicle" 2 "ObjClassSideS_Car" 1 "ObjClassSideS_Obstacle" 0 "ObjClassSideS_Undetermined" ;
VAL_ 789 FLCObject05_TargetToLine 7 "TargetToLine_NotAvailable" 6 "TargetToLine_Error" 5 "TargetToLine_Unknown" 4 "TargetToLine_OnTheLeftEgoLine" 3 "TargetToLine_OnTheRightEgoLine" 2 "TargetToLine_BetweenRightAndLeftEgoLine" 1 "TargetToLine_LeftSideOfTheLeftEgoLine" 0 "TargetToLine_RightSideOfTheRightEgoLine" ;
SIG_GROUP_ 797 FLCObject13_sg 1 : FLCObject13_AnglRightCorner FLCObject13_TimeStamp FLCObject13_ExistConf FLCObject13_ScaleChange FLCObject13_DstRightVar FLCObject13_BrakeLight FLCObject13_LifeTime FLCObject13_DstLeftVar FLCObject13_DistLeftCorner FLCObject13_ObjDynClass FLCObject13_LongAcc FLCObject13_AngRightVar FLCObject13_AnglFarCorner FLCObject13_LatAcc FLCObject13_TurnIndication FLCObject13_Counter FLCObject13_Heading FLCObject13_HeadingVar FLCObject13_DstFarVar FLCObject13_LongPosVar FLCObject13_Height FLCObject13_TargetToLine FLCObject13_LatVel FLCObject13_CoastIndex FLCObject13_LatPosVar FLCObject13_DistFarCorner FLCObject13_LongPos FLCObject13_ObjClass FLCObject13_LatPos FLCObject13_LongVelVar FLCObject13_DistRightCorner FLCObject13_TrackStatus FLCObject13_CRC FLCObject13_AngFarVar FLCObject13_LatVelVar FLCObject13_AnglLeftCorner FLCObject13_LongVel FLCObject13_AngLeftVar FLCObject13_ReliabilityConf FLCObject13_ObjID;
SIG_GROUP_ 796 FLCObject12_sg 1 : FLCObject12_TimeStamp FLCObject12_AnglRightCorner FLCObject12_AnglLeftCorner FLCObject12_AngRightVar FLCObject12_ScaleChange FLCObject12_CRC FLCObject12_AnglFarCorner FLCObject12_LatPos FLCObject12_DistLeftCorner FLCObject12_LongVel FLCObject12_BrakeLight FLCObject12_Heading FLCObject12_ObjDynClass FLCObject12_TurnIndication FLCObject12_LatVelVar FLCObject12_LongVelVar FLCObject12_LatPosVar FLCObject12_LatAcc FLCObject12_LongAcc FLCObject12_DistFarCorner FLCObject12_DistRightCorner FLCObject12_AngLeftVar FLCObject12_LongPosVar FLCObject12_TrackStatus FLCObject12_TargetToLine FLCObject12_ObjID FLCObject12_DstFarVar FLCObject12_ReliabilityConf FLCObject12_ObjClass FLCObject12_ExistConf FLCObject12_LongPos FLCObject12_Height FLCObject12_Counter FLCObject12_LifeTime FLCObject12_DstLeftVar FLCObject12_DstRightVar FLCObject12_CoastIndex FLCObject12_AngFarVar FLCObject12_LatVel FLCObject12_HeadingVar;
SIG_GROUP_ 795 FLCObject11_sg 1 : FLCObject11_ReliabilityConf FLCObject11_ObjID FLCObject11_LongPosVar FLCObject11_LatVelVar FLCObject11_LongPos FLCObject11_LongVel FLCObject11_LongAcc FLCObject11_TimeStamp FLCObject11_AnglRightCorner FLCObject11_LatVel FLCObject11_CoastIndex FLCObject11_TurnIndication FLCObject11_AngFarVar FLCObject11_AnglFarCorner FLCObject11_DstRightVar FLCObject11_LatAcc FLCObject11_CRC FLCObject11_LatPosVar FLCObject11_ObjClass FLCObject11_DistRightCorner FLCObject11_ScaleChange FLCObject11_DstFarVar FLCObject11_ObjDynClass FLCObject11_DstLeftVar FLCObject11_TrackStatus FLCObject11_LifeTime FLCObject11_Heading FLCObject11_BrakeLight FLCObject11_AngRightVar FLCObject11_DistFarCorner FLCObject11_LongVelVar FLCObject11_HeadingVar FLCObject11_Height FLCObject11_AnglLeftCorner FLCObject11_DistLeftCorner FLCObject11_AngLeftVar FLCObject11_ExistConf FLCObject11_TargetToLine FLCObject11_Counter FLCObject11_LatPos;
SIG_GROUP_ 794 FLCObject10_sg 1 : FLCObject10_LatAcc FLCObject10_AnglRightCorner FLCObject10_TrackStatus FLCObject10_AnglFarCorner FLCObject10_ObjClass FLCObject10_CoastIndex FLCObject10_LatPosVar FLCObject10_Height FLCObject10_ScaleChange FLCObject10_DistLeftCorner FLCObject10_Counter FLCObject10_DistRightCorner FLCObject10_DstFarVar FLCObject10_DistFarCorner FLCObject10_AnglLeftCorner FLCObject10_BrakeLight FLCObject10_LatPos FLCObject10_LatVelVar FLCObject10_LongVelVar FLCObject10_HeadingVar FLCObject10_AngFarVar FLCObject10_Heading FLCObject10_ObjID FLCObject10_TimeStamp FLCObject10_LongAcc FLCObject10_LongVel FLCObject10_AngLeftVar FLCObject10_LifeTime FLCObject10_LongPosVar FLCObject10_ReliabilityConf FLCObject10_TurnIndication FLCObject10_CRC FLCObject10_DstLeftVar FLCObject10_AngRightVar FLCObject10_TargetToLine FLCObject10_ObjDynClass FLCObject10_LatVel FLCObject10_LongPos FLCObject10_ExistConf FLCObject10_DstRightVar;
SIG_GROUP_ 793 FLCObject09_sg 1 : FLCObject09_CoastIndex FLCObject09_DstRightVar FLCObject09_LatAcc FLCObject09_AngLeftVar FLCObject09_ExistConf FLCObject09_DistFarCorner FLCObject09_AnglRightCorner FLCObject09_AnglFarCorner FLCObject09_HeadingVar FLCObject09_LongPos FLCObject09_DistRightCorner FLCObject09_TrackStatus FLCObject09_DstFarVar FLCObject09_LifeTime FLCObject09_TimeStamp FLCObject09_DstLeftVar FLCObject09_LatPos FLCObject09_CRC FLCObject09_Heading FLCObject09_LongVelVar FLCObject09_AngRightVar FLCObject09_ObjClass FLCObject09_LongAcc FLCObject09_ScaleChange FLCObject09_LongVel FLCObject09_LongPosVar FLCObject09_DistLeftCorner FLCObject09_ObjID FLCObject09_LatPosVar FLCObject09_BrakeLight FLCObject09_Counter FLCObject09_Height FLCObject09_TargetToLine FLCObject09_ReliabilityConf FLCObject09_AngFarVar FLCObject09_LatVelVar FLCObject09_LatVel FLCObject09_TurnIndication FLCObject09_ObjDynClass FLCObject09_AnglLeftCorner;
SIG_GROUP_ 792 FLCObject08_sg 1 : FLCObject08_LifeTime FLCObject08_LatVelVar FLCObject08_AngLeftVar FLCObject08_LatPos FLCObject08_AnglRightCorner FLCObject08_DistRightCorner FLCObject08_LongPos FLCObject08_ObjClass FLCObject08_TurnIndication FLCObject08_DstFarVar FLCObject08_TrackStatus FLCObject08_DstRightVar FLCObject08_LatAcc FLCObject08_AngRightVar FLCObject08_ScaleChange FLCObject08_ObjDynClass FLCObject08_BrakeLight FLCObject08_Counter FLCObject08_TargetToLine FLCObject08_DstLeftVar FLCObject08_ReliabilityConf FLCObject08_ObjID FLCObject08_AngFarVar FLCObject08_HeadingVar FLCObject08_LongVel FLCObject08_CRC FLCObject08_LongPosVar FLCObject08_AnglFarCorner FLCObject08_LatPosVar FLCObject08_CoastIndex FLCObject08_TimeStamp FLCObject08_DistFarCorner FLCObject08_ExistConf FLCObject08_Heading FLCObject08_Height FLCObject08_AnglLeftCorner FLCObject08_LatVel FLCObject08_DistLeftCorner FLCObject08_LongAcc FLCObject08_LongVelVar;
SIG_GROUP_ 791 FLCObject07_sg 1 : FLCObject07_Counter FLCObject07_TargetToLine FLCObject07_LongPosVar FLCObject07_DistFarCorner FLCObject07_AngLeftVar FLCObject07_AngRightVar FLCObject07_LatVel FLCObject07_HeadingVar FLCObject07_TurnIndication FLCObject07_LatVelVar FLCObject07_CoastIndex FLCObject07_ObjClass FLCObject07_LatAcc FLCObject07_DstRightVar FLCObject07_LongVel FLCObject07_AnglRightCorner FLCObject07_ObjDynClass FLCObject07_AnglLeftCorner FLCObject07_Heading FLCObject07_ExistConf FLCObject07_TimeStamp FLCObject07_DstLeftVar FLCObject07_DstFarVar FLCObject07_Height FLCObject07_DistRightCorner FLCObject07_ReliabilityConf FLCObject07_LongPos FLCObject07_LatPosVar FLCObject07_AnglFarCorner FLCObject07_ObjID FLCObject07_ScaleChange FLCObject07_AngFarVar FLCObject07_LatPos FLCObject07_TrackStatus FLCObject07_LongVelVar FLCObject07_DistLeftCorner FLCObject07_CRC FLCObject07_LongAcc FLCObject07_LifeTime FLCObject07_BrakeLight;
SIG_GROUP_ 790 FLCObject06_sg 1 : FLCObject06_LatPosVar FLCObject06_CoastIndex FLCObject06_LifeTime FLCObject06_DistLeftCorner FLCObject06_LongAcc FLCObject06_ObjClass FLCObject06_ObjID FLCObject06_LongPosVar FLCObject06_TrackStatus FLCObject06_AngFarVar FLCObject06_DstLeftVar FLCObject06_LongVelVar FLCObject06_BrakeLight FLCObject06_HeadingVar FLCObject06_TimeStamp FLCObject06_ExistConf FLCObject06_CRC FLCObject06_DistFarCorner FLCObject06_LongPos FLCObject06_AnglFarCorner FLCObject06_LatVelVar FLCObject06_DstRightVar FLCObject06_AngLeftVar FLCObject06_TurnIndication FLCObject06_LongVel FLCObject06_AnglLeftCorner FLCObject06_Height FLCObject06_LatPos FLCObject06_AngRightVar FLCObject06_TargetToLine FLCObject06_LatAcc FLCObject06_ReliabilityConf FLCObject06_Counter FLCObject06_Heading FLCObject06_ScaleChange FLCObject06_DstFarVar FLCObject06_DistRightCorner FLCObject06_AnglRightCorner FLCObject06_LatVel FLCObject06_ObjDynClass;
SIG_GROUP_ 789 FLCObject05_sg 1 : FLCObject05_LongVelVar FLCObject05_TurnIndication FLCObject05_BrakeLight FLCObject05_DistRightCorner FLCObject05_DstFarVar FLCObject05_DstLeftVar FLCObject05_AngFarVar FLCObject05_AnglFarCorner FLCObject05_LongVel FLCObject05_Counter FLCObject05_LatAcc FLCObject05_AnglRightCorner FLCObject05_ReliabilityConf FLCObject05_Heading FLCObject05_CoastIndex FLCObject05_LongAcc FLCObject05_LatVel FLCObject05_ScaleChange FLCObject05_HeadingVar FLCObject05_LifeTime FLCObject05_LongPosVar FLCObject05_DistLeftCorner FLCObject05_TrackStatus FLCObject05_LatPosVar FLCObject05_AngLeftVar FLCObject05_ExistConf FLCObject05_DstRightVar FLCObject05_AnglLeftCorner FLCObject05_ObjDynClass FLCObject05_DistFarCorner FLCObject05_ObjClass FLCObject05_TimeStamp FLCObject05_LatVelVar FLCObject05_LatPos FLCObject05_LongPos FLCObject05_TargetToLine FLCObject05_CRC FLCObject05_Height FLCObject05_ObjID FLCObject05_AngRightVar;
