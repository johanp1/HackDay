VERSION ""

NS_ :

BS_:

BU_: FLC2 DACU

BO_ 806 FLCObject22_Vic2: 48 FLC2
 SG_ FLCObject22_HeadingVar : 104|8@1+ (0.1,0) [0|25.5] "NotApplicable"  VCM
 SG_ FLCObject22_DstRightVar : 80|8@1+ (0.4,0) [0|102] "NotApplicable"  VCM
 SG_ FLCObject22_LatPos : 264|13@1+ (0.05,-180) [-180|229.55] "m"  VCM
 SG_ FLCObject22_TrackStatus : 339|3@1+ (1,0) [0|0] ""  VCM
 SG_ FLCObject22_ObjID : 320|6@1+ (1,0) [0|63] "NotApplicable"  VCM
 SG_ FLCObject22_CoastIndex : 328|5@1+ (1,0) [0|31] "NotApplicable"  VCM
 SG_ FLCObject22_LatVel : 277|13@1+ (0.032,-80) [-80|182.112] "m_per_s"  VCM
 SG_ FLCObject22_LongPos : 290|13@1+ (0.05,-180) [-180|229.55] "m"  VCM
 SG_ FLCObject22_TimeStamp : 48|16@1+ (0.1,0) [0|6553.5] "ms"  VCM
 SG_ FLCObject22_ReliabilityConf : 336|3@1+ (1,0) [0|0] ""  VCM
 SG_ FLCObject22_LatVelVar : 32|8@1+ (0.1,0) [0|25.5] "NotApplicable"  VCM
 SG_ FLCObject22_DistRightCorner : 164|12@1+ (0.05,0) [0|204.75] "m"  VCM
 SG_ FLCObject22_AngRightVar : 136|8@1+ (1E-005,0) [0|0.00255] "NotApplicable"  VCM
 SG_ FLCObject22_ExistConf : 257|7@1+ (0.01,0) [0|1.27] "NotApplicable"  VCM
 SG_ FLCObject22_LatPosVar : 40|8@1+ (0.1,0) [0|25.5] "NotApplicable"  VCM
 SG_ FLCObject22_CRC : 0|16@1+ (1,0) [0|65535] "NotApplicable"  VCM
 SG_ FLCObject22_DstLeftVar : 112|8@1+ (0.4,0) [0|102] "NotApplicable"  VCM
 SG_ FLCObject22_Heading : 188|11@1+ (0.005818,-4.71) [-4.71|7.199446] "rad"  VCM
 SG_ FLCObject22_Height : 96|8@1+ (0.02,0) [0|5.1] "m"  VCM
 SG_ FLCObject22_TurnIndication : 333|3@1+ (1,0) [0|0] ""  VCM
 SG_ FLCObject22_AnglFarCorner : 229|10@1+ (0.005,-1.57) [-1.57|3.545] "rad"  VCM
 SG_ FLCObject22_AnglRightCorner : 199|10@1+ (0.005,-1.57) [-1.57|3.545] "rad"  VCM
 SG_ FLCObject22_LongAcc : 239|9@1+ (0.08,-20) [-20|20.88] "m_per_s_squared"  VCM
 SG_ FLCObject22_AngFarVar : 128|8@1+ (1E-005,0) [0|0.00255] "NotApplicable"  VCM
 SG_ FLCObject22_AnglLeftCorner : 209|10@1+ (0.005,-1.57) [-1.57|3.545] "rad"  VCM
 SG_ FLCObject22_Counter : 16|8@1+ (1,0) [0|255] "Count"  VCM
 SG_ FLCObject22_LongVelVar : 88|8@1+ (0.4,0) [0|102] "NotApplicable"  VCM
 SG_ FLCObject22_ObjClass : 316|4@1+ (1,0) [0|0] ""  VCM
 SG_ FLCObject22_DistFarCorner : 176|12@1+ (0.05,0) [0|204.75] "m"  VCM
 SG_ FLCObject22_BrakeLight : 345|3@1+ (1,0) [0|0] ""  VCM
 SG_ FLCObject22_LongVel : 303|13@1+ (0.032,-80) [-80|182.112] "m_per_s"  VCM
 SG_ FLCObject22_ScaleChange : 219|10@1+ (0.002,0) [0|2.046] "NotApplicable"  VCM
 SG_ FLCObject22_TargetToLine : 342|3@1+ (1,0) [0|0] ""  VCM
 SG_ FLCObject22_LifeTime : 64|16@1+ (0.1,0) [0|6553.5] "s"  VCM
 SG_ FLCObject22_LongPosVar : 144|8@1+ (0.4,0) [0|102] "NotApplicable"  VCM
 SG_ FLCObject22_DistLeftCorner : 152|12@1+ (0.05,0) [0|204.75] "m"  VCM
 SG_ FLCObject22_ObjDynClass : 326|2@1+ (1,0) [0|0] ""  VCM
 SG_ FLCObject22_LatAcc : 248|9@1+ (0.08,-20) [-20|20.88] "m_per_s_squared"  VCM
 SG_ FLCObject22_DstFarVar : 24|8@1+ (0.4,0) [0|102] "NotApplicable"  VCM
 SG_ FLCObject22_AngLeftVar : 120|8@1+ (1E-005,0) [0|0.00255] "NotApplicable"  VCM

BO_ 805 FLCObject21_Vic2: 48 FLC2
 SG_ FLCObject21_ScaleChange : 219|10@1+ (0.002,0) [0|2.046] "NotApplicable"  VCM
 SG_ FLCObject21_DistFarCorner : 176|12@1+ (0.05,0) [0|204.75] "m"  VCM
 SG_ FLCObject21_Heading : 188|11@1+ (0.005818,-4.71) [-4.71|7.199446] "rad"  VCM
 SG_ FLCObject21_LongAcc : 239|9@1+ (0.08,-20) [-20|20.88] "m_per_s_squared"  VCM
 SG_ FLCObject21_CRC : 0|16@1+ (1,0) [0|65535] "NotApplicable"  VCM
 SG_ FLCObject21_ObjID : 320|6@1+ (1,0) [0|63] "NotApplicable"  VCM
 SG_ FLCObject21_DstLeftVar : 112|8@1+ (0.4,0) [0|102] "NotApplicable"  VCM
 SG_ FLCObject21_DstFarVar : 24|8@1+ (0.4,0) [0|102] "NotApplicable"  VCM
 SG_ FLCObject21_ObjClass : 316|4@1+ (1,0) [0|0] ""  VCM
 SG_ FLCObject21_ObjDynClass : 326|2@1+ (1,0) [0|0] ""  VCM
 SG_ FLCObject21_ExistConf : 257|7@1+ (0.01,0) [0|1.27] "NotApplicable"  VCM
 SG_ FLCObject21_DstRightVar : 80|8@1+ (0.4,0) [0|102] "NotApplicable"  VCM
 SG_ FLCObject21_ReliabilityConf : 336|3@1+ (1,0) [0|0] ""  VCM
 SG_ FLCObject21_LongVelVar : 88|8@1+ (0.4,0) [0|102] "NotApplicable"  VCM
 SG_ FLCObject21_LongPosVar : 144|8@1+ (0.4,0) [0|102] "NotApplicable"  VCM
 SG_ FLCObject21_TargetToLine : 342|3@1+ (1,0) [0|0] ""  VCM
 SG_ FLCObject21_Counter : 16|8@1+ (1,0) [0|255] "Count"  VCM
 SG_ FLCObject21_DistLeftCorner : 152|12@1+ (0.05,0) [0|204.75] "m"  VCM
 SG_ FLCObject21_LatVel : 277|13@1+ (0.032,-80) [-80|182.112] "m_per_s"  VCM
 SG_ FLCObject21_LatVelVar : 32|8@1+ (0.1,0) [0|25.5] "NotApplicable"  VCM
 SG_ FLCObject21_LatPos : 264|13@1+ (0.05,-180) [-180|229.55] "m"  VCM
 SG_ FLCObject21_LongVel : 303|13@1+ (0.032,-80) [-80|182.112] "m_per_s"  VCM
 SG_ FLCObject21_AngLeftVar : 120|8@1+ (1E-005,0) [0|0.00255] "NotApplicable"  VCM
 SG_ FLCObject21_AngRightVar : 136|8@1+ (1E-005,0) [0|0.00255] "NotApplicable"  VCM
 SG_ FLCObject21_AnglFarCorner : 229|10@1+ (0.005,-1.57) [-1.57|3.545] "rad"  VCM
 SG_ FLCObject21_DistRightCorner : 164|12@1+ (0.05,0) [0|204.75] "m"  VCM
 SG_ FLCObject21_LifeTime : 64|16@1+ (0.1,0) [0|6553.5] "s"  VCM
 SG_ FLCObject21_TrackStatus : 339|3@1+ (1,0) [0|0] ""  VCM
 SG_ FLCObject21_AnglRightCorner : 199|10@1+ (0.005,-1.57) [-1.57|3.545] "rad"  VCM
 SG_ FLCObject21_LatAcc : 248|9@1+ (0.08,-20) [-20|20.88] "m_per_s_squared"  VCM
 SG_ FLCObject21_HeadingVar : 104|8@1+ (0.1,0) [0|25.5] "NotApplicable"  VCM
 SG_ FLCObject21_LatPosVar : 40|8@1+ (0.1,0) [0|25.5] "NotApplicable"  VCM
 SG_ FLCObject21_LongPos : 290|13@1+ (0.05,-180) [-180|229.55] "m"  VCM
 SG_ FLCObject21_AngFarVar : 128|8@1+ (1E-005,0) [0|0.00255] "NotApplicable"  VCM
 SG_ FLCObject21_TurnIndication : 333|3@1+ (1,0) [0|0] ""  VCM
 SG_ FLCObject21_TimeStamp : 48|16@1+ (0.1,0) [0|6553.5] "ms"  VCM
 SG_ FLCObject21_CoastIndex : 328|5@1+ (1,0) [0|31] "NotApplicable"  VCM
 SG_ FLCObject21_Height : 96|8@1+ (0.02,0) [0|5.1] "m"  VCM
 SG_ FLCObject21_BrakeLight : 345|3@1+ (1,0) [0|0] ""  VCM
 SG_ FLCObject21_AnglLeftCorner : 209|10@1+ (0.005,-1.57) [-1.57|3.545] "rad"  VCM

BO_ 804 FLCObject20_Vic2: 48 FLC2
 SG_ FLCObject20_DistLeftCorner : 152|12@1+ (0.05,0) [0|204.75] "m"  VCM
 SG_ FLCObject20_HeadingVar : 104|8@1+ (0.1,0) [0|25.5] "NotApplicable"  VCM
 SG_ FLCObject20_LatPosVar : 40|8@1+ (0.1,0) [0|25.5] "NotApplicable"  VCM
 SG_ FLCObject20_ExistConf : 257|7@1+ (0.01,0) [0|1.27] "NotApplicable"  VCM
 SG_ FLCObject20_LatVel : 277|13@1+ (0.032,-80) [-80|182.112] "m_per_s"  VCM
 SG_ FLCObject20_LongVelVar : 88|8@1+ (0.4,0) [0|102] "NotApplicable"  VCM
 SG_ FLCObject20_LongVel : 303|13@1+ (0.032,-80) [-80|182.112] "m_per_s"  VCM
 SG_ FLCObject20_AnglRightCorner : 199|10@1+ (0.005,-1.57) [-1.57|3.545] "rad"  VCM
 SG_ FLCObject20_DistRightCorner : 164|12@1+ (0.05,0) [0|204.75] "m"  VCM
 SG_ FLCObject20_Heading : 188|11@1+ (0.005818,-4.71) [-4.71|7.199446] "rad"  VCM
 SG_ FLCObject20_BrakeLight : 345|3@1+ (1,0) [0|0] ""  VCM
 SG_ FLCObject20_DstFarVar : 24|8@1+ (0.4,0) [0|102] "NotApplicable"  VCM
 SG_ FLCObject20_TargetToLine : 342|3@1+ (1,0) [0|0] ""  VCM
 SG_ FLCObject20_TimeStamp : 48|16@1+ (0.1,0) [0|6553.5] "ms"  VCM
 SG_ FLCObject20_DstRightVar : 80|8@1+ (0.4,0) [0|102] "NotApplicable"  VCM
 SG_ FLCObject20_AngLeftVar : 120|8@1+ (1E-005,0) [0|0.00255] "NotApplicable"  VCM
 SG_ FLCObject20_CRC : 0|16@1+ (1,0) [0|65535] "NotApplicable"  VCM
 SG_ FLCObject20_ObjID : 320|6@1+ (1,0) [0|63] "NotApplicable"  VCM
 SG_ FLCObject20_AngRightVar : 136|8@1+ (1E-005,0) [0|0.00255] "NotApplicable"  VCM
 SG_ FLCObject20_AngFarVar : 128|8@1+ (1E-005,0) [0|0.00255] "NotApplicable"  VCM
 SG_ FLCObject20_TrackStatus : 339|3@1+ (1,0) [0|0] ""  VCM
 SG_ FLCObject20_LatVelVar : 32|8@1+ (0.1,0) [0|25.5] "NotApplicable"  VCM
 SG_ FLCObject20_LongPosVar : 144|8@1+ (0.4,0) [0|102] "NotApplicable"  VCM
 SG_ FLCObject20_ObjDynClass : 326|2@1+ (1,0) [0|0] ""  VCM
 SG_ FLCObject20_LongAcc : 239|9@1+ (0.08,-20) [-20|20.88] "m_per_s_squared"  VCM
 SG_ FLCObject20_Counter : 16|8@1+ (1,0) [0|255] "Count"  VCM
 SG_ FLCObject20_LatPos : 264|13@1+ (0.05,-180) [-180|229.55] "m"  VCM
 SG_ FLCObject20_AnglFarCorner : 229|10@1+ (0.005,-1.57) [-1.57|3.545] "rad"  VCM
 SG_ FLCObject20_ScaleChange : 219|10@1+ (0.002,0) [0|2.046] "NotApplicable"  VCM
 SG_ FLCObject20_Height : 96|8@1+ (0.02,0) [0|5.1] "m"  VCM
 SG_ FLCObject20_ReliabilityConf : 336|3@1+ (1,0) [0|0] ""  VCM
 SG_ FLCObject20_LatAcc : 248|9@1+ (0.08,-20) [-20|20.88] "m_per_s_squared"  VCM
 SG_ FLCObject20_ObjClass : 316|4@1+ (1,0) [0|0] ""  VCM
 SG_ FLCObject20_AnglLeftCorner : 209|10@1+ (0.005,-1.57) [-1.57|3.545] "rad"  VCM
 SG_ FLCObject20_LifeTime : 64|16@1+ (0.1,0) [0|6553.5] "s"  VCM
 SG_ FLCObject20_DstLeftVar : 112|8@1+ (0.4,0) [0|102] "NotApplicable"  VCM
 SG_ FLCObject20_DistFarCorner : 176|12@1+ (0.05,0) [0|204.75] "m"  VCM
 SG_ FLCObject20_TurnIndication : 333|3@1+ (1,0) [0|0] ""  VCM
 SG_ FLCObject20_CoastIndex : 328|5@1+ (1,0) [0|31] "NotApplicable"  VCM
 SG_ FLCObject20_LongPos : 290|13@1+ (0.05,-180) [-180|229.55] "m"  VCM

BO_ 803 FLCObject19_Vic2: 48 FLC2
 SG_ FLCObject19_DistFarCorner : 176|12@1+ (0.05,0) [0|204.75] "m"  VCM
 SG_ FLCObject19_LongPosVar : 144|8@1+ (0.4,0) [0|102] "NotApplicable"  VCM
 SG_ FLCObject19_TargetToLine : 342|3@1+ (1,0) [0|0] ""  VCM
 SG_ FLCObject19_DstLeftVar : 112|8@1+ (0.4,0) [0|102] "NotApplicable"  VCM
 SG_ FLCObject19_DistRightCorner : 164|12@1+ (0.05,0) [0|204.75] "m"  VCM
 SG_ FLCObject19_LifeTime : 64|16@1+ (0.1,0) [0|6553.5] "s"  VCM
 SG_ FLCObject19_Height : 96|8@1+ (0.02,0) [0|5.1] "m"  VCM
 SG_ FLCObject19_CRC : 0|16@1+ (1,0) [0|65535] "NotApplicable"  VCM
 SG_ FLCObject19_TrackStatus : 339|3@1+ (1,0) [0|0] ""  VCM
 SG_ FLCObject19_ReliabilityConf : 336|3@1+ (1,0) [0|0] ""  VCM
 SG_ FLCObject19_Counter : 16|8@1+ (1,0) [0|255] "Count"  VCM
 SG_ FLCObject19_TurnIndication : 333|3@1+ (1,0) [0|0] ""  VCM
 SG_ FLCObject19_AngFarVar : 128|8@1+ (1E-005,0) [0|0.00255] "NotApplicable"  VCM
 SG_ FLCObject19_BrakeLight : 345|3@1+ (1,0) [0|0] ""  VCM
 SG_ FLCObject19_LatAcc : 248|9@1+ (0.08,-20) [-20|20.88] "m_per_s_squared"  VCM
 SG_ FLCObject19_ObjDynClass : 326|2@1+ (1,0) [0|0] ""  VCM
 SG_ FLCObject19_DstRightVar : 80|8@1+ (0.4,0) [0|102] "NotApplicable"  VCM
 SG_ FLCObject19_LongVel : 303|13@1+ (0.032,-80) [-80|182.112] "m_per_s"  VCM
 SG_ FLCObject19_AnglLeftCorner : 209|10@1+ (0.005,-1.57) [-1.57|3.545] "rad"  VCM
 SG_ FLCObject19_AngRightVar : 136|8@1+ (1E-005,0) [0|0.00255] "NotApplicable"  VCM
 SG_ FLCObject19_Heading : 188|11@1+ (0.005818,-4.71) [-4.71|7.199446] "rad"  VCM
 SG_ FLCObject19_HeadingVar : 104|8@1+ (0.1,0) [0|25.5] "NotApplicable"  VCM
 SG_ FLCObject19_LatVelVar : 32|8@1+ (0.1,0) [0|25.5] "NotApplicable"  VCM
 SG_ FLCObject19_ObjClass : 316|4@1+ (1,0) [0|0] ""  VCM
 SG_ FLCObject19_AnglRightCorner : 199|10@1+ (0.005,-1.57) [-1.57|3.545] "rad"  VCM
 SG_ FLCObject19_AnglFarCorner : 229|10@1+ (0.005,-1.57) [-1.57|3.545] "rad"  VCM
 SG_ FLCObject19_TimeStamp : 48|16@1+ (0.1,0) [0|6553.5] "ms"  VCM
 SG_ FLCObject19_ObjID : 320|6@1+ (1,0) [0|63] "NotApplicable"  VCM
 SG_ FLCObject19_ExistConf : 257|7@1+ (0.01,0) [0|1.27] "NotApplicable"  VCM
 SG_ FLCObject19_LongPos : 290|13@1+ (0.05,-180) [-180|229.55] "m"  VCM
 SG_ FLCObject19_DstFarVar : 24|8@1+ (0.4,0) [0|102] "NotApplicable"  VCM
 SG_ FLCObject19_LongVelVar : 88|8@1+ (0.4,0) [0|102] "NotApplicable"  VCM
 SG_ FLCObject19_LatVel : 277|13@1+ (0.032,-80) [-80|182.112] "m_per_s"  VCM
 SG_ FLCObject19_AngLeftVar : 120|8@1+ (1E-005,0) [0|0.00255] "NotApplicable"  VCM
 SG_ FLCObject19_LatPosVar : 40|8@1+ (0.1,0) [0|25.5] "NotApplicable"  VCM
 SG_ FLCObject19_DistLeftCorner : 152|12@1+ (0.05,0) [0|204.75] "m"  VCM
 SG_ FLCObject19_CoastIndex : 328|5@1+ (1,0) [0|31] "NotApplicable"  VCM
 SG_ FLCObject19_LongAcc : 239|9@1+ (0.08,-20) [-20|20.88] "m_per_s_squared"  VCM
 SG_ FLCObject19_ScaleChange : 219|10@1+ (0.002,0) [0|2.046] "NotApplicable"  VCM
 SG_ FLCObject19_LatPos : 264|13@1+ (0.05,-180) [-180|229.55] "m"  VCM

BO_ 802 FLCObject18_Vic2: 48 FLC2
 SG_ FLCObject18_TargetToLine : 342|3@1+ (1,0) [0|0] ""  VCM
 SG_ FLCObject18_LatAcc : 248|9@1+ (0.08,-20) [-20|20.88] "m_per_s_squared"  VCM
 SG_ FLCObject18_BrakeLight : 345|3@1+ (1,0) [0|0] ""  VCM
 SG_ FLCObject18_LatVel : 277|13@1+ (0.032,-80) [-80|182.112] "m_per_s"  VCM
 SG_ FLCObject18_LongVel : 303|13@1+ (0.032,-80) [-80|182.112] "m_per_s"  VCM
 SG_ FLCObject18_LongVelVar : 88|8@1+ (0.4,0) [0|102] "NotApplicable"  VCM
 SG_ FLCObject18_DstFarVar : 24|8@1+ (0.4,0) [0|102] "NotApplicable"  VCM
 SG_ FLCObject18_LatPosVar : 40|8@1+ (0.1,0) [0|25.5] "NotApplicable"  VCM
 SG_ FLCObject18_LongAcc : 239|9@1+ (0.08,-20) [-20|20.88] "m_per_s_squared"  VCM
 SG_ FLCObject18_CoastIndex : 328|5@1+ (1,0) [0|31] "NotApplicable"  VCM
 SG_ FLCObject18_TimeStamp : 48|16@1+ (0.1,0) [0|6553.5] "ms"  VCM
 SG_ FLCObject18_LongPos : 290|13@1+ (0.05,-180) [-180|229.55] "m"  VCM
 SG_ FLCObject18_LongPosVar : 144|8@1+ (0.4,0) [0|102] "NotApplicable"  VCM
 SG_ FLCObject18_ObjClass : 316|4@1+ (1,0) [0|0] ""  VCM
 SG_ FLCObject18_ObjID : 320|6@1+ (1,0) [0|63] "NotApplicable"  VCM
 SG_ FLCObject18_Heading : 188|11@1+ (0.005818,-4.71) [-4.71|7.199446] "rad"  VCM
 SG_ FLCObject18_DstLeftVar : 112|8@1+ (0.4,0) [0|102] "NotApplicable"  VCM
 SG_ FLCObject18_LifeTime : 64|16@1+ (0.1,0) [0|6553.5] "s"  VCM
 SG_ FLCObject18_Height : 96|8@1+ (0.02,0) [0|5.1] "m"  VCM
 SG_ FLCObject18_AngFarVar : 128|8@1+ (1E-005,0) [0|0.00255] "NotApplicable"  VCM
 SG_ FLCObject18_ObjDynClass : 326|2@1+ (1,0) [0|0] ""  VCM
 SG_ FLCObject18_AnglLeftCorner : 209|10@1+ (0.005,-1.57) [-1.57|3.545] "rad"  VCM
 SG_ FLCObject18_ReliabilityConf : 336|3@1+ (1,0) [0|0] ""  VCM
 SG_ FLCObject18_LatVelVar : 32|8@1+ (0.1,0) [0|25.5] "NotApplicable"  VCM
 SG_ FLCObject18_ExistConf : 257|7@1+ (0.01,0) [0|1.27] "NotApplicable"  VCM
 SG_ FLCObject18_Counter : 16|8@1+ (1,0) [0|255] "Count"  VCM
 SG_ FLCObject18_DistLeftCorner : 152|12@1+ (0.05,0) [0|204.75] "m"  VCM
 SG_ FLCObject18_ScaleChange : 219|10@1+ (0.002,0) [0|2.046] "NotApplicable"  VCM
 SG_ FLCObject18_AnglFarCorner : 229|10@1+ (0.005,-1.57) [-1.57|3.545] "rad"  VCM
 SG_ FLCObject18_DstRightVar : 80|8@1+ (0.4,0) [0|102] "NotApplicable"  VCM
 SG_ FLCObject18_HeadingVar : 104|8@1+ (0.1,0) [0|25.5] "NotApplicable"  VCM
 SG_ FLCObject18_TrackStatus : 339|3@1+ (1,0) [0|0] ""  VCM
 SG_ FLCObject18_LatPos : 264|13@1+ (0.05,-180) [-180|229.55] "m"  VCM
 SG_ FLCObject18_AngLeftVar : 120|8@1+ (1E-005,0) [0|0.00255] "NotApplicable"  VCM
 SG_ FLCObject18_DistFarCorner : 176|12@1+ (0.05,0) [0|204.75] "m"  VCM
 SG_ FLCObject18_TurnIndication : 333|3@1+ (1,0) [0|0] ""  VCM
 SG_ FLCObject18_CRC : 0|16@1+ (1,0) [0|65535] "NotApplicable"  VCM
 SG_ FLCObject18_AngRightVar : 136|8@1+ (1E-005,0) [0|0.00255] "NotApplicable"  VCM
 SG_ FLCObject18_AnglRightCorner : 199|10@1+ (0.005,-1.57) [-1.57|3.545] "rad"  VCM
 SG_ FLCObject18_DistRightCorner : 164|12@1+ (0.05,0) [0|204.75] "m"  VCM

BO_ 801 FLCObject17_Vic2: 48 FLC2
 SG_ FLCObject17_TargetToLine : 342|3@1+ (1,0) [0|0] ""  VCM
 SG_ FLCObject17_DstFarVar : 24|8@1+ (0.4,0) [0|102] "NotApplicable"  VCM
 SG_ FLCObject17_LifeTime : 64|16@1+ (0.1,0) [0|6553.5] "s"  VCM
 SG_ FLCObject17_DistLeftCorner : 152|12@1+ (0.05,0) [0|204.75] "m"  VCM
 SG_ FLCObject17_LatAcc : 248|9@1+ (0.08,-20) [-20|20.88] "m_per_s_squared"  VCM
 SG_ FLCObject17_AnglRightCorner : 199|10@1+ (0.005,-1.57) [-1.57|3.545] "rad"  VCM
 SG_ FLCObject17_CRC : 0|16@1+ (1,0) [0|65535] "NotApplicable"  VCM
 SG_ FLCObject17_DistFarCorner : 176|12@1+ (0.05,0) [0|204.75] "m"  VCM
 SG_ FLCObject17_LongAcc : 239|9@1+ (0.08,-20) [-20|20.88] "m_per_s_squared"  VCM
 SG_ FLCObject17_AngRightVar : 136|8@1+ (1E-005,0) [0|0.00255] "NotApplicable"  VCM
 SG_ FLCObject17_CoastIndex : 328|5@1+ (1,0) [0|31] "NotApplicable"  VCM
 SG_ FLCObject17_ObjClass : 316|4@1+ (1,0) [0|0] ""  VCM
 SG_ FLCObject17_TrackStatus : 339|3@1+ (1,0) [0|0] ""  VCM
 SG_ FLCObject17_LongPos : 290|13@1+ (0.05,-180) [-180|229.55] "m"  VCM
 SG_ FLCObject17_LongVelVar : 88|8@1+ (0.4,0) [0|102] "NotApplicable"  VCM
 SG_ FLCObject17_ObjID : 320|6@1+ (1,0) [0|63] "NotApplicable"  VCM
 SG_ FLCObject17_LongPosVar : 144|8@1+ (0.4,0) [0|102] "NotApplicable"  VCM
 SG_ FLCObject17_DstRightVar : 80|8@1+ (0.4,0) [0|102] "NotApplicable"  VCM
 SG_ FLCObject17_DstLeftVar : 112|8@1+ (0.4,0) [0|102] "NotApplicable"  VCM
 SG_ FLCObject17_Height : 96|8@1+ (0.02,0) [0|5.1] "m"  VCM
 SG_ FLCObject17_LatPos : 264|13@1+ (0.05,-180) [-180|229.55] "m"  VCM
 SG_ FLCObject17_LongVel : 303|13@1+ (0.032,-80) [-80|182.112] "m_per_s"  VCM
 SG_ FLCObject17_LatVel : 277|13@1+ (0.032,-80) [-80|182.112] "m_per_s"  VCM
 SG_ FLCObject17_DistRightCorner : 164|12@1+ (0.05,0) [0|204.75] "m"  VCM
 SG_ FLCObject17_AngFarVar : 128|8@1+ (1E-005,0) [0|0.00255] "NotApplicable"  VCM
 SG_ FLCObject17_TurnIndication : 333|3@1+ (1,0) [0|0] ""  VCM
 SG_ FLCObject17_AnglLeftCorner : 209|10@1+ (0.005,-1.57) [-1.57|3.545] "rad"  VCM
 SG_ FLCObject17_TimeStamp : 48|16@1+ (0.1,0) [0|6553.5] "ms"  VCM
 SG_ FLCObject17_ExistConf : 257|7@1+ (0.01,0) [0|1.27] "NotApplicable"  VCM
 SG_ FLCObject17_Counter : 16|8@1+ (1,0) [0|255] "Count"  VCM
 SG_ FLCObject17_Heading : 188|11@1+ (0.005818,-4.71) [-4.71|7.199446] "rad"  VCM
 SG_ FLCObject17_AnglFarCorner : 229|10@1+ (0.005,-1.57) [-1.57|3.545] "rad"  VCM
 SG_ FLCObject17_ReliabilityConf : 336|3@1+ (1,0) [0|0] ""  VCM
 SG_ FLCObject17_AngLeftVar : 120|8@1+ (1E-005,0) [0|0.00255] "NotApplicable"  VCM
 SG_ FLCObject17_ScaleChange : 219|10@1+ (0.002,0) [0|2.046] "NotApplicable"  VCM
 SG_ FLCObject17_LatPosVar : 40|8@1+ (0.1,0) [0|25.5] "NotApplicable"  VCM
 SG_ FLCObject17_LatVelVar : 32|8@1+ (0.1,0) [0|25.5] "NotApplicable"  VCM
 SG_ FLCObject17_ObjDynClass : 326|2@1+ (1,0) [0|0] ""  VCM
 SG_ FLCObject17_BrakeLight : 345|3@1+ (1,0) [0|0] ""  VCM
 SG_ FLCObject17_HeadingVar : 104|8@1+ (0.1,0) [0|25.5] "NotApplicable"  VCM

BO_ 800 FLCObject16_Vic2: 48 FLC2
 SG_ FLCObject16_LatPos : 264|13@1+ (0.05,-180) [-180|229.55] "m"  VCM
 SG_ FLCObject16_LifeTime : 64|16@1+ (0.1,0) [0|6553.5] "s"  VCM
 SG_ FLCObject16_ObjID : 320|6@1+ (1,0) [0|63] "NotApplicable"  VCM
 SG_ FLCObject16_LongAcc : 239|9@1+ (0.08,-20) [-20|20.88] "m_per_s_squared"  VCM
 SG_ FLCObject16_DstRightVar : 80|8@1+ (0.4,0) [0|102] "NotApplicable"  VCM
 SG_ FLCObject16_Counter : 16|8@1+ (1,0) [0|255] "Count"  VCM
 SG_ FLCObject16_AnglFarCorner : 229|10@1+ (0.005,-1.57) [-1.57|3.545] "rad"  VCM
 SG_ FLCObject16_DstLeftVar : 112|8@1+ (0.4,0) [0|102] "NotApplicable"  VCM
 SG_ FLCObject16_DistRightCorner : 164|12@1+ (0.05,0) [0|204.75] "m"  VCM
 SG_ FLCObject16_LatVel : 277|13@1+ (0.032,-80) [-80|182.112] "m_per_s"  VCM
 SG_ FLCObject16_LatAcc : 248|9@1+ (0.08,-20) [-20|20.88] "m_per_s_squared"  VCM
 SG_ FLCObject16_Heading : 188|11@1+ (0.005818,-4.71) [-4.71|7.199446] "rad"  VCM
 SG_ FLCObject16_BrakeLight : 345|3@1+ (1,0) [0|0] ""  VCM
 SG_ FLCObject16_DstFarVar : 24|8@1+ (0.4,0) [0|102] "NotApplicable"  VCM
 SG_ FLCObject16_ScaleChange : 219|10@1+ (0.002,0) [0|2.046] "NotApplicable"  VCM
 SG_ FLCObject16_TimeStamp : 48|16@1+ (0.1,0) [0|6553.5] "ms"  VCM
 SG_ FLCObject16_TrackStatus : 339|3@1+ (1,0) [0|0] ""  VCM
 SG_ FLCObject16_LatVelVar : 32|8@1+ (0.1,0) [0|25.5] "NotApplicable"  VCM
 SG_ FLCObject16_LongPos : 290|13@1+ (0.05,-180) [-180|229.55] "m"  VCM
 SG_ FLCObject16_ExistConf : 257|7@1+ (0.01,0) [0|1.27] "NotApplicable"  VCM
 SG_ FLCObject16_CoastIndex : 328|5@1+ (1,0) [0|31] "NotApplicable"  VCM
 SG_ FLCObject16_TargetToLine : 342|3@1+ (1,0) [0|0] ""  VCM
 SG_ FLCObject16_AngRightVar : 136|8@1+ (1E-005,0) [0|0.00255] "NotApplicable"  VCM
 SG_ FLCObject16_ObjDynClass : 326|2@1+ (1,0) [0|0] ""  VCM
 SG_ FLCObject16_AnglRightCorner : 199|10@1+ (0.005,-1.57) [-1.57|3.545] "rad"  VCM
 SG_ FLCObject16_HeadingVar : 104|8@1+ (0.1,0) [0|25.5] "NotApplicable"  VCM
 SG_ FLCObject16_DistFarCorner : 176|12@1+ (0.05,0) [0|204.75] "m"  VCM
 SG_ FLCObject16_AngFarVar : 128|8@1+ (1E-005,0) [0|0.00255] "NotApplicable"  VCM
 SG_ FLCObject16_LongVelVar : 88|8@1+ (0.4,0) [0|102] "NotApplicable"  VCM
 SG_ FLCObject16_LatPosVar : 40|8@1+ (0.1,0) [0|25.5] "NotApplicable"  VCM
 SG_ FLCObject16_LongPosVar : 144|8@1+ (0.4,0) [0|102] "NotApplicable"  VCM
 SG_ FLCObject16_DistLeftCorner : 152|12@1+ (0.05,0) [0|204.75] "m"  VCM
 SG_ FLCObject16_Height : 96|8@1+ (0.02,0) [0|5.1] "m"  VCM
 SG_ FLCObject16_LongVel : 303|13@1+ (0.032,-80) [-80|182.112] "m_per_s"  VCM
 SG_ FLCObject16_CRC : 0|16@1+ (1,0) [0|65535] "NotApplicable"  VCM
 SG_ FLCObject16_ObjClass : 316|4@1+ (1,0) [0|0] ""  VCM
 SG_ FLCObject16_AnglLeftCorner : 209|10@1+ (0.005,-1.57) [-1.57|3.545] "rad"  VCM
 SG_ FLCObject16_TurnIndication : 333|3@1+ (1,0) [0|0] ""  VCM
 SG_ FLCObject16_ReliabilityConf : 336|3@1+ (1,0) [0|0] ""  VCM
 SG_ FLCObject16_AngLeftVar : 120|8@1+ (1E-005,0) [0|0.00255] "NotApplicable"  VCM

BO_ 799 FLCObject15_Vic2: 48 FLC2
 SG_ FLCObject15_LongVel : 303|13@1+ (0.032,-80) [-80|182.112] "m_per_s"  VCM
 SG_ FLCObject15_ScaleChange : 219|10@1+ (0.002,0) [0|2.046] "NotApplicable"  VCM
 SG_ FLCObject15_DistLeftCorner : 152|12@1+ (0.05,0) [0|204.75] "m"  VCM
 SG_ FLCObject15_DstRightVar : 80|8@1+ (0.4,0) [0|102] "NotApplicable"  VCM
 SG_ FLCObject15_LatVel : 277|13@1+ (0.032,-80) [-80|182.112] "m_per_s"  VCM
 SG_ FLCObject15_LatPos : 264|13@1+ (0.05,-180) [-180|229.55] "m"  VCM
 SG_ FLCObject15_TargetToLine : 342|3@1+ (1,0) [0|0] ""  VCM
 SG_ FLCObject15_AnglLeftCorner : 209|10@1+ (0.005,-1.57) [-1.57|3.545] "rad"  VCM
 SG_ FLCObject15_AnglRightCorner : 199|10@1+ (0.005,-1.57) [-1.57|3.545] "rad"  VCM
 SG_ FLCObject15_DstLeftVar : 112|8@1+ (0.4,0) [0|102] "NotApplicable"  VCM
 SG_ FLCObject15_LatAcc : 248|9@1+ (0.08,-20) [-20|20.88] "m_per_s_squared"  VCM
 SG_ FLCObject15_ObjDynClass : 326|2@1+ (1,0) [0|0] ""  VCM
 SG_ FLCObject15_TrackStatus : 339|3@1+ (1,0) [0|0] ""  VCM
 SG_ FLCObject15_LongAcc : 239|9@1+ (0.08,-20) [-20|20.88] "m_per_s_squared"  VCM
 SG_ FLCObject15_CRC : 0|16@1+ (1,0) [0|65535] "NotApplicable"  VCM
 SG_ FLCObject15_Height : 96|8@1+ (0.02,0) [0|5.1] "m"  VCM
 SG_ FLCObject15_Heading : 188|11@1+ (0.005818,-4.71) [-4.71|7.199446] "rad"  VCM
 SG_ FLCObject15_LatVelVar : 32|8@1+ (0.1,0) [0|25.5] "NotApplicable"  VCM
 SG_ FLCObject15_DistFarCorner : 176|12@1+ (0.05,0) [0|204.75] "m"  VCM
 SG_ FLCObject15_CoastIndex : 328|5@1+ (1,0) [0|31] "NotApplicable"  VCM
 SG_ FLCObject15_ExistConf : 257|7@1+ (0.01,0) [0|1.27] "NotApplicable"  VCM
 SG_ FLCObject15_LatPosVar : 40|8@1+ (0.1,0) [0|25.5] "NotApplicable"  VCM
 SG_ FLCObject15_BrakeLight : 345|3@1+ (1,0) [0|0] ""  VCM
 SG_ FLCObject15_HeadingVar : 104|8@1+ (0.1,0) [0|25.5] "NotApplicable"  VCM
 SG_ FLCObject15_DistRightCorner : 164|12@1+ (0.05,0) [0|204.75] "m"  VCM
 SG_ FLCObject15_LongVelVar : 88|8@1+ (0.4,0) [0|102] "NotApplicable"  VCM
 SG_ FLCObject15_LongPosVar : 144|8@1+ (0.4,0) [0|102] "NotApplicable"  VCM
 SG_ FLCObject15_AngLeftVar : 120|8@1+ (1E-005,0) [0|0.00255] "NotApplicable"  VCM
 SG_ FLCObject15_ObjID : 320|6@1+ (1,0) [0|63] "NotApplicable"  VCM
 SG_ FLCObject15_AngRightVar : 136|8@1+ (1E-005,0) [0|0.00255] "NotApplicable"  VCM
 SG_ FLCObject15_ObjClass : 316|4@1+ (1,0) [0|0] ""  VCM
 SG_ FLCObject15_ReliabilityConf : 336|3@1+ (1,0) [0|0] ""  VCM
 SG_ FLCObject15_LongPos : 290|13@1+ (0.05,-180) [-180|229.55] "m"  VCM
 SG_ FLCObject15_TurnIndication : 333|3@1+ (1,0) [0|0] ""  VCM
 SG_ FLCObject15_AngFarVar : 128|8@1+ (1E-005,0) [0|0.00255] "NotApplicable"  VCM
 SG_ FLCObject15_AnglFarCorner : 229|10@1+ (0.005,-1.57) [-1.57|3.545] "rad"  VCM
 SG_ FLCObject15_DstFarVar : 24|8@1+ (0.4,0) [0|102] "NotApplicable"  VCM
 SG_ FLCObject15_Counter : 16|8@1+ (1,0) [0|255] "Count"  VCM
 SG_ FLCObject15_LifeTime : 64|16@1+ (0.1,0) [0|6553.5] "s"  VCM
 SG_ FLCObject15_TimeStamp : 48|16@1+ (0.1,0) [0|6553.5] "ms"  VCM

BO_ 798 FLCObject14_Vic2: 48 FLC2
 SG_ FLCObject14_LongPosVar : 144|8@1+ (0.4,0) [0|102] "NotApplicable"  VCM
 SG_ FLCObject14_BrakeLight : 345|3@1+ (1,0) [0|0] ""  VCM
 SG_ FLCObject14_AnglRightCorner : 199|10@1+ (0.005,-1.57) [-1.57|3.545] "rad"  VCM
 SG_ FLCObject14_Heading : 188|11@1+ (0.005818,-4.71) [-4.71|7.199446] "rad"  VCM
 SG_ FLCObject14_CoastIndex : 328|5@1+ (1,0) [0|31] "NotApplicable"  VCM
 SG_ FLCObject14_ObjDynClass : 326|2@1+ (1,0) [0|0] ""  VCM
 SG_ FLCObject14_DistLeftCorner : 152|12@1+ (0.05,0) [0|204.75] "m"  VCM
 SG_ FLCObject14_LongPos : 290|13@1+ (0.05,-180) [-180|229.55] "m"  VCM
 SG_ FLCObject14_AnglFarCorner : 229|10@1+ (0.005,-1.57) [-1.57|3.545] "rad"  VCM
 SG_ FLCObject14_DstRightVar : 80|8@1+ (0.4,0) [0|102] "NotApplicable"  VCM
 SG_ FLCObject14_LifeTime : 64|16@1+ (0.1,0) [0|6553.5] "s"  VCM
 SG_ FLCObject14_ExistConf : 257|7@1+ (0.01,0) [0|1.27] "NotApplicable"  VCM
 SG_ FLCObject14_Height : 96|8@1+ (0.02,0) [0|5.1] "m"  VCM
 SG_ FLCObject14_TurnIndication : 333|3@1+ (1,0) [0|0] ""  VCM
 SG_ FLCObject14_ObjID : 320|6@1+ (1,0) [0|63] "NotApplicable"  VCM
 SG_ FLCObject14_LatPosVar : 40|8@1+ (0.1,0) [0|25.5] "NotApplicable"  VCM
 SG_ FLCObject14_TimeStamp : 48|16@1+ (0.1,0) [0|6553.5] "ms"  VCM
 SG_ FLCObject14_DstFarVar : 24|8@1+ (0.4,0) [0|102] "NotApplicable"  VCM
 SG_ FLCObject14_ReliabilityConf : 336|3@1+ (1,0) [0|0] ""  VCM
 SG_ FLCObject14_TargetToLine : 342|3@1+ (1,0) [0|0] ""  VCM
 SG_ FLCObject14_AngLeftVar : 120|8@1+ (1E-005,0) [0|0.00255] "NotApplicable"  VCM
 SG_ FLCObject14_DistFarCorner : 176|12@1+ (0.05,0) [0|204.75] "m"  VCM
 SG_ FLCObject14_AngRightVar : 136|8@1+ (1E-005,0) [0|0.00255] "NotApplicable"  VCM
 SG_ FLCObject14_CRC : 0|16@1+ (1,0) [0|65535] "NotApplicable"  VCM
 SG_ FLCObject14_LatPos : 264|13@1+ (0.05,-180) [-180|229.55] "m"  VCM
 SG_ FLCObject14_AngFarVar : 128|8@1+ (1E-005,0) [0|0.00255] "NotApplicable"  VCM
 SG_ FLCObject14_Counter : 16|8@1+ (1,0) [0|255] "Count"  VCM
 SG_ FLCObject14_DistRightCorner : 164|12@1+ (0.05,0) [0|204.75] "m"  VCM
 SG_ FLCObject14_ObjClass : 316|4@1+ (1,0) [0|0] ""  VCM
 SG_ FLCObject14_ScaleChange : 219|10@1+ (0.002,0) [0|2.046] "NotApplicable"  VCM
 SG_ FLCObject14_HeadingVar : 104|8@1+ (0.1,0) [0|25.5] "NotApplicable"  VCM
 SG_ FLCObject14_LongVelVar : 88|8@1+ (0.4,0) [0|102] "NotApplicable"  VCM
 SG_ FLCObject14_LatAcc : 248|9@1+ (0.08,-20) [-20|20.88] "m_per_s_squared"  VCM
 SG_ FLCObject14_LongVel : 303|13@1+ (0.032,-80) [-80|182.112] "m_per_s"  VCM
 SG_ FLCObject14_AnglLeftCorner : 209|10@1+ (0.005,-1.57) [-1.57|3.545] "rad"  VCM
 SG_ FLCObject14_TrackStatus : 339|3@1+ (1,0) [0|0] ""  VCM
 SG_ FLCObject14_LongAcc : 239|9@1+ (0.08,-20) [-20|20.88] "m_per_s_squared"  VCM
 SG_ FLCObject14_DstLeftVar : 112|8@1+ (0.4,0) [0|102] "NotApplicable"  VCM
 SG_ FLCObject14_LatVelVar : 32|8@1+ (0.1,0) [0|25.5] "NotApplicable"  VCM
 SG_ FLCObject14_LatVel : 277|13@1+ (0.032,-80) [-80|182.112] "m_per_s"  VCM

BA_DEF_ BO_  "GenMsgStartDelayTime" INT 0 0;
BA_DEF_ BO_  "GenMsgDelayTime" INT 0 0;
BA_DEF_ BO_  "GenMsgCycleTime" INT 0 0;
BA_DEF_ BO_  "GenMsgSendType" ENUM  "Cyclic","NotUsed","NotUsed","NotUsed","NotUsed","NotUsed","NotUsed","IfActive","NoMsgSendType","NotUsed";
BA_DEF_ SG_  "GenSigStartValue" INT 0 0;
BA_DEF_ SG_  "GenSigCycleTimeActive" INT 0 0;
BA_DEF_ SG_  "GenSigCycleTime" INT 0 0;
BA_DEF_ SG_  "GenSigSendType" ENUM  "Cyclic","OnWrite","OnWriteWithRepetition","OnChange","OnChangeWithRepetition","IfActive","IfActiveWithRepetition","NoSigSendType","NotUsed","NotUsed","NotUsed","NotUsed","NotUsed";
BA_DEF_ BO_  "VFrameFormat" ENUM  "StandardCAN","ExtendedCAN","reserved","J1939PG","reserved","reserved","reserved","reserved","reserved","reserved","reserved","reserved","reserved","reserved","StandardCAN_FD","ExtendedCAN_FD";
BA_DEF_ SG_  "SigType" ENUM  "Default","Range","RangeSigned","ASCII","Discrete","Control","ReferencePGN","DTC","StringDelimiter","StringLength","StringLengthControl";
BA_DEF_ SG_  "SeToolVersion_SIGNAL" STRING ;
BA_DEF_ SG_  "SeToolUniqueID_SIGNAL" STRING ;
BA_DEF_ SG_  "SeToolName_SIGNAL" STRING ;
BA_DEF_ SG_  "SeToolItemID_SIGNAL" STRING ;
BA_DEF_ SG_  "SeToolAncestorID_SIGNAL" STRING ;
BA_DEF_ SG_  "NeedsUpdateBit" ENUM  "No","Yes";
BA_DEF_ SG_  "GenSigILSupport" ENUM  "Yes","No";
BA_DEF_ BO_  "GenMsgILSupport" ENUM  "No","Yes";
BA_DEF_ SG_  "E2EProfile" STRING ;
BA_DEF_ SG_  "E2EDataLength" INT 0 65535;
BA_DEF_ SG_  "E2EDataId" INT 0 65535;
BA_DEF_ BO_  "DiagUUDTResponse" ENUM  "No","Yes";
BA_DEF_ BO_  "DiagState" ENUM  "No","Yes";
BA_DEF_ BO_  "DiagResponse" ENUM  "No","Yes";
BA_DEF_ BO_  "DiagRequest" ENUM  "No","Yes";
BA_DEF_ BO_  "DiagConnection" HEX 0 65535;
BA_DEF_ BO_  "CanTpFcFrameId" HEX 0 2147483647;
BA_DEF_ BO_  "CanTpBs" INT 0 255;
BA_DEF_ BO_  "CANFD_BRS" ENUM  "0","1";
BA_DEF_REL_ BU_SG_REL_  "GenSigTimeoutTime" INT 0 65535;
BA_DEF_REL_ BU_SG_REL_  "GenSigFirstTimeoutTime" INT 0 65535;
BA_DEF_DEF_  "GenMsgStartDelayTime" 0;
BA_DEF_DEF_  "GenMsgDelayTime" 0;
BA_DEF_DEF_  "GenMsgCycleTime" 0;
BA_DEF_DEF_  "GenMsgSendType" "Cyclic";
BA_DEF_DEF_  "GenSigStartValue" 0;
BA_DEF_DEF_  "GenSigCycleTimeActive" 0;
BA_DEF_DEF_  "GenSigCycleTime" 0;
BA_DEF_DEF_  "GenSigSendType" "Cyclic";
BA_DEF_DEF_  "VFrameFormat" "ExtendedCAN";
BA_DEF_DEF_  "SigType" "Default";
BA_DEF_DEF_  "SeToolVersion_SIGNAL" "";
BA_DEF_DEF_  "SeToolUniqueID_SIGNAL" "";
BA_DEF_DEF_  "SeToolName_SIGNAL" "";
BA_DEF_DEF_  "SeToolItemID_SIGNAL" "";
BA_DEF_DEF_  "SeToolAncestorID_SIGNAL" "";
BA_DEF_DEF_  "NeedsUpdateBit" "No";
BA_DEF_DEF_  "GenSigILSupport" "Yes";
BA_DEF_DEF_  "GenMsgILSupport" "Yes";
BA_DEF_DEF_  "E2EProfile" "none";
BA_DEF_DEF_  "E2EDataLength" 0;
BA_DEF_DEF_  "E2EDataId" 0;
BA_DEF_DEF_  "DiagUUDTResponse" "No";
BA_DEF_DEF_  "DiagState" "No";
BA_DEF_DEF_  "DiagResponse" "No";
BA_DEF_DEF_  "DiagRequest" "No";
BA_DEF_DEF_  "DiagConnection" 0;
BA_DEF_DEF_  "CanTpFcFrameId" 2147483647;
BA_DEF_DEF_  "CanTpBs" 255;
BA_DEF_DEF_  "CANFD_BRS" "0";
BA_DEF_DEF_REL_ "GenSigTimeoutTime" 0;
BA_DEF_DEF_REL_ "GenSigFirstTimeoutTime" 0;
BA_ "CANFD_BRS" BO_ 806 1;
BA_ "GenMsgSendType" BO_ 806 8;
BA_ "VFrameFormat" BO_ 806 14;
BA_ "CANFD_BRS" BO_ 805 1;
BA_ "GenMsgSendType" BO_ 805 8;
BA_ "VFrameFormat" BO_ 805 14;
BA_ "CANFD_BRS" BO_ 804 1;
BA_ "GenMsgSendType" BO_ 804 8;
BA_ "VFrameFormat" BO_ 804 14;
BA_ "CANFD_BRS" BO_ 803 1;
BA_ "GenMsgSendType" BO_ 803 8;
BA_ "VFrameFormat" BO_ 803 14;
BA_ "CANFD_BRS" BO_ 802 1;
BA_ "GenMsgSendType" BO_ 802 8;
BA_ "VFrameFormat" BO_ 802 14;
BA_ "CANFD_BRS" BO_ 801 1;
BA_ "GenMsgSendType" BO_ 801 8;
BA_ "VFrameFormat" BO_ 801 14;
BA_ "CANFD_BRS" BO_ 800 1;
BA_ "GenMsgSendType" BO_ 800 8;
BA_ "VFrameFormat" BO_ 800 14;
BA_ "CANFD_BRS" BO_ 799 1;
BA_ "GenMsgSendType" BO_ 799 8;
BA_ "VFrameFormat" BO_ 799 14;
BA_ "CANFD_BRS" BO_ 798 1;
BA_ "GenMsgSendType" BO_ 798 8;
BA_ "VFrameFormat" BO_ 798 14;
BA_ "GenSigSendType" SG_ 806 FLCObject22_HeadingVar 1;
BA_ "GenSigStartValue" SG_ 806 FLCObject22_HeadingVar 255;
BA_ "GenSigSendType" SG_ 806 FLCObject22_DstRightVar 1;
BA_ "GenSigStartValue" SG_ 806 FLCObject22_DstRightVar 255;
BA_ "GenSigSendType" SG_ 806 FLCObject22_LatPos 1;
BA_ "GenSigStartValue" SG_ 806 FLCObject22_LatPos 8191;
BA_ "GenSigSendType" SG_ 806 FLCObject22_TrackStatus 1;
BA_ "GenSigStartValue" SG_ 806 FLCObject22_TrackStatus 7;
BA_ "GenSigSendType" SG_ 806 FLCObject22_ObjID 1;
BA_ "GenSigStartValue" SG_ 806 FLCObject22_ObjID 63;
BA_ "GenSigSendType" SG_ 806 FLCObject22_CoastIndex 1;
BA_ "GenSigStartValue" SG_ 806 FLCObject22_CoastIndex 31;
BA_ "GenSigSendType" SG_ 806 FLCObject22_LatVel 1;
BA_ "GenSigStartValue" SG_ 806 FLCObject22_LatVel 8191;
BA_ "GenSigSendType" SG_ 806 FLCObject22_LongPos 1;
BA_ "GenSigStartValue" SG_ 806 FLCObject22_LongPos 8191;
BA_ "GenSigSendType" SG_ 806 FLCObject22_TimeStamp 1;
BA_ "GenSigStartValue" SG_ 806 FLCObject22_TimeStamp 65535;
BA_ "GenSigSendType" SG_ 806 FLCObject22_ReliabilityConf 1;
BA_ "GenSigStartValue" SG_ 806 FLCObject22_ReliabilityConf 7;
BA_ "GenSigSendType" SG_ 806 FLCObject22_LatVelVar 1;
BA_ "GenSigStartValue" SG_ 806 FLCObject22_LatVelVar 255;
BA_ "GenSigSendType" SG_ 806 FLCObject22_DistRightCorner 1;
BA_ "GenSigStartValue" SG_ 806 FLCObject22_DistRightCorner 4095;
BA_ "GenSigSendType" SG_ 806 FLCObject22_AngRightVar 1;
BA_ "GenSigStartValue" SG_ 806 FLCObject22_AngRightVar 255;
BA_ "GenSigSendType" SG_ 806 FLCObject22_ExistConf 1;
BA_ "GenSigStartValue" SG_ 806 FLCObject22_ExistConf 127;
BA_ "GenSigSendType" SG_ 806 FLCObject22_LatPosVar 1;
BA_ "GenSigStartValue" SG_ 806 FLCObject22_LatPosVar 255;
BA_ "GenSigSendType" SG_ 806 FLCObject22_CRC 1;
BA_ "GenSigStartValue" SG_ 806 FLCObject22_CRC 65535;
BA_ "E2EDataId" SG_ 806 FLCObject22_CRC 127;
BA_ "E2EDataLength" SG_ 806 FLCObject22_CRC 352;
BA_ "E2EProfile" SG_ 806 FLCObject22_CRC "P05";
BA_ "GenSigSendType" SG_ 806 FLCObject22_DstLeftVar 1;
BA_ "GenSigStartValue" SG_ 806 FLCObject22_DstLeftVar 255;
BA_ "GenSigSendType" SG_ 806 FLCObject22_Heading 1;
BA_ "GenSigStartValue" SG_ 806 FLCObject22_Heading 2047;
BA_ "GenSigSendType" SG_ 806 FLCObject22_Height 1;
BA_ "GenSigStartValue" SG_ 806 FLCObject22_Height 255;
BA_ "GenSigSendType" SG_ 806 FLCObject22_TurnIndication 1;
BA_ "GenSigStartValue" SG_ 806 FLCObject22_TurnIndication 7;
BA_ "GenSigSendType" SG_ 806 FLCObject22_AnglFarCorner 1;
BA_ "GenSigStartValue" SG_ 806 FLCObject22_AnglFarCorner 1023;
BA_ "GenSigSendType" SG_ 806 FLCObject22_AnglRightCorner 1;
BA_ "GenSigStartValue" SG_ 806 FLCObject22_AnglRightCorner 1023;
BA_ "GenSigSendType" SG_ 806 FLCObject22_LongAcc 1;
BA_ "GenSigStartValue" SG_ 806 FLCObject22_LongAcc 511;
BA_ "GenSigSendType" SG_ 806 FLCObject22_AngFarVar 1;
BA_ "GenSigStartValue" SG_ 806 FLCObject22_AngFarVar 255;
BA_ "GenSigSendType" SG_ 806 FLCObject22_AnglLeftCorner 1;
BA_ "GenSigStartValue" SG_ 806 FLCObject22_AnglLeftCorner 1023;
BA_ "GenSigSendType" SG_ 806 FLCObject22_Counter 1;
BA_ "GenSigStartValue" SG_ 806 FLCObject22_Counter 255;
BA_ "GenSigSendType" SG_ 806 FLCObject22_LongVelVar 1;
BA_ "GenSigStartValue" SG_ 806 FLCObject22_LongVelVar 255;
BA_ "GenSigSendType" SG_ 806 FLCObject22_ObjClass 1;
BA_ "GenSigStartValue" SG_ 806 FLCObject22_ObjClass 15;
BA_ "GenSigSendType" SG_ 806 FLCObject22_DistFarCorner 1;
BA_ "GenSigStartValue" SG_ 806 FLCObject22_DistFarCorner 4095;
BA_ "GenSigSendType" SG_ 806 FLCObject22_BrakeLight 1;
BA_ "GenSigStartValue" SG_ 806 FLCObject22_BrakeLight 7;
BA_ "GenSigSendType" SG_ 806 FLCObject22_LongVel 1;
BA_ "GenSigStartValue" SG_ 806 FLCObject22_LongVel 8191;
BA_ "GenSigSendType" SG_ 806 FLCObject22_ScaleChange 1;
BA_ "GenSigStartValue" SG_ 806 FLCObject22_ScaleChange 1023;
BA_ "GenSigSendType" SG_ 806 FLCObject22_TargetToLine 1;
BA_ "GenSigStartValue" SG_ 806 FLCObject22_TargetToLine 7;
BA_ "GenSigSendType" SG_ 806 FLCObject22_LifeTime 1;
BA_ "GenSigStartValue" SG_ 806 FLCObject22_LifeTime 65535;
BA_ "GenSigSendType" SG_ 806 FLCObject22_LongPosVar 1;
BA_ "GenSigStartValue" SG_ 806 FLCObject22_LongPosVar 255;
BA_ "GenSigSendType" SG_ 806 FLCObject22_DistLeftCorner 1;
BA_ "GenSigStartValue" SG_ 806 FLCObject22_DistLeftCorner 4095;
BA_ "GenSigSendType" SG_ 806 FLCObject22_ObjDynClass 1;
BA_ "GenSigStartValue" SG_ 806 FLCObject22_ObjDynClass 3;
BA_ "GenSigSendType" SG_ 806 FLCObject22_LatAcc 1;
BA_ "GenSigStartValue" SG_ 806 FLCObject22_LatAcc 511;
BA_ "GenSigSendType" SG_ 806 FLCObject22_DstFarVar 1;
BA_ "GenSigStartValue" SG_ 806 FLCObject22_DstFarVar 255;
BA_ "GenSigSendType" SG_ 806 FLCObject22_AngLeftVar 1;
BA_ "GenSigStartValue" SG_ 806 FLCObject22_AngLeftVar 255;
BA_ "GenSigSendType" SG_ 805 FLCObject21_ScaleChange 1;
BA_ "GenSigStartValue" SG_ 805 FLCObject21_ScaleChange 1023;
BA_ "GenSigSendType" SG_ 805 FLCObject21_DistFarCorner 1;
BA_ "GenSigStartValue" SG_ 805 FLCObject21_DistFarCorner 4095;
BA_ "GenSigSendType" SG_ 805 FLCObject21_Heading 1;
BA_ "GenSigStartValue" SG_ 805 FLCObject21_Heading 2047;
BA_ "GenSigSendType" SG_ 805 FLCObject21_LongAcc 1;
BA_ "GenSigStartValue" SG_ 805 FLCObject21_LongAcc 511;
BA_ "GenSigSendType" SG_ 805 FLCObject21_CRC 1;
BA_ "GenSigStartValue" SG_ 805 FLCObject21_CRC 65535;
BA_ "E2EDataId" SG_ 805 FLCObject21_CRC 126;
BA_ "E2EDataLength" SG_ 805 FLCObject21_CRC 352;
BA_ "E2EProfile" SG_ 805 FLCObject21_CRC "P05";
BA_ "GenSigSendType" SG_ 805 FLCObject21_ObjID 1;
BA_ "GenSigStartValue" SG_ 805 FLCObject21_ObjID 63;
BA_ "GenSigSendType" SG_ 805 FLCObject21_DstLeftVar 1;
BA_ "GenSigStartValue" SG_ 805 FLCObject21_DstLeftVar 255;
BA_ "GenSigSendType" SG_ 805 FLCObject21_DstFarVar 1;
BA_ "GenSigStartValue" SG_ 805 FLCObject21_DstFarVar 255;
BA_ "GenSigSendType" SG_ 805 FLCObject21_ObjClass 1;
BA_ "GenSigStartValue" SG_ 805 FLCObject21_ObjClass 15;
BA_ "GenSigSendType" SG_ 805 FLCObject21_ObjDynClass 1;
BA_ "GenSigStartValue" SG_ 805 FLCObject21_ObjDynClass 3;
BA_ "GenSigSendType" SG_ 805 FLCObject21_ExistConf 1;
BA_ "GenSigStartValue" SG_ 805 FLCObject21_ExistConf 127;
BA_ "GenSigSendType" SG_ 805 FLCObject21_DstRightVar 1;
BA_ "GenSigStartValue" SG_ 805 FLCObject21_DstRightVar 255;
BA_ "GenSigSendType" SG_ 805 FLCObject21_ReliabilityConf 1;
BA_ "GenSigStartValue" SG_ 805 FLCObject21_ReliabilityConf 7;
BA_ "GenSigSendType" SG_ 805 FLCObject21_LongVelVar 1;
BA_ "GenSigStartValue" SG_ 805 FLCObject21_LongVelVar 255;
BA_ "GenSigSendType" SG_ 805 FLCObject21_LongPosVar 1;
BA_ "GenSigStartValue" SG_ 805 FLCObject21_LongPosVar 255;
BA_ "GenSigSendType" SG_ 805 FLCObject21_TargetToLine 1;
BA_ "GenSigStartValue" SG_ 805 FLCObject21_TargetToLine 7;
BA_ "GenSigSendType" SG_ 805 FLCObject21_Counter 1;
BA_ "GenSigStartValue" SG_ 805 FLCObject21_Counter 255;
BA_ "GenSigSendType" SG_ 805 FLCObject21_DistLeftCorner 1;
BA_ "GenSigStartValue" SG_ 805 FLCObject21_DistLeftCorner 4095;
BA_ "GenSigSendType" SG_ 805 FLCObject21_LatVel 1;
BA_ "GenSigStartValue" SG_ 805 FLCObject21_LatVel 8191;
BA_ "GenSigSendType" SG_ 805 FLCObject21_LatVelVar 1;
BA_ "GenSigStartValue" SG_ 805 FLCObject21_LatVelVar 255;
BA_ "GenSigSendType" SG_ 805 FLCObject21_LatPos 1;
BA_ "GenSigStartValue" SG_ 805 FLCObject21_LatPos 8191;
BA_ "GenSigSendType" SG_ 805 FLCObject21_LongVel 1;
BA_ "GenSigStartValue" SG_ 805 FLCObject21_LongVel 8191;
BA_ "GenSigSendType" SG_ 805 FLCObject21_AngLeftVar 1;
BA_ "GenSigStartValue" SG_ 805 FLCObject21_AngLeftVar 255;
BA_ "GenSigSendType" SG_ 805 FLCObject21_AngRightVar 1;
BA_ "GenSigStartValue" SG_ 805 FLCObject21_AngRightVar 255;
BA_ "GenSigSendType" SG_ 805 FLCObject21_AnglFarCorner 1;
BA_ "GenSigStartValue" SG_ 805 FLCObject21_AnglFarCorner 1023;
BA_ "GenSigSendType" SG_ 805 FLCObject21_DistRightCorner 1;
BA_ "GenSigStartValue" SG_ 805 FLCObject21_DistRightCorner 4095;
BA_ "GenSigSendType" SG_ 805 FLCObject21_LifeTime 1;
BA_ "GenSigStartValue" SG_ 805 FLCObject21_LifeTime 65535;
BA_ "GenSigSendType" SG_ 805 FLCObject21_TrackStatus 1;
BA_ "GenSigStartValue" SG_ 805 FLCObject21_TrackStatus 7;
BA_ "GenSigSendType" SG_ 805 FLCObject21_AnglRightCorner 1;
BA_ "GenSigStartValue" SG_ 805 FLCObject21_AnglRightCorner 1023;
BA_ "GenSigSendType" SG_ 805 FLCObject21_LatAcc 1;
BA_ "GenSigStartValue" SG_ 805 FLCObject21_LatAcc 511;
BA_ "GenSigSendType" SG_ 805 FLCObject21_HeadingVar 1;
BA_ "GenSigStartValue" SG_ 805 FLCObject21_HeadingVar 255;
BA_ "GenSigSendType" SG_ 805 FLCObject21_LatPosVar 1;
BA_ "GenSigStartValue" SG_ 805 FLCObject21_LatPosVar 255;
BA_ "GenSigSendType" SG_ 805 FLCObject21_LongPos 1;
BA_ "GenSigStartValue" SG_ 805 FLCObject21_LongPos 8191;
BA_ "GenSigSendType" SG_ 805 FLCObject21_AngFarVar 1;
BA_ "GenSigStartValue" SG_ 805 FLCObject21_AngFarVar 255;
BA_ "GenSigSendType" SG_ 805 FLCObject21_TurnIndication 1;
BA_ "GenSigStartValue" SG_ 805 FLCObject21_TurnIndication 7;
BA_ "GenSigSendType" SG_ 805 FLCObject21_TimeStamp 1;
BA_ "GenSigStartValue" SG_ 805 FLCObject21_TimeStamp 65535;
BA_ "GenSigSendType" SG_ 805 FLCObject21_CoastIndex 1;
BA_ "GenSigStartValue" SG_ 805 FLCObject21_CoastIndex 31;
BA_ "GenSigSendType" SG_ 805 FLCObject21_Height 1;
BA_ "GenSigStartValue" SG_ 805 FLCObject21_Height 255;
BA_ "GenSigSendType" SG_ 805 FLCObject21_BrakeLight 1;
BA_ "GenSigStartValue" SG_ 805 FLCObject21_BrakeLight 7;
BA_ "GenSigSendType" SG_ 805 FLCObject21_AnglLeftCorner 1;
BA_ "GenSigStartValue" SG_ 805 FLCObject21_AnglLeftCorner 1023;
BA_ "GenSigSendType" SG_ 804 FLCObject20_DistLeftCorner 1;
BA_ "GenSigStartValue" SG_ 804 FLCObject20_DistLeftCorner 4095;
BA_ "GenSigSendType" SG_ 804 FLCObject20_HeadingVar 1;
BA_ "GenSigStartValue" SG_ 804 FLCObject20_HeadingVar 255;
BA_ "GenSigSendType" SG_ 804 FLCObject20_LatPosVar 1;
BA_ "GenSigStartValue" SG_ 804 FLCObject20_LatPosVar 255;
BA_ "GenSigSendType" SG_ 804 FLCObject20_ExistConf 1;
BA_ "GenSigStartValue" SG_ 804 FLCObject20_ExistConf 127;
BA_ "GenSigSendType" SG_ 804 FLCObject20_LatVel 1;
BA_ "GenSigStartValue" SG_ 804 FLCObject20_LatVel 8191;
BA_ "GenSigSendType" SG_ 804 FLCObject20_LongVelVar 1;
BA_ "GenSigStartValue" SG_ 804 FLCObject20_LongVelVar 255;
BA_ "GenSigSendType" SG_ 804 FLCObject20_LongVel 1;
BA_ "GenSigStartValue" SG_ 804 FLCObject20_LongVel 8191;
BA_ "GenSigSendType" SG_ 804 FLCObject20_AnglRightCorner 1;
BA_ "GenSigStartValue" SG_ 804 FLCObject20_AnglRightCorner 1023;
BA_ "GenSigSendType" SG_ 804 FLCObject20_DistRightCorner 1;
BA_ "GenSigStartValue" SG_ 804 FLCObject20_DistRightCorner 4095;
BA_ "GenSigSendType" SG_ 804 FLCObject20_Heading 1;
BA_ "GenSigStartValue" SG_ 804 FLCObject20_Heading 2047;
BA_ "GenSigSendType" SG_ 804 FLCObject20_BrakeLight 1;
BA_ "GenSigStartValue" SG_ 804 FLCObject20_BrakeLight 7;
BA_ "GenSigSendType" SG_ 804 FLCObject20_DstFarVar 1;
BA_ "GenSigStartValue" SG_ 804 FLCObject20_DstFarVar 255;
BA_ "GenSigSendType" SG_ 804 FLCObject20_TargetToLine 1;
BA_ "GenSigStartValue" SG_ 804 FLCObject20_TargetToLine 7;
BA_ "GenSigSendType" SG_ 804 FLCObject20_TimeStamp 1;
BA_ "GenSigStartValue" SG_ 804 FLCObject20_TimeStamp 65535;
BA_ "GenSigSendType" SG_ 804 FLCObject20_DstRightVar 1;
BA_ "GenSigStartValue" SG_ 804 FLCObject20_DstRightVar 255;
BA_ "GenSigSendType" SG_ 804 FLCObject20_AngLeftVar 1;
BA_ "GenSigStartValue" SG_ 804 FLCObject20_AngLeftVar 255;
BA_ "GenSigSendType" SG_ 804 FLCObject20_CRC 1;
BA_ "GenSigStartValue" SG_ 804 FLCObject20_CRC 65535;
BA_ "E2EDataId" SG_ 804 FLCObject20_CRC 125;
BA_ "E2EDataLength" SG_ 804 FLCObject20_CRC 352;
BA_ "E2EProfile" SG_ 804 FLCObject20_CRC "P05";
BA_ "GenSigSendType" SG_ 804 FLCObject20_ObjID 1;
BA_ "GenSigStartValue" SG_ 804 FLCObject20_ObjID 63;
BA_ "GenSigSendType" SG_ 804 FLCObject20_AngRightVar 1;
BA_ "GenSigStartValue" SG_ 804 FLCObject20_AngRightVar 255;
BA_ "GenSigSendType" SG_ 804 FLCObject20_AngFarVar 1;
BA_ "GenSigStartValue" SG_ 804 FLCObject20_AngFarVar 255;
BA_ "GenSigSendType" SG_ 804 FLCObject20_TrackStatus 1;
BA_ "GenSigStartValue" SG_ 804 FLCObject20_TrackStatus 7;
BA_ "GenSigSendType" SG_ 804 FLCObject20_LatVelVar 1;
BA_ "GenSigStartValue" SG_ 804 FLCObject20_LatVelVar 255;
BA_ "GenSigSendType" SG_ 804 FLCObject20_LongPosVar 1;
BA_ "GenSigStartValue" SG_ 804 FLCObject20_LongPosVar 255;
BA_ "GenSigSendType" SG_ 804 FLCObject20_ObjDynClass 1;
BA_ "GenSigStartValue" SG_ 804 FLCObject20_ObjDynClass 3;
BA_ "GenSigSendType" SG_ 804 FLCObject20_LongAcc 1;
BA_ "GenSigStartValue" SG_ 804 FLCObject20_LongAcc 511;
BA_ "GenSigSendType" SG_ 804 FLCObject20_Counter 1;
BA_ "GenSigStartValue" SG_ 804 FLCObject20_Counter 255;
BA_ "GenSigSendType" SG_ 804 FLCObject20_LatPos 1;
BA_ "GenSigStartValue" SG_ 804 FLCObject20_LatPos 8191;
BA_ "GenSigSendType" SG_ 804 FLCObject20_AnglFarCorner 1;
BA_ "GenSigStartValue" SG_ 804 FLCObject20_AnglFarCorner 1023;
BA_ "GenSigSendType" SG_ 804 FLCObject20_ScaleChange 1;
BA_ "GenSigStartValue" SG_ 804 FLCObject20_ScaleChange 1023;
BA_ "GenSigSendType" SG_ 804 FLCObject20_Height 1;
BA_ "GenSigStartValue" SG_ 804 FLCObject20_Height 255;
BA_ "GenSigSendType" SG_ 804 FLCObject20_ReliabilityConf 1;
BA_ "GenSigStartValue" SG_ 804 FLCObject20_ReliabilityConf 7;
BA_ "GenSigSendType" SG_ 804 FLCObject20_LatAcc 1;
BA_ "GenSigStartValue" SG_ 804 FLCObject20_LatAcc 511;
BA_ "GenSigSendType" SG_ 804 FLCObject20_ObjClass 1;
BA_ "GenSigStartValue" SG_ 804 FLCObject20_ObjClass 15;
BA_ "GenSigSendType" SG_ 804 FLCObject20_AnglLeftCorner 1;
BA_ "GenSigStartValue" SG_ 804 FLCObject20_AnglLeftCorner 1023;
BA_ "GenSigSendType" SG_ 804 FLCObject20_LifeTime 1;
BA_ "GenSigStartValue" SG_ 804 FLCObject20_LifeTime 65535;
BA_ "GenSigSendType" SG_ 804 FLCObject20_DstLeftVar 1;
BA_ "GenSigStartValue" SG_ 804 FLCObject20_DstLeftVar 255;
BA_ "GenSigSendType" SG_ 804 FLCObject20_DistFarCorner 1;
BA_ "GenSigStartValue" SG_ 804 FLCObject20_DistFarCorner 4095;
BA_ "GenSigSendType" SG_ 804 FLCObject20_TurnIndication 1;
BA_ "GenSigStartValue" SG_ 804 FLCObject20_TurnIndication 7;
BA_ "GenSigSendType" SG_ 804 FLCObject20_CoastIndex 1;
BA_ "GenSigStartValue" SG_ 804 FLCObject20_CoastIndex 31;
BA_ "GenSigSendType" SG_ 804 FLCObject20_LongPos 1;
BA_ "GenSigStartValue" SG_ 804 FLCObject20_LongPos 8191;
BA_ "GenSigSendType" SG_ 803 FLCObject19_DistFarCorner 1;
BA_ "GenSigStartValue" SG_ 803 FLCObject19_DistFarCorner 4095;
BA_ "GenSigSendType" SG_ 803 FLCObject19_LongPosVar 1;
BA_ "GenSigStartValue" SG_ 803 FLCObject19_LongPosVar 255;
BA_ "GenSigSendType" SG_ 803 FLCObject19_TargetToLine 1;
BA_ "GenSigStartValue" SG_ 803 FLCObject19_TargetToLine 7;
BA_ "GenSigSendType" SG_ 803 FLCObject19_DstLeftVar 1;
BA_ "GenSigStartValue" SG_ 803 FLCObject19_DstLeftVar 255;
BA_ "GenSigSendType" SG_ 803 FLCObject19_DistRightCorner 1;
BA_ "GenSigStartValue" SG_ 803 FLCObject19_DistRightCorner 4095;
BA_ "GenSigSendType" SG_ 803 FLCObject19_LifeTime 1;
BA_ "GenSigStartValue" SG_ 803 FLCObject19_LifeTime 65535;
BA_ "GenSigSendType" SG_ 803 FLCObject19_Height 1;
BA_ "GenSigStartValue" SG_ 803 FLCObject19_Height 255;
BA_ "GenSigSendType" SG_ 803 FLCObject19_CRC 1;
BA_ "GenSigStartValue" SG_ 803 FLCObject19_CRC 65535;
BA_ "E2EDataId" SG_ 803 FLCObject19_CRC 124;
BA_ "E2EDataLength" SG_ 803 FLCObject19_CRC 352;
BA_ "E2EProfile" SG_ 803 FLCObject19_CRC "P05";
BA_ "GenSigSendType" SG_ 803 FLCObject19_TrackStatus 1;
BA_ "GenSigStartValue" SG_ 803 FLCObject19_TrackStatus 7;
BA_ "GenSigSendType" SG_ 803 FLCObject19_ReliabilityConf 1;
BA_ "GenSigStartValue" SG_ 803 FLCObject19_ReliabilityConf 7;
BA_ "GenSigSendType" SG_ 803 FLCObject19_Counter 1;
BA_ "GenSigStartValue" SG_ 803 FLCObject19_Counter 255;
BA_ "GenSigSendType" SG_ 803 FLCObject19_TurnIndication 1;
BA_ "GenSigStartValue" SG_ 803 FLCObject19_TurnIndication 7;
BA_ "GenSigSendType" SG_ 803 FLCObject19_AngFarVar 1;
BA_ "GenSigStartValue" SG_ 803 FLCObject19_AngFarVar 255;
BA_ "GenSigSendType" SG_ 803 FLCObject19_BrakeLight 1;
BA_ "GenSigStartValue" SG_ 803 FLCObject19_BrakeLight 7;
BA_ "GenSigSendType" SG_ 803 FLCObject19_LatAcc 1;
BA_ "GenSigStartValue" SG_ 803 FLCObject19_LatAcc 511;
BA_ "GenSigSendType" SG_ 803 FLCObject19_ObjDynClass 1;
BA_ "GenSigStartValue" SG_ 803 FLCObject19_ObjDynClass 3;
BA_ "GenSigSendType" SG_ 803 FLCObject19_DstRightVar 1;
BA_ "GenSigStartValue" SG_ 803 FLCObject19_DstRightVar 255;
BA_ "GenSigSendType" SG_ 803 FLCObject19_LongVel 1;
BA_ "GenSigStartValue" SG_ 803 FLCObject19_LongVel 8191;
BA_ "GenSigSendType" SG_ 803 FLCObject19_AnglLeftCorner 1;
BA_ "GenSigStartValue" SG_ 803 FLCObject19_AnglLeftCorner 1023;
BA_ "GenSigSendType" SG_ 803 FLCObject19_AngRightVar 1;
BA_ "GenSigStartValue" SG_ 803 FLCObject19_AngRightVar 255;
BA_ "GenSigSendType" SG_ 803 FLCObject19_Heading 1;
BA_ "GenSigStartValue" SG_ 803 FLCObject19_Heading 2047;
BA_ "GenSigSendType" SG_ 803 FLCObject19_HeadingVar 1;
BA_ "GenSigStartValue" SG_ 803 FLCObject19_HeadingVar 255;
BA_ "GenSigSendType" SG_ 803 FLCObject19_LatVelVar 1;
BA_ "GenSigStartValue" SG_ 803 FLCObject19_LatVelVar 255;
BA_ "GenSigSendType" SG_ 803 FLCObject19_ObjClass 1;
BA_ "GenSigStartValue" SG_ 803 FLCObject19_ObjClass 15;
BA_ "GenSigSendType" SG_ 803 FLCObject19_AnglRightCorner 1;
BA_ "GenSigStartValue" SG_ 803 FLCObject19_AnglRightCorner 1023;
BA_ "GenSigSendType" SG_ 803 FLCObject19_AnglFarCorner 1;
BA_ "GenSigStartValue" SG_ 803 FLCObject19_AnglFarCorner 1023;
BA_ "GenSigSendType" SG_ 803 FLCObject19_TimeStamp 1;
BA_ "GenSigStartValue" SG_ 803 FLCObject19_TimeStamp 65535;
BA_ "GenSigSendType" SG_ 803 FLCObject19_ObjID 1;
BA_ "GenSigStartValue" SG_ 803 FLCObject19_ObjID 63;
BA_ "GenSigSendType" SG_ 803 FLCObject19_ExistConf 1;
BA_ "GenSigStartValue" SG_ 803 FLCObject19_ExistConf 127;
BA_ "GenSigSendType" SG_ 803 FLCObject19_LongPos 1;
BA_ "GenSigStartValue" SG_ 803 FLCObject19_LongPos 8191;
BA_ "GenSigSendType" SG_ 803 FLCObject19_DstFarVar 1;
BA_ "GenSigStartValue" SG_ 803 FLCObject19_DstFarVar 255;
BA_ "GenSigSendType" SG_ 803 FLCObject19_LongVelVar 1;
BA_ "GenSigStartValue" SG_ 803 FLCObject19_LongVelVar 255;
BA_ "GenSigSendType" SG_ 803 FLCObject19_LatVel 1;
BA_ "GenSigStartValue" SG_ 803 FLCObject19_LatVel 8191;
BA_ "GenSigSendType" SG_ 803 FLCObject19_AngLeftVar 1;
BA_ "GenSigStartValue" SG_ 803 FLCObject19_AngLeftVar 255;
BA_ "GenSigSendType" SG_ 803 FLCObject19_LatPosVar 1;
BA_ "GenSigStartValue" SG_ 803 FLCObject19_LatPosVar 255;
BA_ "GenSigSendType" SG_ 803 FLCObject19_DistLeftCorner 1;
BA_ "GenSigStartValue" SG_ 803 FLCObject19_DistLeftCorner 4095;
BA_ "GenSigSendType" SG_ 803 FLCObject19_CoastIndex 1;
BA_ "GenSigStartValue" SG_ 803 FLCObject19_CoastIndex 31;
BA_ "GenSigSendType" SG_ 803 FLCObject19_LongAcc 1;
BA_ "GenSigStartValue" SG_ 803 FLCObject19_LongAcc 511;
BA_ "GenSigSendType" SG_ 803 FLCObject19_ScaleChange 1;
BA_ "GenSigStartValue" SG_ 803 FLCObject19_ScaleChange 1023;
BA_ "GenSigSendType" SG_ 803 FLCObject19_LatPos 1;
BA_ "GenSigStartValue" SG_ 803 FLCObject19_LatPos 8191;
BA_ "GenSigSendType" SG_ 802 FLCObject18_TargetToLine 1;
BA_ "GenSigStartValue" SG_ 802 FLCObject18_TargetToLine 7;
BA_ "GenSigSendType" SG_ 802 FLCObject18_LatAcc 1;
BA_ "GenSigStartValue" SG_ 802 FLCObject18_LatAcc 511;
BA_ "GenSigSendType" SG_ 802 FLCObject18_BrakeLight 1;
BA_ "GenSigStartValue" SG_ 802 FLCObject18_BrakeLight 7;
BA_ "GenSigSendType" SG_ 802 FLCObject18_LatVel 1;
BA_ "GenSigStartValue" SG_ 802 FLCObject18_LatVel 8191;
BA_ "GenSigSendType" SG_ 802 FLCObject18_LongVel 1;
BA_ "GenSigStartValue" SG_ 802 FLCObject18_LongVel 8191;
BA_ "GenSigSendType" SG_ 802 FLCObject18_LongVelVar 1;
BA_ "GenSigStartValue" SG_ 802 FLCObject18_LongVelVar 255;
BA_ "GenSigSendType" SG_ 802 FLCObject18_DstFarVar 1;
BA_ "GenSigStartValue" SG_ 802 FLCObject18_DstFarVar 255;
BA_ "GenSigSendType" SG_ 802 FLCObject18_LatPosVar 1;
BA_ "GenSigStartValue" SG_ 802 FLCObject18_LatPosVar 255;
BA_ "GenSigSendType" SG_ 802 FLCObject18_LongAcc 1;
BA_ "GenSigStartValue" SG_ 802 FLCObject18_LongAcc 511;
BA_ "GenSigSendType" SG_ 802 FLCObject18_CoastIndex 1;
BA_ "GenSigStartValue" SG_ 802 FLCObject18_CoastIndex 31;
BA_ "GenSigSendType" SG_ 802 FLCObject18_TimeStamp 1;
BA_ "GenSigStartValue" SG_ 802 FLCObject18_TimeStamp 65535;
BA_ "GenSigSendType" SG_ 802 FLCObject18_LongPos 1;
BA_ "GenSigStartValue" SG_ 802 FLCObject18_LongPos 8191;
BA_ "GenSigSendType" SG_ 802 FLCObject18_LongPosVar 1;
BA_ "GenSigStartValue" SG_ 802 FLCObject18_LongPosVar 255;
BA_ "GenSigSendType" SG_ 802 FLCObject18_ObjClass 1;
BA_ "GenSigStartValue" SG_ 802 FLCObject18_ObjClass 15;
BA_ "GenSigSendType" SG_ 802 FLCObject18_ObjID 1;
BA_ "GenSigStartValue" SG_ 802 FLCObject18_ObjID 63;
BA_ "GenSigSendType" SG_ 802 FLCObject18_Heading 1;
BA_ "GenSigStartValue" SG_ 802 FLCObject18_Heading 2047;
BA_ "GenSigSendType" SG_ 802 FLCObject18_DstLeftVar 1;
BA_ "GenSigStartValue" SG_ 802 FLCObject18_DstLeftVar 255;
BA_ "GenSigSendType" SG_ 802 FLCObject18_LifeTime 1;
BA_ "GenSigStartValue" SG_ 802 FLCObject18_LifeTime 65535;
BA_ "GenSigSendType" SG_ 802 FLCObject18_Height 1;
BA_ "GenSigStartValue" SG_ 802 FLCObject18_Height 255;
BA_ "GenSigSendType" SG_ 802 FLCObject18_AngFarVar 1;
BA_ "GenSigStartValue" SG_ 802 FLCObject18_AngFarVar 255;
BA_ "GenSigSendType" SG_ 802 FLCObject18_ObjDynClass 1;
BA_ "GenSigStartValue" SG_ 802 FLCObject18_ObjDynClass 3;
BA_ "GenSigSendType" SG_ 802 FLCObject18_AnglLeftCorner 1;
BA_ "GenSigStartValue" SG_ 802 FLCObject18_AnglLeftCorner 1023;
BA_ "GenSigSendType" SG_ 802 FLCObject18_ReliabilityConf 1;
BA_ "GenSigStartValue" SG_ 802 FLCObject18_ReliabilityConf 7;
BA_ "GenSigSendType" SG_ 802 FLCObject18_LatVelVar 1;
BA_ "GenSigStartValue" SG_ 802 FLCObject18_LatVelVar 255;
BA_ "GenSigSendType" SG_ 802 FLCObject18_ExistConf 1;
BA_ "GenSigStartValue" SG_ 802 FLCObject18_ExistConf 127;
BA_ "GenSigSendType" SG_ 802 FLCObject18_Counter 1;
BA_ "GenSigStartValue" SG_ 802 FLCObject18_Counter 255;
BA_ "GenSigSendType" SG_ 802 FLCObject18_DistLeftCorner 1;
BA_ "GenSigStartValue" SG_ 802 FLCObject18_DistLeftCorner 4095;
BA_ "GenSigSendType" SG_ 802 FLCObject18_ScaleChange 1;
BA_ "GenSigStartValue" SG_ 802 FLCObject18_ScaleChange 1023;
BA_ "GenSigSendType" SG_ 802 FLCObject18_AnglFarCorner 1;
BA_ "GenSigStartValue" SG_ 802 FLCObject18_AnglFarCorner 1023;
BA_ "GenSigSendType" SG_ 802 FLCObject18_DstRightVar 1;
BA_ "GenSigStartValue" SG_ 802 FLCObject18_DstRightVar 255;
BA_ "GenSigSendType" SG_ 802 FLCObject18_HeadingVar 1;
BA_ "GenSigStartValue" SG_ 802 FLCObject18_HeadingVar 255;
BA_ "GenSigSendType" SG_ 802 FLCObject18_TrackStatus 1;
BA_ "GenSigStartValue" SG_ 802 FLCObject18_TrackStatus 7;
BA_ "GenSigSendType" SG_ 802 FLCObject18_LatPos 1;
BA_ "GenSigStartValue" SG_ 802 FLCObject18_LatPos 8191;
BA_ "GenSigSendType" SG_ 802 FLCObject18_AngLeftVar 1;
BA_ "GenSigStartValue" SG_ 802 FLCObject18_AngLeftVar 255;
BA_ "GenSigSendType" SG_ 802 FLCObject18_DistFarCorner 1;
BA_ "GenSigStartValue" SG_ 802 FLCObject18_DistFarCorner 4095;
BA_ "GenSigSendType" SG_ 802 FLCObject18_TurnIndication 1;
BA_ "GenSigStartValue" SG_ 802 FLCObject18_TurnIndication 7;
BA_ "GenSigSendType" SG_ 802 FLCObject18_CRC 1;
BA_ "GenSigStartValue" SG_ 802 FLCObject18_CRC 65535;
BA_ "E2EDataId" SG_ 802 FLCObject18_CRC 123;
BA_ "E2EDataLength" SG_ 802 FLCObject18_CRC 352;
BA_ "E2EProfile" SG_ 802 FLCObject18_CRC "P05";
BA_ "GenSigSendType" SG_ 802 FLCObject18_AngRightVar 1;
BA_ "GenSigStartValue" SG_ 802 FLCObject18_AngRightVar 255;
BA_ "GenSigSendType" SG_ 802 FLCObject18_AnglRightCorner 1;
BA_ "GenSigStartValue" SG_ 802 FLCObject18_AnglRightCorner 1023;
BA_ "GenSigSendType" SG_ 802 FLCObject18_DistRightCorner 1;
BA_ "GenSigStartValue" SG_ 802 FLCObject18_DistRightCorner 4095;
BA_ "GenSigSendType" SG_ 801 FLCObject17_TargetToLine 1;
BA_ "GenSigStartValue" SG_ 801 FLCObject17_TargetToLine 7;
BA_ "GenSigSendType" SG_ 801 FLCObject17_DstFarVar 1;
BA_ "GenSigStartValue" SG_ 801 FLCObject17_DstFarVar 255;
BA_ "GenSigSendType" SG_ 801 FLCObject17_LifeTime 1;
BA_ "GenSigStartValue" SG_ 801 FLCObject17_LifeTime 65535;
BA_ "GenSigSendType" SG_ 801 FLCObject17_DistLeftCorner 1;
BA_ "GenSigStartValue" SG_ 801 FLCObject17_DistLeftCorner 4095;
BA_ "GenSigSendType" SG_ 801 FLCObject17_LatAcc 1;
BA_ "GenSigStartValue" SG_ 801 FLCObject17_LatAcc 511;
BA_ "GenSigSendType" SG_ 801 FLCObject17_AnglRightCorner 1;
BA_ "GenSigStartValue" SG_ 801 FLCObject17_AnglRightCorner 1023;
BA_ "GenSigSendType" SG_ 801 FLCObject17_CRC 1;
BA_ "GenSigStartValue" SG_ 801 FLCObject17_CRC 65535;
BA_ "E2EDataId" SG_ 801 FLCObject17_CRC 122;
BA_ "E2EDataLength" SG_ 801 FLCObject17_CRC 352;
BA_ "E2EProfile" SG_ 801 FLCObject17_CRC "P05";
BA_ "GenSigSendType" SG_ 801 FLCObject17_DistFarCorner 1;
BA_ "GenSigStartValue" SG_ 801 FLCObject17_DistFarCorner 4095;
BA_ "GenSigSendType" SG_ 801 FLCObject17_LongAcc 1;
BA_ "GenSigStartValue" SG_ 801 FLCObject17_LongAcc 511;
BA_ "GenSigSendType" SG_ 801 FLCObject17_AngRightVar 1;
BA_ "GenSigStartValue" SG_ 801 FLCObject17_AngRightVar 255;
BA_ "GenSigSendType" SG_ 801 FLCObject17_CoastIndex 1;
BA_ "GenSigStartValue" SG_ 801 FLCObject17_CoastIndex 31;
BA_ "GenSigSendType" SG_ 801 FLCObject17_ObjClass 1;
BA_ "GenSigStartValue" SG_ 801 FLCObject17_ObjClass 15;
BA_ "GenSigSendType" SG_ 801 FLCObject17_TrackStatus 1;
BA_ "GenSigStartValue" SG_ 801 FLCObject17_TrackStatus 7;
BA_ "GenSigSendType" SG_ 801 FLCObject17_LongPos 1;
BA_ "GenSigStartValue" SG_ 801 FLCObject17_LongPos 8191;
BA_ "GenSigSendType" SG_ 801 FLCObject17_LongVelVar 1;
BA_ "GenSigStartValue" SG_ 801 FLCObject17_LongVelVar 255;
BA_ "GenSigSendType" SG_ 801 FLCObject17_ObjID 1;
BA_ "GenSigStartValue" SG_ 801 FLCObject17_ObjID 63;
BA_ "GenSigSendType" SG_ 801 FLCObject17_LongPosVar 1;
BA_ "GenSigStartValue" SG_ 801 FLCObject17_LongPosVar 255;
BA_ "GenSigSendType" SG_ 801 FLCObject17_DstRightVar 1;
BA_ "GenSigStartValue" SG_ 801 FLCObject17_DstRightVar 255;
BA_ "GenSigSendType" SG_ 801 FLCObject17_DstLeftVar 1;
BA_ "GenSigStartValue" SG_ 801 FLCObject17_DstLeftVar 255;
BA_ "GenSigSendType" SG_ 801 FLCObject17_Height 1;
BA_ "GenSigStartValue" SG_ 801 FLCObject17_Height 255;
BA_ "GenSigSendType" SG_ 801 FLCObject17_LatPos 1;
BA_ "GenSigStartValue" SG_ 801 FLCObject17_LatPos 8191;
BA_ "GenSigSendType" SG_ 801 FLCObject17_LongVel 1;
BA_ "GenSigStartValue" SG_ 801 FLCObject17_LongVel 8191;
BA_ "GenSigSendType" SG_ 801 FLCObject17_LatVel 1;
BA_ "GenSigStartValue" SG_ 801 FLCObject17_LatVel 8191;
BA_ "GenSigSendType" SG_ 801 FLCObject17_DistRightCorner 1;
BA_ "GenSigStartValue" SG_ 801 FLCObject17_DistRightCorner 4095;
BA_ "GenSigSendType" SG_ 801 FLCObject17_AngFarVar 1;
BA_ "GenSigStartValue" SG_ 801 FLCObject17_AngFarVar 255;
BA_ "GenSigSendType" SG_ 801 FLCObject17_TurnIndication 1;
BA_ "GenSigStartValue" SG_ 801 FLCObject17_TurnIndication 7;
BA_ "GenSigSendType" SG_ 801 FLCObject17_AnglLeftCorner 1;
BA_ "GenSigStartValue" SG_ 801 FLCObject17_AnglLeftCorner 1023;
BA_ "GenSigSendType" SG_ 801 FLCObject17_TimeStamp 1;
BA_ "GenSigStartValue" SG_ 801 FLCObject17_TimeStamp 65535;
BA_ "GenSigSendType" SG_ 801 FLCObject17_ExistConf 1;
BA_ "GenSigStartValue" SG_ 801 FLCObject17_ExistConf 127;
BA_ "GenSigSendType" SG_ 801 FLCObject17_Counter 1;
BA_ "GenSigStartValue" SG_ 801 FLCObject17_Counter 255;
BA_ "GenSigSendType" SG_ 801 FLCObject17_Heading 1;
BA_ "GenSigStartValue" SG_ 801 FLCObject17_Heading 2047;
BA_ "GenSigSendType" SG_ 801 FLCObject17_AnglFarCorner 1;
BA_ "GenSigStartValue" SG_ 801 FLCObject17_AnglFarCorner 1023;
BA_ "GenSigSendType" SG_ 801 FLCObject17_ReliabilityConf 1;
BA_ "GenSigStartValue" SG_ 801 FLCObject17_ReliabilityConf 7;
BA_ "GenSigSendType" SG_ 801 FLCObject17_AngLeftVar 1;
BA_ "GenSigStartValue" SG_ 801 FLCObject17_AngLeftVar 255;
BA_ "GenSigSendType" SG_ 801 FLCObject17_ScaleChange 1;
BA_ "GenSigStartValue" SG_ 801 FLCObject17_ScaleChange 1023;
BA_ "GenSigSendType" SG_ 801 FLCObject17_LatPosVar 1;
BA_ "GenSigStartValue" SG_ 801 FLCObject17_LatPosVar 255;
BA_ "GenSigSendType" SG_ 801 FLCObject17_LatVelVar 1;
BA_ "GenSigStartValue" SG_ 801 FLCObject17_LatVelVar 255;
BA_ "GenSigSendType" SG_ 801 FLCObject17_ObjDynClass 1;
BA_ "GenSigStartValue" SG_ 801 FLCObject17_ObjDynClass 3;
BA_ "GenSigSendType" SG_ 801 FLCObject17_BrakeLight 1;
BA_ "GenSigStartValue" SG_ 801 FLCObject17_BrakeLight 7;
BA_ "GenSigSendType" SG_ 801 FLCObject17_HeadingVar 1;
BA_ "GenSigStartValue" SG_ 801 FLCObject17_HeadingVar 255;
BA_ "GenSigSendType" SG_ 800 FLCObject16_LatPos 1;
BA_ "GenSigStartValue" SG_ 800 FLCObject16_LatPos 8191;
BA_ "GenSigSendType" SG_ 800 FLCObject16_LifeTime 1;
BA_ "GenSigStartValue" SG_ 800 FLCObject16_LifeTime 65535;
BA_ "GenSigSendType" SG_ 800 FLCObject16_ObjID 1;
BA_ "GenSigStartValue" SG_ 800 FLCObject16_ObjID 63;
BA_ "GenSigSendType" SG_ 800 FLCObject16_LongAcc 1;
BA_ "GenSigStartValue" SG_ 800 FLCObject16_LongAcc 511;
BA_ "GenSigSendType" SG_ 800 FLCObject16_DstRightVar 1;
BA_ "GenSigStartValue" SG_ 800 FLCObject16_DstRightVar 255;
BA_ "GenSigSendType" SG_ 800 FLCObject16_Counter 1;
BA_ "GenSigStartValue" SG_ 800 FLCObject16_Counter 255;
BA_ "GenSigSendType" SG_ 800 FLCObject16_AnglFarCorner 1;
BA_ "GenSigStartValue" SG_ 800 FLCObject16_AnglFarCorner 1023;
BA_ "GenSigSendType" SG_ 800 FLCObject16_DstLeftVar 1;
BA_ "GenSigStartValue" SG_ 800 FLCObject16_DstLeftVar 255;
BA_ "GenSigSendType" SG_ 800 FLCObject16_DistRightCorner 1;
BA_ "GenSigStartValue" SG_ 800 FLCObject16_DistRightCorner 4095;
BA_ "GenSigSendType" SG_ 800 FLCObject16_LatVel 1;
BA_ "GenSigStartValue" SG_ 800 FLCObject16_LatVel 8191;
BA_ "GenSigSendType" SG_ 800 FLCObject16_LatAcc 1;
BA_ "GenSigStartValue" SG_ 800 FLCObject16_LatAcc 511;
BA_ "GenSigSendType" SG_ 800 FLCObject16_Heading 1;
BA_ "GenSigStartValue" SG_ 800 FLCObject16_Heading 2047;
BA_ "GenSigSendType" SG_ 800 FLCObject16_BrakeLight 1;
BA_ "GenSigStartValue" SG_ 800 FLCObject16_BrakeLight 7;
BA_ "GenSigSendType" SG_ 800 FLCObject16_DstFarVar 1;
BA_ "GenSigStartValue" SG_ 800 FLCObject16_DstFarVar 255;
BA_ "GenSigSendType" SG_ 800 FLCObject16_ScaleChange 1;
BA_ "GenSigStartValue" SG_ 800 FLCObject16_ScaleChange 1023;
BA_ "GenSigSendType" SG_ 800 FLCObject16_TimeStamp 1;
BA_ "GenSigStartValue" SG_ 800 FLCObject16_TimeStamp 65535;
BA_ "GenSigSendType" SG_ 800 FLCObject16_TrackStatus 1;
BA_ "GenSigStartValue" SG_ 800 FLCObject16_TrackStatus 7;
BA_ "GenSigSendType" SG_ 800 FLCObject16_LatVelVar 1;
BA_ "GenSigStartValue" SG_ 800 FLCObject16_LatVelVar 255;
BA_ "GenSigSendType" SG_ 800 FLCObject16_LongPos 1;
BA_ "GenSigStartValue" SG_ 800 FLCObject16_LongPos 8191;
BA_ "GenSigSendType" SG_ 800 FLCObject16_ExistConf 1;
BA_ "GenSigStartValue" SG_ 800 FLCObject16_ExistConf 127;
BA_ "GenSigSendType" SG_ 800 FLCObject16_CoastIndex 1;
BA_ "GenSigStartValue" SG_ 800 FLCObject16_CoastIndex 31;
BA_ "GenSigSendType" SG_ 800 FLCObject16_TargetToLine 1;
BA_ "GenSigStartValue" SG_ 800 FLCObject16_TargetToLine 7;
BA_ "GenSigSendType" SG_ 800 FLCObject16_AngRightVar 1;
BA_ "GenSigStartValue" SG_ 800 FLCObject16_AngRightVar 255;
BA_ "GenSigSendType" SG_ 800 FLCObject16_ObjDynClass 1;
BA_ "GenSigStartValue" SG_ 800 FLCObject16_ObjDynClass 3;
BA_ "GenSigSendType" SG_ 800 FLCObject16_AnglRightCorner 1;
BA_ "GenSigStartValue" SG_ 800 FLCObject16_AnglRightCorner 1023;
BA_ "GenSigSendType" SG_ 800 FLCObject16_HeadingVar 1;
BA_ "GenSigStartValue" SG_ 800 FLCObject16_HeadingVar 255;
BA_ "GenSigSendType" SG_ 800 FLCObject16_DistFarCorner 1;
BA_ "GenSigStartValue" SG_ 800 FLCObject16_DistFarCorner 4095;
BA_ "GenSigSendType" SG_ 800 FLCObject16_AngFarVar 1;
BA_ "GenSigStartValue" SG_ 800 FLCObject16_AngFarVar 255;
BA_ "GenSigSendType" SG_ 800 FLCObject16_LongVelVar 1;
BA_ "GenSigStartValue" SG_ 800 FLCObject16_LongVelVar 255;
BA_ "GenSigSendType" SG_ 800 FLCObject16_LatPosVar 1;
BA_ "GenSigStartValue" SG_ 800 FLCObject16_LatPosVar 255;
BA_ "GenSigSendType" SG_ 800 FLCObject16_LongPosVar 1;
BA_ "GenSigStartValue" SG_ 800 FLCObject16_LongPosVar 255;
BA_ "GenSigSendType" SG_ 800 FLCObject16_DistLeftCorner 1;
BA_ "GenSigStartValue" SG_ 800 FLCObject16_DistLeftCorner 4095;
BA_ "GenSigSendType" SG_ 800 FLCObject16_Height 1;
BA_ "GenSigStartValue" SG_ 800 FLCObject16_Height 255;
BA_ "GenSigSendType" SG_ 800 FLCObject16_LongVel 1;
BA_ "GenSigStartValue" SG_ 800 FLCObject16_LongVel 8191;
BA_ "GenSigSendType" SG_ 800 FLCObject16_CRC 1;
BA_ "GenSigStartValue" SG_ 800 FLCObject16_CRC 65535;
BA_ "E2EDataId" SG_ 800 FLCObject16_CRC 121;
BA_ "E2EDataLength" SG_ 800 FLCObject16_CRC 352;
BA_ "E2EProfile" SG_ 800 FLCObject16_CRC "P05";
BA_ "GenSigSendType" SG_ 800 FLCObject16_ObjClass 1;
BA_ "GenSigStartValue" SG_ 800 FLCObject16_ObjClass 15;
BA_ "GenSigSendType" SG_ 800 FLCObject16_AnglLeftCorner 1;
BA_ "GenSigStartValue" SG_ 800 FLCObject16_AnglLeftCorner 1023;
BA_ "GenSigSendType" SG_ 800 FLCObject16_TurnIndication 1;
BA_ "GenSigStartValue" SG_ 800 FLCObject16_TurnIndication 7;
BA_ "GenSigSendType" SG_ 800 FLCObject16_ReliabilityConf 1;
BA_ "GenSigStartValue" SG_ 800 FLCObject16_ReliabilityConf 7;
BA_ "GenSigSendType" SG_ 800 FLCObject16_AngLeftVar 1;
BA_ "GenSigStartValue" SG_ 800 FLCObject16_AngLeftVar 255;
BA_ "GenSigSendType" SG_ 799 FLCObject15_LongVel 1;
BA_ "GenSigStartValue" SG_ 799 FLCObject15_LongVel 8191;
BA_ "GenSigSendType" SG_ 799 FLCObject15_ScaleChange 1;
BA_ "GenSigStartValue" SG_ 799 FLCObject15_ScaleChange 1023;
BA_ "GenSigSendType" SG_ 799 FLCObject15_DistLeftCorner 1;
BA_ "GenSigStartValue" SG_ 799 FLCObject15_DistLeftCorner 4095;
BA_ "GenSigSendType" SG_ 799 FLCObject15_DstRightVar 1;
BA_ "GenSigStartValue" SG_ 799 FLCObject15_DstRightVar 255;
BA_ "GenSigSendType" SG_ 799 FLCObject15_LatVel 1;
BA_ "GenSigStartValue" SG_ 799 FLCObject15_LatVel 8191;
BA_ "GenSigSendType" SG_ 799 FLCObject15_LatPos 1;
BA_ "GenSigStartValue" SG_ 799 FLCObject15_LatPos 8191;
BA_ "GenSigSendType" SG_ 799 FLCObject15_TargetToLine 1;
BA_ "GenSigStartValue" SG_ 799 FLCObject15_TargetToLine 7;
BA_ "GenSigSendType" SG_ 799 FLCObject15_AnglLeftCorner 1;
BA_ "GenSigStartValue" SG_ 799 FLCObject15_AnglLeftCorner 1023;
BA_ "GenSigSendType" SG_ 799 FLCObject15_AnglRightCorner 1;
BA_ "GenSigStartValue" SG_ 799 FLCObject15_AnglRightCorner 1023;
BA_ "GenSigSendType" SG_ 799 FLCObject15_DstLeftVar 1;
BA_ "GenSigStartValue" SG_ 799 FLCObject15_DstLeftVar 255;
BA_ "GenSigSendType" SG_ 799 FLCObject15_LatAcc 1;
BA_ "GenSigStartValue" SG_ 799 FLCObject15_LatAcc 511;
BA_ "GenSigSendType" SG_ 799 FLCObject15_ObjDynClass 1;
BA_ "GenSigStartValue" SG_ 799 FLCObject15_ObjDynClass 3;
BA_ "GenSigSendType" SG_ 799 FLCObject15_TrackStatus 1;
BA_ "GenSigStartValue" SG_ 799 FLCObject15_TrackStatus 7;
BA_ "GenSigSendType" SG_ 799 FLCObject15_LongAcc 1;
BA_ "GenSigStartValue" SG_ 799 FLCObject15_LongAcc 511;
BA_ "GenSigSendType" SG_ 799 FLCObject15_CRC 1;
BA_ "GenSigStartValue" SG_ 799 FLCObject15_CRC 65535;
BA_ "E2EDataId" SG_ 799 FLCObject15_CRC 120;
BA_ "E2EDataLength" SG_ 799 FLCObject15_CRC 352;
BA_ "E2EProfile" SG_ 799 FLCObject15_CRC "P05";
BA_ "GenSigSendType" SG_ 799 FLCObject15_Height 1;
BA_ "GenSigStartValue" SG_ 799 FLCObject15_Height 255;
BA_ "GenSigSendType" SG_ 799 FLCObject15_Heading 1;
BA_ "GenSigStartValue" SG_ 799 FLCObject15_Heading 2047;
BA_ "GenSigSendType" SG_ 799 FLCObject15_LatVelVar 1;
BA_ "GenSigStartValue" SG_ 799 FLCObject15_LatVelVar 255;
BA_ "GenSigSendType" SG_ 799 FLCObject15_DistFarCorner 1;
BA_ "GenSigStartValue" SG_ 799 FLCObject15_DistFarCorner 4095;
BA_ "GenSigSendType" SG_ 799 FLCObject15_CoastIndex 1;
BA_ "GenSigStartValue" SG_ 799 FLCObject15_CoastIndex 31;
BA_ "GenSigSendType" SG_ 799 FLCObject15_ExistConf 1;
BA_ "GenSigStartValue" SG_ 799 FLCObject15_ExistConf 127;
BA_ "GenSigSendType" SG_ 799 FLCObject15_LatPosVar 1;
BA_ "GenSigStartValue" SG_ 799 FLCObject15_LatPosVar 255;
BA_ "GenSigSendType" SG_ 799 FLCObject15_BrakeLight 1;
BA_ "GenSigStartValue" SG_ 799 FLCObject15_BrakeLight 7;
BA_ "GenSigSendType" SG_ 799 FLCObject15_HeadingVar 1;
BA_ "GenSigStartValue" SG_ 799 FLCObject15_HeadingVar 255;
BA_ "GenSigSendType" SG_ 799 FLCObject15_DistRightCorner 1;
BA_ "GenSigStartValue" SG_ 799 FLCObject15_DistRightCorner 4095;
BA_ "GenSigSendType" SG_ 799 FLCObject15_LongVelVar 1;
BA_ "GenSigStartValue" SG_ 799 FLCObject15_LongVelVar 255;
BA_ "GenSigSendType" SG_ 799 FLCObject15_LongPosVar 1;
BA_ "GenSigStartValue" SG_ 799 FLCObject15_LongPosVar 255;
BA_ "GenSigSendType" SG_ 799 FLCObject15_AngLeftVar 1;
BA_ "GenSigStartValue" SG_ 799 FLCObject15_AngLeftVar 255;
BA_ "GenSigSendType" SG_ 799 FLCObject15_ObjID 1;
BA_ "GenSigStartValue" SG_ 799 FLCObject15_ObjID 63;
BA_ "GenSigSendType" SG_ 799 FLCObject15_AngRightVar 1;
BA_ "GenSigStartValue" SG_ 799 FLCObject15_AngRightVar 255;
BA_ "GenSigSendType" SG_ 799 FLCObject15_ObjClass 1;
BA_ "GenSigStartValue" SG_ 799 FLCObject15_ObjClass 15;
BA_ "GenSigSendType" SG_ 799 FLCObject15_ReliabilityConf 1;
BA_ "GenSigStartValue" SG_ 799 FLCObject15_ReliabilityConf 7;
BA_ "GenSigSendType" SG_ 799 FLCObject15_LongPos 1;
BA_ "GenSigStartValue" SG_ 799 FLCObject15_LongPos 8191;
BA_ "GenSigSendType" SG_ 799 FLCObject15_TurnIndication 1;
BA_ "GenSigStartValue" SG_ 799 FLCObject15_TurnIndication 7;
BA_ "GenSigSendType" SG_ 799 FLCObject15_AngFarVar 1;
BA_ "GenSigStartValue" SG_ 799 FLCObject15_AngFarVar 255;
BA_ "GenSigSendType" SG_ 799 FLCObject15_AnglFarCorner 1;
BA_ "GenSigStartValue" SG_ 799 FLCObject15_AnglFarCorner 1023;
BA_ "GenSigSendType" SG_ 799 FLCObject15_DstFarVar 1;
BA_ "GenSigStartValue" SG_ 799 FLCObject15_DstFarVar 255;
BA_ "GenSigSendType" SG_ 799 FLCObject15_Counter 1;
BA_ "GenSigStartValue" SG_ 799 FLCObject15_Counter 255;
BA_ "GenSigSendType" SG_ 799 FLCObject15_LifeTime 1;
BA_ "GenSigStartValue" SG_ 799 FLCObject15_LifeTime 65535;
BA_ "GenSigSendType" SG_ 799 FLCObject15_TimeStamp 1;
BA_ "GenSigStartValue" SG_ 799 FLCObject15_TimeStamp 65535;
BA_ "GenSigSendType" SG_ 798 FLCObject14_LongPosVar 1;
BA_ "GenSigStartValue" SG_ 798 FLCObject14_LongPosVar 255;
BA_ "GenSigSendType" SG_ 798 FLCObject14_BrakeLight 1;
BA_ "GenSigStartValue" SG_ 798 FLCObject14_BrakeLight 7;
BA_ "GenSigSendType" SG_ 798 FLCObject14_AnglRightCorner 1;
BA_ "GenSigStartValue" SG_ 798 FLCObject14_AnglRightCorner 1023;
BA_ "GenSigSendType" SG_ 798 FLCObject14_Heading 1;
BA_ "GenSigStartValue" SG_ 798 FLCObject14_Heading 2047;
BA_ "GenSigSendType" SG_ 798 FLCObject14_CoastIndex 1;
BA_ "GenSigStartValue" SG_ 798 FLCObject14_CoastIndex 31;
BA_ "GenSigSendType" SG_ 798 FLCObject14_ObjDynClass 1;
BA_ "GenSigStartValue" SG_ 798 FLCObject14_ObjDynClass 3;
BA_ "GenSigSendType" SG_ 798 FLCObject14_DistLeftCorner 1;
BA_ "GenSigStartValue" SG_ 798 FLCObject14_DistLeftCorner 4095;
BA_ "GenSigSendType" SG_ 798 FLCObject14_LongPos 1;
BA_ "GenSigStartValue" SG_ 798 FLCObject14_LongPos 8191;
BA_ "GenSigSendType" SG_ 798 FLCObject14_AnglFarCorner 1;
BA_ "GenSigStartValue" SG_ 798 FLCObject14_AnglFarCorner 1023;
BA_ "GenSigSendType" SG_ 798 FLCObject14_DstRightVar 1;
BA_ "GenSigStartValue" SG_ 798 FLCObject14_DstRightVar 255;
BA_ "GenSigSendType" SG_ 798 FLCObject14_LifeTime 1;
BA_ "GenSigStartValue" SG_ 798 FLCObject14_LifeTime 65535;
BA_ "GenSigSendType" SG_ 798 FLCObject14_ExistConf 1;
BA_ "GenSigStartValue" SG_ 798 FLCObject14_ExistConf 127;
BA_ "GenSigSendType" SG_ 798 FLCObject14_Height 1;
BA_ "GenSigStartValue" SG_ 798 FLCObject14_Height 255;
BA_ "GenSigSendType" SG_ 798 FLCObject14_TurnIndication 1;
BA_ "GenSigStartValue" SG_ 798 FLCObject14_TurnIndication 7;
BA_ "GenSigSendType" SG_ 798 FLCObject14_ObjID 1;
BA_ "GenSigStartValue" SG_ 798 FLCObject14_ObjID 63;
BA_ "GenSigSendType" SG_ 798 FLCObject14_LatPosVar 1;
BA_ "GenSigStartValue" SG_ 798 FLCObject14_LatPosVar 255;
BA_ "GenSigSendType" SG_ 798 FLCObject14_TimeStamp 1;
BA_ "GenSigStartValue" SG_ 798 FLCObject14_TimeStamp 65535;
BA_ "GenSigSendType" SG_ 798 FLCObject14_DstFarVar 1;
BA_ "GenSigStartValue" SG_ 798 FLCObject14_DstFarVar 255;
BA_ "GenSigSendType" SG_ 798 FLCObject14_ReliabilityConf 1;
BA_ "GenSigStartValue" SG_ 798 FLCObject14_ReliabilityConf 7;
BA_ "GenSigSendType" SG_ 798 FLCObject14_TargetToLine 1;
BA_ "GenSigStartValue" SG_ 798 FLCObject14_TargetToLine 7;
BA_ "GenSigSendType" SG_ 798 FLCObject14_AngLeftVar 1;
BA_ "GenSigStartValue" SG_ 798 FLCObject14_AngLeftVar 255;
BA_ "GenSigSendType" SG_ 798 FLCObject14_DistFarCorner 1;
BA_ "GenSigStartValue" SG_ 798 FLCObject14_DistFarCorner 4095;
BA_ "GenSigSendType" SG_ 798 FLCObject14_AngRightVar 1;
BA_ "GenSigStartValue" SG_ 798 FLCObject14_AngRightVar 255;
BA_ "GenSigSendType" SG_ 798 FLCObject14_CRC 1;
BA_ "GenSigStartValue" SG_ 798 FLCObject14_CRC 65535;
BA_ "E2EDataId" SG_ 798 FLCObject14_CRC 119;
BA_ "E2EDataLength" SG_ 798 FLCObject14_CRC 352;
BA_ "E2EProfile" SG_ 798 FLCObject14_CRC "P05";
BA_ "GenSigSendType" SG_ 798 FLCObject14_LatPos 1;
BA_ "GenSigStartValue" SG_ 798 FLCObject14_LatPos 8191;
BA_ "GenSigSendType" SG_ 798 FLCObject14_AngFarVar 1;
BA_ "GenSigStartValue" SG_ 798 FLCObject14_AngFarVar 255;
BA_ "GenSigSendType" SG_ 798 FLCObject14_Counter 1;
BA_ "GenSigStartValue" SG_ 798 FLCObject14_Counter 255;
BA_ "GenSigSendType" SG_ 798 FLCObject14_DistRightCorner 1;
BA_ "GenSigStartValue" SG_ 798 FLCObject14_DistRightCorner 4095;
BA_ "GenSigSendType" SG_ 798 FLCObject14_ObjClass 1;
BA_ "GenSigStartValue" SG_ 798 FLCObject14_ObjClass 15;
BA_ "GenSigSendType" SG_ 798 FLCObject14_ScaleChange 1;
BA_ "GenSigStartValue" SG_ 798 FLCObject14_ScaleChange 1023;
BA_ "GenSigSendType" SG_ 798 FLCObject14_HeadingVar 1;
BA_ "GenSigStartValue" SG_ 798 FLCObject14_HeadingVar 255;
BA_ "GenSigSendType" SG_ 798 FLCObject14_LongVelVar 1;
BA_ "GenSigStartValue" SG_ 798 FLCObject14_LongVelVar 255;
BA_ "GenSigSendType" SG_ 798 FLCObject14_LatAcc 1;
BA_ "GenSigStartValue" SG_ 798 FLCObject14_LatAcc 511;
BA_ "GenSigSendType" SG_ 798 FLCObject14_LongVel 1;
BA_ "GenSigStartValue" SG_ 798 FLCObject14_LongVel 8191;
BA_ "GenSigSendType" SG_ 798 FLCObject14_AnglLeftCorner 1;
BA_ "GenSigStartValue" SG_ 798 FLCObject14_AnglLeftCorner 1023;
BA_ "GenSigSendType" SG_ 798 FLCObject14_TrackStatus 1;
BA_ "GenSigStartValue" SG_ 798 FLCObject14_TrackStatus 7;
BA_ "GenSigSendType" SG_ 798 FLCObject14_LongAcc 1;
BA_ "GenSigStartValue" SG_ 798 FLCObject14_LongAcc 511;
BA_ "GenSigSendType" SG_ 798 FLCObject14_DstLeftVar 1;
BA_ "GenSigStartValue" SG_ 798 FLCObject14_DstLeftVar 255;
BA_ "GenSigSendType" SG_ 798 FLCObject14_LatVelVar 1;
BA_ "GenSigStartValue" SG_ 798 FLCObject14_LatVelVar 255;
BA_ "GenSigSendType" SG_ 798 FLCObject14_LatVel 1;
BA_ "GenSigStartValue" SG_ 798 FLCObject14_LatVel 8191;
BA_REL_ "GenSigFirstTimeoutTime" BU_SG_REL_ DACU SG_ 806 FLCObject22_HeadingVar 3000;
BA_REL_ "GenSigTimeoutTime" BU_SG_REL_ DACU SG_ 806 FLCObject22_HeadingVar 120;
BA_REL_ "GenSigFirstTimeoutTime" BU_SG_REL_ DACU SG_ 806 FLCObject22_DstRightVar 3000;
BA_REL_ "GenSigTimeoutTime" BU_SG_REL_ DACU SG_ 806 FLCObject22_DstRightVar 120;
BA_REL_ "GenSigFirstTimeoutTime" BU_SG_REL_ DACU SG_ 806 FLCObject22_LatPos 3000;
BA_REL_ "GenSigTimeoutTime" BU_SG_REL_ DACU SG_ 806 FLCObject22_LatPos 120;
BA_REL_ "GenSigFirstTimeoutTime" BU_SG_REL_ DACU SG_ 806 FLCObject22_TrackStatus 3000;
BA_REL_ "GenSigTimeoutTime" BU_SG_REL_ DACU SG_ 806 FLCObject22_TrackStatus 120;
BA_REL_ "GenSigFirstTimeoutTime" BU_SG_REL_ DACU SG_ 806 FLCObject22_ObjID 3000;
BA_REL_ "GenSigTimeoutTime" BU_SG_REL_ DACU SG_ 806 FLCObject22_ObjID 120;
BA_REL_ "GenSigFirstTimeoutTime" BU_SG_REL_ DACU SG_ 806 FLCObject22_CoastIndex 3000;
BA_REL_ "GenSigTimeoutTime" BU_SG_REL_ DACU SG_ 806 FLCObject22_CoastIndex 120;
BA_REL_ "GenSigFirstTimeoutTime" BU_SG_REL_ DACU SG_ 806 FLCObject22_LatVel 3000;
BA_REL_ "GenSigTimeoutTime" BU_SG_REL_ DACU SG_ 806 FLCObject22_LatVel 120;
BA_REL_ "GenSigFirstTimeoutTime" BU_SG_REL_ DACU SG_ 806 FLCObject22_LongPos 3000;
BA_REL_ "GenSigTimeoutTime" BU_SG_REL_ DACU SG_ 806 FLCObject22_LongPos 120;
BA_REL_ "GenSigFirstTimeoutTime" BU_SG_REL_ DACU SG_ 806 FLCObject22_TimeStamp 3000;
BA_REL_ "GenSigTimeoutTime" BU_SG_REL_ DACU SG_ 806 FLCObject22_TimeStamp 120;
BA_REL_ "GenSigFirstTimeoutTime" BU_SG_REL_ DACU SG_ 806 FLCObject22_ReliabilityConf 3000;
BA_REL_ "GenSigTimeoutTime" BU_SG_REL_ DACU SG_ 806 FLCObject22_ReliabilityConf 120;
BA_REL_ "GenSigFirstTimeoutTime" BU_SG_REL_ DACU SG_ 806 FLCObject22_LatVelVar 3000;
BA_REL_ "GenSigTimeoutTime" BU_SG_REL_ DACU SG_ 806 FLCObject22_LatVelVar 120;
BA_REL_ "GenSigFirstTimeoutTime" BU_SG_REL_ DACU SG_ 806 FLCObject22_DistRightCorner 3000;
BA_REL_ "GenSigTimeoutTime" BU_SG_REL_ DACU SG_ 806 FLCObject22_DistRightCorner 120;
BA_REL_ "GenSigFirstTimeoutTime" BU_SG_REL_ DACU SG_ 806 FLCObject22_AngRightVar 3000;
BA_REL_ "GenSigTimeoutTime" BU_SG_REL_ DACU SG_ 806 FLCObject22_AngRightVar 120;
BA_REL_ "GenSigFirstTimeoutTime" BU_SG_REL_ DACU SG_ 806 FLCObject22_ExistConf 3000;
BA_REL_ "GenSigTimeoutTime" BU_SG_REL_ DACU SG_ 806 FLCObject22_ExistConf 120;
BA_REL_ "GenSigFirstTimeoutTime" BU_SG_REL_ DACU SG_ 806 FLCObject22_LatPosVar 3000;
BA_REL_ "GenSigTimeoutTime" BU_SG_REL_ DACU SG_ 806 FLCObject22_LatPosVar 120;
BA_REL_ "GenSigFirstTimeoutTime" BU_SG_REL_ DACU SG_ 806 FLCObject22_CRC 3000;
BA_REL_ "GenSigTimeoutTime" BU_SG_REL_ DACU SG_ 806 FLCObject22_CRC 120;
BA_REL_ "GenSigFirstTimeoutTime" BU_SG_REL_ DACU SG_ 806 FLCObject22_DstLeftVar 3000;
BA_REL_ "GenSigTimeoutTime" BU_SG_REL_ DACU SG_ 806 FLCObject22_DstLeftVar 120;
BA_REL_ "GenSigFirstTimeoutTime" BU_SG_REL_ DACU SG_ 806 FLCObject22_Heading 3000;
BA_REL_ "GenSigTimeoutTime" BU_SG_REL_ DACU SG_ 806 FLCObject22_Heading 120;
BA_REL_ "GenSigFirstTimeoutTime" BU_SG_REL_ DACU SG_ 806 FLCObject22_Height 3000;
BA_REL_ "GenSigTimeoutTime" BU_SG_REL_ DACU SG_ 806 FLCObject22_Height 120;
BA_REL_ "GenSigFirstTimeoutTime" BU_SG_REL_ DACU SG_ 806 FLCObject22_TurnIndication 3000;
BA_REL_ "GenSigTimeoutTime" BU_SG_REL_ DACU SG_ 806 FLCObject22_TurnIndication 120;
BA_REL_ "GenSigFirstTimeoutTime" BU_SG_REL_ DACU SG_ 806 FLCObject22_AnglFarCorner 3000;
BA_REL_ "GenSigTimeoutTime" BU_SG_REL_ DACU SG_ 806 FLCObject22_AnglFarCorner 120;
BA_REL_ "GenSigFirstTimeoutTime" BU_SG_REL_ DACU SG_ 806 FLCObject22_AnglRightCorner 3000;
BA_REL_ "GenSigTimeoutTime" BU_SG_REL_ DACU SG_ 806 FLCObject22_AnglRightCorner 120;
BA_REL_ "GenSigFirstTimeoutTime" BU_SG_REL_ DACU SG_ 806 FLCObject22_LongAcc 3000;
BA_REL_ "GenSigTimeoutTime" BU_SG_REL_ DACU SG_ 806 FLCObject22_LongAcc 120;
BA_REL_ "GenSigFirstTimeoutTime" BU_SG_REL_ DACU SG_ 806 FLCObject22_AngFarVar 3000;
BA_REL_ "GenSigTimeoutTime" BU_SG_REL_ DACU SG_ 806 FLCObject22_AngFarVar 120;
BA_REL_ "GenSigFirstTimeoutTime" BU_SG_REL_ DACU SG_ 806 FLCObject22_AnglLeftCorner 3000;
BA_REL_ "GenSigTimeoutTime" BU_SG_REL_ DACU SG_ 806 FLCObject22_AnglLeftCorner 120;
BA_REL_ "GenSigFirstTimeoutTime" BU_SG_REL_ DACU SG_ 806 FLCObject22_Counter 3000;
BA_REL_ "GenSigTimeoutTime" BU_SG_REL_ DACU SG_ 806 FLCObject22_Counter 120;
BA_REL_ "GenSigFirstTimeoutTime" BU_SG_REL_ DACU SG_ 806 FLCObject22_LongVelVar 3000;
BA_REL_ "GenSigTimeoutTime" BU_SG_REL_ DACU SG_ 806 FLCObject22_LongVelVar 120;
BA_REL_ "GenSigFirstTimeoutTime" BU_SG_REL_ DACU SG_ 806 FLCObject22_ObjClass 3000;
BA_REL_ "GenSigTimeoutTime" BU_SG_REL_ DACU SG_ 806 FLCObject22_ObjClass 120;
BA_REL_ "GenSigFirstTimeoutTime" BU_SG_REL_ DACU SG_ 806 FLCObject22_DistFarCorner 3000;
BA_REL_ "GenSigTimeoutTime" BU_SG_REL_ DACU SG_ 806 FLCObject22_DistFarCorner 120;
BA_REL_ "GenSigFirstTimeoutTime" BU_SG_REL_ DACU SG_ 806 FLCObject22_BrakeLight 3000;
BA_REL_ "GenSigTimeoutTime" BU_SG_REL_ DACU SG_ 806 FLCObject22_BrakeLight 120;
BA_REL_ "GenSigFirstTimeoutTime" BU_SG_REL_ DACU SG_ 806 FLCObject22_LongVel 3000;
BA_REL_ "GenSigTimeoutTime" BU_SG_REL_ DACU SG_ 806 FLCObject22_LongVel 120;
BA_REL_ "GenSigFirstTimeoutTime" BU_SG_REL_ DACU SG_ 806 FLCObject22_ScaleChange 3000;
BA_REL_ "GenSigTimeoutTime" BU_SG_REL_ DACU SG_ 806 FLCObject22_ScaleChange 120;
BA_REL_ "GenSigFirstTimeoutTime" BU_SG_REL_ DACU SG_ 806 FLCObject22_TargetToLine 3000;
BA_REL_ "GenSigTimeoutTime" BU_SG_REL_ DACU SG_ 806 FLCObject22_TargetToLine 120;
BA_REL_ "GenSigFirstTimeoutTime" BU_SG_REL_ DACU SG_ 806 FLCObject22_LifeTime 3000;
BA_REL_ "GenSigTimeoutTime" BU_SG_REL_ DACU SG_ 806 FLCObject22_LifeTime 120;
BA_REL_ "GenSigFirstTimeoutTime" BU_SG_REL_ DACU SG_ 806 FLCObject22_LongPosVar 3000;
BA_REL_ "GenSigTimeoutTime" BU_SG_REL_ DACU SG_ 806 FLCObject22_LongPosVar 120;
BA_REL_ "GenSigFirstTimeoutTime" BU_SG_REL_ DACU SG_ 806 FLCObject22_DistLeftCorner 3000;
BA_REL_ "GenSigTimeoutTime" BU_SG_REL_ DACU SG_ 806 FLCObject22_DistLeftCorner 120;
BA_REL_ "GenSigFirstTimeoutTime" BU_SG_REL_ DACU SG_ 806 FLCObject22_ObjDynClass 3000;
BA_REL_ "GenSigTimeoutTime" BU_SG_REL_ DACU SG_ 806 FLCObject22_ObjDynClass 120;
BA_REL_ "GenSigFirstTimeoutTime" BU_SG_REL_ DACU SG_ 806 FLCObject22_LatAcc 3000;
BA_REL_ "GenSigTimeoutTime" BU_SG_REL_ DACU SG_ 806 FLCObject22_LatAcc 120;
BA_REL_ "GenSigFirstTimeoutTime" BU_SG_REL_ DACU SG_ 806 FLCObject22_DstFarVar 3000;
BA_REL_ "GenSigTimeoutTime" BU_SG_REL_ DACU SG_ 806 FLCObject22_DstFarVar 120;
BA_REL_ "GenSigFirstTimeoutTime" BU_SG_REL_ DACU SG_ 806 FLCObject22_AngLeftVar 3000;
BA_REL_ "GenSigTimeoutTime" BU_SG_REL_ DACU SG_ 806 FLCObject22_AngLeftVar 120;
BA_REL_ "GenSigFirstTimeoutTime" BU_SG_REL_ DACU SG_ 805 FLCObject21_ScaleChange 3000;
BA_REL_ "GenSigTimeoutTime" BU_SG_REL_ DACU SG_ 805 FLCObject21_ScaleChange 120;
BA_REL_ "GenSigFirstTimeoutTime" BU_SG_REL_ DACU SG_ 805 FLCObject21_DistFarCorner 3000;
BA_REL_ "GenSigTimeoutTime" BU_SG_REL_ DACU SG_ 805 FLCObject21_DistFarCorner 120;
BA_REL_ "GenSigFirstTimeoutTime" BU_SG_REL_ DACU SG_ 805 FLCObject21_Heading 3000;
BA_REL_ "GenSigTimeoutTime" BU_SG_REL_ DACU SG_ 805 FLCObject21_Heading 120;
BA_REL_ "GenSigFirstTimeoutTime" BU_SG_REL_ DACU SG_ 805 FLCObject21_LongAcc 3000;
BA_REL_ "GenSigTimeoutTime" BU_SG_REL_ DACU SG_ 805 FLCObject21_LongAcc 120;
BA_REL_ "GenSigFirstTimeoutTime" BU_SG_REL_ DACU SG_ 805 FLCObject21_CRC 3000;
BA_REL_ "GenSigTimeoutTime" BU_SG_REL_ DACU SG_ 805 FLCObject21_CRC 120;
BA_REL_ "GenSigFirstTimeoutTime" BU_SG_REL_ DACU SG_ 805 FLCObject21_ObjID 3000;
BA_REL_ "GenSigTimeoutTime" BU_SG_REL_ DACU SG_ 805 FLCObject21_ObjID 120;
BA_REL_ "GenSigFirstTimeoutTime" BU_SG_REL_ DACU SG_ 805 FLCObject21_DstLeftVar 3000;
BA_REL_ "GenSigTimeoutTime" BU_SG_REL_ DACU SG_ 805 FLCObject21_DstLeftVar 120;
BA_REL_ "GenSigFirstTimeoutTime" BU_SG_REL_ DACU SG_ 805 FLCObject21_DstFarVar 3000;
BA_REL_ "GenSigTimeoutTime" BU_SG_REL_ DACU SG_ 805 FLCObject21_DstFarVar 120;
BA_REL_ "GenSigFirstTimeoutTime" BU_SG_REL_ DACU SG_ 805 FLCObject21_ObjClass 3000;
BA_REL_ "GenSigTimeoutTime" BU_SG_REL_ DACU SG_ 805 FLCObject21_ObjClass 120;
BA_REL_ "GenSigFirstTimeoutTime" BU_SG_REL_ DACU SG_ 805 FLCObject21_ObjDynClass 3000;
BA_REL_ "GenSigTimeoutTime" BU_SG_REL_ DACU SG_ 805 FLCObject21_ObjDynClass 120;
BA_REL_ "GenSigFirstTimeoutTime" BU_SG_REL_ DACU SG_ 805 FLCObject21_ExistConf 3000;
BA_REL_ "GenSigTimeoutTime" BU_SG_REL_ DACU SG_ 805 FLCObject21_ExistConf 120;
BA_REL_ "GenSigFirstTimeoutTime" BU_SG_REL_ DACU SG_ 805 FLCObject21_DstRightVar 3000;
BA_REL_ "GenSigTimeoutTime" BU_SG_REL_ DACU SG_ 805 FLCObject21_DstRightVar 120;
BA_REL_ "GenSigFirstTimeoutTime" BU_SG_REL_ DACU SG_ 805 FLCObject21_ReliabilityConf 3000;
BA_REL_ "GenSigTimeoutTime" BU_SG_REL_ DACU SG_ 805 FLCObject21_ReliabilityConf 120;
BA_REL_ "GenSigFirstTimeoutTime" BU_SG_REL_ DACU SG_ 805 FLCObject21_LongVelVar 3000;
BA_REL_ "GenSigTimeoutTime" BU_SG_REL_ DACU SG_ 805 FLCObject21_LongVelVar 120;
BA_REL_ "GenSigFirstTimeoutTime" BU_SG_REL_ DACU SG_ 805 FLCObject21_LongPosVar 3000;
BA_REL_ "GenSigTimeoutTime" BU_SG_REL_ DACU SG_ 805 FLCObject21_LongPosVar 120;
BA_REL_ "GenSigFirstTimeoutTime" BU_SG_REL_ DACU SG_ 805 FLCObject21_TargetToLine 3000;
BA_REL_ "GenSigTimeoutTime" BU_SG_REL_ DACU SG_ 805 FLCObject21_TargetToLine 120;
BA_REL_ "GenSigFirstTimeoutTime" BU_SG_REL_ DACU SG_ 805 FLCObject21_Counter 3000;
BA_REL_ "GenSigTimeoutTime" BU_SG_REL_ DACU SG_ 805 FLCObject21_Counter 120;
BA_REL_ "GenSigFirstTimeoutTime" BU_SG_REL_ DACU SG_ 805 FLCObject21_DistLeftCorner 3000;
BA_REL_ "GenSigTimeoutTime" BU_SG_REL_ DACU SG_ 805 FLCObject21_DistLeftCorner 120;
BA_REL_ "GenSigFirstTimeoutTime" BU_SG_REL_ DACU SG_ 805 FLCObject21_LatVel 3000;
BA_REL_ "GenSigTimeoutTime" BU_SG_REL_ DACU SG_ 805 FLCObject21_LatVel 120;
BA_REL_ "GenSigFirstTimeoutTime" BU_SG_REL_ DACU SG_ 805 FLCObject21_LatVelVar 3000;
BA_REL_ "GenSigTimeoutTime" BU_SG_REL_ DACU SG_ 805 FLCObject21_LatVelVar 120;
BA_REL_ "GenSigFirstTimeoutTime" BU_SG_REL_ DACU SG_ 805 FLCObject21_LatPos 3000;
BA_REL_ "GenSigTimeoutTime" BU_SG_REL_ DACU SG_ 805 FLCObject21_LatPos 120;
BA_REL_ "GenSigFirstTimeoutTime" BU_SG_REL_ DACU SG_ 805 FLCObject21_LongVel 3000;
BA_REL_ "GenSigTimeoutTime" BU_SG_REL_ DACU SG_ 805 FLCObject21_LongVel 120;
BA_REL_ "GenSigFirstTimeoutTime" BU_SG_REL_ DACU SG_ 805 FLCObject21_AngLeftVar 3000;
BA_REL_ "GenSigTimeoutTime" BU_SG_REL_ DACU SG_ 805 FLCObject21_AngLeftVar 120;
BA_REL_ "GenSigFirstTimeoutTime" BU_SG_REL_ DACU SG_ 805 FLCObject21_AngRightVar 3000;
BA_REL_ "GenSigTimeoutTime" BU_SG_REL_ DACU SG_ 805 FLCObject21_AngRightVar 120;
BA_REL_ "GenSigFirstTimeoutTime" BU_SG_REL_ DACU SG_ 805 FLCObject21_AnglFarCorner 3000;
BA_REL_ "GenSigTimeoutTime" BU_SG_REL_ DACU SG_ 805 FLCObject21_AnglFarCorner 120;
BA_REL_ "GenSigFirstTimeoutTime" BU_SG_REL_ DACU SG_ 805 FLCObject21_DistRightCorner 3000;
BA_REL_ "GenSigTimeoutTime" BU_SG_REL_ DACU SG_ 805 FLCObject21_DistRightCorner 120;
BA_REL_ "GenSigFirstTimeoutTime" BU_SG_REL_ DACU SG_ 805 FLCObject21_LifeTime 3000;
BA_REL_ "GenSigTimeoutTime" BU_SG_REL_ DACU SG_ 805 FLCObject21_LifeTime 120;
BA_REL_ "GenSigFirstTimeoutTime" BU_SG_REL_ DACU SG_ 805 FLCObject21_TrackStatus 3000;
BA_REL_ "GenSigTimeoutTime" BU_SG_REL_ DACU SG_ 805 FLCObject21_TrackStatus 120;
BA_REL_ "GenSigFirstTimeoutTime" BU_SG_REL_ DACU SG_ 805 FLCObject21_AnglRightCorner 3000;
BA_REL_ "GenSigTimeoutTime" BU_SG_REL_ DACU SG_ 805 FLCObject21_AnglRightCorner 120;
BA_REL_ "GenSigFirstTimeoutTime" BU_SG_REL_ DACU SG_ 805 FLCObject21_LatAcc 3000;
BA_REL_ "GenSigTimeoutTime" BU_SG_REL_ DACU SG_ 805 FLCObject21_LatAcc 120;
BA_REL_ "GenSigFirstTimeoutTime" BU_SG_REL_ DACU SG_ 805 FLCObject21_HeadingVar 3000;
BA_REL_ "GenSigTimeoutTime" BU_SG_REL_ DACU SG_ 805 FLCObject21_HeadingVar 120;
BA_REL_ "GenSigFirstTimeoutTime" BU_SG_REL_ DACU SG_ 805 FLCObject21_LatPosVar 3000;
BA_REL_ "GenSigTimeoutTime" BU_SG_REL_ DACU SG_ 805 FLCObject21_LatPosVar 120;
BA_REL_ "GenSigFirstTimeoutTime" BU_SG_REL_ DACU SG_ 805 FLCObject21_LongPos 3000;
BA_REL_ "GenSigTimeoutTime" BU_SG_REL_ DACU SG_ 805 FLCObject21_LongPos 120;
BA_REL_ "GenSigFirstTimeoutTime" BU_SG_REL_ DACU SG_ 805 FLCObject21_AngFarVar 3000;
BA_REL_ "GenSigTimeoutTime" BU_SG_REL_ DACU SG_ 805 FLCObject21_AngFarVar 120;
BA_REL_ "GenSigFirstTimeoutTime" BU_SG_REL_ DACU SG_ 805 FLCObject21_TurnIndication 3000;
BA_REL_ "GenSigTimeoutTime" BU_SG_REL_ DACU SG_ 805 FLCObject21_TurnIndication 120;
BA_REL_ "GenSigFirstTimeoutTime" BU_SG_REL_ DACU SG_ 805 FLCObject21_TimeStamp 3000;
BA_REL_ "GenSigTimeoutTime" BU_SG_REL_ DACU SG_ 805 FLCObject21_TimeStamp 120;
BA_REL_ "GenSigFirstTimeoutTime" BU_SG_REL_ DACU SG_ 805 FLCObject21_CoastIndex 3000;
BA_REL_ "GenSigTimeoutTime" BU_SG_REL_ DACU SG_ 805 FLCObject21_CoastIndex 120;
BA_REL_ "GenSigFirstTimeoutTime" BU_SG_REL_ DACU SG_ 805 FLCObject21_Height 3000;
BA_REL_ "GenSigTimeoutTime" BU_SG_REL_ DACU SG_ 805 FLCObject21_Height 120;
BA_REL_ "GenSigFirstTimeoutTime" BU_SG_REL_ DACU SG_ 805 FLCObject21_BrakeLight 3000;
BA_REL_ "GenSigTimeoutTime" BU_SG_REL_ DACU SG_ 805 FLCObject21_BrakeLight 120;
BA_REL_ "GenSigFirstTimeoutTime" BU_SG_REL_ DACU SG_ 805 FLCObject21_AnglLeftCorner 3000;
BA_REL_ "GenSigTimeoutTime" BU_SG_REL_ DACU SG_ 805 FLCObject21_AnglLeftCorner 120;
BA_REL_ "GenSigFirstTimeoutTime" BU_SG_REL_ DACU SG_ 804 FLCObject20_DistLeftCorner 3000;
BA_REL_ "GenSigTimeoutTime" BU_SG_REL_ DACU SG_ 804 FLCObject20_DistLeftCorner 120;
BA_REL_ "GenSigFirstTimeoutTime" BU_SG_REL_ DACU SG_ 804 FLCObject20_HeadingVar 3000;
BA_REL_ "GenSigTimeoutTime" BU_SG_REL_ DACU SG_ 804 FLCObject20_HeadingVar 120;
BA_REL_ "GenSigFirstTimeoutTime" BU_SG_REL_ DACU SG_ 804 FLCObject20_LatPosVar 3000;
BA_REL_ "GenSigTimeoutTime" BU_SG_REL_ DACU SG_ 804 FLCObject20_LatPosVar 120;
BA_REL_ "GenSigFirstTimeoutTime" BU_SG_REL_ DACU SG_ 804 FLCObject20_ExistConf 3000;
BA_REL_ "GenSigTimeoutTime" BU_SG_REL_ DACU SG_ 804 FLCObject20_ExistConf 120;
BA_REL_ "GenSigFirstTimeoutTime" BU_SG_REL_ DACU SG_ 804 FLCObject20_LatVel 3000;
BA_REL_ "GenSigTimeoutTime" BU_SG_REL_ DACU SG_ 804 FLCObject20_LatVel 120;
BA_REL_ "GenSigFirstTimeoutTime" BU_SG_REL_ DACU SG_ 804 FLCObject20_LongVelVar 3000;
BA_REL_ "GenSigTimeoutTime" BU_SG_REL_ DACU SG_ 804 FLCObject20_LongVelVar 120;
BA_REL_ "GenSigFirstTimeoutTime" BU_SG_REL_ DACU SG_ 804 FLCObject20_LongVel 3000;
BA_REL_ "GenSigTimeoutTime" BU_SG_REL_ DACU SG_ 804 FLCObject20_LongVel 120;
BA_REL_ "GenSigFirstTimeoutTime" BU_SG_REL_ DACU SG_ 804 FLCObject20_AnglRightCorner 3000;
BA_REL_ "GenSigTimeoutTime" BU_SG_REL_ DACU SG_ 804 FLCObject20_AnglRightCorner 120;
BA_REL_ "GenSigFirstTimeoutTime" BU_SG_REL_ DACU SG_ 804 FLCObject20_DistRightCorner 3000;
BA_REL_ "GenSigTimeoutTime" BU_SG_REL_ DACU SG_ 804 FLCObject20_DistRightCorner 120;
BA_REL_ "GenSigFirstTimeoutTime" BU_SG_REL_ DACU SG_ 804 FLCObject20_Heading 3000;
BA_REL_ "GenSigTimeoutTime" BU_SG_REL_ DACU SG_ 804 FLCObject20_Heading 120;
BA_REL_ "GenSigFirstTimeoutTime" BU_SG_REL_ DACU SG_ 804 FLCObject20_BrakeLight 3000;
BA_REL_ "GenSigTimeoutTime" BU_SG_REL_ DACU SG_ 804 FLCObject20_BrakeLight 120;
BA_REL_ "GenSigFirstTimeoutTime" BU_SG_REL_ DACU SG_ 804 FLCObject20_DstFarVar 3000;
BA_REL_ "GenSigTimeoutTime" BU_SG_REL_ DACU SG_ 804 FLCObject20_DstFarVar 120;
BA_REL_ "GenSigFirstTimeoutTime" BU_SG_REL_ DACU SG_ 804 FLCObject20_TargetToLine 3000;
BA_REL_ "GenSigTimeoutTime" BU_SG_REL_ DACU SG_ 804 FLCObject20_TargetToLine 120;
BA_REL_ "GenSigFirstTimeoutTime" BU_SG_REL_ DACU SG_ 804 FLCObject20_TimeStamp 3000;
BA_REL_ "GenSigTimeoutTime" BU_SG_REL_ DACU SG_ 804 FLCObject20_TimeStamp 120;
BA_REL_ "GenSigFirstTimeoutTime" BU_SG_REL_ DACU SG_ 804 FLCObject20_DstRightVar 3000;
BA_REL_ "GenSigTimeoutTime" BU_SG_REL_ DACU SG_ 804 FLCObject20_DstRightVar 120;
BA_REL_ "GenSigFirstTimeoutTime" BU_SG_REL_ DACU SG_ 804 FLCObject20_AngLeftVar 3000;
BA_REL_ "GenSigTimeoutTime" BU_SG_REL_ DACU SG_ 804 FLCObject20_AngLeftVar 120;
BA_REL_ "GenSigFirstTimeoutTime" BU_SG_REL_ DACU SG_ 804 FLCObject20_CRC 3000;
BA_REL_ "GenSigTimeoutTime" BU_SG_REL_ DACU SG_ 804 FLCObject20_CRC 120;
BA_REL_ "GenSigFirstTimeoutTime" BU_SG_REL_ DACU SG_ 804 FLCObject20_ObjID 3000;
BA_REL_ "GenSigTimeoutTime" BU_SG_REL_ DACU SG_ 804 FLCObject20_ObjID 120;
BA_REL_ "GenSigFirstTimeoutTime" BU_SG_REL_ DACU SG_ 804 FLCObject20_AngRightVar 3000;
BA_REL_ "GenSigTimeoutTime" BU_SG_REL_ DACU SG_ 804 FLCObject20_AngRightVar 120;
BA_REL_ "GenSigFirstTimeoutTime" BU_SG_REL_ DACU SG_ 804 FLCObject20_AngFarVar 3000;
BA_REL_ "GenSigTimeoutTime" BU_SG_REL_ DACU SG_ 804 FLCObject20_AngFarVar 120;
BA_REL_ "GenSigFirstTimeoutTime" BU_SG_REL_ DACU SG_ 804 FLCObject20_TrackStatus 3000;
BA_REL_ "GenSigTimeoutTime" BU_SG_REL_ DACU SG_ 804 FLCObject20_TrackStatus 120;
BA_REL_ "GenSigFirstTimeoutTime" BU_SG_REL_ DACU SG_ 804 FLCObject20_LatVelVar 3000;
BA_REL_ "GenSigTimeoutTime" BU_SG_REL_ DACU SG_ 804 FLCObject20_LatVelVar 120;
BA_REL_ "GenSigFirstTimeoutTime" BU_SG_REL_ DACU SG_ 804 FLCObject20_LongPosVar 3000;
BA_REL_ "GenSigTimeoutTime" BU_SG_REL_ DACU SG_ 804 FLCObject20_LongPosVar 120;
BA_REL_ "GenSigFirstTimeoutTime" BU_SG_REL_ DACU SG_ 804 FLCObject20_ObjDynClass 3000;
BA_REL_ "GenSigTimeoutTime" BU_SG_REL_ DACU SG_ 804 FLCObject20_ObjDynClass 120;
BA_REL_ "GenSigFirstTimeoutTime" BU_SG_REL_ DACU SG_ 804 FLCObject20_LongAcc 3000;
BA_REL_ "GenSigTimeoutTime" BU_SG_REL_ DACU SG_ 804 FLCObject20_LongAcc 120;
BA_REL_ "GenSigFirstTimeoutTime" BU_SG_REL_ DACU SG_ 804 FLCObject20_Counter 3000;
BA_REL_ "GenSigTimeoutTime" BU_SG_REL_ DACU SG_ 804 FLCObject20_Counter 120;
BA_REL_ "GenSigFirstTimeoutTime" BU_SG_REL_ DACU SG_ 804 FLCObject20_LatPos 3000;
BA_REL_ "GenSigTimeoutTime" BU_SG_REL_ DACU SG_ 804 FLCObject20_LatPos 120;
BA_REL_ "GenSigFirstTimeoutTime" BU_SG_REL_ DACU SG_ 804 FLCObject20_AnglFarCorner 3000;
BA_REL_ "GenSigTimeoutTime" BU_SG_REL_ DACU SG_ 804 FLCObject20_AnglFarCorner 120;
BA_REL_ "GenSigFirstTimeoutTime" BU_SG_REL_ DACU SG_ 804 FLCObject20_ScaleChange 3000;
BA_REL_ "GenSigTimeoutTime" BU_SG_REL_ DACU SG_ 804 FLCObject20_ScaleChange 120;
BA_REL_ "GenSigFirstTimeoutTime" BU_SG_REL_ DACU SG_ 804 FLCObject20_Height 3000;
BA_REL_ "GenSigTimeoutTime" BU_SG_REL_ DACU SG_ 804 FLCObject20_Height 120;
BA_REL_ "GenSigFirstTimeoutTime" BU_SG_REL_ DACU SG_ 804 FLCObject20_ReliabilityConf 3000;
BA_REL_ "GenSigTimeoutTime" BU_SG_REL_ DACU SG_ 804 FLCObject20_ReliabilityConf 120;
BA_REL_ "GenSigFirstTimeoutTime" BU_SG_REL_ DACU SG_ 804 FLCObject20_LatAcc 3000;
BA_REL_ "GenSigTimeoutTime" BU_SG_REL_ DACU SG_ 804 FLCObject20_LatAcc 120;
BA_REL_ "GenSigFirstTimeoutTime" BU_SG_REL_ DACU SG_ 804 FLCObject20_ObjClass 3000;
BA_REL_ "GenSigTimeoutTime" BU_SG_REL_ DACU SG_ 804 FLCObject20_ObjClass 120;
BA_REL_ "GenSigFirstTimeoutTime" BU_SG_REL_ DACU SG_ 804 FLCObject20_AnglLeftCorner 3000;
BA_REL_ "GenSigTimeoutTime" BU_SG_REL_ DACU SG_ 804 FLCObject20_AnglLeftCorner 120;
BA_REL_ "GenSigFirstTimeoutTime" BU_SG_REL_ DACU SG_ 804 FLCObject20_LifeTime 3000;
BA_REL_ "GenSigTimeoutTime" BU_SG_REL_ DACU SG_ 804 FLCObject20_LifeTime 120;
BA_REL_ "GenSigFirstTimeoutTime" BU_SG_REL_ DACU SG_ 804 FLCObject20_DstLeftVar 3000;
BA_REL_ "GenSigTimeoutTime" BU_SG_REL_ DACU SG_ 804 FLCObject20_DstLeftVar 120;
BA_REL_ "GenSigFirstTimeoutTime" BU_SG_REL_ DACU SG_ 804 FLCObject20_DistFarCorner 3000;
BA_REL_ "GenSigTimeoutTime" BU_SG_REL_ DACU SG_ 804 FLCObject20_DistFarCorner 120;
BA_REL_ "GenSigFirstTimeoutTime" BU_SG_REL_ DACU SG_ 804 FLCObject20_TurnIndication 3000;
BA_REL_ "GenSigTimeoutTime" BU_SG_REL_ DACU SG_ 804 FLCObject20_TurnIndication 120;
BA_REL_ "GenSigFirstTimeoutTime" BU_SG_REL_ DACU SG_ 804 FLCObject20_CoastIndex 3000;
BA_REL_ "GenSigTimeoutTime" BU_SG_REL_ DACU SG_ 804 FLCObject20_CoastIndex 120;
BA_REL_ "GenSigFirstTimeoutTime" BU_SG_REL_ DACU SG_ 804 FLCObject20_LongPos 3000;
BA_REL_ "GenSigTimeoutTime" BU_SG_REL_ DACU SG_ 804 FLCObject20_LongPos 120;
BA_REL_ "GenSigFirstTimeoutTime" BU_SG_REL_ DACU SG_ 803 FLCObject19_DistFarCorner 3000;
BA_REL_ "GenSigTimeoutTime" BU_SG_REL_ DACU SG_ 803 FLCObject19_DistFarCorner 120;
BA_REL_ "GenSigFirstTimeoutTime" BU_SG_REL_ DACU SG_ 803 FLCObject19_LongPosVar 3000;
BA_REL_ "GenSigTimeoutTime" BU_SG_REL_ DACU SG_ 803 FLCObject19_LongPosVar 120;
BA_REL_ "GenSigFirstTimeoutTime" BU_SG_REL_ DACU SG_ 803 FLCObject19_TargetToLine 3000;
BA_REL_ "GenSigTimeoutTime" BU_SG_REL_ DACU SG_ 803 FLCObject19_TargetToLine 120;
BA_REL_ "GenSigFirstTimeoutTime" BU_SG_REL_ DACU SG_ 803 FLCObject19_DstLeftVar 3000;
BA_REL_ "GenSigTimeoutTime" BU_SG_REL_ DACU SG_ 803 FLCObject19_DstLeftVar 120;
BA_REL_ "GenSigFirstTimeoutTime" BU_SG_REL_ DACU SG_ 803 FLCObject19_DistRightCorner 3000;
BA_REL_ "GenSigTimeoutTime" BU_SG_REL_ DACU SG_ 803 FLCObject19_DistRightCorner 120;
BA_REL_ "GenSigFirstTimeoutTime" BU_SG_REL_ DACU SG_ 803 FLCObject19_LifeTime 3000;
BA_REL_ "GenSigTimeoutTime" BU_SG_REL_ DACU SG_ 803 FLCObject19_LifeTime 120;
BA_REL_ "GenSigFirstTimeoutTime" BU_SG_REL_ DACU SG_ 803 FLCObject19_Height 3000;
BA_REL_ "GenSigTimeoutTime" BU_SG_REL_ DACU SG_ 803 FLCObject19_Height 120;
BA_REL_ "GenSigFirstTimeoutTime" BU_SG_REL_ DACU SG_ 803 FLCObject19_CRC 3000;
BA_REL_ "GenSigTimeoutTime" BU_SG_REL_ DACU SG_ 803 FLCObject19_CRC 120;
BA_REL_ "GenSigFirstTimeoutTime" BU_SG_REL_ DACU SG_ 803 FLCObject19_TrackStatus 3000;
BA_REL_ "GenSigTimeoutTime" BU_SG_REL_ DACU SG_ 803 FLCObject19_TrackStatus 120;
BA_REL_ "GenSigFirstTimeoutTime" BU_SG_REL_ DACU SG_ 803 FLCObject19_ReliabilityConf 3000;
BA_REL_ "GenSigTimeoutTime" BU_SG_REL_ DACU SG_ 803 FLCObject19_ReliabilityConf 120;
BA_REL_ "GenSigFirstTimeoutTime" BU_SG_REL_ DACU SG_ 803 FLCObject19_Counter 3000;
BA_REL_ "GenSigTimeoutTime" BU_SG_REL_ DACU SG_ 803 FLCObject19_Counter 120;
BA_REL_ "GenSigFirstTimeoutTime" BU_SG_REL_ DACU SG_ 803 FLCObject19_TurnIndication 3000;
BA_REL_ "GenSigTimeoutTime" BU_SG_REL_ DACU SG_ 803 FLCObject19_TurnIndication 120;
BA_REL_ "GenSigFirstTimeoutTime" BU_SG_REL_ DACU SG_ 803 FLCObject19_AngFarVar 3000;
BA_REL_ "GenSigTimeoutTime" BU_SG_REL_ DACU SG_ 803 FLCObject19_AngFarVar 120;
BA_REL_ "GenSigFirstTimeoutTime" BU_SG_REL_ DACU SG_ 803 FLCObject19_BrakeLight 3000;
BA_REL_ "GenSigTimeoutTime" BU_SG_REL_ DACU SG_ 803 FLCObject19_BrakeLight 120;
BA_REL_ "GenSigFirstTimeoutTime" BU_SG_REL_ DACU SG_ 803 FLCObject19_LatAcc 3000;
BA_REL_ "GenSigTimeoutTime" BU_SG_REL_ DACU SG_ 803 FLCObject19_LatAcc 120;
BA_REL_ "GenSigFirstTimeoutTime" BU_SG_REL_ DACU SG_ 803 FLCObject19_ObjDynClass 3000;
BA_REL_ "GenSigTimeoutTime" BU_SG_REL_ DACU SG_ 803 FLCObject19_ObjDynClass 120;
BA_REL_ "GenSigFirstTimeoutTime" BU_SG_REL_ DACU SG_ 803 FLCObject19_DstRightVar 3000;
BA_REL_ "GenSigTimeoutTime" BU_SG_REL_ DACU SG_ 803 FLCObject19_DstRightVar 120;
BA_REL_ "GenSigFirstTimeoutTime" BU_SG_REL_ DACU SG_ 803 FLCObject19_LongVel 3000;
BA_REL_ "GenSigTimeoutTime" BU_SG_REL_ DACU SG_ 803 FLCObject19_LongVel 120;
BA_REL_ "GenSigFirstTimeoutTime" BU_SG_REL_ DACU SG_ 803 FLCObject19_AnglLeftCorner 3000;
BA_REL_ "GenSigTimeoutTime" BU_SG_REL_ DACU SG_ 803 FLCObject19_AnglLeftCorner 120;
BA_REL_ "GenSigFirstTimeoutTime" BU_SG_REL_ DACU SG_ 803 FLCObject19_AngRightVar 3000;
BA_REL_ "GenSigTimeoutTime" BU_SG_REL_ DACU SG_ 803 FLCObject19_AngRightVar 120;
BA_REL_ "GenSigFirstTimeoutTime" BU_SG_REL_ DACU SG_ 803 FLCObject19_Heading 3000;
BA_REL_ "GenSigTimeoutTime" BU_SG_REL_ DACU SG_ 803 FLCObject19_Heading 120;
BA_REL_ "GenSigFirstTimeoutTime" BU_SG_REL_ DACU SG_ 803 FLCObject19_HeadingVar 3000;
BA_REL_ "GenSigTimeoutTime" BU_SG_REL_ DACU SG_ 803 FLCObject19_HeadingVar 120;
BA_REL_ "GenSigFirstTimeoutTime" BU_SG_REL_ DACU SG_ 803 FLCObject19_LatVelVar 3000;
BA_REL_ "GenSigTimeoutTime" BU_SG_REL_ DACU SG_ 803 FLCObject19_LatVelVar 120;
BA_REL_ "GenSigFirstTimeoutTime" BU_SG_REL_ DACU SG_ 803 FLCObject19_ObjClass 3000;
BA_REL_ "GenSigTimeoutTime" BU_SG_REL_ DACU SG_ 803 FLCObject19_ObjClass 120;
BA_REL_ "GenSigFirstTimeoutTime" BU_SG_REL_ DACU SG_ 803 FLCObject19_AnglRightCorner 3000;
BA_REL_ "GenSigTimeoutTime" BU_SG_REL_ DACU SG_ 803 FLCObject19_AnglRightCorner 120;
BA_REL_ "GenSigFirstTimeoutTime" BU_SG_REL_ DACU SG_ 803 FLCObject19_AnglFarCorner 3000;
BA_REL_ "GenSigTimeoutTime" BU_SG_REL_ DACU SG_ 803 FLCObject19_AnglFarCorner 120;
BA_REL_ "GenSigFirstTimeoutTime" BU_SG_REL_ DACU SG_ 803 FLCObject19_TimeStamp 3000;
BA_REL_ "GenSigTimeoutTime" BU_SG_REL_ DACU SG_ 803 FLCObject19_TimeStamp 120;
BA_REL_ "GenSigFirstTimeoutTime" BU_SG_REL_ DACU SG_ 803 FLCObject19_ObjID 3000;
BA_REL_ "GenSigTimeoutTime" BU_SG_REL_ DACU SG_ 803 FLCObject19_ObjID 120;
BA_REL_ "GenSigFirstTimeoutTime" BU_SG_REL_ DACU SG_ 803 FLCObject19_ExistConf 3000;
BA_REL_ "GenSigTimeoutTime" BU_SG_REL_ DACU SG_ 803 FLCObject19_ExistConf 120;
BA_REL_ "GenSigFirstTimeoutTime" BU_SG_REL_ DACU SG_ 803 FLCObject19_LongPos 3000;
BA_REL_ "GenSigTimeoutTime" BU_SG_REL_ DACU SG_ 803 FLCObject19_LongPos 120;
BA_REL_ "GenSigFirstTimeoutTime" BU_SG_REL_ DACU SG_ 803 FLCObject19_DstFarVar 3000;
BA_REL_ "GenSigTimeoutTime" BU_SG_REL_ DACU SG_ 803 FLCObject19_DstFarVar 120;
BA_REL_ "GenSigFirstTimeoutTime" BU_SG_REL_ DACU SG_ 803 FLCObject19_LongVelVar 3000;
BA_REL_ "GenSigTimeoutTime" BU_SG_REL_ DACU SG_ 803 FLCObject19_LongVelVar 120;
BA_REL_ "GenSigFirstTimeoutTime" BU_SG_REL_ DACU SG_ 803 FLCObject19_LatVel 3000;
BA_REL_ "GenSigTimeoutTime" BU_SG_REL_ DACU SG_ 803 FLCObject19_LatVel 120;
BA_REL_ "GenSigFirstTimeoutTime" BU_SG_REL_ DACU SG_ 803 FLCObject19_AngLeftVar 3000;
BA_REL_ "GenSigTimeoutTime" BU_SG_REL_ DACU SG_ 803 FLCObject19_AngLeftVar 120;
BA_REL_ "GenSigFirstTimeoutTime" BU_SG_REL_ DACU SG_ 803 FLCObject19_LatPosVar 3000;
BA_REL_ "GenSigTimeoutTime" BU_SG_REL_ DACU SG_ 803 FLCObject19_LatPosVar 120;
BA_REL_ "GenSigFirstTimeoutTime" BU_SG_REL_ DACU SG_ 803 FLCObject19_DistLeftCorner 3000;
BA_REL_ "GenSigTimeoutTime" BU_SG_REL_ DACU SG_ 803 FLCObject19_DistLeftCorner 120;
BA_REL_ "GenSigFirstTimeoutTime" BU_SG_REL_ DACU SG_ 803 FLCObject19_CoastIndex 3000;
BA_REL_ "GenSigTimeoutTime" BU_SG_REL_ DACU SG_ 803 FLCObject19_CoastIndex 120;
BA_REL_ "GenSigFirstTimeoutTime" BU_SG_REL_ DACU SG_ 803 FLCObject19_LongAcc 3000;
BA_REL_ "GenSigTimeoutTime" BU_SG_REL_ DACU SG_ 803 FLCObject19_LongAcc 120;
BA_REL_ "GenSigFirstTimeoutTime" BU_SG_REL_ DACU SG_ 803 FLCObject19_ScaleChange 3000;
BA_REL_ "GenSigTimeoutTime" BU_SG_REL_ DACU SG_ 803 FLCObject19_ScaleChange 120;
BA_REL_ "GenSigFirstTimeoutTime" BU_SG_REL_ DACU SG_ 803 FLCObject19_LatPos 3000;
BA_REL_ "GenSigTimeoutTime" BU_SG_REL_ DACU SG_ 803 FLCObject19_LatPos 120;
BA_REL_ "GenSigFirstTimeoutTime" BU_SG_REL_ DACU SG_ 802 FLCObject18_TargetToLine 3000;
BA_REL_ "GenSigTimeoutTime" BU_SG_REL_ DACU SG_ 802 FLCObject18_TargetToLine 120;
BA_REL_ "GenSigFirstTimeoutTime" BU_SG_REL_ DACU SG_ 802 FLCObject18_LatAcc 3000;
BA_REL_ "GenSigTimeoutTime" BU_SG_REL_ DACU SG_ 802 FLCObject18_LatAcc 120;
BA_REL_ "GenSigFirstTimeoutTime" BU_SG_REL_ DACU SG_ 802 FLCObject18_BrakeLight 3000;
BA_REL_ "GenSigTimeoutTime" BU_SG_REL_ DACU SG_ 802 FLCObject18_BrakeLight 120;
BA_REL_ "GenSigFirstTimeoutTime" BU_SG_REL_ DACU SG_ 802 FLCObject18_LatVel 3000;
BA_REL_ "GenSigTimeoutTime" BU_SG_REL_ DACU SG_ 802 FLCObject18_LatVel 120;
BA_REL_ "GenSigFirstTimeoutTime" BU_SG_REL_ DACU SG_ 802 FLCObject18_LongVel 3000;
BA_REL_ "GenSigTimeoutTime" BU_SG_REL_ DACU SG_ 802 FLCObject18_LongVel 120;
BA_REL_ "GenSigFirstTimeoutTime" BU_SG_REL_ DACU SG_ 802 FLCObject18_LongVelVar 3000;
BA_REL_ "GenSigTimeoutTime" BU_SG_REL_ DACU SG_ 802 FLCObject18_LongVelVar 120;
BA_REL_ "GenSigFirstTimeoutTime" BU_SG_REL_ DACU SG_ 802 FLCObject18_DstFarVar 3000;
BA_REL_ "GenSigTimeoutTime" BU_SG_REL_ DACU SG_ 802 FLCObject18_DstFarVar 120;
BA_REL_ "GenSigFirstTimeoutTime" BU_SG_REL_ DACU SG_ 802 FLCObject18_LatPosVar 3000;
BA_REL_ "GenSigTimeoutTime" BU_SG_REL_ DACU SG_ 802 FLCObject18_LatPosVar 120;
BA_REL_ "GenSigFirstTimeoutTime" BU_SG_REL_ DACU SG_ 802 FLCObject18_LongAcc 3000;
BA_REL_ "GenSigTimeoutTime" BU_SG_REL_ DACU SG_ 802 FLCObject18_LongAcc 120;
BA_REL_ "GenSigFirstTimeoutTime" BU_SG_REL_ DACU SG_ 802 FLCObject18_CoastIndex 3000;
BA_REL_ "GenSigTimeoutTime" BU_SG_REL_ DACU SG_ 802 FLCObject18_CoastIndex 120;
BA_REL_ "GenSigFirstTimeoutTime" BU_SG_REL_ DACU SG_ 802 FLCObject18_TimeStamp 3000;
BA_REL_ "GenSigTimeoutTime" BU_SG_REL_ DACU SG_ 802 FLCObject18_TimeStamp 120;
BA_REL_ "GenSigFirstTimeoutTime" BU_SG_REL_ DACU SG_ 802 FLCObject18_LongPos 3000;
BA_REL_ "GenSigTimeoutTime" BU_SG_REL_ DACU SG_ 802 FLCObject18_LongPos 120;
BA_REL_ "GenSigFirstTimeoutTime" BU_SG_REL_ DACU SG_ 802 FLCObject18_LongPosVar 3000;
BA_REL_ "GenSigTimeoutTime" BU_SG_REL_ DACU SG_ 802 FLCObject18_LongPosVar 120;
BA_REL_ "GenSigFirstTimeoutTime" BU_SG_REL_ DACU SG_ 802 FLCObject18_ObjClass 3000;
BA_REL_ "GenSigTimeoutTime" BU_SG_REL_ DACU SG_ 802 FLCObject18_ObjClass 120;
BA_REL_ "GenSigFirstTimeoutTime" BU_SG_REL_ DACU SG_ 802 FLCObject18_ObjID 3000;
BA_REL_ "GenSigTimeoutTime" BU_SG_REL_ DACU SG_ 802 FLCObject18_ObjID 120;
BA_REL_ "GenSigFirstTimeoutTime" BU_SG_REL_ DACU SG_ 802 FLCObject18_Heading 3000;
BA_REL_ "GenSigTimeoutTime" BU_SG_REL_ DACU SG_ 802 FLCObject18_Heading 120;
BA_REL_ "GenSigFirstTimeoutTime" BU_SG_REL_ DACU SG_ 802 FLCObject18_DstLeftVar 3000;
BA_REL_ "GenSigTimeoutTime" BU_SG_REL_ DACU SG_ 802 FLCObject18_DstLeftVar 120;
BA_REL_ "GenSigFirstTimeoutTime" BU_SG_REL_ DACU SG_ 802 FLCObject18_LifeTime 3000;
BA_REL_ "GenSigTimeoutTime" BU_SG_REL_ DACU SG_ 802 FLCObject18_LifeTime 120;
BA_REL_ "GenSigFirstTimeoutTime" BU_SG_REL_ DACU SG_ 802 FLCObject18_Height 3000;
BA_REL_ "GenSigTimeoutTime" BU_SG_REL_ DACU SG_ 802 FLCObject18_Height 120;
BA_REL_ "GenSigFirstTimeoutTime" BU_SG_REL_ DACU SG_ 802 FLCObject18_AngFarVar 3000;
BA_REL_ "GenSigTimeoutTime" BU_SG_REL_ DACU SG_ 802 FLCObject18_AngFarVar 120;
BA_REL_ "GenSigFirstTimeoutTime" BU_SG_REL_ DACU SG_ 802 FLCObject18_ObjDynClass 3000;
BA_REL_ "GenSigTimeoutTime" BU_SG_REL_ DACU SG_ 802 FLCObject18_ObjDynClass 120;
BA_REL_ "GenSigFirstTimeoutTime" BU_SG_REL_ DACU SG_ 802 FLCObject18_AnglLeftCorner 3000;
BA_REL_ "GenSigTimeoutTime" BU_SG_REL_ DACU SG_ 802 FLCObject18_AnglLeftCorner 120;
BA_REL_ "GenSigFirstTimeoutTime" BU_SG_REL_ DACU SG_ 802 FLCObject18_ReliabilityConf 3000;
BA_REL_ "GenSigTimeoutTime" BU_SG_REL_ DACU SG_ 802 FLCObject18_ReliabilityConf 120;
BA_REL_ "GenSigFirstTimeoutTime" BU_SG_REL_ DACU SG_ 802 FLCObject18_LatVelVar 3000;
BA_REL_ "GenSigTimeoutTime" BU_SG_REL_ DACU SG_ 802 FLCObject18_LatVelVar 120;
BA_REL_ "GenSigFirstTimeoutTime" BU_SG_REL_ DACU SG_ 802 FLCObject18_ExistConf 3000;
BA_REL_ "GenSigTimeoutTime" BU_SG_REL_ DACU SG_ 802 FLCObject18_ExistConf 120;
BA_REL_ "GenSigFirstTimeoutTime" BU_SG_REL_ DACU SG_ 802 FLCObject18_Counter 3000;
BA_REL_ "GenSigTimeoutTime" BU_SG_REL_ DACU SG_ 802 FLCObject18_Counter 120;
BA_REL_ "GenSigFirstTimeoutTime" BU_SG_REL_ DACU SG_ 802 FLCObject18_DistLeftCorner 3000;
BA_REL_ "GenSigTimeoutTime" BU_SG_REL_ DACU SG_ 802 FLCObject18_DistLeftCorner 120;
BA_REL_ "GenSigFirstTimeoutTime" BU_SG_REL_ DACU SG_ 802 FLCObject18_ScaleChange 3000;
BA_REL_ "GenSigTimeoutTime" BU_SG_REL_ DACU SG_ 802 FLCObject18_ScaleChange 120;
BA_REL_ "GenSigFirstTimeoutTime" BU_SG_REL_ DACU SG_ 802 FLCObject18_AnglFarCorner 3000;
BA_REL_ "GenSigTimeoutTime" BU_SG_REL_ DACU SG_ 802 FLCObject18_AnglFarCorner 120;
BA_REL_ "GenSigFirstTimeoutTime" BU_SG_REL_ DACU SG_ 802 FLCObject18_DstRightVar 3000;
BA_REL_ "GenSigTimeoutTime" BU_SG_REL_ DACU SG_ 802 FLCObject18_DstRightVar 120;
BA_REL_ "GenSigFirstTimeoutTime" BU_SG_REL_ DACU SG_ 802 FLCObject18_HeadingVar 3000;
BA_REL_ "GenSigTimeoutTime" BU_SG_REL_ DACU SG_ 802 FLCObject18_HeadingVar 120;
BA_REL_ "GenSigFirstTimeoutTime" BU_SG_REL_ DACU SG_ 802 FLCObject18_TrackStatus 3000;
BA_REL_ "GenSigTimeoutTime" BU_SG_REL_ DACU SG_ 802 FLCObject18_TrackStatus 120;
BA_REL_ "GenSigFirstTimeoutTime" BU_SG_REL_ DACU SG_ 802 FLCObject18_LatPos 3000;
BA_REL_ "GenSigTimeoutTime" BU_SG_REL_ DACU SG_ 802 FLCObject18_LatPos 120;
BA_REL_ "GenSigFirstTimeoutTime" BU_SG_REL_ DACU SG_ 802 FLCObject18_AngLeftVar 3000;
BA_REL_ "GenSigTimeoutTime" BU_SG_REL_ DACU SG_ 802 FLCObject18_AngLeftVar 120;
BA_REL_ "GenSigFirstTimeoutTime" BU_SG_REL_ DACU SG_ 802 FLCObject18_DistFarCorner 3000;
BA_REL_ "GenSigTimeoutTime" BU_SG_REL_ DACU SG_ 802 FLCObject18_DistFarCorner 120;
BA_REL_ "GenSigFirstTimeoutTime" BU_SG_REL_ DACU SG_ 802 FLCObject18_TurnIndication 3000;
BA_REL_ "GenSigTimeoutTime" BU_SG_REL_ DACU SG_ 802 FLCObject18_TurnIndication 120;
BA_REL_ "GenSigFirstTimeoutTime" BU_SG_REL_ DACU SG_ 802 FLCObject18_CRC 3000;
BA_REL_ "GenSigTimeoutTime" BU_SG_REL_ DACU SG_ 802 FLCObject18_CRC 120;
BA_REL_ "GenSigFirstTimeoutTime" BU_SG_REL_ DACU SG_ 802 FLCObject18_AngRightVar 3000;
BA_REL_ "GenSigTimeoutTime" BU_SG_REL_ DACU SG_ 802 FLCObject18_AngRightVar 120;
BA_REL_ "GenSigFirstTimeoutTime" BU_SG_REL_ DACU SG_ 802 FLCObject18_AnglRightCorner 3000;
BA_REL_ "GenSigTimeoutTime" BU_SG_REL_ DACU SG_ 802 FLCObject18_AnglRightCorner 120;
BA_REL_ "GenSigFirstTimeoutTime" BU_SG_REL_ DACU SG_ 802 FLCObject18_DistRightCorner 3000;
BA_REL_ "GenSigTimeoutTime" BU_SG_REL_ DACU SG_ 802 FLCObject18_DistRightCorner 120;
BA_REL_ "GenSigFirstTimeoutTime" BU_SG_REL_ DACU SG_ 801 FLCObject17_TargetToLine 3000;
BA_REL_ "GenSigTimeoutTime" BU_SG_REL_ DACU SG_ 801 FLCObject17_TargetToLine 120;
BA_REL_ "GenSigFirstTimeoutTime" BU_SG_REL_ DACU SG_ 801 FLCObject17_DstFarVar 3000;
BA_REL_ "GenSigTimeoutTime" BU_SG_REL_ DACU SG_ 801 FLCObject17_DstFarVar 120;
BA_REL_ "GenSigFirstTimeoutTime" BU_SG_REL_ DACU SG_ 801 FLCObject17_LifeTime 3000;
BA_REL_ "GenSigTimeoutTime" BU_SG_REL_ DACU SG_ 801 FLCObject17_LifeTime 120;
BA_REL_ "GenSigFirstTimeoutTime" BU_SG_REL_ DACU SG_ 801 FLCObject17_DistLeftCorner 3000;
BA_REL_ "GenSigTimeoutTime" BU_SG_REL_ DACU SG_ 801 FLCObject17_DistLeftCorner 120;
BA_REL_ "GenSigFirstTimeoutTime" BU_SG_REL_ DACU SG_ 801 FLCObject17_LatAcc 3000;
BA_REL_ "GenSigTimeoutTime" BU_SG_REL_ DACU SG_ 801 FLCObject17_LatAcc 120;
BA_REL_ "GenSigFirstTimeoutTime" BU_SG_REL_ DACU SG_ 801 FLCObject17_AnglRightCorner 3000;
BA_REL_ "GenSigTimeoutTime" BU_SG_REL_ DACU SG_ 801 FLCObject17_AnglRightCorner 120;
BA_REL_ "GenSigFirstTimeoutTime" BU_SG_REL_ DACU SG_ 801 FLCObject17_CRC 3000;
BA_REL_ "GenSigTimeoutTime" BU_SG_REL_ DACU SG_ 801 FLCObject17_CRC 120;
BA_REL_ "GenSigFirstTimeoutTime" BU_SG_REL_ DACU SG_ 801 FLCObject17_DistFarCorner 3000;
BA_REL_ "GenSigTimeoutTime" BU_SG_REL_ DACU SG_ 801 FLCObject17_DistFarCorner 120;
BA_REL_ "GenSigFirstTimeoutTime" BU_SG_REL_ DACU SG_ 801 FLCObject17_LongAcc 3000;
BA_REL_ "GenSigTimeoutTime" BU_SG_REL_ DACU SG_ 801 FLCObject17_LongAcc 120;
BA_REL_ "GenSigFirstTimeoutTime" BU_SG_REL_ DACU SG_ 801 FLCObject17_AngRightVar 3000;
BA_REL_ "GenSigTimeoutTime" BU_SG_REL_ DACU SG_ 801 FLCObject17_AngRightVar 120;
BA_REL_ "GenSigFirstTimeoutTime" BU_SG_REL_ DACU SG_ 801 FLCObject17_CoastIndex 3000;
BA_REL_ "GenSigTimeoutTime" BU_SG_REL_ DACU SG_ 801 FLCObject17_CoastIndex 120;
BA_REL_ "GenSigFirstTimeoutTime" BU_SG_REL_ DACU SG_ 801 FLCObject17_ObjClass 3000;
BA_REL_ "GenSigTimeoutTime" BU_SG_REL_ DACU SG_ 801 FLCObject17_ObjClass 120;
BA_REL_ "GenSigFirstTimeoutTime" BU_SG_REL_ DACU SG_ 801 FLCObject17_TrackStatus 3000;
BA_REL_ "GenSigTimeoutTime" BU_SG_REL_ DACU SG_ 801 FLCObject17_TrackStatus 120;
BA_REL_ "GenSigFirstTimeoutTime" BU_SG_REL_ DACU SG_ 801 FLCObject17_LongPos 3000;
BA_REL_ "GenSigTimeoutTime" BU_SG_REL_ DACU SG_ 801 FLCObject17_LongPos 120;
BA_REL_ "GenSigFirstTimeoutTime" BU_SG_REL_ DACU SG_ 801 FLCObject17_LongVelVar 3000;
BA_REL_ "GenSigTimeoutTime" BU_SG_REL_ DACU SG_ 801 FLCObject17_LongVelVar 120;
BA_REL_ "GenSigFirstTimeoutTime" BU_SG_REL_ DACU SG_ 801 FLCObject17_ObjID 3000;
BA_REL_ "GenSigTimeoutTime" BU_SG_REL_ DACU SG_ 801 FLCObject17_ObjID 120;
BA_REL_ "GenSigFirstTimeoutTime" BU_SG_REL_ DACU SG_ 801 FLCObject17_LongPosVar 3000;
BA_REL_ "GenSigTimeoutTime" BU_SG_REL_ DACU SG_ 801 FLCObject17_LongPosVar 120;
BA_REL_ "GenSigFirstTimeoutTime" BU_SG_REL_ DACU SG_ 801 FLCObject17_DstRightVar 3000;
BA_REL_ "GenSigTimeoutTime" BU_SG_REL_ DACU SG_ 801 FLCObject17_DstRightVar 120;
BA_REL_ "GenSigFirstTimeoutTime" BU_SG_REL_ DACU SG_ 801 FLCObject17_DstLeftVar 3000;
BA_REL_ "GenSigTimeoutTime" BU_SG_REL_ DACU SG_ 801 FLCObject17_DstLeftVar 120;
BA_REL_ "GenSigFirstTimeoutTime" BU_SG_REL_ DACU SG_ 801 FLCObject17_Height 3000;
BA_REL_ "GenSigTimeoutTime" BU_SG_REL_ DACU SG_ 801 FLCObject17_Height 120;
BA_REL_ "GenSigFirstTimeoutTime" BU_SG_REL_ DACU SG_ 801 FLCObject17_LatPos 3000;
BA_REL_ "GenSigTimeoutTime" BU_SG_REL_ DACU SG_ 801 FLCObject17_LatPos 120;
BA_REL_ "GenSigFirstTimeoutTime" BU_SG_REL_ DACU SG_ 801 FLCObject17_LongVel 3000;
BA_REL_ "GenSigTimeoutTime" BU_SG_REL_ DACU SG_ 801 FLCObject17_LongVel 120;
BA_REL_ "GenSigFirstTimeoutTime" BU_SG_REL_ DACU SG_ 801 FLCObject17_LatVel 3000;
BA_REL_ "GenSigTimeoutTime" BU_SG_REL_ DACU SG_ 801 FLCObject17_LatVel 120;
BA_REL_ "GenSigFirstTimeoutTime" BU_SG_REL_ DACU SG_ 801 FLCObject17_DistRightCorner 3000;
BA_REL_ "GenSigTimeoutTime" BU_SG_REL_ DACU SG_ 801 FLCObject17_DistRightCorner 120;
BA_REL_ "GenSigFirstTimeoutTime" BU_SG_REL_ DACU SG_ 801 FLCObject17_AngFarVar 3000;
BA_REL_ "GenSigTimeoutTime" BU_SG_REL_ DACU SG_ 801 FLCObject17_AngFarVar 120;
BA_REL_ "GenSigFirstTimeoutTime" BU_SG_REL_ DACU SG_ 801 FLCObject17_TurnIndication 3000;
BA_REL_ "GenSigTimeoutTime" BU_SG_REL_ DACU SG_ 801 FLCObject17_TurnIndication 120;
BA_REL_ "GenSigFirstTimeoutTime" BU_SG_REL_ DACU SG_ 801 FLCObject17_AnglLeftCorner 3000;
BA_REL_ "GenSigTimeoutTime" BU_SG_REL_ DACU SG_ 801 FLCObject17_AnglLeftCorner 120;
BA_REL_ "GenSigFirstTimeoutTime" BU_SG_REL_ DACU SG_ 801 FLCObject17_TimeStamp 3000;
BA_REL_ "GenSigTimeoutTime" BU_SG_REL_ DACU SG_ 801 FLCObject17_TimeStamp 120;
BA_REL_ "GenSigFirstTimeoutTime" BU_SG_REL_ DACU SG_ 801 FLCObject17_ExistConf 3000;
BA_REL_ "GenSigTimeoutTime" BU_SG_REL_ DACU SG_ 801 FLCObject17_ExistConf 120;
BA_REL_ "GenSigFirstTimeoutTime" BU_SG_REL_ DACU SG_ 801 FLCObject17_Counter 3000;
BA_REL_ "GenSigTimeoutTime" BU_SG_REL_ DACU SG_ 801 FLCObject17_Counter 120;
BA_REL_ "GenSigFirstTimeoutTime" BU_SG_REL_ DACU SG_ 801 FLCObject17_Heading 3000;
BA_REL_ "GenSigTimeoutTime" BU_SG_REL_ DACU SG_ 801 FLCObject17_Heading 120;
BA_REL_ "GenSigFirstTimeoutTime" BU_SG_REL_ DACU SG_ 801 FLCObject17_AnglFarCorner 3000;
BA_REL_ "GenSigTimeoutTime" BU_SG_REL_ DACU SG_ 801 FLCObject17_AnglFarCorner 120;
BA_REL_ "GenSigFirstTimeoutTime" BU_SG_REL_ DACU SG_ 801 FLCObject17_ReliabilityConf 3000;
BA_REL_ "GenSigTimeoutTime" BU_SG_REL_ DACU SG_ 801 FLCObject17_ReliabilityConf 120;
BA_REL_ "GenSigFirstTimeoutTime" BU_SG_REL_ DACU SG_ 801 FLCObject17_AngLeftVar 3000;
BA_REL_ "GenSigTimeoutTime" BU_SG_REL_ DACU SG_ 801 FLCObject17_AngLeftVar 120;
BA_REL_ "GenSigFirstTimeoutTime" BU_SG_REL_ DACU SG_ 801 FLCObject17_ScaleChange 3000;
BA_REL_ "GenSigTimeoutTime" BU_SG_REL_ DACU SG_ 801 FLCObject17_ScaleChange 120;
BA_REL_ "GenSigFirstTimeoutTime" BU_SG_REL_ DACU SG_ 801 FLCObject17_LatPosVar 3000;
BA_REL_ "GenSigTimeoutTime" BU_SG_REL_ DACU SG_ 801 FLCObject17_LatPosVar 120;
BA_REL_ "GenSigFirstTimeoutTime" BU_SG_REL_ DACU SG_ 801 FLCObject17_LatVelVar 3000;
BA_REL_ "GenSigTimeoutTime" BU_SG_REL_ DACU SG_ 801 FLCObject17_LatVelVar 120;
BA_REL_ "GenSigFirstTimeoutTime" BU_SG_REL_ DACU SG_ 801 FLCObject17_ObjDynClass 3000;
BA_REL_ "GenSigTimeoutTime" BU_SG_REL_ DACU SG_ 801 FLCObject17_ObjDynClass 120;
BA_REL_ "GenSigFirstTimeoutTime" BU_SG_REL_ DACU SG_ 801 FLCObject17_BrakeLight 3000;
BA_REL_ "GenSigTimeoutTime" BU_SG_REL_ DACU SG_ 801 FLCObject17_BrakeLight 120;
BA_REL_ "GenSigFirstTimeoutTime" BU_SG_REL_ DACU SG_ 801 FLCObject17_HeadingVar 3000;
BA_REL_ "GenSigTimeoutTime" BU_SG_REL_ DACU SG_ 801 FLCObject17_HeadingVar 120;
BA_REL_ "GenSigFirstTimeoutTime" BU_SG_REL_ DACU SG_ 800 FLCObject16_LatPos 3000;
BA_REL_ "GenSigTimeoutTime" BU_SG_REL_ DACU SG_ 800 FLCObject16_LatPos 120;
BA_REL_ "GenSigFirstTimeoutTime" BU_SG_REL_ DACU SG_ 800 FLCObject16_LifeTime 3000;
BA_REL_ "GenSigTimeoutTime" BU_SG_REL_ DACU SG_ 800 FLCObject16_LifeTime 120;
BA_REL_ "GenSigFirstTimeoutTime" BU_SG_REL_ DACU SG_ 800 FLCObject16_ObjID 3000;
BA_REL_ "GenSigTimeoutTime" BU_SG_REL_ DACU SG_ 800 FLCObject16_ObjID 120;
BA_REL_ "GenSigFirstTimeoutTime" BU_SG_REL_ DACU SG_ 800 FLCObject16_LongAcc 3000;
BA_REL_ "GenSigTimeoutTime" BU_SG_REL_ DACU SG_ 800 FLCObject16_LongAcc 120;
BA_REL_ "GenSigFirstTimeoutTime" BU_SG_REL_ DACU SG_ 800 FLCObject16_DstRightVar 3000;
BA_REL_ "GenSigTimeoutTime" BU_SG_REL_ DACU SG_ 800 FLCObject16_DstRightVar 120;
BA_REL_ "GenSigFirstTimeoutTime" BU_SG_REL_ DACU SG_ 800 FLCObject16_Counter 3000;
BA_REL_ "GenSigTimeoutTime" BU_SG_REL_ DACU SG_ 800 FLCObject16_Counter 120;
BA_REL_ "GenSigFirstTimeoutTime" BU_SG_REL_ DACU SG_ 800 FLCObject16_AnglFarCorner 3000;
BA_REL_ "GenSigTimeoutTime" BU_SG_REL_ DACU SG_ 800 FLCObject16_AnglFarCorner 120;
BA_REL_ "GenSigFirstTimeoutTime" BU_SG_REL_ DACU SG_ 800 FLCObject16_DstLeftVar 3000;
BA_REL_ "GenSigTimeoutTime" BU_SG_REL_ DACU SG_ 800 FLCObject16_DstLeftVar 120;
BA_REL_ "GenSigFirstTimeoutTime" BU_SG_REL_ DACU SG_ 800 FLCObject16_DistRightCorner 3000;
BA_REL_ "GenSigTimeoutTime" BU_SG_REL_ DACU SG_ 800 FLCObject16_DistRightCorner 120;
BA_REL_ "GenSigFirstTimeoutTime" BU_SG_REL_ DACU SG_ 800 FLCObject16_LatVel 3000;
BA_REL_ "GenSigTimeoutTime" BU_SG_REL_ DACU SG_ 800 FLCObject16_LatVel 120;
BA_REL_ "GenSigFirstTimeoutTime" BU_SG_REL_ DACU SG_ 800 FLCObject16_LatAcc 3000;
BA_REL_ "GenSigTimeoutTime" BU_SG_REL_ DACU SG_ 800 FLCObject16_LatAcc 120;
BA_REL_ "GenSigFirstTimeoutTime" BU_SG_REL_ DACU SG_ 800 FLCObject16_Heading 3000;
BA_REL_ "GenSigTimeoutTime" BU_SG_REL_ DACU SG_ 800 FLCObject16_Heading 120;
BA_REL_ "GenSigFirstTimeoutTime" BU_SG_REL_ DACU SG_ 800 FLCObject16_BrakeLight 3000;
BA_REL_ "GenSigTimeoutTime" BU_SG_REL_ DACU SG_ 800 FLCObject16_BrakeLight 120;
BA_REL_ "GenSigFirstTimeoutTime" BU_SG_REL_ DACU SG_ 800 FLCObject16_DstFarVar 3000;
BA_REL_ "GenSigTimeoutTime" BU_SG_REL_ DACU SG_ 800 FLCObject16_DstFarVar 120;
BA_REL_ "GenSigFirstTimeoutTime" BU_SG_REL_ DACU SG_ 800 FLCObject16_ScaleChange 3000;
BA_REL_ "GenSigTimeoutTime" BU_SG_REL_ DACU SG_ 800 FLCObject16_ScaleChange 120;
BA_REL_ "GenSigFirstTimeoutTime" BU_SG_REL_ DACU SG_ 800 FLCObject16_TimeStamp 3000;
BA_REL_ "GenSigTimeoutTime" BU_SG_REL_ DACU SG_ 800 FLCObject16_TimeStamp 120;
BA_REL_ "GenSigFirstTimeoutTime" BU_SG_REL_ DACU SG_ 800 FLCObject16_TrackStatus 3000;
BA_REL_ "GenSigTimeoutTime" BU_SG_REL_ DACU SG_ 800 FLCObject16_TrackStatus 120;
BA_REL_ "GenSigFirstTimeoutTime" BU_SG_REL_ DACU SG_ 800 FLCObject16_LatVelVar 3000;
BA_REL_ "GenSigTimeoutTime" BU_SG_REL_ DACU SG_ 800 FLCObject16_LatVelVar 120;
BA_REL_ "GenSigFirstTimeoutTime" BU_SG_REL_ DACU SG_ 800 FLCObject16_LongPos 3000;
BA_REL_ "GenSigTimeoutTime" BU_SG_REL_ DACU SG_ 800 FLCObject16_LongPos 120;
BA_REL_ "GenSigFirstTimeoutTime" BU_SG_REL_ DACU SG_ 800 FLCObject16_ExistConf 3000;
BA_REL_ "GenSigTimeoutTime" BU_SG_REL_ DACU SG_ 800 FLCObject16_ExistConf 120;
BA_REL_ "GenSigFirstTimeoutTime" BU_SG_REL_ DACU SG_ 800 FLCObject16_CoastIndex 3000;
BA_REL_ "GenSigTimeoutTime" BU_SG_REL_ DACU SG_ 800 FLCObject16_CoastIndex 120;
BA_REL_ "GenSigFirstTimeoutTime" BU_SG_REL_ DACU SG_ 800 FLCObject16_TargetToLine 3000;
BA_REL_ "GenSigTimeoutTime" BU_SG_REL_ DACU SG_ 800 FLCObject16_TargetToLine 120;
BA_REL_ "GenSigFirstTimeoutTime" BU_SG_REL_ DACU SG_ 800 FLCObject16_AngRightVar 3000;
BA_REL_ "GenSigTimeoutTime" BU_SG_REL_ DACU SG_ 800 FLCObject16_AngRightVar 120;
BA_REL_ "GenSigFirstTimeoutTime" BU_SG_REL_ DACU SG_ 800 FLCObject16_ObjDynClass 3000;
BA_REL_ "GenSigTimeoutTime" BU_SG_REL_ DACU SG_ 800 FLCObject16_ObjDynClass 120;
BA_REL_ "GenSigFirstTimeoutTime" BU_SG_REL_ DACU SG_ 800 FLCObject16_AnglRightCorner 3000;
BA_REL_ "GenSigTimeoutTime" BU_SG_REL_ DACU SG_ 800 FLCObject16_AnglRightCorner 120;
BA_REL_ "GenSigFirstTimeoutTime" BU_SG_REL_ DACU SG_ 800 FLCObject16_HeadingVar 3000;
BA_REL_ "GenSigTimeoutTime" BU_SG_REL_ DACU SG_ 800 FLCObject16_HeadingVar 120;
BA_REL_ "GenSigFirstTimeoutTime" BU_SG_REL_ DACU SG_ 800 FLCObject16_DistFarCorner 3000;
BA_REL_ "GenSigTimeoutTime" BU_SG_REL_ DACU SG_ 800 FLCObject16_DistFarCorner 120;
BA_REL_ "GenSigFirstTimeoutTime" BU_SG_REL_ DACU SG_ 800 FLCObject16_AngFarVar 3000;
BA_REL_ "GenSigTimeoutTime" BU_SG_REL_ DACU SG_ 800 FLCObject16_AngFarVar 120;
BA_REL_ "GenSigFirstTimeoutTime" BU_SG_REL_ DACU SG_ 800 FLCObject16_LongVelVar 3000;
BA_REL_ "GenSigTimeoutTime" BU_SG_REL_ DACU SG_ 800 FLCObject16_LongVelVar 120;
BA_REL_ "GenSigFirstTimeoutTime" BU_SG_REL_ DACU SG_ 800 FLCObject16_LatPosVar 3000;
BA_REL_ "GenSigTimeoutTime" BU_SG_REL_ DACU SG_ 800 FLCObject16_LatPosVar 120;
BA_REL_ "GenSigFirstTimeoutTime" BU_SG_REL_ DACU SG_ 800 FLCObject16_LongPosVar 3000;
BA_REL_ "GenSigTimeoutTime" BU_SG_REL_ DACU SG_ 800 FLCObject16_LongPosVar 120;
BA_REL_ "GenSigFirstTimeoutTime" BU_SG_REL_ DACU SG_ 800 FLCObject16_DistLeftCorner 3000;
BA_REL_ "GenSigTimeoutTime" BU_SG_REL_ DACU SG_ 800 FLCObject16_DistLeftCorner 120;
BA_REL_ "GenSigFirstTimeoutTime" BU_SG_REL_ DACU SG_ 800 FLCObject16_Height 3000;
BA_REL_ "GenSigTimeoutTime" BU_SG_REL_ DACU SG_ 800 FLCObject16_Height 120;
BA_REL_ "GenSigFirstTimeoutTime" BU_SG_REL_ DACU SG_ 800 FLCObject16_LongVel 3000;
BA_REL_ "GenSigTimeoutTime" BU_SG_REL_ DACU SG_ 800 FLCObject16_LongVel 120;
BA_REL_ "GenSigFirstTimeoutTime" BU_SG_REL_ DACU SG_ 800 FLCObject16_CRC 3000;
BA_REL_ "GenSigTimeoutTime" BU_SG_REL_ DACU SG_ 800 FLCObject16_CRC 120;
BA_REL_ "GenSigFirstTimeoutTime" BU_SG_REL_ DACU SG_ 800 FLCObject16_ObjClass 3000;
BA_REL_ "GenSigTimeoutTime" BU_SG_REL_ DACU SG_ 800 FLCObject16_ObjClass 120;
BA_REL_ "GenSigFirstTimeoutTime" BU_SG_REL_ DACU SG_ 800 FLCObject16_AnglLeftCorner 3000;
BA_REL_ "GenSigTimeoutTime" BU_SG_REL_ DACU SG_ 800 FLCObject16_AnglLeftCorner 120;
BA_REL_ "GenSigFirstTimeoutTime" BU_SG_REL_ DACU SG_ 800 FLCObject16_TurnIndication 3000;
BA_REL_ "GenSigTimeoutTime" BU_SG_REL_ DACU SG_ 800 FLCObject16_TurnIndication 120;
BA_REL_ "GenSigFirstTimeoutTime" BU_SG_REL_ DACU SG_ 800 FLCObject16_ReliabilityConf 3000;
BA_REL_ "GenSigTimeoutTime" BU_SG_REL_ DACU SG_ 800 FLCObject16_ReliabilityConf 120;
BA_REL_ "GenSigFirstTimeoutTime" BU_SG_REL_ DACU SG_ 800 FLCObject16_AngLeftVar 3000;
BA_REL_ "GenSigTimeoutTime" BU_SG_REL_ DACU SG_ 800 FLCObject16_AngLeftVar 120;
BA_REL_ "GenSigFirstTimeoutTime" BU_SG_REL_ DACU SG_ 799 FLCObject15_LongVel 3000;
BA_REL_ "GenSigTimeoutTime" BU_SG_REL_ DACU SG_ 799 FLCObject15_LongVel 120;
BA_REL_ "GenSigFirstTimeoutTime" BU_SG_REL_ DACU SG_ 799 FLCObject15_ScaleChange 3000;
BA_REL_ "GenSigTimeoutTime" BU_SG_REL_ DACU SG_ 799 FLCObject15_ScaleChange 120;
BA_REL_ "GenSigFirstTimeoutTime" BU_SG_REL_ DACU SG_ 799 FLCObject15_DistLeftCorner 3000;
BA_REL_ "GenSigTimeoutTime" BU_SG_REL_ DACU SG_ 799 FLCObject15_DistLeftCorner 120;
BA_REL_ "GenSigFirstTimeoutTime" BU_SG_REL_ DACU SG_ 799 FLCObject15_DstRightVar 3000;
BA_REL_ "GenSigTimeoutTime" BU_SG_REL_ DACU SG_ 799 FLCObject15_DstRightVar 120;
BA_REL_ "GenSigFirstTimeoutTime" BU_SG_REL_ DACU SG_ 799 FLCObject15_LatVel 3000;
BA_REL_ "GenSigTimeoutTime" BU_SG_REL_ DACU SG_ 799 FLCObject15_LatVel 120;
BA_REL_ "GenSigFirstTimeoutTime" BU_SG_REL_ DACU SG_ 799 FLCObject15_LatPos 3000;
BA_REL_ "GenSigTimeoutTime" BU_SG_REL_ DACU SG_ 799 FLCObject15_LatPos 120;
BA_REL_ "GenSigFirstTimeoutTime" BU_SG_REL_ DACU SG_ 799 FLCObject15_TargetToLine 3000;
BA_REL_ "GenSigTimeoutTime" BU_SG_REL_ DACU SG_ 799 FLCObject15_TargetToLine 120;
BA_REL_ "GenSigFirstTimeoutTime" BU_SG_REL_ DACU SG_ 799 FLCObject15_AnglLeftCorner 3000;
BA_REL_ "GenSigTimeoutTime" BU_SG_REL_ DACU SG_ 799 FLCObject15_AnglLeftCorner 120;
BA_REL_ "GenSigFirstTimeoutTime" BU_SG_REL_ DACU SG_ 799 FLCObject15_AnglRightCorner 3000;
BA_REL_ "GenSigTimeoutTime" BU_SG_REL_ DACU SG_ 799 FLCObject15_AnglRightCorner 120;
BA_REL_ "GenSigFirstTimeoutTime" BU_SG_REL_ DACU SG_ 799 FLCObject15_DstLeftVar 3000;
BA_REL_ "GenSigTimeoutTime" BU_SG_REL_ DACU SG_ 799 FLCObject15_DstLeftVar 120;
BA_REL_ "GenSigFirstTimeoutTime" BU_SG_REL_ DACU SG_ 799 FLCObject15_LatAcc 3000;
BA_REL_ "GenSigTimeoutTime" BU_SG_REL_ DACU SG_ 799 FLCObject15_LatAcc 120;
BA_REL_ "GenSigFirstTimeoutTime" BU_SG_REL_ DACU SG_ 799 FLCObject15_ObjDynClass 3000;
BA_REL_ "GenSigTimeoutTime" BU_SG_REL_ DACU SG_ 799 FLCObject15_ObjDynClass 120;
BA_REL_ "GenSigFirstTimeoutTime" BU_SG_REL_ DACU SG_ 799 FLCObject15_TrackStatus 3000;
BA_REL_ "GenSigTimeoutTime" BU_SG_REL_ DACU SG_ 799 FLCObject15_TrackStatus 120;
BA_REL_ "GenSigFirstTimeoutTime" BU_SG_REL_ DACU SG_ 799 FLCObject15_LongAcc 3000;
BA_REL_ "GenSigTimeoutTime" BU_SG_REL_ DACU SG_ 799 FLCObject15_LongAcc 120;
BA_REL_ "GenSigFirstTimeoutTime" BU_SG_REL_ DACU SG_ 799 FLCObject15_CRC 3000;
BA_REL_ "GenSigTimeoutTime" BU_SG_REL_ DACU SG_ 799 FLCObject15_CRC 120;
BA_REL_ "GenSigFirstTimeoutTime" BU_SG_REL_ DACU SG_ 799 FLCObject15_Height 3000;
BA_REL_ "GenSigTimeoutTime" BU_SG_REL_ DACU SG_ 799 FLCObject15_Height 120;
BA_REL_ "GenSigFirstTimeoutTime" BU_SG_REL_ DACU SG_ 799 FLCObject15_Heading 3000;
BA_REL_ "GenSigTimeoutTime" BU_SG_REL_ DACU SG_ 799 FLCObject15_Heading 120;
BA_REL_ "GenSigFirstTimeoutTime" BU_SG_REL_ DACU SG_ 799 FLCObject15_LatVelVar 3000;
BA_REL_ "GenSigTimeoutTime" BU_SG_REL_ DACU SG_ 799 FLCObject15_LatVelVar 120;
BA_REL_ "GenSigFirstTimeoutTime" BU_SG_REL_ DACU SG_ 799 FLCObject15_DistFarCorner 3000;
BA_REL_ "GenSigTimeoutTime" BU_SG_REL_ DACU SG_ 799 FLCObject15_DistFarCorner 120;
BA_REL_ "GenSigFirstTimeoutTime" BU_SG_REL_ DACU SG_ 799 FLCObject15_CoastIndex 3000;
BA_REL_ "GenSigTimeoutTime" BU_SG_REL_ DACU SG_ 799 FLCObject15_CoastIndex 120;
BA_REL_ "GenSigFirstTimeoutTime" BU_SG_REL_ DACU SG_ 799 FLCObject15_ExistConf 3000;
BA_REL_ "GenSigTimeoutTime" BU_SG_REL_ DACU SG_ 799 FLCObject15_ExistConf 120;
BA_REL_ "GenSigFirstTimeoutTime" BU_SG_REL_ DACU SG_ 799 FLCObject15_LatPosVar 3000;
BA_REL_ "GenSigTimeoutTime" BU_SG_REL_ DACU SG_ 799 FLCObject15_LatPosVar 120;
BA_REL_ "GenSigFirstTimeoutTime" BU_SG_REL_ DACU SG_ 799 FLCObject15_BrakeLight 3000;
BA_REL_ "GenSigTimeoutTime" BU_SG_REL_ DACU SG_ 799 FLCObject15_BrakeLight 120;
BA_REL_ "GenSigFirstTimeoutTime" BU_SG_REL_ DACU SG_ 799 FLCObject15_HeadingVar 3000;
BA_REL_ "GenSigTimeoutTime" BU_SG_REL_ DACU SG_ 799 FLCObject15_HeadingVar 120;
BA_REL_ "GenSigFirstTimeoutTime" BU_SG_REL_ DACU SG_ 799 FLCObject15_DistRightCorner 3000;
BA_REL_ "GenSigTimeoutTime" BU_SG_REL_ DACU SG_ 799 FLCObject15_DistRightCorner 120;
BA_REL_ "GenSigFirstTimeoutTime" BU_SG_REL_ DACU SG_ 799 FLCObject15_LongVelVar 3000;
BA_REL_ "GenSigTimeoutTime" BU_SG_REL_ DACU SG_ 799 FLCObject15_LongVelVar 120;
BA_REL_ "GenSigFirstTimeoutTime" BU_SG_REL_ DACU SG_ 799 FLCObject15_LongPosVar 3000;
BA_REL_ "GenSigTimeoutTime" BU_SG_REL_ DACU SG_ 799 FLCObject15_LongPosVar 120;
BA_REL_ "GenSigFirstTimeoutTime" BU_SG_REL_ DACU SG_ 799 FLCObject15_AngLeftVar 3000;
BA_REL_ "GenSigTimeoutTime" BU_SG_REL_ DACU SG_ 799 FLCObject15_AngLeftVar 120;
BA_REL_ "GenSigFirstTimeoutTime" BU_SG_REL_ DACU SG_ 799 FLCObject15_ObjID 3000;
BA_REL_ "GenSigTimeoutTime" BU_SG_REL_ DACU SG_ 799 FLCObject15_ObjID 120;
BA_REL_ "GenSigFirstTimeoutTime" BU_SG_REL_ DACU SG_ 799 FLCObject15_AngRightVar 3000;
BA_REL_ "GenSigTimeoutTime" BU_SG_REL_ DACU SG_ 799 FLCObject15_AngRightVar 120;
BA_REL_ "GenSigFirstTimeoutTime" BU_SG_REL_ DACU SG_ 799 FLCObject15_ObjClass 3000;
BA_REL_ "GenSigTimeoutTime" BU_SG_REL_ DACU SG_ 799 FLCObject15_ObjClass 120;
BA_REL_ "GenSigFirstTimeoutTime" BU_SG_REL_ DACU SG_ 799 FLCObject15_ReliabilityConf 3000;
BA_REL_ "GenSigTimeoutTime" BU_SG_REL_ DACU SG_ 799 FLCObject15_ReliabilityConf 120;
BA_REL_ "GenSigFirstTimeoutTime" BU_SG_REL_ DACU SG_ 799 FLCObject15_LongPos 3000;
BA_REL_ "GenSigTimeoutTime" BU_SG_REL_ DACU SG_ 799 FLCObject15_LongPos 120;
BA_REL_ "GenSigFirstTimeoutTime" BU_SG_REL_ DACU SG_ 799 FLCObject15_TurnIndication 3000;
BA_REL_ "GenSigTimeoutTime" BU_SG_REL_ DACU SG_ 799 FLCObject15_TurnIndication 120;
BA_REL_ "GenSigFirstTimeoutTime" BU_SG_REL_ DACU SG_ 799 FLCObject15_AngFarVar 3000;
BA_REL_ "GenSigTimeoutTime" BU_SG_REL_ DACU SG_ 799 FLCObject15_AngFarVar 120;
BA_REL_ "GenSigFirstTimeoutTime" BU_SG_REL_ DACU SG_ 799 FLCObject15_AnglFarCorner 3000;
BA_REL_ "GenSigTimeoutTime" BU_SG_REL_ DACU SG_ 799 FLCObject15_AnglFarCorner 120;
BA_REL_ "GenSigFirstTimeoutTime" BU_SG_REL_ DACU SG_ 799 FLCObject15_DstFarVar 3000;
BA_REL_ "GenSigTimeoutTime" BU_SG_REL_ DACU SG_ 799 FLCObject15_DstFarVar 120;
BA_REL_ "GenSigFirstTimeoutTime" BU_SG_REL_ DACU SG_ 799 FLCObject15_Counter 3000;
BA_REL_ "GenSigTimeoutTime" BU_SG_REL_ DACU SG_ 799 FLCObject15_Counter 120;
BA_REL_ "GenSigFirstTimeoutTime" BU_SG_REL_ DACU SG_ 799 FLCObject15_LifeTime 3000;
BA_REL_ "GenSigTimeoutTime" BU_SG_REL_ DACU SG_ 799 FLCObject15_LifeTime 120;
BA_REL_ "GenSigFirstTimeoutTime" BU_SG_REL_ DACU SG_ 799 FLCObject15_TimeStamp 3000;
BA_REL_ "GenSigTimeoutTime" BU_SG_REL_ DACU SG_ 799 FLCObject15_TimeStamp 120;
BA_REL_ "GenSigFirstTimeoutTime" BU_SG_REL_ DACU SG_ 798 FLCObject14_LongPosVar 3000;
BA_REL_ "GenSigTimeoutTime" BU_SG_REL_ DACU SG_ 798 FLCObject14_LongPosVar 120;
BA_REL_ "GenSigFirstTimeoutTime" BU_SG_REL_ DACU SG_ 798 FLCObject14_BrakeLight 3000;
BA_REL_ "GenSigTimeoutTime" BU_SG_REL_ DACU SG_ 798 FLCObject14_BrakeLight 120;
BA_REL_ "GenSigFirstTimeoutTime" BU_SG_REL_ DACU SG_ 798 FLCObject14_AnglRightCorner 3000;
BA_REL_ "GenSigTimeoutTime" BU_SG_REL_ DACU SG_ 798 FLCObject14_AnglRightCorner 120;
BA_REL_ "GenSigFirstTimeoutTime" BU_SG_REL_ DACU SG_ 798 FLCObject14_Heading 3000;
BA_REL_ "GenSigTimeoutTime" BU_SG_REL_ DACU SG_ 798 FLCObject14_Heading 120;
BA_REL_ "GenSigFirstTimeoutTime" BU_SG_REL_ DACU SG_ 798 FLCObject14_CoastIndex 3000;
BA_REL_ "GenSigTimeoutTime" BU_SG_REL_ DACU SG_ 798 FLCObject14_CoastIndex 120;
BA_REL_ "GenSigFirstTimeoutTime" BU_SG_REL_ DACU SG_ 798 FLCObject14_ObjDynClass 3000;
BA_REL_ "GenSigTimeoutTime" BU_SG_REL_ DACU SG_ 798 FLCObject14_ObjDynClass 120;
BA_REL_ "GenSigFirstTimeoutTime" BU_SG_REL_ DACU SG_ 798 FLCObject14_DistLeftCorner 3000;
BA_REL_ "GenSigTimeoutTime" BU_SG_REL_ DACU SG_ 798 FLCObject14_DistLeftCorner 120;
BA_REL_ "GenSigFirstTimeoutTime" BU_SG_REL_ DACU SG_ 798 FLCObject14_LongPos 3000;
BA_REL_ "GenSigTimeoutTime" BU_SG_REL_ DACU SG_ 798 FLCObject14_LongPos 120;
BA_REL_ "GenSigFirstTimeoutTime" BU_SG_REL_ DACU SG_ 798 FLCObject14_AnglFarCorner 3000;
BA_REL_ "GenSigTimeoutTime" BU_SG_REL_ DACU SG_ 798 FLCObject14_AnglFarCorner 120;
BA_REL_ "GenSigFirstTimeoutTime" BU_SG_REL_ DACU SG_ 798 FLCObject14_DstRightVar 3000;
BA_REL_ "GenSigTimeoutTime" BU_SG_REL_ DACU SG_ 798 FLCObject14_DstRightVar 120;
BA_REL_ "GenSigFirstTimeoutTime" BU_SG_REL_ DACU SG_ 798 FLCObject14_LifeTime 3000;
BA_REL_ "GenSigTimeoutTime" BU_SG_REL_ DACU SG_ 798 FLCObject14_LifeTime 120;
BA_REL_ "GenSigFirstTimeoutTime" BU_SG_REL_ DACU SG_ 798 FLCObject14_ExistConf 3000;
BA_REL_ "GenSigTimeoutTime" BU_SG_REL_ DACU SG_ 798 FLCObject14_ExistConf 120;
BA_REL_ "GenSigFirstTimeoutTime" BU_SG_REL_ DACU SG_ 798 FLCObject14_Height 3000;
BA_REL_ "GenSigTimeoutTime" BU_SG_REL_ DACU SG_ 798 FLCObject14_Height 120;
BA_REL_ "GenSigFirstTimeoutTime" BU_SG_REL_ DACU SG_ 798 FLCObject14_TurnIndication 3000;
BA_REL_ "GenSigTimeoutTime" BU_SG_REL_ DACU SG_ 798 FLCObject14_TurnIndication 120;
BA_REL_ "GenSigFirstTimeoutTime" BU_SG_REL_ DACU SG_ 798 FLCObject14_ObjID 3000;
BA_REL_ "GenSigTimeoutTime" BU_SG_REL_ DACU SG_ 798 FLCObject14_ObjID 120;
BA_REL_ "GenSigFirstTimeoutTime" BU_SG_REL_ DACU SG_ 798 FLCObject14_LatPosVar 3000;
BA_REL_ "GenSigTimeoutTime" BU_SG_REL_ DACU SG_ 798 FLCObject14_LatPosVar 120;
BA_REL_ "GenSigFirstTimeoutTime" BU_SG_REL_ DACU SG_ 798 FLCObject14_TimeStamp 3000;
BA_REL_ "GenSigTimeoutTime" BU_SG_REL_ DACU SG_ 798 FLCObject14_TimeStamp 120;
BA_REL_ "GenSigFirstTimeoutTime" BU_SG_REL_ DACU SG_ 798 FLCObject14_DstFarVar 3000;
BA_REL_ "GenSigTimeoutTime" BU_SG_REL_ DACU SG_ 798 FLCObject14_DstFarVar 120;
BA_REL_ "GenSigFirstTimeoutTime" BU_SG_REL_ DACU SG_ 798 FLCObject14_ReliabilityConf 3000;
BA_REL_ "GenSigTimeoutTime" BU_SG_REL_ DACU SG_ 798 FLCObject14_ReliabilityConf 120;
BA_REL_ "GenSigFirstTimeoutTime" BU_SG_REL_ DACU SG_ 798 FLCObject14_TargetToLine 3000;
BA_REL_ "GenSigTimeoutTime" BU_SG_REL_ DACU SG_ 798 FLCObject14_TargetToLine 120;
BA_REL_ "GenSigFirstTimeoutTime" BU_SG_REL_ DACU SG_ 798 FLCObject14_AngLeftVar 3000;
BA_REL_ "GenSigTimeoutTime" BU_SG_REL_ DACU SG_ 798 FLCObject14_AngLeftVar 120;
BA_REL_ "GenSigFirstTimeoutTime" BU_SG_REL_ DACU SG_ 798 FLCObject14_DistFarCorner 3000;
BA_REL_ "GenSigTimeoutTime" BU_SG_REL_ DACU SG_ 798 FLCObject14_DistFarCorner 120;
BA_REL_ "GenSigFirstTimeoutTime" BU_SG_REL_ DACU SG_ 798 FLCObject14_AngRightVar 3000;
BA_REL_ "GenSigTimeoutTime" BU_SG_REL_ DACU SG_ 798 FLCObject14_AngRightVar 120;
BA_REL_ "GenSigFirstTimeoutTime" BU_SG_REL_ DACU SG_ 798 FLCObject14_CRC 3000;
BA_REL_ "GenSigTimeoutTime" BU_SG_REL_ DACU SG_ 798 FLCObject14_CRC 120;
BA_REL_ "GenSigFirstTimeoutTime" BU_SG_REL_ DACU SG_ 798 FLCObject14_LatPos 3000;
BA_REL_ "GenSigTimeoutTime" BU_SG_REL_ DACU SG_ 798 FLCObject14_LatPos 120;
BA_REL_ "GenSigFirstTimeoutTime" BU_SG_REL_ DACU SG_ 798 FLCObject14_AngFarVar 3000;
BA_REL_ "GenSigTimeoutTime" BU_SG_REL_ DACU SG_ 798 FLCObject14_AngFarVar 120;
BA_REL_ "GenSigFirstTimeoutTime" BU_SG_REL_ DACU SG_ 798 FLCObject14_Counter 3000;
BA_REL_ "GenSigTimeoutTime" BU_SG_REL_ DACU SG_ 798 FLCObject14_Counter 120;
BA_REL_ "GenSigFirstTimeoutTime" BU_SG_REL_ DACU SG_ 798 FLCObject14_DistRightCorner 3000;
BA_REL_ "GenSigTimeoutTime" BU_SG_REL_ DACU SG_ 798 FLCObject14_DistRightCorner 120;
BA_REL_ "GenSigFirstTimeoutTime" BU_SG_REL_ DACU SG_ 798 FLCObject14_ObjClass 3000;
BA_REL_ "GenSigTimeoutTime" BU_SG_REL_ DACU SG_ 798 FLCObject14_ObjClass 120;
BA_REL_ "GenSigFirstTimeoutTime" BU_SG_REL_ DACU SG_ 798 FLCObject14_ScaleChange 3000;
BA_REL_ "GenSigTimeoutTime" BU_SG_REL_ DACU SG_ 798 FLCObject14_ScaleChange 120;
BA_REL_ "GenSigFirstTimeoutTime" BU_SG_REL_ DACU SG_ 798 FLCObject14_HeadingVar 3000;
BA_REL_ "GenSigTimeoutTime" BU_SG_REL_ DACU SG_ 798 FLCObject14_HeadingVar 120;
BA_REL_ "GenSigFirstTimeoutTime" BU_SG_REL_ DACU SG_ 798 FLCObject14_LongVelVar 3000;
BA_REL_ "GenSigTimeoutTime" BU_SG_REL_ DACU SG_ 798 FLCObject14_LongVelVar 120;
BA_REL_ "GenSigFirstTimeoutTime" BU_SG_REL_ DACU SG_ 798 FLCObject14_LatAcc 3000;
BA_REL_ "GenSigTimeoutTime" BU_SG_REL_ DACU SG_ 798 FLCObject14_LatAcc 120;
BA_REL_ "GenSigFirstTimeoutTime" BU_SG_REL_ DACU SG_ 798 FLCObject14_LongVel 3000;
BA_REL_ "GenSigTimeoutTime" BU_SG_REL_ DACU SG_ 798 FLCObject14_LongVel 120;
BA_REL_ "GenSigFirstTimeoutTime" BU_SG_REL_ DACU SG_ 798 FLCObject14_AnglLeftCorner 3000;
BA_REL_ "GenSigTimeoutTime" BU_SG_REL_ DACU SG_ 798 FLCObject14_AnglLeftCorner 120;
BA_REL_ "GenSigFirstTimeoutTime" BU_SG_REL_ DACU SG_ 798 FLCObject14_TrackStatus 3000;
BA_REL_ "GenSigTimeoutTime" BU_SG_REL_ DACU SG_ 798 FLCObject14_TrackStatus 120;
BA_REL_ "GenSigFirstTimeoutTime" BU_SG_REL_ DACU SG_ 798 FLCObject14_LongAcc 3000;
BA_REL_ "GenSigTimeoutTime" BU_SG_REL_ DACU SG_ 798 FLCObject14_LongAcc 120;
BA_REL_ "GenSigFirstTimeoutTime" BU_SG_REL_ DACU SG_ 798 FLCObject14_DstLeftVar 3000;
BA_REL_ "GenSigTimeoutTime" BU_SG_REL_ DACU SG_ 798 FLCObject14_DstLeftVar 120;
BA_REL_ "GenSigFirstTimeoutTime" BU_SG_REL_ DACU SG_ 798 FLCObject14_LatVelVar 3000;
BA_REL_ "GenSigTimeoutTime" BU_SG_REL_ DACU SG_ 798 FLCObject14_LatVelVar 120;
BA_REL_ "GenSigFirstTimeoutTime" BU_SG_REL_ DACU SG_ 798 FLCObject14_LatVel 3000;
BA_REL_ "GenSigTimeoutTime" BU_SG_REL_ DACU SG_ 798 FLCObject14_LatVel 120;
VAL_ 806 FLCObject22_TrackStatus 7 "TrackStatus_NotAvailable" 6 "TrackStatus_Error" 5 "TrackStatus_Spare3" 4 "TrackStatus_Spare2" 3 "TrackStatus_Spare1" 2 "TrackStatus_Invalid" 1 "TrackStatus_Predicted" 0 "TrackStatus_Tracked" ;
VAL_ 806 FLCObject22_ReliabilityConf 7 "ReliabilityConf_NotAvailable" 6 "ReliabilityConf_Error" 5 "ReliabilityConf_Spare2" 4 "ReliabilityConf_Spare1" 3 "ReliabilityConf_Restricted" 2 "ReliabilityConf_ASIL_B" 1 "ReliabilityConf_CNNConfirmed_ObjectShape" 0 "ReliabilityConf_ConfirmedbyGenericStream" ;
VAL_ 806 FLCObject22_TurnIndication 7 "TurnIndication_NotAvailable" 6 "TurnIndication_Error" 5 "TurnIndication_Spare" 4 "TurnIndication_DirectionIndicatorBoth" 3 "TurnIndication_DirectionIndicatorRight" 2 "TurnIndication_DirectionIndicatorLeft" 1 "TurnIndication_NoDirectionIndicator" 0 "TurnIndication_Unknown" ;
VAL_ 806 FLCObject22_ObjClass 15 "ObjClassSideS_NotAvailable" 14 "ObjClassSideS_Error" 13 "ObjClassSideS_Spare4" 12 "ObjClassSideS_Spare3" 11 "ObjClassSideS_Motorcycle" 10 "ObjClassSideS_Bicycle" 9 "ObjClassSideS_UnidentifiedMovableObject" 8 "ObjClassSideS_UnidentifiedVRU" 7 "ObjClassSideS_UnidentifiedVehicle" 6 "ObjClassSideS_StaticObject" 5 "ObjClassSideS_Pedestrian" 4 "ObjClassSideS_2Wheeler" 3 "ObjClassSideS_HeavyVehicle" 2 "ObjClassSideS_Car" 1 "ObjClassSideS_Obstacle" 0 "ObjClassSideS_Undetermined" ;
VAL_ 806 FLCObject22_BrakeLight 7 "BrakeLight_NotAvailable" 6 "BrakeLight_Error" 5 "BrakeLight_Spare" 4 "BrakeLight_BrakeLightThree" 3 "BrakeLight_BrakeLightTwo" 2 "BrakeLight_BrakeLightOne" 1 "BrakeLight_NoBrakeLight" 0 "BrakeLight_BrakeLightUnknown" ;
VAL_ 806 FLCObject22_TargetToLine 7 "TargetToLine_NotAvailable" 6 "TargetToLine_Error" 5 "TargetToLine_Unknown" 4 "TargetToLine_OnTheLeftEgoLine" 3 "TargetToLine_OnTheRightEgoLine" 2 "TargetToLine_BetweenRightAndLeftEgoLine" 1 "TargetToLine_LeftSideOfTheLeftEgoLine" 0 "TargetToLine_RightSideOfTheRightEgoLine" ;
VAL_ 806 FLCObject22_ObjDynClass 3 "ObjDynClass_Error" 2 "ObjDynClass_Movable" 1 "ObjDynClass_Stationary" 0 "ObjDynClass_Reserved" ;
VAL_ 805 FLCObject21_ObjClass 15 "ObjClassSideS_NotAvailable" 14 "ObjClassSideS_Error" 13 "ObjClassSideS_Spare4" 12 "ObjClassSideS_Spare3" 11 "ObjClassSideS_Motorcycle" 10 "ObjClassSideS_Bicycle" 9 "ObjClassSideS_UnidentifiedMovableObject" 8 "ObjClassSideS_UnidentifiedVRU" 7 "ObjClassSideS_UnidentifiedVehicle" 6 "ObjClassSideS_StaticObject" 5 "ObjClassSideS_Pedestrian" 4 "ObjClassSideS_2Wheeler" 3 "ObjClassSideS_HeavyVehicle" 2 "ObjClassSideS_Car" 1 "ObjClassSideS_Obstacle" 0 "ObjClassSideS_Undetermined" ;
VAL_ 805 FLCObject21_ObjDynClass 3 "ObjDynClass_Error" 2 "ObjDynClass_Movable" 1 "ObjDynClass_Stationary" 0 "ObjDynClass_Reserved" ;
VAL_ 805 FLCObject21_ReliabilityConf 7 "ReliabilityConf_NotAvailable" 6 "ReliabilityConf_Error" 5 "ReliabilityConf_Spare2" 4 "ReliabilityConf_Spare1" 3 "ReliabilityConf_Restricted" 2 "ReliabilityConf_ASIL_B" 1 "ReliabilityConf_CNNConfirmed_ObjectShape" 0 "ReliabilityConf_ConfirmedbyGenericStream" ;
VAL_ 805 FLCObject21_TargetToLine 7 "TargetToLine_NotAvailable" 6 "TargetToLine_Error" 5 "TargetToLine_Unknown" 4 "TargetToLine_OnTheLeftEgoLine" 3 "TargetToLine_OnTheRightEgoLine" 2 "TargetToLine_BetweenRightAndLeftEgoLine" 1 "TargetToLine_LeftSideOfTheLeftEgoLine" 0 "TargetToLine_RightSideOfTheRightEgoLine" ;
VAL_ 805 FLCObject21_TrackStatus 7 "TrackStatus_NotAvailable" 6 "TrackStatus_Error" 5 "TrackStatus_Spare3" 4 "TrackStatus_Spare2" 3 "TrackStatus_Spare1" 2 "TrackStatus_Invalid" 1 "TrackStatus_Predicted" 0 "TrackStatus_Tracked" ;
VAL_ 805 FLCObject21_TurnIndication 7 "TurnIndication_NotAvailable" 6 "TurnIndication_Error" 5 "TurnIndication_Spare" 4 "TurnIndication_DirectionIndicatorBoth" 3 "TurnIndication_DirectionIndicatorRight" 2 "TurnIndication_DirectionIndicatorLeft" 1 "TurnIndication_NoDirectionIndicator" 0 "TurnIndication_Unknown" ;
VAL_ 805 FLCObject21_BrakeLight 7 "BrakeLight_NotAvailable" 6 "BrakeLight_Error" 5 "BrakeLight_Spare" 4 "BrakeLight_BrakeLightThree" 3 "BrakeLight_BrakeLightTwo" 2 "BrakeLight_BrakeLightOne" 1 "BrakeLight_NoBrakeLight" 0 "BrakeLight_BrakeLightUnknown" ;
VAL_ 804 FLCObject20_BrakeLight 7 "BrakeLight_NotAvailable" 6 "BrakeLight_Error" 5 "BrakeLight_Spare" 4 "BrakeLight_BrakeLightThree" 3 "BrakeLight_BrakeLightTwo" 2 "BrakeLight_BrakeLightOne" 1 "BrakeLight_NoBrakeLight" 0 "BrakeLight_BrakeLightUnknown" ;
VAL_ 804 FLCObject20_TargetToLine 7 "TargetToLine_NotAvailable" 6 "TargetToLine_Error" 5 "TargetToLine_Unknown" 4 "TargetToLine_OnTheLeftEgoLine" 3 "TargetToLine_OnTheRightEgoLine" 2 "TargetToLine_BetweenRightAndLeftEgoLine" 1 "TargetToLine_LeftSideOfTheLeftEgoLine" 0 "TargetToLine_RightSideOfTheRightEgoLine" ;
VAL_ 804 FLCObject20_TrackStatus 7 "TrackStatus_NotAvailable" 6 "TrackStatus_Error" 5 "TrackStatus_Spare3" 4 "TrackStatus_Spare2" 3 "TrackStatus_Spare1" 2 "TrackStatus_Invalid" 1 "TrackStatus_Predicted" 0 "TrackStatus_Tracked" ;
VAL_ 804 FLCObject20_ObjDynClass 3 "ObjDynClass_Error" 2 "ObjDynClass_Movable" 1 "ObjDynClass_Stationary" 0 "ObjDynClass_Reserved" ;
VAL_ 804 FLCObject20_ReliabilityConf 7 "ReliabilityConf_NotAvailable" 6 "ReliabilityConf_Error" 5 "ReliabilityConf_Spare2" 4 "ReliabilityConf_Spare1" 3 "ReliabilityConf_Restricted" 2 "ReliabilityConf_ASIL_B" 1 "ReliabilityConf_CNNConfirmed_ObjectShape" 0 "ReliabilityConf_ConfirmedbyGenericStream" ;
VAL_ 804 FLCObject20_ObjClass 15 "ObjClassSideS_NotAvailable" 14 "ObjClassSideS_Error" 13 "ObjClassSideS_Spare4" 12 "ObjClassSideS_Spare3" 11 "ObjClassSideS_Motorcycle" 10 "ObjClassSideS_Bicycle" 9 "ObjClassSideS_UnidentifiedMovableObject" 8 "ObjClassSideS_UnidentifiedVRU" 7 "ObjClassSideS_UnidentifiedVehicle" 6 "ObjClassSideS_StaticObject" 5 "ObjClassSideS_Pedestrian" 4 "ObjClassSideS_2Wheeler" 3 "ObjClassSideS_HeavyVehicle" 2 "ObjClassSideS_Car" 1 "ObjClassSideS_Obstacle" 0 "ObjClassSideS_Undetermined" ;
VAL_ 804 FLCObject20_TurnIndication 7 "TurnIndication_NotAvailable" 6 "TurnIndication_Error" 5 "TurnIndication_Spare" 4 "TurnIndication_DirectionIndicatorBoth" 3 "TurnIndication_DirectionIndicatorRight" 2 "TurnIndication_DirectionIndicatorLeft" 1 "TurnIndication_NoDirectionIndicator" 0 "TurnIndication_Unknown" ;
VAL_ 803 FLCObject19_TargetToLine 7 "TargetToLine_NotAvailable" 6 "TargetToLine_Error" 5 "TargetToLine_Unknown" 4 "TargetToLine_OnTheLeftEgoLine" 3 "TargetToLine_OnTheRightEgoLine" 2 "TargetToLine_BetweenRightAndLeftEgoLine" 1 "TargetToLine_LeftSideOfTheLeftEgoLine" 0 "TargetToLine_RightSideOfTheRightEgoLine" ;
VAL_ 803 FLCObject19_TrackStatus 7 "TrackStatus_NotAvailable" 6 "TrackStatus_Error" 5 "TrackStatus_Spare3" 4 "TrackStatus_Spare2" 3 "TrackStatus_Spare1" 2 "TrackStatus_Invalid" 1 "TrackStatus_Predicted" 0 "TrackStatus_Tracked" ;
VAL_ 803 FLCObject19_ReliabilityConf 7 "ReliabilityConf_NotAvailable" 6 "ReliabilityConf_Error" 5 "ReliabilityConf_Spare2" 4 "ReliabilityConf_Spare1" 3 "ReliabilityConf_Restricted" 2 "ReliabilityConf_ASIL_B" 1 "ReliabilityConf_CNNConfirmed_ObjectShape" 0 "ReliabilityConf_ConfirmedbyGenericStream" ;
VAL_ 803 FLCObject19_TurnIndication 7 "TurnIndication_NotAvailable" 6 "TurnIndication_Error" 5 "TurnIndication_Spare" 4 "TurnIndication_DirectionIndicatorBoth" 3 "TurnIndication_DirectionIndicatorRight" 2 "TurnIndication_DirectionIndicatorLeft" 1 "TurnIndication_NoDirectionIndicator" 0 "TurnIndication_Unknown" ;
VAL_ 803 FLCObject19_BrakeLight 7 "BrakeLight_NotAvailable" 6 "BrakeLight_Error" 5 "BrakeLight_Spare" 4 "BrakeLight_BrakeLightThree" 3 "BrakeLight_BrakeLightTwo" 2 "BrakeLight_BrakeLightOne" 1 "BrakeLight_NoBrakeLight" 0 "BrakeLight_BrakeLightUnknown" ;
VAL_ 803 FLCObject19_ObjDynClass 3 "ObjDynClass_Error" 2 "ObjDynClass_Movable" 1 "ObjDynClass_Stationary" 0 "ObjDynClass_Reserved" ;
VAL_ 803 FLCObject19_ObjClass 15 "ObjClassSideS_NotAvailable" 14 "ObjClassSideS_Error" 13 "ObjClassSideS_Spare4" 12 "ObjClassSideS_Spare3" 11 "ObjClassSideS_Motorcycle" 10 "ObjClassSideS_Bicycle" 9 "ObjClassSideS_UnidentifiedMovableObject" 8 "ObjClassSideS_UnidentifiedVRU" 7 "ObjClassSideS_UnidentifiedVehicle" 6 "ObjClassSideS_StaticObject" 5 "ObjClassSideS_Pedestrian" 4 "ObjClassSideS_2Wheeler" 3 "ObjClassSideS_HeavyVehicle" 2 "ObjClassSideS_Car" 1 "ObjClassSideS_Obstacle" 0 "ObjClassSideS_Undetermined" ;
VAL_ 802 FLCObject18_TargetToLine 7 "TargetToLine_NotAvailable" 6 "TargetToLine_Error" 5 "TargetToLine_Unknown" 4 "TargetToLine_OnTheLeftEgoLine" 3 "TargetToLine_OnTheRightEgoLine" 2 "TargetToLine_BetweenRightAndLeftEgoLine" 1 "TargetToLine_LeftSideOfTheLeftEgoLine" 0 "TargetToLine_RightSideOfTheRightEgoLine" ;
VAL_ 802 FLCObject18_BrakeLight 7 "BrakeLight_NotAvailable" 6 "BrakeLight_Error" 5 "BrakeLight_Spare" 4 "BrakeLight_BrakeLightThree" 3 "BrakeLight_BrakeLightTwo" 2 "BrakeLight_BrakeLightOne" 1 "BrakeLight_NoBrakeLight" 0 "BrakeLight_BrakeLightUnknown" ;
VAL_ 802 FLCObject18_ObjClass 15 "ObjClassSideS_NotAvailable" 14 "ObjClassSideS_Error" 13 "ObjClassSideS_Spare4" 12 "ObjClassSideS_Spare3" 11 "ObjClassSideS_Motorcycle" 10 "ObjClassSideS_Bicycle" 9 "ObjClassSideS_UnidentifiedMovableObject" 8 "ObjClassSideS_UnidentifiedVRU" 7 "ObjClassSideS_UnidentifiedVehicle" 6 "ObjClassSideS_StaticObject" 5 "ObjClassSideS_Pedestrian" 4 "ObjClassSideS_2Wheeler" 3 "ObjClassSideS_HeavyVehicle" 2 "ObjClassSideS_Car" 1 "ObjClassSideS_Obstacle" 0 "ObjClassSideS_Undetermined" ;
VAL_ 802 FLCObject18_ObjDynClass 3 "ObjDynClass_Error" 2 "ObjDynClass_Movable" 1 "ObjDynClass_Stationary" 0 "ObjDynClass_Reserved" ;
VAL_ 802 FLCObject18_ReliabilityConf 7 "ReliabilityConf_NotAvailable" 6 "ReliabilityConf_Error" 5 "ReliabilityConf_Spare2" 4 "ReliabilityConf_Spare1" 3 "ReliabilityConf_Restricted" 2 "ReliabilityConf_ASIL_B" 1 "ReliabilityConf_CNNConfirmed_ObjectShape" 0 "ReliabilityConf_ConfirmedbyGenericStream" ;
VAL_ 802 FLCObject18_TrackStatus 7 "TrackStatus_NotAvailable" 6 "TrackStatus_Error" 5 "TrackStatus_Spare3" 4 "TrackStatus_Spare2" 3 "TrackStatus_Spare1" 2 "TrackStatus_Invalid" 1 "TrackStatus_Predicted" 0 "TrackStatus_Tracked" ;
VAL_ 802 FLCObject18_TurnIndication 7 "TurnIndication_NotAvailable" 6 "TurnIndication_Error" 5 "TurnIndication_Spare" 4 "TurnIndication_DirectionIndicatorBoth" 3 "TurnIndication_DirectionIndicatorRight" 2 "TurnIndication_DirectionIndicatorLeft" 1 "TurnIndication_NoDirectionIndicator" 0 "TurnIndication_Unknown" ;
VAL_ 801 FLCObject17_TargetToLine 7 "TargetToLine_NotAvailable" 6 "TargetToLine_Error" 5 "TargetToLine_Unknown" 4 "TargetToLine_OnTheLeftEgoLine" 3 "TargetToLine_OnTheRightEgoLine" 2 "TargetToLine_BetweenRightAndLeftEgoLine" 1 "TargetToLine_LeftSideOfTheLeftEgoLine" 0 "TargetToLine_RightSideOfTheRightEgoLine" ;
VAL_ 801 FLCObject17_ObjClass 15 "ObjClassSideS_NotAvailable" 14 "ObjClassSideS_Error" 13 "ObjClassSideS_Spare4" 12 "ObjClassSideS_Spare3" 11 "ObjClassSideS_Motorcycle" 10 "ObjClassSideS_Bicycle" 9 "ObjClassSideS_UnidentifiedMovableObject" 8 "ObjClassSideS_UnidentifiedVRU" 7 "ObjClassSideS_UnidentifiedVehicle" 6 "ObjClassSideS_StaticObject" 5 "ObjClassSideS_Pedestrian" 4 "ObjClassSideS_2Wheeler" 3 "ObjClassSideS_HeavyVehicle" 2 "ObjClassSideS_Car" 1 "ObjClassSideS_Obstacle" 0 "ObjClassSideS_Undetermined" ;
VAL_ 801 FLCObject17_TrackStatus 7 "TrackStatus_NotAvailable" 6 "TrackStatus_Error" 5 "TrackStatus_Spare3" 4 "TrackStatus_Spare2" 3 "TrackStatus_Spare1" 2 "TrackStatus_Invalid" 1 "TrackStatus_Predicted" 0 "TrackStatus_Tracked" ;
VAL_ 801 FLCObject17_TurnIndication 7 "TurnIndication_NotAvailable" 6 "TurnIndication_Error" 5 "TurnIndication_Spare" 4 "TurnIndication_DirectionIndicatorBoth" 3 "TurnIndication_DirectionIndicatorRight" 2 "TurnIndication_DirectionIndicatorLeft" 1 "TurnIndication_NoDirectionIndicator" 0 "TurnIndication_Unknown" ;
VAL_ 801 FLCObject17_ReliabilityConf 7 "ReliabilityConf_NotAvailable" 6 "ReliabilityConf_Error" 5 "ReliabilityConf_Spare2" 4 "ReliabilityConf_Spare1" 3 "ReliabilityConf_Restricted" 2 "ReliabilityConf_ASIL_B" 1 "ReliabilityConf_CNNConfirmed_ObjectShape" 0 "ReliabilityConf_ConfirmedbyGenericStream" ;
VAL_ 801 FLCObject17_ObjDynClass 3 "ObjDynClass_Error" 2 "ObjDynClass_Movable" 1 "ObjDynClass_Stationary" 0 "ObjDynClass_Reserved" ;
VAL_ 801 FLCObject17_BrakeLight 7 "BrakeLight_NotAvailable" 6 "BrakeLight_Error" 5 "BrakeLight_Spare" 4 "BrakeLight_BrakeLightThree" 3 "BrakeLight_BrakeLightTwo" 2 "BrakeLight_BrakeLightOne" 1 "BrakeLight_NoBrakeLight" 0 "BrakeLight_BrakeLightUnknown" ;
VAL_ 800 FLCObject16_BrakeLight 7 "BrakeLight_NotAvailable" 6 "BrakeLight_Error" 5 "BrakeLight_Spare" 4 "BrakeLight_BrakeLightThree" 3 "BrakeLight_BrakeLightTwo" 2 "BrakeLight_BrakeLightOne" 1 "BrakeLight_NoBrakeLight" 0 "BrakeLight_BrakeLightUnknown" ;
VAL_ 800 FLCObject16_TrackStatus 7 "TrackStatus_NotAvailable" 6 "TrackStatus_Error" 5 "TrackStatus_Spare3" 4 "TrackStatus_Spare2" 3 "TrackStatus_Spare1" 2 "TrackStatus_Invalid" 1 "TrackStatus_Predicted" 0 "TrackStatus_Tracked" ;
VAL_ 800 FLCObject16_TargetToLine 7 "TargetToLine_NotAvailable" 6 "TargetToLine_Error" 5 "TargetToLine_Unknown" 4 "TargetToLine_OnTheLeftEgoLine" 3 "TargetToLine_OnTheRightEgoLine" 2 "TargetToLine_BetweenRightAndLeftEgoLine" 1 "TargetToLine_LeftSideOfTheLeftEgoLine" 0 "TargetToLine_RightSideOfTheRightEgoLine" ;
VAL_ 800 FLCObject16_ObjDynClass 3 "ObjDynClass_Error" 2 "ObjDynClass_Movable" 1 "ObjDynClass_Stationary" 0 "ObjDynClass_Reserved" ;
VAL_ 800 FLCObject16_ObjClass 15 "ObjClassSideS_NotAvailable" 14 "ObjClassSideS_Error" 13 "ObjClassSideS_Spare4" 12 "ObjClassSideS_Spare3" 11 "ObjClassSideS_Motorcycle" 10 "ObjClassSideS_Bicycle" 9 "ObjClassSideS_UnidentifiedMovableObject" 8 "ObjClassSideS_UnidentifiedVRU" 7 "ObjClassSideS_UnidentifiedVehicle" 6 "ObjClassSideS_StaticObject" 5 "ObjClassSideS_Pedestrian" 4 "ObjClassSideS_2Wheeler" 3 "ObjClassSideS_HeavyVehicle" 2 "ObjClassSideS_Car" 1 "ObjClassSideS_Obstacle" 0 "ObjClassSideS_Undetermined" ;
VAL_ 800 FLCObject16_TurnIndication 7 "TurnIndication_NotAvailable" 6 "TurnIndication_Error" 5 "TurnIndication_Spare" 4 "TurnIndication_DirectionIndicatorBoth" 3 "TurnIndication_DirectionIndicatorRight" 2 "TurnIndication_DirectionIndicatorLeft" 1 "TurnIndication_NoDirectionIndicator" 0 "TurnIndication_Unknown" ;
VAL_ 800 FLCObject16_ReliabilityConf 7 "ReliabilityConf_NotAvailable" 6 "ReliabilityConf_Error" 5 "ReliabilityConf_Spare2" 4 "ReliabilityConf_Spare1" 3 "ReliabilityConf_Restricted" 2 "ReliabilityConf_ASIL_B" 1 "ReliabilityConf_CNNConfirmed_ObjectShape" 0 "ReliabilityConf_ConfirmedbyGenericStream" ;
VAL_ 799 FLCObject15_TargetToLine 7 "TargetToLine_NotAvailable" 6 "TargetToLine_Error" 5 "TargetToLine_Unknown" 4 "TargetToLine_OnTheLeftEgoLine" 3 "TargetToLine_OnTheRightEgoLine" 2 "TargetToLine_BetweenRightAndLeftEgoLine" 1 "TargetToLine_LeftSideOfTheLeftEgoLine" 0 "TargetToLine_RightSideOfTheRightEgoLine" ;
VAL_ 799 FLCObject15_ObjDynClass 3 "ObjDynClass_Error" 2 "ObjDynClass_Movable" 1 "ObjDynClass_Stationary" 0 "ObjDynClass_Reserved" ;
VAL_ 799 FLCObject15_TrackStatus 7 "TrackStatus_NotAvailable" 6 "TrackStatus_Error" 5 "TrackStatus_Spare3" 4 "TrackStatus_Spare2" 3 "TrackStatus_Spare1" 2 "TrackStatus_Invalid" 1 "TrackStatus_Predicted" 0 "TrackStatus_Tracked" ;
VAL_ 799 FLCObject15_BrakeLight 7 "BrakeLight_NotAvailable" 6 "BrakeLight_Error" 5 "BrakeLight_Spare" 4 "BrakeLight_BrakeLightThree" 3 "BrakeLight_BrakeLightTwo" 2 "BrakeLight_BrakeLightOne" 1 "BrakeLight_NoBrakeLight" 0 "BrakeLight_BrakeLightUnknown" ;
VAL_ 799 FLCObject15_ObjClass 15 "ObjClassSideS_NotAvailable" 14 "ObjClassSideS_Error" 13 "ObjClassSideS_Spare4" 12 "ObjClassSideS_Spare3" 11 "ObjClassSideS_Motorcycle" 10 "ObjClassSideS_Bicycle" 9 "ObjClassSideS_UnidentifiedMovableObject" 8 "ObjClassSideS_UnidentifiedVRU" 7 "ObjClassSideS_UnidentifiedVehicle" 6 "ObjClassSideS_StaticObject" 5 "ObjClassSideS_Pedestrian" 4 "ObjClassSideS_2Wheeler" 3 "ObjClassSideS_HeavyVehicle" 2 "ObjClassSideS_Car" 1 "ObjClassSideS_Obstacle" 0 "ObjClassSideS_Undetermined" ;
VAL_ 799 FLCObject15_ReliabilityConf 7 "ReliabilityConf_NotAvailable" 6 "ReliabilityConf_Error" 5 "ReliabilityConf_Spare2" 4 "ReliabilityConf_Spare1" 3 "ReliabilityConf_Restricted" 2 "ReliabilityConf_ASIL_B" 1 "ReliabilityConf_CNNConfirmed_ObjectShape" 0 "ReliabilityConf_ConfirmedbyGenericStream" ;
VAL_ 799 FLCObject15_TurnIndication 7 "TurnIndication_NotAvailable" 6 "TurnIndication_Error" 5 "TurnIndication_Spare" 4 "TurnIndication_DirectionIndicatorBoth" 3 "TurnIndication_DirectionIndicatorRight" 2 "TurnIndication_DirectionIndicatorLeft" 1 "TurnIndication_NoDirectionIndicator" 0 "TurnIndication_Unknown" ;
VAL_ 798 FLCObject14_BrakeLight 7 "BrakeLight_NotAvailable" 6 "BrakeLight_Error" 5 "BrakeLight_Spare" 4 "BrakeLight_BrakeLightThree" 3 "BrakeLight_BrakeLightTwo" 2 "BrakeLight_BrakeLightOne" 1 "BrakeLight_NoBrakeLight" 0 "BrakeLight_BrakeLightUnknown" ;
VAL_ 798 FLCObject14_ObjDynClass 3 "ObjDynClass_Error" 2 "ObjDynClass_Movable" 1 "ObjDynClass_Stationary" 0 "ObjDynClass_Reserved" ;
VAL_ 798 FLCObject14_TurnIndication 7 "TurnIndication_NotAvailable" 6 "TurnIndication_Error" 5 "TurnIndication_Spare" 4 "TurnIndication_DirectionIndicatorBoth" 3 "TurnIndication_DirectionIndicatorRight" 2 "TurnIndication_DirectionIndicatorLeft" 1 "TurnIndication_NoDirectionIndicator" 0 "TurnIndication_Unknown" ;
VAL_ 798 FLCObject14_ReliabilityConf 7 "ReliabilityConf_NotAvailable" 6 "ReliabilityConf_Error" 5 "ReliabilityConf_Spare2" 4 "ReliabilityConf_Spare1" 3 "ReliabilityConf_Restricted" 2 "ReliabilityConf_ASIL_B" 1 "ReliabilityConf_CNNConfirmed_ObjectShape" 0 "ReliabilityConf_ConfirmedbyGenericStream" ;
VAL_ 798 FLCObject14_TargetToLine 7 "TargetToLine_NotAvailable" 6 "TargetToLine_Error" 5 "TargetToLine_Unknown" 4 "TargetToLine_OnTheLeftEgoLine" 3 "TargetToLine_OnTheRightEgoLine" 2 "TargetToLine_BetweenRightAndLeftEgoLine" 1 "TargetToLine_LeftSideOfTheLeftEgoLine" 0 "TargetToLine_RightSideOfTheRightEgoLine" ;
VAL_ 798 FLCObject14_ObjClass 15 "ObjClassSideS_NotAvailable" 14 "ObjClassSideS_Error" 13 "ObjClassSideS_Spare4" 12 "ObjClassSideS_Spare3" 11 "ObjClassSideS_Motorcycle" 10 "ObjClassSideS_Bicycle" 9 "ObjClassSideS_UnidentifiedMovableObject" 8 "ObjClassSideS_UnidentifiedVRU" 7 "ObjClassSideS_UnidentifiedVehicle" 6 "ObjClassSideS_StaticObject" 5 "ObjClassSideS_Pedestrian" 4 "ObjClassSideS_2Wheeler" 3 "ObjClassSideS_HeavyVehicle" 2 "ObjClassSideS_Car" 1 "ObjClassSideS_Obstacle" 0 "ObjClassSideS_Undetermined" ;
VAL_ 798 FLCObject14_TrackStatus 7 "TrackStatus_NotAvailable" 6 "TrackStatus_Error" 5 "TrackStatus_Spare3" 4 "TrackStatus_Spare2" 3 "TrackStatus_Spare1" 2 "TrackStatus_Invalid" 1 "TrackStatus_Predicted" 0 "TrackStatus_Tracked" ;
SIG_GROUP_ 806 FLCObject22_sg 1 : FLCObject22_HeadingVar FLCObject22_DstRightVar FLCObject22_LatPos FLCObject22_TrackStatus FLCObject22_ObjID FLCObject22_CoastIndex FLCObject22_LatVel FLCObject22_LongPos FLCObject22_TimeStamp FLCObject22_ReliabilityConf FLCObject22_LatVelVar FLCObject22_DistRightCorner FLCObject22_AngRightVar FLCObject22_ExistConf FLCObject22_LatPosVar FLCObject22_CRC FLCObject22_DstLeftVar FLCObject22_Heading FLCObject22_Height FLCObject22_TurnIndication FLCObject22_AnglFarCorner FLCObject22_AnglRightCorner FLCObject22_LongAcc FLCObject22_AngFarVar FLCObject22_AnglLeftCorner FLCObject22_Counter FLCObject22_LongVelVar FLCObject22_ObjClass FLCObject22_DistFarCorner FLCObject22_BrakeLight FLCObject22_LongVel FLCObject22_ScaleChange FLCObject22_TargetToLine FLCObject22_LifeTime FLCObject22_LongPosVar FLCObject22_DistLeftCorner FLCObject22_ObjDynClass FLCObject22_LatAcc FLCObject22_DstFarVar FLCObject22_AngLeftVar;
SIG_GROUP_ 805 FLCObject21_sg 1 : FLCObject21_ScaleChange FLCObject21_DistFarCorner FLCObject21_Heading FLCObject21_LongAcc FLCObject21_CRC FLCObject21_ObjID FLCObject21_DstLeftVar FLCObject21_DstFarVar FLCObject21_ObjClass FLCObject21_ObjDynClass FLCObject21_ExistConf FLCObject21_DstRightVar FLCObject21_ReliabilityConf FLCObject21_LongVelVar FLCObject21_LongPosVar FLCObject21_TargetToLine FLCObject21_Counter FLCObject21_DistLeftCorner FLCObject21_LatVel FLCObject21_LatVelVar FLCObject21_LatPos FLCObject21_LongVel FLCObject21_AngLeftVar FLCObject21_AngRightVar FLCObject21_AnglFarCorner FLCObject21_DistRightCorner FLCObject21_LifeTime FLCObject21_TrackStatus FLCObject21_AnglRightCorner FLCObject21_LatAcc FLCObject21_HeadingVar FLCObject21_LatPosVar FLCObject21_LongPos FLCObject21_AngFarVar FLCObject21_TurnIndication FLCObject21_TimeStamp FLCObject21_CoastIndex FLCObject21_Height FLCObject21_BrakeLight FLCObject21_AnglLeftCorner;
SIG_GROUP_ 804 FLCObject20_sg 1 : FLCObject20_DistLeftCorner FLCObject20_HeadingVar FLCObject20_LatPosVar FLCObject20_ExistConf FLCObject20_LatVel FLCObject20_LongVelVar FLCObject20_LongVel FLCObject20_AnglRightCorner FLCObject20_DistRightCorner FLCObject20_Heading FLCObject20_BrakeLight FLCObject20_DstFarVar FLCObject20_TargetToLine FLCObject20_TimeStamp FLCObject20_DstRightVar FLCObject20_AngLeftVar FLCObject20_CRC FLCObject20_ObjID FLCObject20_AngRightVar FLCObject20_AngFarVar FLCObject20_TrackStatus FLCObject20_LatVelVar FLCObject20_LongPosVar FLCObject20_ObjDynClass FLCObject20_LongAcc FLCObject20_Counter FLCObject20_LatPos FLCObject20_AnglFarCorner FLCObject20_ScaleChange FLCObject20_Height FLCObject20_ReliabilityConf FLCObject20_LatAcc FLCObject20_ObjClass FLCObject20_AnglLeftCorner FLCObject20_LifeTime FLCObject20_DstLeftVar FLCObject20_DistFarCorner FLCObject20_TurnIndication FLCObject20_CoastIndex FLCObject20_LongPos;
SIG_GROUP_ 803 FLCObject19_sg 1 : FLCObject19_DistFarCorner FLCObject19_LongPosVar FLCObject19_TargetToLine FLCObject19_DstLeftVar FLCObject19_DistRightCorner FLCObject19_LifeTime FLCObject19_Height FLCObject19_CRC FLCObject19_TrackStatus FLCObject19_ReliabilityConf FLCObject19_Counter FLCObject19_TurnIndication FLCObject19_AngFarVar FLCObject19_BrakeLight FLCObject19_LatAcc FLCObject19_ObjDynClass FLCObject19_DstRightVar FLCObject19_LongVel FLCObject19_AnglLeftCorner FLCObject19_AngRightVar FLCObject19_Heading FLCObject19_HeadingVar FLCObject19_LatVelVar FLCObject19_ObjClass FLCObject19_AnglRightCorner FLCObject19_AnglFarCorner FLCObject19_TimeStamp FLCObject19_ObjID FLCObject19_ExistConf FLCObject19_LongPos FLCObject19_DstFarVar FLCObject19_LongVelVar FLCObject19_LatVel FLCObject19_AngLeftVar FLCObject19_LatPosVar FLCObject19_DistLeftCorner FLCObject19_CoastIndex FLCObject19_LongAcc FLCObject19_ScaleChange FLCObject19_LatPos;
SIG_GROUP_ 802 FLCObject18_sg 1 : FLCObject18_TargetToLine FLCObject18_LatAcc FLCObject18_BrakeLight FLCObject18_LatVel FLCObject18_LongVel FLCObject18_LongVelVar FLCObject18_DstFarVar FLCObject18_LatPosVar FLCObject18_LongAcc FLCObject18_CoastIndex FLCObject18_TimeStamp FLCObject18_LongPos FLCObject18_LongPosVar FLCObject18_ObjClass FLCObject18_ObjID FLCObject18_Heading FLCObject18_DstLeftVar FLCObject18_LifeTime FLCObject18_Height FLCObject18_AngFarVar FLCObject18_ObjDynClass FLCObject18_AnglLeftCorner FLCObject18_ReliabilityConf FLCObject18_LatVelVar FLCObject18_ExistConf FLCObject18_Counter FLCObject18_DistLeftCorner FLCObject18_ScaleChange FLCObject18_AnglFarCorner FLCObject18_DstRightVar FLCObject18_HeadingVar FLCObject18_TrackStatus FLCObject18_LatPos FLCObject18_AngLeftVar FLCObject18_DistFarCorner FLCObject18_TurnIndication FLCObject18_CRC FLCObject18_AngRightVar FLCObject18_AnglRightCorner FLCObject18_DistRightCorner;
SIG_GROUP_ 801 FLCObject17_sg 1 : FLCObject17_TargetToLine FLCObject17_DstFarVar FLCObject17_LifeTime FLCObject17_DistLeftCorner FLCObject17_LatAcc FLCObject17_AnglRightCorner FLCObject17_CRC FLCObject17_DistFarCorner FLCObject17_LongAcc FLCObject17_AngRightVar FLCObject17_CoastIndex FLCObject17_ObjClass FLCObject17_TrackStatus FLCObject17_LongPos FLCObject17_LongVelVar FLCObject17_ObjID FLCObject17_LongPosVar FLCObject17_DstRightVar FLCObject17_DstLeftVar FLCObject17_Height FLCObject17_LatPos FLCObject17_LongVel FLCObject17_LatVel FLCObject17_DistRightCorner FLCObject17_AngFarVar FLCObject17_TurnIndication FLCObject17_AnglLeftCorner FLCObject17_TimeStamp FLCObject17_ExistConf FLCObject17_Counter FLCObject17_Heading FLCObject17_AnglFarCorner FLCObject17_ReliabilityConf FLCObject17_AngLeftVar FLCObject17_ScaleChange FLCObject17_LatPosVar FLCObject17_LatVelVar FLCObject17_ObjDynClass FLCObject17_BrakeLight FLCObject17_HeadingVar;
SIG_GROUP_ 800 FLCObject16_sg 1 : FLCObject16_LatPos FLCObject16_LifeTime FLCObject16_ObjID FLCObject16_LongAcc FLCObject16_DstRightVar FLCObject16_Counter FLCObject16_AnglFarCorner FLCObject16_DstLeftVar FLCObject16_DistRightCorner FLCObject16_LatVel FLCObject16_LatAcc FLCObject16_Heading FLCObject16_BrakeLight FLCObject16_DstFarVar FLCObject16_ScaleChange FLCObject16_TimeStamp FLCObject16_TrackStatus FLCObject16_LatVelVar FLCObject16_LongPos FLCObject16_ExistConf FLCObject16_CoastIndex FLCObject16_TargetToLine FLCObject16_AngRightVar FLCObject16_ObjDynClass FLCObject16_AnglRightCorner FLCObject16_HeadingVar FLCObject16_DistFarCorner FLCObject16_AngFarVar FLCObject16_LongVelVar FLCObject16_LatPosVar FLCObject16_LongPosVar FLCObject16_DistLeftCorner FLCObject16_Height FLCObject16_LongVel FLCObject16_CRC FLCObject16_ObjClass FLCObject16_AnglLeftCorner FLCObject16_TurnIndication FLCObject16_ReliabilityConf FLCObject16_AngLeftVar;
SIG_GROUP_ 799 FLCObject15_sg 1 : FLCObject15_LongVel FLCObject15_ScaleChange FLCObject15_DistLeftCorner FLCObject15_DstRightVar FLCObject15_LatVel FLCObject15_LatPos FLCObject15_TargetToLine FLCObject15_AnglLeftCorner FLCObject15_AnglRightCorner FLCObject15_DstLeftVar FLCObject15_LatAcc FLCObject15_ObjDynClass FLCObject15_TrackStatus FLCObject15_LongAcc FLCObject15_CRC FLCObject15_Height FLCObject15_Heading FLCObject15_LatVelVar FLCObject15_DistFarCorner FLCObject15_CoastIndex FLCObject15_ExistConf FLCObject15_LatPosVar FLCObject15_BrakeLight FLCObject15_HeadingVar FLCObject15_DistRightCorner FLCObject15_LongVelVar FLCObject15_LongPosVar FLCObject15_AngLeftVar FLCObject15_ObjID FLCObject15_AngRightVar FLCObject15_ObjClass FLCObject15_ReliabilityConf FLCObject15_LongPos FLCObject15_TurnIndication FLCObject15_AngFarVar FLCObject15_AnglFarCorner FLCObject15_DstFarVar FLCObject15_Counter FLCObject15_LifeTime FLCObject15_TimeStamp;
SIG_GROUP_ 798 FLCObject14_sg 1 : FLCObject14_LongPosVar FLCObject14_BrakeLight FLCObject14_AnglRightCorner FLCObject14_Heading FLCObject14_CoastIndex FLCObject14_ObjDynClass FLCObject14_DistLeftCorner FLCObject14_LongPos FLCObject14_AnglFarCorner FLCObject14_DstRightVar FLCObject14_LifeTime FLCObject14_ExistConf FLCObject14_Height FLCObject14_TurnIndication FLCObject14_ObjID FLCObject14_LatPosVar FLCObject14_TimeStamp FLCObject14_DstFarVar FLCObject14_ReliabilityConf FLCObject14_TargetToLine FLCObject14_AngLeftVar FLCObject14_DistFarCorner FLCObject14_AngRightVar FLCObject14_CRC FLCObject14_LatPos FLCObject14_AngFarVar FLCObject14_Counter FLCObject14_DistRightCorner FLCObject14_ObjClass FLCObject14_ScaleChange FLCObject14_HeadingVar FLCObject14_LongVelVar FLCObject14_LatAcc FLCObject14_LongVel FLCObject14_AnglLeftCorner FLCObject14_TrackStatus FLCObject14_LongAcc FLCObject14_DstLeftVar FLCObject14_LatVelVar FLCObject14_LatVel;
