VERSION ""

NS_ :

BS_:

BU_: FLC2 DACU

BO_ 839 FLC_Clothoid07_Vic2: 24 FLC2
 SG_ Clothoid07_TrackStatus : 149|3@1+ (1,0) [0|0] ""  VCM
 SG_ Clothoid07_Curvature : 112|18@1+ (1E-006,-0.1310705) [-0.1310705|0.1310725] "per_meter"  VCM
 SG_ Clothoid07_LifeTime : 24|16@1+ (0.1,0) [0|6553.5] "s"  VCM
 SG_ Clothoid07_CRC : 0|16@1+ (1,0) [0|65535] "NotApplicable"  VCM
 SG_ Clothoid07_Counter : 16|8@1+ (1,0) [0|255] "Count"  VCM
 SG_ Clothoid07_CurvatureRate : 97|11@1+ (5.1E-007,-0.000516) [-0.000516|0.00052797] "per_meter_squared"  VCM
 SG_ Clothoid07_Confidence : 160|7@1+ (0.01,0) [0|1.27] "NotApplicable"  VCM
 SG_ Clothoid07_LatDistVar : 40|8@1+ (0.001,0) [0|0.255] "NotApplicable"  VCM
 SG_ Clothoid07_Type : 136|5@1+ (1,0) [0|0] ""  VCM
 SG_ Clothoid07_HeadingAngle : 72|13@1+ (0.0005,-1.57) [-1.57|2.5255] "rad"  VCM
 SG_ Clothoid07_LatDist : 85|12@1+ (0.005,-10) [-10|10.475] "m"  VCM
 SG_ Clothoid07_CoastIndex : 144|5@1+ (1,0) [0|31] "NotApplicable"  VCM
 SG_ Clothoid07_TimeStamp : 56|16@1+ (0.1,0) [0|6553.5] "ms"  VCM
 SG_ Clothoid07_DxStart : 48|8@1+ (1,0) [0|255] "m"  VCM
 SG_ Clothoid07_Location : 108|4@1+ (1,0) [0|0] ""  VCM
 SG_ Clothoid07_Color : 141|3@1+ (1,0) [0|0] ""  VCM
 SG_ Clothoid07_DxEnd : 152|8@1+ (1,0) [0|255] "m"  VCM
 SG_ Clothoid07_Width : 130|6@1+ (0.02,0) [0|1.26] "m"  VCM

BO_ 838 FLC_Clothoid06_Vic2: 24 FLC2
 SG_ Clothoid06_Type : 136|5@1+ (1,0) [0|0] ""  VCM
 SG_ Clothoid06_Width : 130|6@1+ (0.02,0) [0|1.26] "m"  VCM
 SG_ Clothoid06_LatDistVar : 40|8@1+ (0.001,0) [0|0.255] "NotApplicable"  VCM
 SG_ Clothoid06_Location : 108|4@1+ (1,0) [0|0] ""  VCM
 SG_ Clothoid06_Color : 141|3@1+ (1,0) [0|0] ""  VCM
 SG_ Clothoid06_Curvature : 112|18@1+ (1E-006,-0.1310705) [-0.1310705|0.1310725] "per_meter"  VCM
 SG_ Clothoid06_DxEnd : 152|8@1+ (1,0) [0|255] "m"  VCM
 SG_ Clothoid06_HeadingAngle : 72|13@1+ (0.0005,-1.57) [-1.57|2.5255] "rad"  VCM
 SG_ Clothoid06_Counter : 16|8@1+ (1,0) [0|255] "Count"  VCM
 SG_ Clothoid06_TrackStatus : 149|3@1+ (1,0) [0|0] ""  VCM
 SG_ Clothoid06_CRC : 0|16@1+ (1,0) [0|65535] "NotApplicable"  VCM
 SG_ Clothoid06_LifeTime : 24|16@1+ (0.1,0) [0|6553.5] "s"  VCM
 SG_ Clothoid06_LatDist : 85|12@1+ (0.005,-10) [-10|10.475] "m"  VCM
 SG_ Clothoid06_CoastIndex : 144|5@1+ (1,0) [0|31] "NotApplicable"  VCM
 SG_ Clothoid06_CurvatureRate : 97|11@1+ (5.1E-007,-0.000516) [-0.000516|0.00052797] "per_meter_squared"  VCM
 SG_ Clothoid06_TimeStamp : 56|16@1+ (0.1,0) [0|6553.5] "ms"  VCM
 SG_ Clothoid06_DxStart : 48|8@1+ (1,0) [0|255] "m"  VCM
 SG_ Clothoid06_Confidence : 160|7@1+ (0.01,0) [0|1.27] "NotApplicable"  VCM

BO_ 837 FLC_Clothoid05_Vic2: 24 FLC2
 SG_ Clothoid05_CurvatureRate : 97|11@1+ (5.1E-007,-0.000516) [-0.000516|0.00052797] "per_meter_squared"  VCM
 SG_ Clothoid05_LifeTime : 24|16@1+ (0.1,0) [0|6553.5] "s"  VCM
 SG_ Clothoid05_Counter : 16|8@1+ (1,0) [0|255] "Count"  VCM
 SG_ Clothoid05_DxEnd : 152|8@1+ (1,0) [0|255] "m"  VCM
 SG_ Clothoid05_Curvature : 112|18@1+ (1E-006,-0.1310705) [-0.1310705|0.1310725] "per_meter"  VCM
 SG_ Clothoid05_DxStart : 48|8@1+ (1,0) [0|255] "m"  VCM
 SG_ Clothoid05_CRC : 0|16@1+ (1,0) [0|65535] "NotApplicable"  VCM
 SG_ Clothoid05_Color : 141|3@1+ (1,0) [0|0] ""  VCM
 SG_ Clothoid05_TimeStamp : 56|16@1+ (0.1,0) [0|6553.5] "ms"  VCM
 SG_ Clothoid05_Confidence : 160|7@1+ (0.01,0) [0|1.27] "NotApplicable"  VCM
 SG_ Clothoid05_HeadingAngle : 72|13@1+ (0.0005,-1.57) [-1.57|2.5255] "rad"  VCM
 SG_ Clothoid05_LatDistVar : 40|8@1+ (0.001,0) [0|0.255] "NotApplicable"  VCM
 SG_ Clothoid05_LatDist : 85|12@1+ (0.005,-10) [-10|10.475] "m"  VCM
 SG_ Clothoid05_Location : 108|4@1+ (1,0) [0|0] ""  VCM
 SG_ Clothoid05_Type : 136|5@1+ (1,0) [0|0] ""  VCM
 SG_ Clothoid05_CoastIndex : 144|5@1+ (1,0) [0|31] "NotApplicable"  VCM
 SG_ Clothoid05_TrackStatus : 149|3@1+ (1,0) [0|0] ""  VCM
 SG_ Clothoid05_Width : 130|6@1+ (0.02,0) [0|1.26] "m"  VCM

BO_ 836 FLC_Clothoid04_Vic2: 24 FLC2
 SG_ Clothoid04_DxEnd : 152|8@1+ (1,0) [0|255] "m"  VCM
 SG_ Clothoid04_Width : 130|6@1+ (0.02,0) [0|1.26] "m"  VCM
 SG_ Clothoid04_Counter : 16|8@1+ (1,0) [0|255] "Count"  VCM
 SG_ Clothoid04_LifeTime : 24|16@1+ (0.1,0) [0|6553.5] "s"  VCM
 SG_ Clothoid04_Confidence : 160|7@1+ (0.01,0) [0|1.27] "NotApplicable"  VCM
 SG_ Clothoid04_LatDist : 85|12@1+ (0.005,-10) [-10|10.475] "m"  VCM
 SG_ Clothoid04_LatDistVar : 40|8@1+ (0.001,0) [0|0.255] "NotApplicable"  VCM
 SG_ Clothoid04_Type : 136|5@1+ (1,0) [0|0] ""  VCM
 SG_ Clothoid04_Location : 108|4@1+ (1,0) [0|0] ""  VCM
 SG_ Clothoid04_TrackStatus : 149|3@1+ (1,0) [0|0] ""  VCM
 SG_ Clothoid04_CRC : 0|16@1+ (1,0) [0|65535] "NotApplicable"  VCM
 SG_ Clothoid04_CoastIndex : 144|5@1+ (1,0) [0|31] "NotApplicable"  VCM
 SG_ Clothoid04_Curvature : 112|18@1+ (1E-006,-0.1310705) [-0.1310705|0.1310725] "per_meter"  VCM
 SG_ Clothoid04_DxStart : 48|8@1+ (1,0) [0|255] "m"  VCM
 SG_ Clothoid04_CurvatureRate : 97|11@1+ (5.1E-007,-0.000516) [-0.000516|0.00052797] "per_meter_squared"  VCM
 SG_ Clothoid04_HeadingAngle : 72|13@1+ (0.0005,-1.57) [-1.57|2.5255] "rad"  VCM
 SG_ Clothoid04_Color : 141|3@1+ (1,0) [0|0] ""  VCM
 SG_ Clothoid04_TimeStamp : 56|16@1+ (0.1,0) [0|6553.5] "ms"  VCM

BO_ 835 FLC_Clothoid03_Vic2: 24 FLC2
 SG_ Clothoid03_Curvature : 112|18@1+ (1E-006,-0.1310705) [-0.1310705|0.1310725] "per_meter"  VCM
 SG_ Clothoid03_LatDist : 85|12@1+ (0.005,-10) [-10|10.475] "m"  VCM
 SG_ Clothoid03_LifeTime : 24|16@1+ (0.1,0) [0|6553.5] "s"  VCM
 SG_ Clothoid03_Location : 108|4@1+ (1,0) [0|0] ""  VCM
 SG_ Clothoid03_CurvatureRate : 97|11@1+ (5.1E-007,-0.000516) [-0.000516|0.00052797] "per_meter_squared"  VCM
 SG_ Clothoid03_Width : 130|6@1+ (0.02,0) [0|1.26] "m"  VCM
 SG_ Clothoid03_HeadingAngle : 72|13@1+ (0.0005,-1.57) [-1.57|2.5255] "rad"  VCM
 SG_ Clothoid03_LatDistVar : 40|8@1+ (0.001,0) [0|0.255] "NotApplicable"  VCM
 SG_ Clothoid03_DxEnd : 152|8@1+ (1,0) [0|255] "m"  VCM
 SG_ Clothoid03_Counter : 16|8@1+ (1,0) [0|255] "Count"  VCM
 SG_ Clothoid03_Color : 141|3@1+ (1,0) [0|0] ""  VCM
 SG_ Clothoid03_Type : 136|5@1+ (1,0) [0|0] ""  VCM
 SG_ Clothoid03_CoastIndex : 144|5@1+ (1,0) [0|31] "NotApplicable"  VCM
 SG_ Clothoid03_TimeStamp : 56|16@1+ (0.1,0) [0|6553.5] "ms"  VCM
 SG_ Clothoid03_DxStart : 48|8@1+ (1,0) [0|255] "m"  VCM
 SG_ Clothoid03_Confidence : 160|7@1+ (0.01,0) [0|1.27] "NotApplicable"  VCM
 SG_ Clothoid03_TrackStatus : 149|3@1+ (1,0) [0|0] ""  VCM
 SG_ Clothoid03_CRC : 0|16@1+ (1,0) [0|65535] "NotApplicable"  VCM

BO_ 834 FLC_Clothoid02_Vic2: 24 FLC2
 SG_ Clothoid02_Confidence : 160|7@1+ (0.01,0) [0|1.27] "NotApplicable"  VCM
 SG_ Clothoid02_CurvatureRate : 97|11@1+ (5.1E-007,-0.000516) [-0.000516|0.00052797] "per_meter_squared"  VCM
 SG_ Clothoid02_LifeTime : 24|16@1+ (0.1,0) [0|6553.5] "s"  VCM
 SG_ Clothoid02_DxStart : 48|8@1+ (1,0) [0|255] "m"  VCM
 SG_ Clothoid02_DxEnd : 152|8@1+ (1,0) [0|255] "m"  VCM
 SG_ Clothoid02_Color : 141|3@1+ (1,0) [0|0] ""  VCM
 SG_ Clothoid02_CoastIndex : 144|5@1+ (1,0) [0|31] "NotApplicable"  VCM
 SG_ Clothoid02_LatDistVar : 40|8@1+ (0.001,0) [0|0.255] "NotApplicable"  VCM
 SG_ Clothoid02_Width : 130|6@1+ (0.02,0) [0|1.26] "m"  VCM
 SG_ Clothoid02_TrackStatus : 149|3@1+ (1,0) [0|0] ""  VCM
 SG_ Clothoid02_Curvature : 112|18@1+ (1E-006,-0.1310705) [-0.1310705|0.1310725] "per_meter"  VCM
 SG_ Clothoid02_TimeStamp : 56|16@1+ (0.1,0) [0|6553.5] "ms"  VCM
 SG_ Clothoid02_Type : 136|5@1+ (1,0) [0|0] ""  VCM
 SG_ Clothoid02_HeadingAngle : 72|13@1+ (0.0005,-1.57) [-1.57|2.5255] "rad"  VCM
 SG_ Clothoid02_LatDist : 85|12@1+ (0.005,-10) [-10|10.475] "m"  VCM
 SG_ Clothoid02_CRC : 0|16@1+ (1,0) [0|65535] "NotApplicable"  VCM
 SG_ Clothoid02_Counter : 16|8@1+ (1,0) [0|255] "Count"  VCM
 SG_ Clothoid02_Location : 108|4@1+ (1,0) [0|0] ""  VCM

BO_ 833 FLC_Clothoid01_Vic2: 24 FLC2
 SG_ Clothoid01_HeadingAngle : 72|13@1+ (0.0005,-1.57) [-1.57|2.5255] "rad"  VCM
 SG_ Clothoid01_DxEnd : 152|8@1+ (1,0) [0|255] "m"  VCM
 SG_ Clothoid01_LatDist : 85|12@1+ (0.005,-10) [-10|10.475] "m"  VCM
 SG_ Clothoid01_Width : 130|6@1+ (0.02,0) [0|1.26] "m"  VCM
 SG_ Clothoid01_DxStart : 48|8@1+ (1,0) [0|255] "m"  VCM
 SG_ Clothoid01_CurvatureRate : 97|11@1+ (5.1E-007,-0.000516) [-0.000516|0.00052797] "per_meter_squared"  VCM
 SG_ Clothoid01_LifeTime : 24|16@1+ (0.1,0) [0|6553.5] "s"  VCM
 SG_ Clothoid01_TrackStatus : 149|3@1+ (1,0) [0|0] ""  VCM
 SG_ Clothoid01_Type : 136|5@1+ (1,0) [0|0] ""  VCM
 SG_ Clothoid01_Curvature : 112|18@1+ (1E-006,-0.1310705) [-0.1310705|0.1310725] "per_meter"  VCM
 SG_ Clothoid01_Location : 108|4@1+ (1,0) [0|0] ""  VCM
 SG_ Clothoid01_Color : 141|3@1+ (1,0) [0|0] ""  VCM
 SG_ Clothoid01_CoastIndex : 144|5@1+ (1,0) [0|31] "NotApplicable"  VCM
 SG_ Clothoid01_LatDistVar : 40|8@1+ (0.001,0) [0|0.255] "NotApplicable"  VCM
 SG_ Clothoid01_Counter : 16|8@1+ (1,0) [0|255] "Count"  VCM
 SG_ Clothoid01_CRC : 0|16@1+ (1,0) [0|65535] "NotApplicable"  VCM
 SG_ Clothoid01_TimeStamp : 56|16@1+ (0.1,0) [0|6553.5] "ms"  VCM
 SG_ Clothoid01_Confidence : 160|7@1+ (0.01,0) [0|1.27] "NotApplicable"  VCM

BO_ 832 FLC_Clothoid00_Vic2: 24 FLC2
 SG_ Clothoid00_DxStart : 48|8@1+ (1,0) [0|255] "m"  VCM
 SG_ Clothoid00_LatDistVar : 40|8@1+ (0.001,0) [0|0.255] "NotApplicable"  VCM
 SG_ Clothoid00_Width : 130|6@1+ (0.02,0) [0|1.26] "m"  VCM
 SG_ Clothoid00_Confidence : 160|7@1+ (0.01,0) [0|1.27] "NotApplicable"  VCM
 SG_ Clothoid00_TimeStamp : 56|16@1+ (0.1,0) [0|6553.5] "ms"  VCM
 SG_ Clothoid00_DxEnd : 152|8@1+ (1,0) [0|255] "m"  VCM
 SG_ Clothoid00_TrackStatus : 149|3@1+ (1,0) [0|0] ""  VCM
 SG_ Clothoid00_Color : 141|3@1+ (1,0) [0|0] ""  VCM
 SG_ Clothoid00_Curvature : 112|18@1+ (1E-006,-0.1310705) [-0.1310705|0.1310725] "per_meter"  VCM
 SG_ Clothoid00_CurvatureRate : 97|11@1+ (5.1E-007,-0.000516) [-0.000516|0.00052797] "per_meter_squared"  VCM
 SG_ Clothoid00_Type : 136|5@1+ (1,0) [0|0] ""  VCM
 SG_ Clothoid00_HeadingAngle : 72|13@1+ (0.0005,-1.57) [-1.57|2.5255] "rad"  VCM
 SG_ Clothoid00_CRC : 0|16@1+ (1,0) [0|65535] "NotApplicable"  VCM
 SG_ Clothoid00_Location : 108|4@1+ (1,0) [0|0] ""  VCM
 SG_ Clothoid00_LifeTime : 24|16@1+ (0.1,0) [0|6553.5] "s"  VCM
 SG_ Clothoid00_Counter : 16|8@1+ (1,0) [0|255] "Count"  VCM
 SG_ Clothoid00_CoastIndex : 144|5@1+ (1,0) [0|31] "NotApplicable"  VCM
 SG_ Clothoid00_LatDist : 85|12@1+ (0.005,-10) [-10|10.475] "m"  VCM

BO_ 824 FLC_Brightspot08_Vic2: 16 FLC2
 SG_ Brightspot08_RightAngleVar : 24|8@1+ (0.004,0) [0|1.02] "NotApplicable"  VCM
 SG_ Brightspot08_RightAngle : 80|11@1+ (0.0494,-50.511) [-50.511|50.6108] "deg"  VCM
 SG_ Brightspot08_Direction : 102|2@1+ (1,0) [0|0] ""  VCM
 SG_ Brightspot08_LifeTime : 32|16@1+ (0.1,0) [0|6553.5] "s"  VCM
 SG_ Brightspot08_RightAngVelocity : 0|8@1+ (0.75,-96) [-96|95.25] ""  VCM
 SG_ Brightspot08_LeftAngleVar : 72|8@1+ (0.004,0) [0|1.02] "NotApplicable"  VCM
 SG_ Brightspot08_TrackStatus : 111|3@1+ (1,0) [0|0] ""  VCM
 SG_ Brightspot08_ID : 16|8@1+ (1,0) [0|255] ""  VCM
 SG_ Brightspot08_TimeStamp : 48|16@1+ (0.1,0) [0|6553.5] "ms"  VCM
 SG_ Brightspot08_ExistConf : 104|7@1+ (0.01,0) [0|1.27] "NotApplicable"  VCM
 SG_ Brightspot08_LeftAngVelocity : 64|8@1+ (0.75,-96) [-96|95.25] ""  VCM
 SG_ Brightspot08_DistanceVar : 8|8@1+ (20,0) [0|5100] "NotApplicable"  VCM
 SG_ Brightspot08_Distance : 116|10@1+ (1,0) [0|1023] "m"  VCM
 SG_ Brightspot08_MergeObj : 114|2@1+ (1,0) [0|0] ""  VCM
 SG_ Brightspot08_LeftAngle : 91|11@1+ (0.0494,-50.511) [-50.511|50.6108] "deg"  VCM

BO_ 823 FLC_Brightspot07_Vic2: 16 FLC2
 SG_ Brightspot07_RightAngleVar : 24|8@1+ (0.004,0) [0|1.02] "NotApplicable"  VCM
 SG_ Brightspot07_DistanceVar : 8|8@1+ (20,0) [0|5100] "NotApplicable"  VCM
 SG_ Brightspot07_LeftAngVelocity : 64|8@1+ (0.75,-96) [-96|95.25] ""  VCM
 SG_ Brightspot07_TimeStamp : 48|16@1+ (0.1,0) [0|6553.5] "ms"  VCM
 SG_ Brightspot07_MergeObj : 114|2@1+ (1,0) [0|0] ""  VCM
 SG_ Brightspot07_LifeTime : 32|16@1+ (0.1,0) [0|6553.5] "s"  VCM
 SG_ Brightspot07_TrackStatus : 111|3@1+ (1,0) [0|0] ""  VCM
 SG_ Brightspot07_Direction : 102|2@1+ (1,0) [0|0] ""  VCM
 SG_ Brightspot07_Distance : 116|10@1+ (1,0) [0|1023] "m"  VCM
 SG_ Brightspot07_LeftAngleVar : 72|8@1+ (0.004,0) [0|1.02] "NotApplicable"  VCM
 SG_ Brightspot07_ExistConf : 104|7@1+ (0.01,0) [0|1.27] "NotApplicable"  VCM
 SG_ Brightspot07_RightAngle : 80|11@1+ (0.0494,-50.511) [-50.511|50.6108] "deg"  VCM
 SG_ Brightspot07_RightAngVelocity : 0|8@1+ (0.75,-96) [-96|95.25] ""  VCM
 SG_ Brightspot07_ID : 16|8@1+ (1,0) [0|255] ""  VCM
 SG_ Brightspot07_LeftAngle : 91|11@1+ (0.0494,-50.511) [-50.511|50.6108] "deg"  VCM

BO_ 822 FLC_Brightspot06_Vic2: 16 FLC2
 SG_ Brightspot06_Distance : 116|10@1+ (1,0) [0|1023] "m"  VCM
 SG_ Brightspot06_RightAngle : 80|11@1+ (0.0494,-50.511) [-50.511|50.6108] "deg"  VCM
 SG_ Brightspot06_MergeObj : 114|2@1+ (1,0) [0|0] ""  VCM
 SG_ Brightspot06_LeftAngleVar : 72|8@1+ (0.004,0) [0|1.02] "NotApplicable"  VCM
 SG_ Brightspot06_ExistConf : 104|7@1+ (0.01,0) [0|1.27] "NotApplicable"  VCM
 SG_ Brightspot06_LeftAngle : 91|11@1+ (0.0494,-50.511) [-50.511|50.6108] "deg"  VCM
 SG_ Brightspot06_TrackStatus : 111|3@1+ (1,0) [0|0] ""  VCM
 SG_ Brightspot06_Direction : 102|2@1+ (1,0) [0|0] ""  VCM
 SG_ Brightspot06_DistanceVar : 8|8@1+ (20,0) [0|5100] "NotApplicable"  VCM
 SG_ Brightspot06_LeftAngVelocity : 64|8@1+ (0.75,-96) [-96|95.25] ""  VCM
 SG_ Brightspot06_RightAngleVar : 24|8@1+ (0.004,0) [0|1.02] "NotApplicable"  VCM
 SG_ Brightspot06_LifeTime : 32|16@1+ (0.1,0) [0|6553.5] "s"  VCM
 SG_ Brightspot06_ID : 16|8@1+ (1,0) [0|255] ""  VCM
 SG_ Brightspot06_RightAngVelocity : 0|8@1+ (0.75,-96) [-96|95.25] ""  VCM
 SG_ Brightspot06_TimeStamp : 48|16@1+ (0.1,0) [0|6553.5] "ms"  VCM

BO_ 821 FLC_Brightspot05_Vic2: 16 FLC2
 SG_ Brightspot05_LeftAngleVar : 72|8@1+ (0.004,0) [0|1.02] "NotApplicable"  VCM
 SG_ Brightspot05_LeftAngVelocity : 64|8@1+ (0.75,-96) [-96|95.25] ""  VCM
 SG_ Brightspot05_LeftAngle : 91|11@1+ (0.0494,-50.511) [-50.511|50.6108] "deg"  VCM
 SG_ Brightspot05_TrackStatus : 111|3@1+ (1,0) [0|0] ""  VCM
 SG_ Brightspot05_TimeStamp : 48|16@1+ (0.1,0) [0|6553.5] "ms"  VCM
 SG_ Brightspot05_Distance : 116|10@1+ (1,0) [0|1023] "m"  VCM
 SG_ Brightspot05_Direction : 102|2@1+ (1,0) [0|0] ""  VCM
 SG_ Brightspot05_ID : 16|8@1+ (1,0) [0|255] ""  VCM
 SG_ Brightspot05_ExistConf : 104|7@1+ (0.01,0) [0|1.27] "NotApplicable"  VCM
 SG_ Brightspot05_LifeTime : 32|16@1+ (0.1,0) [0|6553.5] "s"  VCM
 SG_ Brightspot05_DistanceVar : 8|8@1+ (20,0) [0|5100] "NotApplicable"  VCM
 SG_ Brightspot05_RightAngle : 80|11@1+ (0.0494,-50.511) [-50.511|50.6108] "deg"  VCM
 SG_ Brightspot05_MergeObj : 114|2@1+ (1,0) [0|0] ""  VCM
 SG_ Brightspot05_RightAngleVar : 24|8@1+ (0.004,0) [0|1.02] "NotApplicable"  VCM
 SG_ Brightspot05_RightAngVelocity : 0|8@1+ (0.75,-96) [-96|95.25] ""  VCM

BO_ 820 FLC_Brightspot04_Vic2: 16 FLC2
 SG_ Brightspot04_Direction : 102|2@1+ (1,0) [0|0] ""  VCM
 SG_ Brightspot04_TrackStatus : 111|3@1+ (1,0) [0|0] ""  VCM
 SG_ Brightspot04_LeftAngleVar : 72|8@1+ (0.004,0) [0|1.02] "NotApplicable"  VCM
 SG_ Brightspot04_RightAngleVar : 24|8@1+ (0.004,0) [0|1.02] "NotApplicable"  VCM
 SG_ Brightspot04_ID : 16|8@1+ (1,0) [0|255] ""  VCM
 SG_ Brightspot04_LeftAngVelocity : 64|8@1+ (0.75,-96) [-96|95.25] ""  VCM
 SG_ Brightspot04_RightAngVelocity : 0|8@1+ (0.75,-96) [-96|95.25] ""  VCM
 SG_ Brightspot04_ExistConf : 104|7@1+ (0.01,0) [0|1.27] "NotApplicable"  VCM
 SG_ Brightspot04_RightAngle : 80|11@1+ (0.0494,-50.511) [-50.511|50.6108] "deg"  VCM
 SG_ Brightspot04_LifeTime : 32|16@1+ (0.1,0) [0|6553.5] "s"  VCM
 SG_ Brightspot04_Distance : 116|10@1+ (1,0) [0|1023] "m"  VCM
 SG_ Brightspot04_DistanceVar : 8|8@1+ (20,0) [0|5100] "NotApplicable"  VCM
 SG_ Brightspot04_MergeObj : 114|2@1+ (1,0) [0|0] ""  VCM
 SG_ Brightspot04_LeftAngle : 91|11@1+ (0.0494,-50.511) [-50.511|50.6108] "deg"  VCM
 SG_ Brightspot04_TimeStamp : 48|16@1+ (0.1,0) [0|6553.5] "ms"  VCM

BO_ 819 FLC_Brightspot03_Vic2: 16 FLC2
 SG_ Brightspot03_ID : 16|8@1+ (1,0) [0|255] ""  VCM
 SG_ Brightspot03_DistanceVar : 8|8@1+ (20,0) [0|5100] "NotApplicable"  VCM
 SG_ Brightspot03_Distance : 116|10@1+ (1,0) [0|1023] "m"  VCM
 SG_ Brightspot03_RightAngVelocity : 0|8@1+ (0.75,-96) [-96|95.25] ""  VCM
 SG_ Brightspot03_RightAngleVar : 24|8@1+ (0.004,0) [0|1.02] "NotApplicable"  VCM
 SG_ Brightspot03_RightAngle : 80|11@1+ (0.0494,-50.511) [-50.511|50.6108] "deg"  VCM
 SG_ Brightspot03_ExistConf : 104|7@1+ (0.01,0) [0|1.27] "NotApplicable"  VCM
 SG_ Brightspot03_Direction : 102|2@1+ (1,0) [0|0] ""  VCM
 SG_ Brightspot03_MergeObj : 114|2@1+ (1,0) [0|0] ""  VCM
 SG_ Brightspot03_TrackStatus : 111|3@1+ (1,0) [0|0] ""  VCM
 SG_ Brightspot03_LifeTime : 32|16@1+ (0.1,0) [0|6553.5] "s"  VCM
 SG_ Brightspot03_LeftAngleVar : 72|8@1+ (0.004,0) [0|1.02] "NotApplicable"  VCM
 SG_ Brightspot03_TimeStamp : 48|16@1+ (0.1,0) [0|6553.5] "ms"  VCM
 SG_ Brightspot03_LeftAngVelocity : 64|8@1+ (0.75,-96) [-96|95.25] ""  VCM
 SG_ Brightspot03_LeftAngle : 91|11@1+ (0.0494,-50.511) [-50.511|50.6108] "deg"  VCM

BO_ 818 FLC_Brightspot02_Vic2: 16 FLC2
 SG_ Brightspot02_RightAngVelocity : 0|8@1+ (0.75,-96) [-96|95.25] ""  VCM
 SG_ Brightspot02_LeftAngle : 91|11@1+ (0.0494,-50.511) [-50.511|50.6108] "deg"  VCM
 SG_ Brightspot02_Distance : 116|10@1+ (1,0) [0|1023] "m"  VCM
 SG_ Brightspot02_TrackStatus : 111|3@1+ (1,0) [0|0] ""  VCM
 SG_ Brightspot02_ID : 16|8@1+ (1,0) [0|255] ""  VCM
 SG_ Brightspot02_Direction : 102|2@1+ (1,0) [0|0] ""  VCM
 SG_ Brightspot02_RightAngle : 80|11@1+ (0.0494,-50.511) [-50.511|50.6108] "deg"  VCM
 SG_ Brightspot02_MergeObj : 114|2@1+ (1,0) [0|0] ""  VCM
 SG_ Brightspot02_LeftAngleVar : 72|8@1+ (0.004,0) [0|1.02] "NotApplicable"  VCM
 SG_ Brightspot02_DistanceVar : 8|8@1+ (20,0) [0|5100] "NotApplicable"  VCM
 SG_ Brightspot02_ExistConf : 104|7@1+ (0.01,0) [0|1.27] "NotApplicable"  VCM
 SG_ Brightspot02_LifeTime : 32|16@1+ (0.1,0) [0|6553.5] "s"  VCM
 SG_ Brightspot02_RightAngleVar : 24|8@1+ (0.004,0) [0|1.02] "NotApplicable"  VCM
 SG_ Brightspot02_LeftAngVelocity : 64|8@1+ (0.75,-96) [-96|95.25] ""  VCM
 SG_ Brightspot02_TimeStamp : 48|16@1+ (0.1,0) [0|6553.5] "ms"  VCM

BO_ 817 FLC_Brightspot01_Vic2: 16 FLC2
 SG_ Brightspot01_TrackStatus : 111|3@1+ (1,0) [0|0] ""  VCM
 SG_ Brightspot01_MergeObj : 114|2@1+ (1,0) [0|0] ""  VCM
 SG_ Brightspot01_LifeTime : 32|16@1+ (0.1,0) [0|6553.5] "s"  VCM
 SG_ Brightspot01_RightAngle : 80|11@1+ (0.0494,-50.511) [-50.511|50.6108] "deg"  VCM
 SG_ Brightspot01_ID : 16|8@1+ (1,0) [0|255] ""  VCM
 SG_ Brightspot01_Distance : 116|10@1+ (1,0) [0|1023] "m"  VCM
 SG_ Brightspot01_TimeStamp : 48|16@1+ (0.1,0) [0|6553.5] "ms"  VCM
 SG_ Brightspot01_LeftAngleVar : 72|8@1+ (0.004,0) [0|1.02] "NotApplicable"  VCM
 SG_ Brightspot01_RightAngVelocity : 0|8@1+ (0.75,-96) [-96|95.25] ""  VCM
 SG_ Brightspot01_ExistConf : 104|7@1+ (0.01,0) [0|1.27] "NotApplicable"  VCM
 SG_ Brightspot01_Direction : 102|2@1+ (1,0) [0|0] ""  VCM
 SG_ Brightspot01_RightAngleVar : 24|8@1+ (0.004,0) [0|1.02] "NotApplicable"  VCM
 SG_ Brightspot01_DistanceVar : 8|8@1+ (20,0) [0|5100] "NotApplicable"  VCM
 SG_ Brightspot01_LeftAngVelocity : 64|8@1+ (0.75,-96) [-96|95.25] ""  VCM
 SG_ Brightspot01_LeftAngle : 91|11@1+ (0.0494,-50.511) [-50.511|50.6108] "deg"  VCM

BO_ 816 FLC_Brightspot00_Vic2: 16 FLC2
 SG_ Brightspot00_DistanceVar : 8|8@1+ (20,0) [0|5100] "NotApplicable"  VCM
 SG_ Brightspot00_MergeObj : 114|2@1+ (1,0) [0|0] ""  VCM
 SG_ Brightspot00_LeftAngle : 91|11@1+ (0.0494,-50.511) [-50.511|50.6108] "deg"  VCM
 SG_ Brightspot00_LeftAngVelocity : 64|8@1+ (0.75,-96) [-96|95.25] ""  VCM
 SG_ Brightspot00_RightAngVelocity : 0|8@1+ (0.75,-96) [-96|95.25] ""  VCM
 SG_ Brightspot00_TrackStatus : 111|3@1+ (1,0) [0|0] ""  VCM
 SG_ Brightspot00_Distance : 116|10@1+ (1,0) [0|1023] "m"  VCM
 SG_ Brightspot00_RightAngleVar : 24|8@1+ (0.004,0) [0|1.02] "NotApplicable"  VCM
 SG_ Brightspot00_RightAngle : 80|11@1+ (0.0494,-50.511) [-50.511|50.6108] "deg"  VCM
 SG_ Brightspot00_Direction : 102|2@1+ (1,0) [0|0] ""  VCM
 SG_ Brightspot00_ExistConf : 104|7@1+ (0.01,0) [0|1.27] "NotApplicable"  VCM
 SG_ Brightspot00_TimeStamp : 48|16@1+ (0.1,0) [0|6553.5] "ms"  VCM
 SG_ Brightspot00_LifeTime : 32|16@1+ (0.1,0) [0|6553.5] "s"  VCM
 SG_ Brightspot00_LeftAngleVar : 72|8@1+ (0.004,0) [0|1.02] "NotApplicable"  VCM
 SG_ Brightspot00_ID : 16|8@1+ (1,0) [0|255] ""  VCM

BO_ 512 FLC_01P_Vic2: 16 FLC2
 SG_ FwdCam_CalibPausedSpeed : 72|1@1+ (1,0) [0|0] ""  VCM
 SG_ FwdSensingCamStat_CRC : 0|16@1+ (1,0) [0|65535] "NotApplicable"  VCM
 SG_ FwdLookingCamStat3_SqC : 96|8@1+ (1,0) [0|255] "NotApplicable"  VCM
 SG_ FwdSensingCamStat_TSRDetect : 54|3@1+ (1,0) [0|0] ""  VCM
 SG_ FwdSensingCamStat_ClothoidDetect : 60|3@1+ (1,0) [0|0] ""  VCM
 SG_ FwdSensingCamStat_DecalibDetect : 51|3@1+ (1,0) [0|0] ""  VCM
 SG_ FwdSensingCamStat_BrighSpot : 57|3@1+ (1,0) [0|0] ""  VCM
 SG_ FwdCam_CalibState : 74|2@1+ (1,0) [0|0] ""  VCM
 SG_ FwdLookingCamStat3_CRC : 80|16@1+ (1,0) [0|65535] "NotApplicable"  VCM
 SG_ ForwardLookingCameraStatus2 : 76|4@1+ (1,0) [0|0] ""  VCM
 SG_ FwdSensingCamStat_TimeStamp : 24|16@1+ (0.1,0) [0|6553.5] "ms"  VCM
 SG_ FwdCam_CalibProgress : 64|7@1+ (1,0) [0|127] "Percent"  VCM
 SG_ FwdSensingCamStat_TimeSynch : 40|8@1+ (1,0) [0|0] ""  VCM
 SG_ FwdCam_CalibPausedYaw : 73|1@1+ (1,0) [0|0] ""  VCM
 SG_ FwdSensingCamStat_Counter : 16|8@1+ (1,0) [0|255] "Count"  VCM
 SG_ FwdCam_CalibPausedAcc : 71|1@1+ (1,0) [0|0] ""  VCM
 SG_ FwdLookingCamStat3_Status : 104|4@1+ (1,0) [0|0] ""  VCM
 SG_ FwdSensingCamStat_TargetDetect : 48|3@1+ (1,0) [0|0] ""  VCM

BO_ 1553 FLCSwVersion_Vic2: 64 FLC2
 SG_ FLCSwVersion_Substring4 : 256|64@1+ (1,0) [0|0] ""  VCM
 SG_ FLCSwVersion_Substring5 : 320|64@1+ (1,0) [0|0] ""  VCM
 SG_ FLCSwVersion_Substring1 : 64|64@1+ (1,0) [0|0] ""  VCM
 SG_ FLCSwVersion_Substring3 : 192|64@1+ (1,0) [0|0] ""  VCM
 SG_ FLCSwVersion_Substring6 : 384|64@1+ (1,0) [0|0] ""  VCM
 SG_ FLCSwVersion_Substring2 : 128|64@1+ (1,0) [0|0] ""  VCM
 SG_ FLCSwVersion_Substring7 : 448|64@1+ (1,0) [0|0] ""  VCM
 SG_ FLCSwVersion_Substring0 : 0|64@1+ (1,0) [0|0] ""  VCM

BO_ 807 FLCObject23_Vic2: 48 FLC2
 SG_ FLCObject23_LongVel : 303|13@1+ (0.032,-80) [-80|182.112] "m_per_s"  VCM
 SG_ FLCObject23_DstRightVar : 80|8@1+ (0.4,0) [0|102] "NotApplicable"  VCM
 SG_ FLCObject23_TrackStatus : 339|3@1+ (1,0) [0|0] ""  VCM
 SG_ FLCObject23_Counter : 16|8@1+ (1,0) [0|255] "Count"  VCM
 SG_ FLCObject23_BrakeLight : 345|3@1+ (1,0) [0|0] ""  VCM
 SG_ FLCObject23_CoastIndex : 328|5@1+ (1,0) [0|31] "NotApplicable"  VCM
 SG_ FLCObject23_DstFarVar : 24|8@1+ (0.4,0) [0|102] "NotApplicable"  VCM
 SG_ FLCObject23_LifeTime : 64|16@1+ (0.1,0) [0|6553.5] "s"  VCM
 SG_ FLCObject23_AnglFarCorner : 229|10@1+ (0.005,-1.57) [-1.57|3.545] "rad"  VCM
 SG_ FLCObject23_ReliabilityConf : 336|3@1+ (1,0) [0|0] ""  VCM
 SG_ FLCObject23_AnglLeftCorner : 209|10@1+ (0.005,-1.57) [-1.57|3.545] "rad"  VCM
 SG_ FLCObject23_DistRightCorner : 164|12@1+ (0.05,0) [0|204.75] "m"  VCM
 SG_ FLCObject23_AngLeftVar : 120|8@1+ (1E-005,0) [0|0.00255] "NotApplicable"  VCM
 SG_ FLCObject23_TargetToLine : 342|3@1+ (1,0) [0|0] ""  VCM
 SG_ FLCObject23_ScaleChange : 219|10@1+ (0.002,0) [0|2.046] "NotApplicable"  VCM
 SG_ FLCObject23_ObjDynClass : 326|2@1+ (1,0) [0|0] ""  VCM
 SG_ FLCObject23_CRC : 0|16@1+ (1,0) [0|65535] "NotApplicable"  VCM
 SG_ FLCObject23_ExistConf : 257|7@1+ (0.01,0) [0|1.27] "NotApplicable"  VCM
 SG_ FLCObject23_TurnIndication : 333|3@1+ (1,0) [0|0] ""  VCM
 SG_ FLCObject23_AngFarVar : 128|8@1+ (1E-005,0) [0|0.00255] "NotApplicable"  VCM
 SG_ FLCObject23_LongPos : 290|13@1+ (0.05,-180) [-180|229.55] "m"  VCM
 SG_ FLCObject23_ObjID : 320|6@1+ (1,0) [0|63] "NotApplicable"  VCM
 SG_ FLCObject23_LongVelVar : 88|8@1+ (0.4,0) [0|102] "NotApplicable"  VCM
 SG_ FLCObject23_LatVelVar : 32|8@1+ (0.1,0) [0|25.5] "NotApplicable"  VCM
 SG_ FLCObject23_ObjClass : 316|4@1+ (1,0) [0|0] ""  VCM
 SG_ FLCObject23_DistFarCorner : 176|12@1+ (0.05,0) [0|204.75] "m"  VCM
 SG_ FLCObject23_AngRightVar : 136|8@1+ (1E-005,0) [0|0.00255] "NotApplicable"  VCM
 SG_ FLCObject23_LatVel : 277|13@1+ (0.032,-80) [-80|182.112] "m_per_s"  VCM
 SG_ FLCObject23_TimeStamp : 48|16@1+ (0.1,0) [0|6553.5] "ms"  VCM
 SG_ FLCObject23_HeadingVar : 104|8@1+ (0.1,0) [0|25.5] "NotApplicable"  VCM
 SG_ FLCObject23_DstLeftVar : 112|8@1+ (0.4,0) [0|102] "NotApplicable"  VCM
 SG_ FLCObject23_DistLeftCorner : 152|12@1+ (0.05,0) [0|204.75] "m"  VCM
 SG_ FLCObject23_LatPosVar : 40|8@1+ (0.1,0) [0|25.5] "NotApplicable"  VCM
 SG_ FLCObject23_LongPosVar : 144|8@1+ (0.4,0) [0|102] "NotApplicable"  VCM
 SG_ FLCObject23_LongAcc : 239|9@1+ (0.08,-20) [-20|20.88] "m_per_s_squared"  VCM
 SG_ FLCObject23_LatPos : 264|13@1+ (0.05,-180) [-180|229.55] "m"  VCM
 SG_ FLCObject23_LatAcc : 248|9@1+ (0.08,-20) [-20|20.88] "m_per_s_squared"  VCM
 SG_ FLCObject23_Height : 96|8@1+ (0.02,0) [0|5.1] "m"  VCM
 SG_ FLCObject23_Heading : 188|11@1+ (0.005818,-4.71) [-4.71|7.199446] "rad"  VCM
 SG_ FLCObject23_AnglRightCorner : 199|10@1+ (0.005,-1.57) [-1.57|3.545] "rad"  VCM

BA_DEF_ BO_  "GenMsgStartDelayTime" INT 0 0;
BA_DEF_ BO_  "GenMsgDelayTime" INT 0 0;
BA_DEF_ BO_  "GenMsgCycleTime" INT 0 0;
BA_DEF_ BO_  "GenMsgSendType" ENUM  "Cyclic","NotUsed","NotUsed","NotUsed","NotUsed","NotUsed","NotUsed","IfActive","NoMsgSendType","NotUsed";
BA_DEF_ SG_  "GenSigStartValue" INT 0 0;
BA_DEF_ SG_  "GenSigCycleTimeActive" INT 0 0;
BA_DEF_ SG_  "GenSigCycleTime" INT 0 0;
BA_DEF_ SG_  "GenSigSendType" ENUM  "Cyclic","OnWrite","OnWriteWithRepetition","OnChange","OnChangeWithRepetition","IfActive","IfActiveWithRepetition","NoSigSendType","NotUsed","NotUsed","NotUsed","NotUsed","NotUsed";
BA_DEF_ BO_  "VFrameFormat" ENUM  "StandardCAN","ExtendedCAN","reserved","J1939PG","reserved","reserved","reserved","reserved","reserved","reserved","reserved","reserved","reserved","reserved","StandardCAN_FD","ExtendedCAN_FD";
BA_DEF_ SG_  "SigType" ENUM  "Default","Range","RangeSigned","ASCII","Discrete","Control","ReferencePGN","DTC","StringDelimiter","StringLength","StringLengthControl";
BA_DEF_ SG_  "SeToolVersion_SIGNAL" STRING ;
BA_DEF_ SG_  "SeToolUniqueID_SIGNAL" STRING ;
BA_DEF_ SG_  "SeToolName_SIGNAL" STRING ;
BA_DEF_ SG_  "SeToolItemID_SIGNAL" STRING ;
BA_DEF_ SG_  "SeToolAncestorID_SIGNAL" STRING ;
BA_DEF_ SG_  "NeedsUpdateBit" ENUM  "No","Yes";
BA_DEF_ SG_  "GenSigILSupport" ENUM  "Yes","No";
BA_DEF_ BO_  "GenMsgILSupport" ENUM  "No","Yes";
BA_DEF_ SG_  "E2EProfile" STRING ;
BA_DEF_ SG_  "E2EDataLength" INT 0 65535;
BA_DEF_ SG_  "E2EDataId" INT 0 65535;
BA_DEF_ BO_  "DiagUUDTResponse" ENUM  "No","Yes";
BA_DEF_ BO_  "DiagState" ENUM  "No","Yes";
BA_DEF_ BO_  "DiagResponse" ENUM  "No","Yes";
BA_DEF_ BO_  "DiagRequest" ENUM  "No","Yes";
BA_DEF_ BO_  "DiagConnection" HEX 0 65535;
BA_DEF_ BO_  "CanTpFcFrameId" HEX 0 2147483647;
BA_DEF_ BO_  "CanTpBs" INT 0 255;
BA_DEF_ BO_  "CANFD_BRS" ENUM  "0","1";
BA_DEF_REL_ BU_SG_REL_  "GenSigTimeoutTime" INT 0 65535;
BA_DEF_REL_ BU_SG_REL_  "GenSigFirstTimeoutTime" INT 0 65535;
BA_DEF_DEF_  "GenMsgStartDelayTime" 0;
BA_DEF_DEF_  "GenMsgDelayTime" 0;
BA_DEF_DEF_  "GenMsgCycleTime" 0;
BA_DEF_DEF_  "GenMsgSendType" "Cyclic";
BA_DEF_DEF_  "GenSigStartValue" 0;
BA_DEF_DEF_  "GenSigCycleTimeActive" 0;
BA_DEF_DEF_  "GenSigCycleTime" 0;
BA_DEF_DEF_  "GenSigSendType" "Cyclic";
BA_DEF_DEF_  "VFrameFormat" "ExtendedCAN";
BA_DEF_DEF_  "SigType" "Default";
BA_DEF_DEF_  "SeToolVersion_SIGNAL" "";
BA_DEF_DEF_  "SeToolUniqueID_SIGNAL" "";
BA_DEF_DEF_  "SeToolName_SIGNAL" "";
BA_DEF_DEF_  "SeToolItemID_SIGNAL" "";
BA_DEF_DEF_  "SeToolAncestorID_SIGNAL" "";
BA_DEF_DEF_  "NeedsUpdateBit" "No";
BA_DEF_DEF_  "GenSigILSupport" "Yes";
BA_DEF_DEF_  "GenMsgILSupport" "Yes";
BA_DEF_DEF_  "E2EProfile" "none";
BA_DEF_DEF_  "E2EDataLength" 0;
BA_DEF_DEF_  "E2EDataId" 0;
BA_DEF_DEF_  "DiagUUDTResponse" "No";
BA_DEF_DEF_  "DiagState" "No";
BA_DEF_DEF_  "DiagResponse" "No";
BA_DEF_DEF_  "DiagRequest" "No";
BA_DEF_DEF_  "DiagConnection" 0;
BA_DEF_DEF_  "CanTpFcFrameId" 2147483647;
BA_DEF_DEF_  "CanTpBs" 255;
BA_DEF_DEF_  "CANFD_BRS" "0";
BA_DEF_DEF_REL_ "GenSigTimeoutTime" 0;
BA_DEF_DEF_REL_ "GenSigFirstTimeoutTime" 0;
BA_ "CANFD_BRS" BO_ 839 1;
BA_ "GenMsgSendType" BO_ 839 8;
BA_ "VFrameFormat" BO_ 839 14;
BA_ "CANFD_BRS" BO_ 838 1;
BA_ "GenMsgSendType" BO_ 838 8;
BA_ "VFrameFormat" BO_ 838 14;
BA_ "CANFD_BRS" BO_ 837 1;
BA_ "GenMsgSendType" BO_ 837 8;
BA_ "VFrameFormat" BO_ 837 14;
BA_ "CANFD_BRS" BO_ 836 1;
BA_ "GenMsgSendType" BO_ 836 8;
BA_ "VFrameFormat" BO_ 836 14;
BA_ "CANFD_BRS" BO_ 835 1;
BA_ "GenMsgSendType" BO_ 835 8;
BA_ "VFrameFormat" BO_ 835 14;
BA_ "CANFD_BRS" BO_ 834 1;
BA_ "GenMsgSendType" BO_ 834 8;
BA_ "VFrameFormat" BO_ 834 14;
BA_ "CANFD_BRS" BO_ 833 1;
BA_ "GenMsgSendType" BO_ 833 8;
BA_ "VFrameFormat" BO_ 833 14;
BA_ "CANFD_BRS" BO_ 832 1;
BA_ "GenMsgSendType" BO_ 832 8;
BA_ "VFrameFormat" BO_ 832 14;
BA_ "CANFD_BRS" BO_ 824 1;
BA_ "GenMsgSendType" BO_ 824 8;
BA_ "VFrameFormat" BO_ 824 14;
BA_ "CANFD_BRS" BO_ 823 1;
BA_ "GenMsgSendType" BO_ 823 8;
BA_ "VFrameFormat" BO_ 823 14;
BA_ "CANFD_BRS" BO_ 822 1;
BA_ "GenMsgSendType" BO_ 822 8;
BA_ "VFrameFormat" BO_ 822 14;
BA_ "CANFD_BRS" BO_ 821 1;
BA_ "GenMsgSendType" BO_ 821 8;
BA_ "VFrameFormat" BO_ 821 14;
BA_ "CANFD_BRS" BO_ 820 1;
BA_ "GenMsgSendType" BO_ 820 8;
BA_ "VFrameFormat" BO_ 820 14;
BA_ "CANFD_BRS" BO_ 819 1;
BA_ "GenMsgSendType" BO_ 819 8;
BA_ "VFrameFormat" BO_ 819 14;
BA_ "CANFD_BRS" BO_ 818 1;
BA_ "GenMsgSendType" BO_ 818 8;
BA_ "VFrameFormat" BO_ 818 14;
BA_ "CANFD_BRS" BO_ 817 1;
BA_ "GenMsgSendType" BO_ 817 8;
BA_ "VFrameFormat" BO_ 817 14;
BA_ "CANFD_BRS" BO_ 816 1;
BA_ "GenMsgSendType" BO_ 816 8;
BA_ "VFrameFormat" BO_ 816 14;
BA_ "CANFD_BRS" BO_ 512 1;
BA_ "GenMsgSendType" BO_ 512 8;
BA_ "GenMsgDelayTime" BO_ 512 10;
BA_ "VFrameFormat" BO_ 512 14;
BA_ "CANFD_BRS" BO_ 1553 1;
BA_ "GenMsgCycleTime" BO_ 1553 10000;
BA_ "VFrameFormat" BO_ 1553 14;
BA_ "CANFD_BRS" BO_ 807 1;
BA_ "GenMsgSendType" BO_ 807 8;
BA_ "VFrameFormat" BO_ 807 14;
BA_ "GenSigSendType" SG_ 839 Clothoid07_TrackStatus 1;
BA_ "GenSigStartValue" SG_ 839 Clothoid07_TrackStatus 7;
BA_ "GenSigSendType" SG_ 839 Clothoid07_Curvature 1;
BA_ "GenSigStartValue" SG_ 839 Clothoid07_Curvature 262143;
BA_ "GenSigSendType" SG_ 839 Clothoid07_LifeTime 1;
BA_ "GenSigStartValue" SG_ 839 Clothoid07_LifeTime 65535;
BA_ "GenSigSendType" SG_ 839 Clothoid07_CRC 1;
BA_ "GenSigStartValue" SG_ 839 Clothoid07_CRC 65535;
BA_ "E2EDataId" SG_ 839 Clothoid07_CRC 73;
BA_ "E2EDataLength" SG_ 839 Clothoid07_CRC 168;
BA_ "E2EProfile" SG_ 839 Clothoid07_CRC "P05";
BA_ "GenSigSendType" SG_ 839 Clothoid07_Counter 1;
BA_ "GenSigStartValue" SG_ 839 Clothoid07_Counter 255;
BA_ "GenSigSendType" SG_ 839 Clothoid07_CurvatureRate 1;
BA_ "GenSigStartValue" SG_ 839 Clothoid07_CurvatureRate 2047;
BA_ "GenSigSendType" SG_ 839 Clothoid07_Confidence 1;
BA_ "GenSigStartValue" SG_ 839 Clothoid07_Confidence 127;
BA_ "GenSigSendType" SG_ 839 Clothoid07_LatDistVar 1;
BA_ "GenSigStartValue" SG_ 839 Clothoid07_LatDistVar 255;
BA_ "GenSigSendType" SG_ 839 Clothoid07_Type 1;
BA_ "GenSigStartValue" SG_ 839 Clothoid07_Type 31;
BA_ "GenSigSendType" SG_ 839 Clothoid07_HeadingAngle 1;
BA_ "GenSigStartValue" SG_ 839 Clothoid07_HeadingAngle 8191;
BA_ "GenSigSendType" SG_ 839 Clothoid07_LatDist 1;
BA_ "GenSigStartValue" SG_ 839 Clothoid07_LatDist 4095;
BA_ "GenSigSendType" SG_ 839 Clothoid07_CoastIndex 1;
BA_ "GenSigStartValue" SG_ 839 Clothoid07_CoastIndex 31;
BA_ "GenSigSendType" SG_ 839 Clothoid07_TimeStamp 1;
BA_ "GenSigStartValue" SG_ 839 Clothoid07_TimeStamp 65535;
BA_ "GenSigSendType" SG_ 839 Clothoid07_DxStart 1;
BA_ "GenSigStartValue" SG_ 839 Clothoid07_DxStart 255;
BA_ "GenSigSendType" SG_ 839 Clothoid07_Location 1;
BA_ "GenSigStartValue" SG_ 839 Clothoid07_Location 15;
BA_ "GenSigSendType" SG_ 839 Clothoid07_Color 1;
BA_ "GenSigStartValue" SG_ 839 Clothoid07_Color 7;
BA_ "GenSigSendType" SG_ 839 Clothoid07_DxEnd 1;
BA_ "GenSigStartValue" SG_ 839 Clothoid07_DxEnd 255;
BA_ "GenSigSendType" SG_ 839 Clothoid07_Width 1;
BA_ "GenSigStartValue" SG_ 839 Clothoid07_Width 63;
BA_ "GenSigSendType" SG_ 838 Clothoid06_Type 1;
BA_ "GenSigStartValue" SG_ 838 Clothoid06_Type 31;
BA_ "GenSigSendType" SG_ 838 Clothoid06_Width 1;
BA_ "GenSigStartValue" SG_ 838 Clothoid06_Width 63;
BA_ "GenSigSendType" SG_ 838 Clothoid06_LatDistVar 1;
BA_ "GenSigStartValue" SG_ 838 Clothoid06_LatDistVar 255;
BA_ "GenSigSendType" SG_ 838 Clothoid06_Location 1;
BA_ "GenSigStartValue" SG_ 838 Clothoid06_Location 15;
BA_ "GenSigSendType" SG_ 838 Clothoid06_Color 1;
BA_ "GenSigStartValue" SG_ 838 Clothoid06_Color 7;
BA_ "GenSigSendType" SG_ 838 Clothoid06_Curvature 1;
BA_ "GenSigStartValue" SG_ 838 Clothoid06_Curvature 262143;
BA_ "GenSigSendType" SG_ 838 Clothoid06_DxEnd 1;
BA_ "GenSigStartValue" SG_ 838 Clothoid06_DxEnd 255;
BA_ "GenSigSendType" SG_ 838 Clothoid06_HeadingAngle 1;
BA_ "GenSigStartValue" SG_ 838 Clothoid06_HeadingAngle 8191;
BA_ "GenSigSendType" SG_ 838 Clothoid06_Counter 1;
BA_ "GenSigStartValue" SG_ 838 Clothoid06_Counter 255;
BA_ "GenSigSendType" SG_ 838 Clothoid06_TrackStatus 1;
BA_ "GenSigStartValue" SG_ 838 Clothoid06_TrackStatus 7;
BA_ "GenSigSendType" SG_ 838 Clothoid06_CRC 1;
BA_ "GenSigStartValue" SG_ 838 Clothoid06_CRC 65535;
BA_ "E2EDataId" SG_ 838 Clothoid06_CRC 72;
BA_ "E2EDataLength" SG_ 838 Clothoid06_CRC 168;
BA_ "E2EProfile" SG_ 838 Clothoid06_CRC "P05";
BA_ "GenSigSendType" SG_ 838 Clothoid06_LifeTime 1;
BA_ "GenSigStartValue" SG_ 838 Clothoid06_LifeTime 65535;
BA_ "GenSigSendType" SG_ 838 Clothoid06_LatDist 1;
BA_ "GenSigStartValue" SG_ 838 Clothoid06_LatDist 4095;
BA_ "GenSigSendType" SG_ 838 Clothoid06_CoastIndex 1;
BA_ "GenSigStartValue" SG_ 838 Clothoid06_CoastIndex 31;
BA_ "GenSigSendType" SG_ 838 Clothoid06_CurvatureRate 1;
BA_ "GenSigStartValue" SG_ 838 Clothoid06_CurvatureRate 2047;
BA_ "GenSigSendType" SG_ 838 Clothoid06_TimeStamp 1;
BA_ "GenSigStartValue" SG_ 838 Clothoid06_TimeStamp 65535;
BA_ "GenSigSendType" SG_ 838 Clothoid06_DxStart 1;
BA_ "GenSigStartValue" SG_ 838 Clothoid06_DxStart 255;
BA_ "GenSigSendType" SG_ 838 Clothoid06_Confidence 1;
BA_ "GenSigStartValue" SG_ 838 Clothoid06_Confidence 127;
BA_ "GenSigSendType" SG_ 837 Clothoid05_CurvatureRate 1;
BA_ "GenSigStartValue" SG_ 837 Clothoid05_CurvatureRate 2047;
BA_ "GenSigSendType" SG_ 837 Clothoid05_LifeTime 1;
BA_ "GenSigStartValue" SG_ 837 Clothoid05_LifeTime 65535;
BA_ "GenSigSendType" SG_ 837 Clothoid05_Counter 1;
BA_ "GenSigStartValue" SG_ 837 Clothoid05_Counter 255;
BA_ "GenSigSendType" SG_ 837 Clothoid05_DxEnd 1;
BA_ "GenSigStartValue" SG_ 837 Clothoid05_DxEnd 255;
BA_ "GenSigSendType" SG_ 837 Clothoid05_Curvature 1;
BA_ "GenSigStartValue" SG_ 837 Clothoid05_Curvature 262143;
BA_ "GenSigSendType" SG_ 837 Clothoid05_DxStart 1;
BA_ "GenSigStartValue" SG_ 837 Clothoid05_DxStart 255;
BA_ "GenSigSendType" SG_ 837 Clothoid05_CRC 1;
BA_ "GenSigStartValue" SG_ 837 Clothoid05_CRC 65535;
BA_ "E2EDataId" SG_ 837 Clothoid05_CRC 71;
BA_ "E2EDataLength" SG_ 837 Clothoid05_CRC 168;
BA_ "E2EProfile" SG_ 837 Clothoid05_CRC "P05";
BA_ "GenSigSendType" SG_ 837 Clothoid05_Color 1;
BA_ "GenSigSendType" SG_ 837 Clothoid05_TimeStamp 1;
BA_ "GenSigStartValue" SG_ 837 Clothoid05_TimeStamp 65535;
BA_ "GenSigSendType" SG_ 837 Clothoid05_Confidence 1;
BA_ "GenSigStartValue" SG_ 837 Clothoid05_Confidence 127;
BA_ "GenSigSendType" SG_ 837 Clothoid05_HeadingAngle 1;
BA_ "GenSigStartValue" SG_ 837 Clothoid05_HeadingAngle 8191;
BA_ "GenSigSendType" SG_ 837 Clothoid05_LatDistVar 1;
BA_ "GenSigStartValue" SG_ 837 Clothoid05_LatDistVar 255;
BA_ "GenSigSendType" SG_ 837 Clothoid05_LatDist 1;
BA_ "GenSigStartValue" SG_ 837 Clothoid05_LatDist 4095;
BA_ "GenSigSendType" SG_ 837 Clothoid05_Location 1;
BA_ "GenSigStartValue" SG_ 837 Clothoid05_Location 15;
BA_ "GenSigSendType" SG_ 837 Clothoid05_Type 1;
BA_ "GenSigStartValue" SG_ 837 Clothoid05_Type 31;
BA_ "GenSigSendType" SG_ 837 Clothoid05_CoastIndex 1;
BA_ "GenSigStartValue" SG_ 837 Clothoid05_CoastIndex 31;
BA_ "GenSigSendType" SG_ 837 Clothoid05_TrackStatus 1;
BA_ "GenSigStartValue" SG_ 837 Clothoid05_TrackStatus 7;
BA_ "GenSigSendType" SG_ 837 Clothoid05_Width 1;
BA_ "GenSigStartValue" SG_ 837 Clothoid05_Width 63;
BA_ "GenSigSendType" SG_ 836 Clothoid04_DxEnd 1;
BA_ "GenSigStartValue" SG_ 836 Clothoid04_DxEnd 255;
BA_ "GenSigSendType" SG_ 836 Clothoid04_Width 1;
BA_ "GenSigStartValue" SG_ 836 Clothoid04_Width 63;
BA_ "GenSigSendType" SG_ 836 Clothoid04_Counter 1;
BA_ "GenSigStartValue" SG_ 836 Clothoid04_Counter 255;
BA_ "GenSigSendType" SG_ 836 Clothoid04_LifeTime 1;
BA_ "GenSigStartValue" SG_ 836 Clothoid04_LifeTime 65535;
BA_ "GenSigSendType" SG_ 836 Clothoid04_Confidence 1;
BA_ "GenSigStartValue" SG_ 836 Clothoid04_Confidence 127;
BA_ "GenSigSendType" SG_ 836 Clothoid04_LatDist 1;
BA_ "GenSigStartValue" SG_ 836 Clothoid04_LatDist 4095;
BA_ "GenSigSendType" SG_ 836 Clothoid04_LatDistVar 1;
BA_ "GenSigStartValue" SG_ 836 Clothoid04_LatDistVar 255;
BA_ "GenSigSendType" SG_ 836 Clothoid04_Type 1;
BA_ "GenSigStartValue" SG_ 836 Clothoid04_Type 31;
BA_ "GenSigSendType" SG_ 836 Clothoid04_Location 1;
BA_ "GenSigStartValue" SG_ 836 Clothoid04_Location 15;
BA_ "GenSigSendType" SG_ 836 Clothoid04_TrackStatus 1;
BA_ "GenSigStartValue" SG_ 836 Clothoid04_TrackStatus 7;
BA_ "GenSigSendType" SG_ 836 Clothoid04_CRC 1;
BA_ "GenSigStartValue" SG_ 836 Clothoid04_CRC 65535;
BA_ "E2EDataId" SG_ 836 Clothoid04_CRC 70;
BA_ "E2EDataLength" SG_ 836 Clothoid04_CRC 168;
BA_ "E2EProfile" SG_ 836 Clothoid04_CRC "P05";
BA_ "GenSigSendType" SG_ 836 Clothoid04_CoastIndex 1;
BA_ "GenSigStartValue" SG_ 836 Clothoid04_CoastIndex 31;
BA_ "GenSigSendType" SG_ 836 Clothoid04_Curvature 1;
BA_ "GenSigStartValue" SG_ 836 Clothoid04_Curvature 262143;
BA_ "GenSigSendType" SG_ 836 Clothoid04_DxStart 1;
BA_ "GenSigStartValue" SG_ 836 Clothoid04_DxStart 255;
BA_ "GenSigSendType" SG_ 836 Clothoid04_CurvatureRate 1;
BA_ "GenSigStartValue" SG_ 836 Clothoid04_CurvatureRate 2047;
BA_ "GenSigSendType" SG_ 836 Clothoid04_HeadingAngle 1;
BA_ "GenSigStartValue" SG_ 836 Clothoid04_HeadingAngle 8191;
BA_ "GenSigSendType" SG_ 836 Clothoid04_Color 1;
BA_ "GenSigStartValue" SG_ 836 Clothoid04_Color 7;
BA_ "GenSigSendType" SG_ 836 Clothoid04_TimeStamp 1;
BA_ "GenSigStartValue" SG_ 836 Clothoid04_TimeStamp 65535;
BA_ "GenSigSendType" SG_ 835 Clothoid03_Curvature 1;
BA_ "GenSigStartValue" SG_ 835 Clothoid03_Curvature 262143;
BA_ "GenSigSendType" SG_ 835 Clothoid03_LatDist 1;
BA_ "GenSigStartValue" SG_ 835 Clothoid03_LatDist 4095;
BA_ "GenSigSendType" SG_ 835 Clothoid03_LifeTime 1;
BA_ "GenSigStartValue" SG_ 835 Clothoid03_LifeTime 65535;
BA_ "GenSigSendType" SG_ 835 Clothoid03_Location 1;
BA_ "GenSigStartValue" SG_ 835 Clothoid03_Location 15;
BA_ "GenSigSendType" SG_ 835 Clothoid03_CurvatureRate 1;
BA_ "GenSigStartValue" SG_ 835 Clothoid03_CurvatureRate 2047;
BA_ "GenSigSendType" SG_ 835 Clothoid03_Width 1;
BA_ "GenSigStartValue" SG_ 835 Clothoid03_Width 63;
BA_ "GenSigSendType" SG_ 835 Clothoid03_HeadingAngle 1;
BA_ "GenSigStartValue" SG_ 835 Clothoid03_HeadingAngle 8191;
BA_ "GenSigSendType" SG_ 835 Clothoid03_LatDistVar 1;
BA_ "GenSigStartValue" SG_ 835 Clothoid03_LatDistVar 255;
BA_ "GenSigSendType" SG_ 835 Clothoid03_DxEnd 1;
BA_ "GenSigStartValue" SG_ 835 Clothoid03_DxEnd 255;
BA_ "GenSigSendType" SG_ 835 Clothoid03_Counter 1;
BA_ "GenSigStartValue" SG_ 835 Clothoid03_Counter 255;
BA_ "GenSigSendType" SG_ 835 Clothoid03_Color 1;
BA_ "GenSigStartValue" SG_ 835 Clothoid03_Color 7;
BA_ "GenSigSendType" SG_ 835 Clothoid03_Type 1;
BA_ "GenSigStartValue" SG_ 835 Clothoid03_Type 31;
BA_ "GenSigSendType" SG_ 835 Clothoid03_CoastIndex 1;
BA_ "GenSigStartValue" SG_ 835 Clothoid03_CoastIndex 31;
BA_ "GenSigSendType" SG_ 835 Clothoid03_TimeStamp 1;
BA_ "GenSigStartValue" SG_ 835 Clothoid03_TimeStamp 65535;
BA_ "GenSigSendType" SG_ 835 Clothoid03_DxStart 1;
BA_ "GenSigStartValue" SG_ 835 Clothoid03_DxStart 255;
BA_ "GenSigSendType" SG_ 835 Clothoid03_Confidence 1;
BA_ "GenSigStartValue" SG_ 835 Clothoid03_Confidence 127;
BA_ "GenSigSendType" SG_ 835 Clothoid03_TrackStatus 1;
BA_ "GenSigStartValue" SG_ 835 Clothoid03_TrackStatus 7;
BA_ "GenSigSendType" SG_ 835 Clothoid03_CRC 1;
BA_ "GenSigStartValue" SG_ 835 Clothoid03_CRC 65535;
BA_ "E2EDataId" SG_ 835 Clothoid03_CRC 69;
BA_ "E2EDataLength" SG_ 835 Clothoid03_CRC 168;
BA_ "E2EProfile" SG_ 835 Clothoid03_CRC "P05";
BA_ "GenSigSendType" SG_ 834 Clothoid02_Confidence 1;
BA_ "GenSigStartValue" SG_ 834 Clothoid02_Confidence 127;
BA_ "GenSigSendType" SG_ 834 Clothoid02_CurvatureRate 1;
BA_ "GenSigStartValue" SG_ 834 Clothoid02_CurvatureRate 2047;
BA_ "GenSigSendType" SG_ 834 Clothoid02_LifeTime 1;
BA_ "GenSigStartValue" SG_ 834 Clothoid02_LifeTime 65535;
BA_ "GenSigSendType" SG_ 834 Clothoid02_DxStart 1;
BA_ "GenSigStartValue" SG_ 834 Clothoid02_DxStart 255;
BA_ "GenSigSendType" SG_ 834 Clothoid02_DxEnd 1;
BA_ "GenSigStartValue" SG_ 834 Clothoid02_DxEnd 255;
BA_ "GenSigSendType" SG_ 834 Clothoid02_Color 1;
BA_ "GenSigStartValue" SG_ 834 Clothoid02_Color 7;
BA_ "GenSigSendType" SG_ 834 Clothoid02_CoastIndex 1;
BA_ "GenSigStartValue" SG_ 834 Clothoid02_CoastIndex 31;
BA_ "GenSigSendType" SG_ 834 Clothoid02_LatDistVar 1;
BA_ "GenSigStartValue" SG_ 834 Clothoid02_LatDistVar 255;
BA_ "GenSigSendType" SG_ 834 Clothoid02_Width 1;
BA_ "GenSigStartValue" SG_ 834 Clothoid02_Width 63;
BA_ "GenSigSendType" SG_ 834 Clothoid02_TrackStatus 1;
BA_ "GenSigStartValue" SG_ 834 Clothoid02_TrackStatus 7;
BA_ "GenSigSendType" SG_ 834 Clothoid02_Curvature 1;
BA_ "GenSigStartValue" SG_ 834 Clothoid02_Curvature 262143;
BA_ "GenSigSendType" SG_ 834 Clothoid02_TimeStamp 1;
BA_ "GenSigStartValue" SG_ 834 Clothoid02_TimeStamp 65535;
BA_ "GenSigSendType" SG_ 834 Clothoid02_Type 1;
BA_ "GenSigStartValue" SG_ 834 Clothoid02_Type 31;
BA_ "GenSigSendType" SG_ 834 Clothoid02_HeadingAngle 1;
BA_ "GenSigStartValue" SG_ 834 Clothoid02_HeadingAngle 8191;
BA_ "GenSigSendType" SG_ 834 Clothoid02_LatDist 1;
BA_ "GenSigStartValue" SG_ 834 Clothoid02_LatDist 4095;
BA_ "GenSigSendType" SG_ 834 Clothoid02_CRC 1;
BA_ "GenSigStartValue" SG_ 834 Clothoid02_CRC 65535;
BA_ "E2EDataId" SG_ 834 Clothoid02_CRC 68;
BA_ "E2EDataLength" SG_ 834 Clothoid02_CRC 168;
BA_ "E2EProfile" SG_ 834 Clothoid02_CRC "P05";
BA_ "GenSigSendType" SG_ 834 Clothoid02_Counter 1;
BA_ "GenSigStartValue" SG_ 834 Clothoid02_Counter 255;
BA_ "GenSigSendType" SG_ 834 Clothoid02_Location 1;
BA_ "GenSigStartValue" SG_ 834 Clothoid02_Location 15;
BA_ "GenSigSendType" SG_ 833 Clothoid01_HeadingAngle 1;
BA_ "GenSigStartValue" SG_ 833 Clothoid01_HeadingAngle 8191;
BA_ "GenSigSendType" SG_ 833 Clothoid01_DxEnd 1;
BA_ "GenSigStartValue" SG_ 833 Clothoid01_DxEnd 255;
BA_ "GenSigSendType" SG_ 833 Clothoid01_LatDist 1;
BA_ "GenSigStartValue" SG_ 833 Clothoid01_LatDist 4095;
BA_ "GenSigSendType" SG_ 833 Clothoid01_Width 1;
BA_ "GenSigStartValue" SG_ 833 Clothoid01_Width 63;
BA_ "GenSigSendType" SG_ 833 Clothoid01_DxStart 1;
BA_ "GenSigStartValue" SG_ 833 Clothoid01_DxStart 255;
BA_ "GenSigSendType" SG_ 833 Clothoid01_CurvatureRate 1;
BA_ "GenSigStartValue" SG_ 833 Clothoid01_CurvatureRate 2047;
BA_ "GenSigSendType" SG_ 833 Clothoid01_LifeTime 1;
BA_ "GenSigStartValue" SG_ 833 Clothoid01_LifeTime 65535;
BA_ "GenSigSendType" SG_ 833 Clothoid01_TrackStatus 1;
BA_ "GenSigStartValue" SG_ 833 Clothoid01_TrackStatus 7;
BA_ "GenSigSendType" SG_ 833 Clothoid01_Type 1;
BA_ "GenSigStartValue" SG_ 833 Clothoid01_Type 31;
BA_ "GenSigSendType" SG_ 833 Clothoid01_Curvature 1;
BA_ "GenSigStartValue" SG_ 833 Clothoid01_Curvature 262143;
BA_ "GenSigSendType" SG_ 833 Clothoid01_Location 1;
BA_ "GenSigStartValue" SG_ 833 Clothoid01_Location 15;
BA_ "GenSigSendType" SG_ 833 Clothoid01_Color 1;
BA_ "GenSigStartValue" SG_ 833 Clothoid01_Color 7;
BA_ "GenSigSendType" SG_ 833 Clothoid01_CoastIndex 1;
BA_ "GenSigStartValue" SG_ 833 Clothoid01_CoastIndex 31;
BA_ "GenSigSendType" SG_ 833 Clothoid01_LatDistVar 1;
BA_ "GenSigStartValue" SG_ 833 Clothoid01_LatDistVar 255;
BA_ "GenSigSendType" SG_ 833 Clothoid01_Counter 1;
BA_ "GenSigStartValue" SG_ 833 Clothoid01_Counter 255;
BA_ "GenSigSendType" SG_ 833 Clothoid01_CRC 1;
BA_ "GenSigStartValue" SG_ 833 Clothoid01_CRC 65535;
BA_ "E2EDataId" SG_ 833 Clothoid01_CRC 67;
BA_ "E2EDataLength" SG_ 833 Clothoid01_CRC 168;
BA_ "E2EProfile" SG_ 833 Clothoid01_CRC "P05";
BA_ "GenSigSendType" SG_ 833 Clothoid01_TimeStamp 1;
BA_ "GenSigStartValue" SG_ 833 Clothoid01_TimeStamp 65535;
BA_ "GenSigSendType" SG_ 833 Clothoid01_Confidence 1;
BA_ "GenSigStartValue" SG_ 833 Clothoid01_Confidence 127;
BA_ "GenSigSendType" SG_ 832 Clothoid00_DxStart 1;
BA_ "GenSigStartValue" SG_ 832 Clothoid00_DxStart 255;
BA_ "GenSigSendType" SG_ 832 Clothoid00_LatDistVar 1;
BA_ "GenSigStartValue" SG_ 832 Clothoid00_LatDistVar 255;
BA_ "GenSigSendType" SG_ 832 Clothoid00_Width 1;
BA_ "GenSigStartValue" SG_ 832 Clothoid00_Width 63;
BA_ "GenSigSendType" SG_ 832 Clothoid00_Confidence 1;
BA_ "GenSigStartValue" SG_ 832 Clothoid00_Confidence 127;
BA_ "GenSigSendType" SG_ 832 Clothoid00_TimeStamp 1;
BA_ "GenSigStartValue" SG_ 832 Clothoid00_TimeStamp 65535;
BA_ "GenSigSendType" SG_ 832 Clothoid00_DxEnd 1;
BA_ "GenSigStartValue" SG_ 832 Clothoid00_DxEnd 255;
BA_ "GenSigSendType" SG_ 832 Clothoid00_TrackStatus 1;
BA_ "GenSigStartValue" SG_ 832 Clothoid00_TrackStatus 7;
BA_ "GenSigSendType" SG_ 832 Clothoid00_Color 1;
BA_ "GenSigStartValue" SG_ 832 Clothoid00_Color 7;
BA_ "GenSigSendType" SG_ 832 Clothoid00_Curvature 1;
BA_ "GenSigStartValue" SG_ 832 Clothoid00_Curvature 262143;
BA_ "GenSigSendType" SG_ 832 Clothoid00_CurvatureRate 1;
BA_ "GenSigStartValue" SG_ 832 Clothoid00_CurvatureRate 2047;
BA_ "GenSigSendType" SG_ 832 Clothoid00_Type 1;
BA_ "GenSigStartValue" SG_ 832 Clothoid00_Type 31;
BA_ "GenSigSendType" SG_ 832 Clothoid00_HeadingAngle 1;
BA_ "GenSigStartValue" SG_ 832 Clothoid00_HeadingAngle 8191;
BA_ "GenSigSendType" SG_ 832 Clothoid00_CRC 1;
BA_ "GenSigStartValue" SG_ 832 Clothoid00_CRC 65535;
BA_ "E2EDataId" SG_ 832 Clothoid00_CRC 66;
BA_ "E2EDataLength" SG_ 832 Clothoid00_CRC 168;
BA_ "E2EProfile" SG_ 832 Clothoid00_CRC "P05";
BA_ "GenSigSendType" SG_ 832 Clothoid00_Location 1;
BA_ "GenSigStartValue" SG_ 832 Clothoid00_Location 15;
BA_ "GenSigSendType" SG_ 832 Clothoid00_LifeTime 1;
BA_ "GenSigStartValue" SG_ 832 Clothoid00_LifeTime 65535;
BA_ "GenSigSendType" SG_ 832 Clothoid00_Counter 1;
BA_ "GenSigStartValue" SG_ 832 Clothoid00_Counter 255;
BA_ "GenSigSendType" SG_ 832 Clothoid00_CoastIndex 1;
BA_ "GenSigStartValue" SG_ 832 Clothoid00_CoastIndex 31;
BA_ "GenSigSendType" SG_ 832 Clothoid00_LatDist 1;
BA_ "GenSigStartValue" SG_ 832 Clothoid00_LatDist 4095;
BA_ "GenSigSendType" SG_ 824 Brightspot08_RightAngleVar 1;
BA_ "GenSigStartValue" SG_ 824 Brightspot08_RightAngleVar 255;
BA_ "GenSigSendType" SG_ 824 Brightspot08_RightAngle 1;
BA_ "GenSigStartValue" SG_ 824 Brightspot08_RightAngle 2047;
BA_ "GenSigSendType" SG_ 824 Brightspot08_Direction 1;
BA_ "GenSigStartValue" SG_ 824 Brightspot08_Direction 3;
BA_ "GenSigSendType" SG_ 824 Brightspot08_LifeTime 1;
BA_ "GenSigStartValue" SG_ 824 Brightspot08_LifeTime 65535;
BA_ "GenSigSendType" SG_ 824 Brightspot08_RightAngVelocity 1;
BA_ "GenSigStartValue" SG_ 824 Brightspot08_RightAngVelocity 255;
BA_ "GenSigSendType" SG_ 824 Brightspot08_LeftAngleVar 1;
BA_ "GenSigStartValue" SG_ 824 Brightspot08_LeftAngleVar 255;
BA_ "GenSigSendType" SG_ 824 Brightspot08_TrackStatus 1;
BA_ "GenSigStartValue" SG_ 824 Brightspot08_TrackStatus 7;
BA_ "GenSigSendType" SG_ 824 Brightspot08_ID 1;
BA_ "GenSigStartValue" SG_ 824 Brightspot08_ID 255;
BA_ "GenSigSendType" SG_ 824 Brightspot08_TimeStamp 1;
BA_ "GenSigStartValue" SG_ 824 Brightspot08_TimeStamp 65535;
BA_ "GenSigSendType" SG_ 824 Brightspot08_ExistConf 1;
BA_ "GenSigStartValue" SG_ 824 Brightspot08_ExistConf 127;
BA_ "GenSigSendType" SG_ 824 Brightspot08_LeftAngVelocity 1;
BA_ "GenSigStartValue" SG_ 824 Brightspot08_LeftAngVelocity 255;
BA_ "GenSigSendType" SG_ 824 Brightspot08_DistanceVar 1;
BA_ "GenSigStartValue" SG_ 824 Brightspot08_DistanceVar 255;
BA_ "GenSigSendType" SG_ 824 Brightspot08_Distance 1;
BA_ "GenSigStartValue" SG_ 824 Brightspot08_Distance 1023;
BA_ "GenSigSendType" SG_ 824 Brightspot08_MergeObj 1;
BA_ "GenSigStartValue" SG_ 824 Brightspot08_MergeObj 3;
BA_ "GenSigSendType" SG_ 824 Brightspot08_LeftAngle 1;
BA_ "GenSigStartValue" SG_ 824 Brightspot08_LeftAngle 2047;
BA_ "GenSigSendType" SG_ 823 Brightspot07_RightAngleVar 1;
BA_ "GenSigStartValue" SG_ 823 Brightspot07_RightAngleVar 255;
BA_ "GenSigSendType" SG_ 823 Brightspot07_DistanceVar 1;
BA_ "GenSigStartValue" SG_ 823 Brightspot07_DistanceVar 255;
BA_ "GenSigSendType" SG_ 823 Brightspot07_LeftAngVelocity 1;
BA_ "GenSigStartValue" SG_ 823 Brightspot07_LeftAngVelocity 255;
BA_ "GenSigSendType" SG_ 823 Brightspot07_TimeStamp 1;
BA_ "GenSigStartValue" SG_ 823 Brightspot07_TimeStamp 65535;
BA_ "GenSigSendType" SG_ 823 Brightspot07_MergeObj 1;
BA_ "GenSigStartValue" SG_ 823 Brightspot07_MergeObj 3;
BA_ "GenSigSendType" SG_ 823 Brightspot07_LifeTime 1;
BA_ "GenSigStartValue" SG_ 823 Brightspot07_LifeTime 65535;
BA_ "GenSigSendType" SG_ 823 Brightspot07_TrackStatus 1;
BA_ "GenSigStartValue" SG_ 823 Brightspot07_TrackStatus 7;
BA_ "GenSigSendType" SG_ 823 Brightspot07_Direction 1;
BA_ "GenSigStartValue" SG_ 823 Brightspot07_Direction 3;
BA_ "GenSigSendType" SG_ 823 Brightspot07_Distance 1;
BA_ "GenSigStartValue" SG_ 823 Brightspot07_Distance 1023;
BA_ "GenSigSendType" SG_ 823 Brightspot07_LeftAngleVar 1;
BA_ "GenSigStartValue" SG_ 823 Brightspot07_LeftAngleVar 255;
BA_ "GenSigSendType" SG_ 823 Brightspot07_ExistConf 1;
BA_ "GenSigStartValue" SG_ 823 Brightspot07_ExistConf 127;
BA_ "GenSigSendType" SG_ 823 Brightspot07_RightAngle 1;
BA_ "GenSigStartValue" SG_ 823 Brightspot07_RightAngle 2047;
BA_ "GenSigSendType" SG_ 823 Brightspot07_RightAngVelocity 1;
BA_ "GenSigStartValue" SG_ 823 Brightspot07_RightAngVelocity 255;
BA_ "GenSigSendType" SG_ 823 Brightspot07_ID 1;
BA_ "GenSigStartValue" SG_ 823 Brightspot07_ID 255;
BA_ "GenSigSendType" SG_ 823 Brightspot07_LeftAngle 1;
BA_ "GenSigStartValue" SG_ 823 Brightspot07_LeftAngle 2047;
BA_ "GenSigSendType" SG_ 822 Brightspot06_Distance 1;
BA_ "GenSigStartValue" SG_ 822 Brightspot06_Distance 1023;
BA_ "GenSigSendType" SG_ 822 Brightspot06_RightAngle 1;
BA_ "GenSigStartValue" SG_ 822 Brightspot06_RightAngle 2047;
BA_ "GenSigSendType" SG_ 822 Brightspot06_MergeObj 1;
BA_ "GenSigStartValue" SG_ 822 Brightspot06_MergeObj 3;
BA_ "GenSigSendType" SG_ 822 Brightspot06_LeftAngleVar 1;
BA_ "GenSigStartValue" SG_ 822 Brightspot06_LeftAngleVar 255;
BA_ "GenSigSendType" SG_ 822 Brightspot06_ExistConf 1;
BA_ "GenSigStartValue" SG_ 822 Brightspot06_ExistConf 127;
BA_ "GenSigSendType" SG_ 822 Brightspot06_LeftAngle 1;
BA_ "GenSigStartValue" SG_ 822 Brightspot06_LeftAngle 2047;
BA_ "GenSigSendType" SG_ 822 Brightspot06_TrackStatus 1;
BA_ "GenSigStartValue" SG_ 822 Brightspot06_TrackStatus 7;
BA_ "GenSigSendType" SG_ 822 Brightspot06_Direction 1;
BA_ "GenSigStartValue" SG_ 822 Brightspot06_Direction 3;
BA_ "GenSigSendType" SG_ 822 Brightspot06_DistanceVar 1;
BA_ "GenSigStartValue" SG_ 822 Brightspot06_DistanceVar 255;
BA_ "GenSigSendType" SG_ 822 Brightspot06_LeftAngVelocity 1;
BA_ "GenSigStartValue" SG_ 822 Brightspot06_LeftAngVelocity 255;
BA_ "GenSigSendType" SG_ 822 Brightspot06_RightAngleVar 1;
BA_ "GenSigStartValue" SG_ 822 Brightspot06_RightAngleVar 255;
BA_ "GenSigSendType" SG_ 822 Brightspot06_LifeTime 1;
BA_ "GenSigStartValue" SG_ 822 Brightspot06_LifeTime 65535;
BA_ "GenSigSendType" SG_ 822 Brightspot06_ID 1;
BA_ "GenSigStartValue" SG_ 822 Brightspot06_ID 255;
BA_ "GenSigSendType" SG_ 822 Brightspot06_RightAngVelocity 1;
BA_ "GenSigStartValue" SG_ 822 Brightspot06_RightAngVelocity 255;
BA_ "GenSigSendType" SG_ 822 Brightspot06_TimeStamp 1;
BA_ "GenSigStartValue" SG_ 822 Brightspot06_TimeStamp 65535;
BA_ "GenSigSendType" SG_ 821 Brightspot05_LeftAngleVar 1;
BA_ "GenSigStartValue" SG_ 821 Brightspot05_LeftAngleVar 255;
BA_ "GenSigSendType" SG_ 821 Brightspot05_LeftAngVelocity 1;
BA_ "GenSigStartValue" SG_ 821 Brightspot05_LeftAngVelocity 255;
BA_ "GenSigSendType" SG_ 821 Brightspot05_LeftAngle 1;
BA_ "GenSigStartValue" SG_ 821 Brightspot05_LeftAngle 2047;
BA_ "GenSigSendType" SG_ 821 Brightspot05_TrackStatus 1;
BA_ "GenSigStartValue" SG_ 821 Brightspot05_TrackStatus 7;
BA_ "GenSigSendType" SG_ 821 Brightspot05_TimeStamp 1;
BA_ "GenSigStartValue" SG_ 821 Brightspot05_TimeStamp 65535;
BA_ "GenSigSendType" SG_ 821 Brightspot05_Distance 1;
BA_ "GenSigStartValue" SG_ 821 Brightspot05_Distance 1023;
BA_ "GenSigSendType" SG_ 821 Brightspot05_Direction 1;
BA_ "GenSigStartValue" SG_ 821 Brightspot05_Direction 3;
BA_ "GenSigSendType" SG_ 821 Brightspot05_ID 1;
BA_ "GenSigStartValue" SG_ 821 Brightspot05_ID 255;
BA_ "GenSigSendType" SG_ 821 Brightspot05_ExistConf 1;
BA_ "GenSigStartValue" SG_ 821 Brightspot05_ExistConf 127;
BA_ "GenSigSendType" SG_ 821 Brightspot05_LifeTime 1;
BA_ "GenSigStartValue" SG_ 821 Brightspot05_LifeTime 65535;
BA_ "GenSigSendType" SG_ 821 Brightspot05_DistanceVar 1;
BA_ "GenSigStartValue" SG_ 821 Brightspot05_DistanceVar 255;
BA_ "GenSigSendType" SG_ 821 Brightspot05_RightAngle 1;
BA_ "GenSigStartValue" SG_ 821 Brightspot05_RightAngle 2047;
BA_ "GenSigSendType" SG_ 821 Brightspot05_MergeObj 1;
BA_ "GenSigStartValue" SG_ 821 Brightspot05_MergeObj 3;
BA_ "GenSigSendType" SG_ 821 Brightspot05_RightAngleVar 1;
BA_ "GenSigStartValue" SG_ 821 Brightspot05_RightAngleVar 255;
BA_ "GenSigSendType" SG_ 821 Brightspot05_RightAngVelocity 1;
BA_ "GenSigStartValue" SG_ 821 Brightspot05_RightAngVelocity 255;
BA_ "GenSigSendType" SG_ 820 Brightspot04_Direction 1;
BA_ "GenSigStartValue" SG_ 820 Brightspot04_Direction 3;
BA_ "GenSigSendType" SG_ 820 Brightspot04_TrackStatus 1;
BA_ "GenSigStartValue" SG_ 820 Brightspot04_TrackStatus 7;
BA_ "GenSigSendType" SG_ 820 Brightspot04_LeftAngleVar 1;
BA_ "GenSigStartValue" SG_ 820 Brightspot04_LeftAngleVar 255;
BA_ "GenSigSendType" SG_ 820 Brightspot04_RightAngleVar 1;
BA_ "GenSigStartValue" SG_ 820 Brightspot04_RightAngleVar 255;
BA_ "GenSigSendType" SG_ 820 Brightspot04_ID 1;
BA_ "GenSigStartValue" SG_ 820 Brightspot04_ID 255;
BA_ "GenSigSendType" SG_ 820 Brightspot04_LeftAngVelocity 1;
BA_ "GenSigStartValue" SG_ 820 Brightspot04_LeftAngVelocity 255;
BA_ "GenSigSendType" SG_ 820 Brightspot04_RightAngVelocity 1;
BA_ "GenSigStartValue" SG_ 820 Brightspot04_RightAngVelocity 255;
BA_ "GenSigSendType" SG_ 820 Brightspot04_ExistConf 1;
BA_ "GenSigStartValue" SG_ 820 Brightspot04_ExistConf 127;
BA_ "GenSigSendType" SG_ 820 Brightspot04_RightAngle 1;
BA_ "GenSigStartValue" SG_ 820 Brightspot04_RightAngle 2047;
BA_ "GenSigSendType" SG_ 820 Brightspot04_LifeTime 1;
BA_ "GenSigStartValue" SG_ 820 Brightspot04_LifeTime 65535;
BA_ "GenSigSendType" SG_ 820 Brightspot04_Distance 1;
BA_ "GenSigStartValue" SG_ 820 Brightspot04_Distance 1023;
BA_ "GenSigSendType" SG_ 820 Brightspot04_DistanceVar 1;
BA_ "GenSigStartValue" SG_ 820 Brightspot04_DistanceVar 255;
BA_ "GenSigSendType" SG_ 820 Brightspot04_MergeObj 1;
BA_ "GenSigStartValue" SG_ 820 Brightspot04_MergeObj 3;
BA_ "GenSigSendType" SG_ 820 Brightspot04_LeftAngle 1;
BA_ "GenSigStartValue" SG_ 820 Brightspot04_LeftAngle 2047;
BA_ "GenSigSendType" SG_ 820 Brightspot04_TimeStamp 1;
BA_ "GenSigStartValue" SG_ 820 Brightspot04_TimeStamp 65535;
BA_ "GenSigSendType" SG_ 819 Brightspot03_ID 1;
BA_ "GenSigStartValue" SG_ 819 Brightspot03_ID 255;
BA_ "GenSigSendType" SG_ 819 Brightspot03_DistanceVar 1;
BA_ "GenSigStartValue" SG_ 819 Brightspot03_DistanceVar 255;
BA_ "GenSigSendType" SG_ 819 Brightspot03_Distance 1;
BA_ "GenSigStartValue" SG_ 819 Brightspot03_Distance 1023;
BA_ "GenSigSendType" SG_ 819 Brightspot03_RightAngVelocity 1;
BA_ "GenSigStartValue" SG_ 819 Brightspot03_RightAngVelocity 255;
BA_ "GenSigSendType" SG_ 819 Brightspot03_RightAngleVar 1;
BA_ "GenSigStartValue" SG_ 819 Brightspot03_RightAngleVar 255;
BA_ "GenSigSendType" SG_ 819 Brightspot03_RightAngle 1;
BA_ "GenSigStartValue" SG_ 819 Brightspot03_RightAngle 2047;
BA_ "GenSigSendType" SG_ 819 Brightspot03_ExistConf 1;
BA_ "GenSigStartValue" SG_ 819 Brightspot03_ExistConf 127;
BA_ "GenSigSendType" SG_ 819 Brightspot03_Direction 1;
BA_ "GenSigStartValue" SG_ 819 Brightspot03_Direction 3;
BA_ "GenSigSendType" SG_ 819 Brightspot03_MergeObj 1;
BA_ "GenSigStartValue" SG_ 819 Brightspot03_MergeObj 3;
BA_ "GenSigSendType" SG_ 819 Brightspot03_TrackStatus 1;
BA_ "GenSigStartValue" SG_ 819 Brightspot03_TrackStatus 7;
BA_ "GenSigSendType" SG_ 819 Brightspot03_LifeTime 1;
BA_ "GenSigStartValue" SG_ 819 Brightspot03_LifeTime 65535;
BA_ "GenSigSendType" SG_ 819 Brightspot03_LeftAngleVar 1;
BA_ "GenSigStartValue" SG_ 819 Brightspot03_LeftAngleVar 255;
BA_ "GenSigSendType" SG_ 819 Brightspot03_TimeStamp 1;
BA_ "GenSigStartValue" SG_ 819 Brightspot03_TimeStamp 65535;
BA_ "GenSigSendType" SG_ 819 Brightspot03_LeftAngVelocity 1;
BA_ "GenSigStartValue" SG_ 819 Brightspot03_LeftAngVelocity 255;
BA_ "GenSigSendType" SG_ 819 Brightspot03_LeftAngle 1;
BA_ "GenSigStartValue" SG_ 819 Brightspot03_LeftAngle 2047;
BA_ "GenSigSendType" SG_ 818 Brightspot02_RightAngVelocity 1;
BA_ "GenSigStartValue" SG_ 818 Brightspot02_RightAngVelocity 255;
BA_ "GenSigSendType" SG_ 818 Brightspot02_LeftAngle 1;
BA_ "GenSigStartValue" SG_ 818 Brightspot02_LeftAngle 2047;
BA_ "GenSigSendType" SG_ 818 Brightspot02_Distance 1;
BA_ "GenSigStartValue" SG_ 818 Brightspot02_Distance 1023;
BA_ "GenSigSendType" SG_ 818 Brightspot02_TrackStatus 1;
BA_ "GenSigStartValue" SG_ 818 Brightspot02_TrackStatus 7;
BA_ "GenSigSendType" SG_ 818 Brightspot02_ID 1;
BA_ "GenSigStartValue" SG_ 818 Brightspot02_ID 255;
BA_ "GenSigSendType" SG_ 818 Brightspot02_Direction 1;
BA_ "GenSigStartValue" SG_ 818 Brightspot02_Direction 3;
BA_ "GenSigSendType" SG_ 818 Brightspot02_RightAngle 1;
BA_ "GenSigStartValue" SG_ 818 Brightspot02_RightAngle 2047;
BA_ "GenSigSendType" SG_ 818 Brightspot02_MergeObj 1;
BA_ "GenSigStartValue" SG_ 818 Brightspot02_MergeObj 3;
BA_ "GenSigSendType" SG_ 818 Brightspot02_LeftAngleVar 1;
BA_ "GenSigStartValue" SG_ 818 Brightspot02_LeftAngleVar 255;
BA_ "GenSigSendType" SG_ 818 Brightspot02_DistanceVar 1;
BA_ "GenSigStartValue" SG_ 818 Brightspot02_DistanceVar 255;
BA_ "GenSigSendType" SG_ 818 Brightspot02_ExistConf 1;
BA_ "GenSigStartValue" SG_ 818 Brightspot02_ExistConf 127;
BA_ "GenSigSendType" SG_ 818 Brightspot02_LifeTime 1;
BA_ "GenSigStartValue" SG_ 818 Brightspot02_LifeTime 65535;
BA_ "GenSigSendType" SG_ 818 Brightspot02_RightAngleVar 1;
BA_ "GenSigStartValue" SG_ 818 Brightspot02_RightAngleVar 255;
BA_ "GenSigSendType" SG_ 818 Brightspot02_LeftAngVelocity 1;
BA_ "GenSigStartValue" SG_ 818 Brightspot02_LeftAngVelocity 255;
BA_ "GenSigSendType" SG_ 818 Brightspot02_TimeStamp 1;
BA_ "GenSigStartValue" SG_ 818 Brightspot02_TimeStamp 65535;
BA_ "GenSigSendType" SG_ 817 Brightspot01_TrackStatus 1;
BA_ "GenSigStartValue" SG_ 817 Brightspot01_TrackStatus 7;
BA_ "GenSigSendType" SG_ 817 Brightspot01_MergeObj 1;
BA_ "GenSigStartValue" SG_ 817 Brightspot01_MergeObj 3;
BA_ "GenSigSendType" SG_ 817 Brightspot01_LifeTime 1;
BA_ "GenSigStartValue" SG_ 817 Brightspot01_LifeTime 65535;
BA_ "GenSigSendType" SG_ 817 Brightspot01_RightAngle 1;
BA_ "GenSigStartValue" SG_ 817 Brightspot01_RightAngle 2047;
BA_ "GenSigSendType" SG_ 817 Brightspot01_ID 1;
BA_ "GenSigStartValue" SG_ 817 Brightspot01_ID 255;
BA_ "GenSigSendType" SG_ 817 Brightspot01_Distance 1;
BA_ "GenSigStartValue" SG_ 817 Brightspot01_Distance 1023;
BA_ "GenSigSendType" SG_ 817 Brightspot01_TimeStamp 1;
BA_ "GenSigStartValue" SG_ 817 Brightspot01_TimeStamp 65535;
BA_ "GenSigSendType" SG_ 817 Brightspot01_LeftAngleVar 1;
BA_ "GenSigStartValue" SG_ 817 Brightspot01_LeftAngleVar 255;
BA_ "GenSigSendType" SG_ 817 Brightspot01_RightAngVelocity 1;
BA_ "GenSigStartValue" SG_ 817 Brightspot01_RightAngVelocity 255;
BA_ "GenSigSendType" SG_ 817 Brightspot01_ExistConf 1;
BA_ "GenSigStartValue" SG_ 817 Brightspot01_ExistConf 127;
BA_ "GenSigSendType" SG_ 817 Brightspot01_Direction 1;
BA_ "GenSigStartValue" SG_ 817 Brightspot01_Direction 3;
BA_ "GenSigSendType" SG_ 817 Brightspot01_RightAngleVar 1;
BA_ "GenSigStartValue" SG_ 817 Brightspot01_RightAngleVar 255;
BA_ "GenSigSendType" SG_ 817 Brightspot01_DistanceVar 1;
BA_ "GenSigStartValue" SG_ 817 Brightspot01_DistanceVar 255;
BA_ "GenSigSendType" SG_ 817 Brightspot01_LeftAngVelocity 1;
BA_ "GenSigStartValue" SG_ 817 Brightspot01_LeftAngVelocity 255;
BA_ "GenSigSendType" SG_ 817 Brightspot01_LeftAngle 1;
BA_ "GenSigStartValue" SG_ 817 Brightspot01_LeftAngle 2047;
BA_ "GenSigSendType" SG_ 816 Brightspot00_DistanceVar 1;
BA_ "GenSigStartValue" SG_ 816 Brightspot00_DistanceVar 255;
BA_ "GenSigSendType" SG_ 816 Brightspot00_MergeObj 1;
BA_ "GenSigStartValue" SG_ 816 Brightspot00_MergeObj 3;
BA_ "GenSigSendType" SG_ 816 Brightspot00_LeftAngle 1;
BA_ "GenSigStartValue" SG_ 816 Brightspot00_LeftAngle 2047;
BA_ "GenSigSendType" SG_ 816 Brightspot00_LeftAngVelocity 1;
BA_ "GenSigStartValue" SG_ 816 Brightspot00_LeftAngVelocity 255;
BA_ "GenSigSendType" SG_ 816 Brightspot00_RightAngVelocity 1;
BA_ "GenSigStartValue" SG_ 816 Brightspot00_RightAngVelocity 255;
BA_ "GenSigSendType" SG_ 816 Brightspot00_TrackStatus 1;
BA_ "GenSigStartValue" SG_ 816 Brightspot00_TrackStatus 7;
BA_ "GenSigSendType" SG_ 816 Brightspot00_Distance 1;
BA_ "GenSigStartValue" SG_ 816 Brightspot00_Distance 1023;
BA_ "GenSigSendType" SG_ 816 Brightspot00_RightAngleVar 1;
BA_ "GenSigStartValue" SG_ 816 Brightspot00_RightAngleVar 255;
BA_ "GenSigSendType" SG_ 816 Brightspot00_RightAngle 1;
BA_ "GenSigStartValue" SG_ 816 Brightspot00_RightAngle 2047;
BA_ "GenSigSendType" SG_ 816 Brightspot00_Direction 1;
BA_ "GenSigStartValue" SG_ 816 Brightspot00_Direction 3;
BA_ "GenSigSendType" SG_ 816 Brightspot00_ExistConf 1;
BA_ "GenSigStartValue" SG_ 816 Brightspot00_ExistConf 127;
BA_ "GenSigSendType" SG_ 816 Brightspot00_TimeStamp 1;
BA_ "GenSigStartValue" SG_ 816 Brightspot00_TimeStamp 65535;
BA_ "GenSigSendType" SG_ 816 Brightspot00_LifeTime 1;
BA_ "GenSigStartValue" SG_ 816 Brightspot00_LifeTime 65535;
BA_ "GenSigSendType" SG_ 816 Brightspot00_LeftAngleVar 1;
BA_ "GenSigStartValue" SG_ 816 Brightspot00_LeftAngleVar 255;
BA_ "GenSigSendType" SG_ 816 Brightspot00_ID 1;
BA_ "GenSigStartValue" SG_ 816 Brightspot00_ID 255;
BA_ "GenSigSendType" SG_ 512 FwdCam_CalibPausedSpeed 1;
BA_ "GenSigSendType" SG_ 512 FwdSensingCamStat_CRC 1;
BA_ "GenSigStartValue" SG_ 512 FwdSensingCamStat_CRC 65535;
BA_ "E2EDataId" SG_ 512 FwdSensingCamStat_CRC 147;
BA_ "E2EDataLength" SG_ 512 FwdSensingCamStat_CRC 64;
BA_ "E2EProfile" SG_ 512 FwdSensingCamStat_CRC "P05";
BA_ "GenSigSendType" SG_ 512 FwdLookingCamStat3_SqC 1;
BA_ "GenSigSendType" SG_ 512 FwdSensingCamStat_TSRDetect 1;
BA_ "GenSigStartValue" SG_ 512 FwdSensingCamStat_TSRDetect 7;
BA_ "GenSigSendType" SG_ 512 FwdSensingCamStat_ClothoidDetect 1;
BA_ "GenSigStartValue" SG_ 512 FwdSensingCamStat_ClothoidDetect 7;
BA_ "GenSigSendType" SG_ 512 FwdSensingCamStat_DecalibDetect 1;
BA_ "GenSigStartValue" SG_ 512 FwdSensingCamStat_DecalibDetect 7;
BA_ "GenSigSendType" SG_ 512 FwdSensingCamStat_BrighSpot 1;
BA_ "GenSigStartValue" SG_ 512 FwdSensingCamStat_BrighSpot 7;
BA_ "GenSigSendType" SG_ 512 FwdCam_CalibState 1;
BA_ "GenSigStartValue" SG_ 512 FwdCam_CalibState 3;
BA_ "GenSigSendType" SG_ 512 FwdLookingCamStat3_CRC 1;
BA_ "E2EDataId" SG_ 512 FwdLookingCamStat3_CRC 263;
BA_ "E2EDataLength" SG_ 512 FwdLookingCamStat3_CRC 32;
BA_ "E2EProfile" SG_ 512 FwdLookingCamStat3_CRC "P05";
BA_ "GenSigSendType" SG_ 512 ForwardLookingCameraStatus2 1;
BA_ "GenSigStartValue" SG_ 512 ForwardLookingCameraStatus2 15;
BA_ "GenSigSendType" SG_ 512 FwdSensingCamStat_TimeStamp 1;
BA_ "GenSigStartValue" SG_ 512 FwdSensingCamStat_TimeStamp 65535;
BA_ "GenSigSendType" SG_ 512 FwdCam_CalibProgress 1;
BA_ "GenSigStartValue" SG_ 512 FwdCam_CalibProgress 127;
BA_ "GenSigSendType" SG_ 512 FwdSensingCamStat_TimeSynch 1;
BA_ "GenSigSendType" SG_ 512 FwdCam_CalibPausedYaw 1;
BA_ "GenSigSendType" SG_ 512 FwdSensingCamStat_Counter 1;
BA_ "GenSigStartValue" SG_ 512 FwdSensingCamStat_Counter 255;
BA_ "GenSigSendType" SG_ 512 FwdCam_CalibPausedAcc 1;
BA_ "GenSigSendType" SG_ 512 FwdLookingCamStat3_Status 1;
BA_ "GenSigStartValue" SG_ 512 FwdLookingCamStat3_Status 15;
BA_ "GenSigSendType" SG_ 512 FwdSensingCamStat_TargetDetect 1;
BA_ "GenSigStartValue" SG_ 512 FwdSensingCamStat_TargetDetect 7;
BA_ "GenSigCycleTime" SG_ 1553 FLCSwVersion_Substring4 100;
BA_ "GenSigCycleTimeActive" SG_ 1553 FLCSwVersion_Substring4 100;
BA_ "GenSigCycleTime" SG_ 1553 FLCSwVersion_Substring5 100;
BA_ "GenSigCycleTimeActive" SG_ 1553 FLCSwVersion_Substring5 100;
BA_ "GenSigCycleTime" SG_ 1553 FLCSwVersion_Substring1 100;
BA_ "GenSigCycleTimeActive" SG_ 1553 FLCSwVersion_Substring1 100;
BA_ "GenSigCycleTime" SG_ 1553 FLCSwVersion_Substring3 100;
BA_ "GenSigCycleTimeActive" SG_ 1553 FLCSwVersion_Substring3 100;
BA_ "GenSigCycleTime" SG_ 1553 FLCSwVersion_Substring6 100;
BA_ "GenSigCycleTimeActive" SG_ 1553 FLCSwVersion_Substring6 100;
BA_ "GenSigCycleTime" SG_ 1553 FLCSwVersion_Substring2 100;
BA_ "GenSigCycleTimeActive" SG_ 1553 FLCSwVersion_Substring2 100;
BA_ "GenSigCycleTime" SG_ 1553 FLCSwVersion_Substring7 100;
BA_ "GenSigCycleTimeActive" SG_ 1553 FLCSwVersion_Substring7 100;
BA_ "GenSigCycleTime" SG_ 1553 FLCSwVersion_Substring0 100;
BA_ "GenSigCycleTimeActive" SG_ 1553 FLCSwVersion_Substring0 100;
BA_ "GenSigSendType" SG_ 807 FLCObject23_LongVel 1;
BA_ "GenSigStartValue" SG_ 807 FLCObject23_LongVel 8191;
BA_ "GenSigSendType" SG_ 807 FLCObject23_DstRightVar 1;
BA_ "GenSigStartValue" SG_ 807 FLCObject23_DstRightVar 255;
BA_ "GenSigSendType" SG_ 807 FLCObject23_TrackStatus 1;
BA_ "GenSigStartValue" SG_ 807 FLCObject23_TrackStatus 7;
BA_ "GenSigSendType" SG_ 807 FLCObject23_Counter 1;
BA_ "GenSigStartValue" SG_ 807 FLCObject23_Counter 255;
BA_ "GenSigSendType" SG_ 807 FLCObject23_BrakeLight 1;
BA_ "GenSigStartValue" SG_ 807 FLCObject23_BrakeLight 7;
BA_ "GenSigSendType" SG_ 807 FLCObject23_CoastIndex 1;
BA_ "GenSigStartValue" SG_ 807 FLCObject23_CoastIndex 31;
BA_ "GenSigSendType" SG_ 807 FLCObject23_DstFarVar 1;
BA_ "GenSigStartValue" SG_ 807 FLCObject23_DstFarVar 255;
BA_ "GenSigSendType" SG_ 807 FLCObject23_LifeTime 1;
BA_ "GenSigStartValue" SG_ 807 FLCObject23_LifeTime 65535;
BA_ "GenSigSendType" SG_ 807 FLCObject23_AnglFarCorner 1;
BA_ "GenSigStartValue" SG_ 807 FLCObject23_AnglFarCorner 1023;
BA_ "GenSigSendType" SG_ 807 FLCObject23_ReliabilityConf 1;
BA_ "GenSigStartValue" SG_ 807 FLCObject23_ReliabilityConf 7;
BA_ "GenSigSendType" SG_ 807 FLCObject23_AnglLeftCorner 1;
BA_ "GenSigStartValue" SG_ 807 FLCObject23_AnglLeftCorner 1023;
BA_ "GenSigSendType" SG_ 807 FLCObject23_DistRightCorner 1;
BA_ "GenSigStartValue" SG_ 807 FLCObject23_DistRightCorner 4095;
BA_ "GenSigSendType" SG_ 807 FLCObject23_AngLeftVar 1;
BA_ "GenSigStartValue" SG_ 807 FLCObject23_AngLeftVar 255;
BA_ "GenSigSendType" SG_ 807 FLCObject23_TargetToLine 1;
BA_ "GenSigStartValue" SG_ 807 FLCObject23_TargetToLine 7;
BA_ "GenSigSendType" SG_ 807 FLCObject23_ScaleChange 1;
BA_ "GenSigStartValue" SG_ 807 FLCObject23_ScaleChange 1023;
BA_ "GenSigSendType" SG_ 807 FLCObject23_ObjDynClass 1;
BA_ "GenSigStartValue" SG_ 807 FLCObject23_ObjDynClass 3;
BA_ "GenSigSendType" SG_ 807 FLCObject23_CRC 1;
BA_ "GenSigStartValue" SG_ 807 FLCObject23_CRC 65535;
BA_ "E2EDataId" SG_ 807 FLCObject23_CRC 128;
BA_ "E2EDataLength" SG_ 807 FLCObject23_CRC 352;
BA_ "E2EProfile" SG_ 807 FLCObject23_CRC "P05";
BA_ "GenSigSendType" SG_ 807 FLCObject23_ExistConf 1;
BA_ "GenSigStartValue" SG_ 807 FLCObject23_ExistConf 127;
BA_ "GenSigSendType" SG_ 807 FLCObject23_TurnIndication 1;
BA_ "GenSigStartValue" SG_ 807 FLCObject23_TurnIndication 7;
BA_ "GenSigSendType" SG_ 807 FLCObject23_AngFarVar 1;
BA_ "GenSigStartValue" SG_ 807 FLCObject23_AngFarVar 255;
BA_ "GenSigSendType" SG_ 807 FLCObject23_LongPos 1;
BA_ "GenSigStartValue" SG_ 807 FLCObject23_LongPos 8191;
BA_ "GenSigSendType" SG_ 807 FLCObject23_ObjID 1;
BA_ "GenSigStartValue" SG_ 807 FLCObject23_ObjID 63;
BA_ "GenSigSendType" SG_ 807 FLCObject23_LongVelVar 1;
BA_ "GenSigStartValue" SG_ 807 FLCObject23_LongVelVar 255;
BA_ "GenSigSendType" SG_ 807 FLCObject23_LatVelVar 1;
BA_ "GenSigStartValue" SG_ 807 FLCObject23_LatVelVar 255;
BA_ "GenSigSendType" SG_ 807 FLCObject23_ObjClass 1;
BA_ "GenSigStartValue" SG_ 807 FLCObject23_ObjClass 15;
BA_ "GenSigSendType" SG_ 807 FLCObject23_DistFarCorner 1;
BA_ "GenSigStartValue" SG_ 807 FLCObject23_DistFarCorner 4095;
BA_ "GenSigSendType" SG_ 807 FLCObject23_AngRightVar 1;
BA_ "GenSigStartValue" SG_ 807 FLCObject23_AngRightVar 255;
BA_ "GenSigSendType" SG_ 807 FLCObject23_LatVel 1;
BA_ "GenSigStartValue" SG_ 807 FLCObject23_LatVel 8191;
BA_ "GenSigSendType" SG_ 807 FLCObject23_TimeStamp 1;
BA_ "GenSigStartValue" SG_ 807 FLCObject23_TimeStamp 65535;
BA_ "GenSigSendType" SG_ 807 FLCObject23_HeadingVar 1;
BA_ "GenSigStartValue" SG_ 807 FLCObject23_HeadingVar 255;
BA_ "GenSigSendType" SG_ 807 FLCObject23_DstLeftVar 1;
BA_ "GenSigStartValue" SG_ 807 FLCObject23_DstLeftVar 255;
BA_ "GenSigSendType" SG_ 807 FLCObject23_DistLeftCorner 1;
BA_ "GenSigStartValue" SG_ 807 FLCObject23_DistLeftCorner 4095;
BA_ "GenSigSendType" SG_ 807 FLCObject23_LatPosVar 1;
BA_ "GenSigStartValue" SG_ 807 FLCObject23_LatPosVar 255;
BA_ "GenSigSendType" SG_ 807 FLCObject23_LongPosVar 1;
BA_ "GenSigStartValue" SG_ 807 FLCObject23_LongPosVar 255;
BA_ "GenSigSendType" SG_ 807 FLCObject23_LongAcc 1;
BA_ "GenSigStartValue" SG_ 807 FLCObject23_LongAcc 511;
BA_ "GenSigSendType" SG_ 807 FLCObject23_LatPos 1;
BA_ "GenSigStartValue" SG_ 807 FLCObject23_LatPos 8191;
BA_ "GenSigSendType" SG_ 807 FLCObject23_LatAcc 1;
BA_ "GenSigStartValue" SG_ 807 FLCObject23_LatAcc 511;
BA_ "GenSigSendType" SG_ 807 FLCObject23_Height 1;
BA_ "GenSigStartValue" SG_ 807 FLCObject23_Height 255;
BA_ "GenSigSendType" SG_ 807 FLCObject23_Heading 1;
BA_ "GenSigStartValue" SG_ 807 FLCObject23_Heading 2047;
BA_ "GenSigSendType" SG_ 807 FLCObject23_AnglRightCorner 1;
BA_ "GenSigStartValue" SG_ 807 FLCObject23_AnglRightCorner 1023;
BA_REL_ "GenSigFirstTimeoutTime" BU_SG_REL_ DACU SG_ 839 Clothoid07_TrackStatus 3000;
BA_REL_ "GenSigTimeoutTime" BU_SG_REL_ DACU SG_ 839 Clothoid07_TrackStatus 120;
BA_REL_ "GenSigFirstTimeoutTime" BU_SG_REL_ DACU SG_ 839 Clothoid07_Curvature 3000;
BA_REL_ "GenSigTimeoutTime" BU_SG_REL_ DACU SG_ 839 Clothoid07_Curvature 120;
BA_REL_ "GenSigFirstTimeoutTime" BU_SG_REL_ DACU SG_ 839 Clothoid07_LifeTime 3000;
BA_REL_ "GenSigTimeoutTime" BU_SG_REL_ DACU SG_ 839 Clothoid07_LifeTime 120;
BA_REL_ "GenSigFirstTimeoutTime" BU_SG_REL_ DACU SG_ 839 Clothoid07_CRC 3000;
BA_REL_ "GenSigTimeoutTime" BU_SG_REL_ DACU SG_ 839 Clothoid07_CRC 120;
BA_REL_ "GenSigFirstTimeoutTime" BU_SG_REL_ DACU SG_ 839 Clothoid07_Counter 3000;
BA_REL_ "GenSigTimeoutTime" BU_SG_REL_ DACU SG_ 839 Clothoid07_Counter 120;
BA_REL_ "GenSigFirstTimeoutTime" BU_SG_REL_ DACU SG_ 839 Clothoid07_CurvatureRate 3000;
BA_REL_ "GenSigTimeoutTime" BU_SG_REL_ DACU SG_ 839 Clothoid07_CurvatureRate 120;
BA_REL_ "GenSigFirstTimeoutTime" BU_SG_REL_ DACU SG_ 839 Clothoid07_Confidence 3000;
BA_REL_ "GenSigTimeoutTime" BU_SG_REL_ DACU SG_ 839 Clothoid07_Confidence 120;
BA_REL_ "GenSigFirstTimeoutTime" BU_SG_REL_ DACU SG_ 839 Clothoid07_LatDistVar 3000;
BA_REL_ "GenSigTimeoutTime" BU_SG_REL_ DACU SG_ 839 Clothoid07_LatDistVar 120;
BA_REL_ "GenSigFirstTimeoutTime" BU_SG_REL_ DACU SG_ 839 Clothoid07_Type 3000;
BA_REL_ "GenSigTimeoutTime" BU_SG_REL_ DACU SG_ 839 Clothoid07_Type 120;
BA_REL_ "GenSigFirstTimeoutTime" BU_SG_REL_ DACU SG_ 839 Clothoid07_HeadingAngle 3000;
BA_REL_ "GenSigTimeoutTime" BU_SG_REL_ DACU SG_ 839 Clothoid07_HeadingAngle 120;
BA_REL_ "GenSigFirstTimeoutTime" BU_SG_REL_ DACU SG_ 839 Clothoid07_LatDist 3000;
BA_REL_ "GenSigTimeoutTime" BU_SG_REL_ DACU SG_ 839 Clothoid07_LatDist 120;
BA_REL_ "GenSigFirstTimeoutTime" BU_SG_REL_ DACU SG_ 839 Clothoid07_CoastIndex 3000;
BA_REL_ "GenSigTimeoutTime" BU_SG_REL_ DACU SG_ 839 Clothoid07_CoastIndex 120;
BA_REL_ "GenSigFirstTimeoutTime" BU_SG_REL_ DACU SG_ 839 Clothoid07_TimeStamp 3000;
BA_REL_ "GenSigTimeoutTime" BU_SG_REL_ DACU SG_ 839 Clothoid07_TimeStamp 120;
BA_REL_ "GenSigFirstTimeoutTime" BU_SG_REL_ DACU SG_ 839 Clothoid07_DxStart 3000;
BA_REL_ "GenSigTimeoutTime" BU_SG_REL_ DACU SG_ 839 Clothoid07_DxStart 120;
BA_REL_ "GenSigFirstTimeoutTime" BU_SG_REL_ DACU SG_ 839 Clothoid07_Location 3000;
BA_REL_ "GenSigTimeoutTime" BU_SG_REL_ DACU SG_ 839 Clothoid07_Location 120;
BA_REL_ "GenSigFirstTimeoutTime" BU_SG_REL_ DACU SG_ 839 Clothoid07_Color 3000;
BA_REL_ "GenSigTimeoutTime" BU_SG_REL_ DACU SG_ 839 Clothoid07_Color 120;
BA_REL_ "GenSigFirstTimeoutTime" BU_SG_REL_ DACU SG_ 839 Clothoid07_DxEnd 3000;
BA_REL_ "GenSigTimeoutTime" BU_SG_REL_ DACU SG_ 839 Clothoid07_DxEnd 120;
BA_REL_ "GenSigFirstTimeoutTime" BU_SG_REL_ DACU SG_ 839 Clothoid07_Width 3000;
BA_REL_ "GenSigTimeoutTime" BU_SG_REL_ DACU SG_ 839 Clothoid07_Width 120;
BA_REL_ "GenSigFirstTimeoutTime" BU_SG_REL_ DACU SG_ 838 Clothoid06_Type 3000;
BA_REL_ "GenSigTimeoutTime" BU_SG_REL_ DACU SG_ 838 Clothoid06_Type 120;
BA_REL_ "GenSigFirstTimeoutTime" BU_SG_REL_ DACU SG_ 838 Clothoid06_Width 3000;
BA_REL_ "GenSigTimeoutTime" BU_SG_REL_ DACU SG_ 838 Clothoid06_Width 120;
BA_REL_ "GenSigFirstTimeoutTime" BU_SG_REL_ DACU SG_ 838 Clothoid06_LatDistVar 3000;
BA_REL_ "GenSigTimeoutTime" BU_SG_REL_ DACU SG_ 838 Clothoid06_LatDistVar 120;
BA_REL_ "GenSigFirstTimeoutTime" BU_SG_REL_ DACU SG_ 838 Clothoid06_Location 3000;
BA_REL_ "GenSigTimeoutTime" BU_SG_REL_ DACU SG_ 838 Clothoid06_Location 120;
BA_REL_ "GenSigFirstTimeoutTime" BU_SG_REL_ DACU SG_ 838 Clothoid06_Color 3000;
BA_REL_ "GenSigTimeoutTime" BU_SG_REL_ DACU SG_ 838 Clothoid06_Color 120;
BA_REL_ "GenSigFirstTimeoutTime" BU_SG_REL_ DACU SG_ 838 Clothoid06_Curvature 3000;
BA_REL_ "GenSigTimeoutTime" BU_SG_REL_ DACU SG_ 838 Clothoid06_Curvature 120;
BA_REL_ "GenSigFirstTimeoutTime" BU_SG_REL_ DACU SG_ 838 Clothoid06_DxEnd 3000;
BA_REL_ "GenSigTimeoutTime" BU_SG_REL_ DACU SG_ 838 Clothoid06_DxEnd 120;
BA_REL_ "GenSigFirstTimeoutTime" BU_SG_REL_ DACU SG_ 838 Clothoid06_HeadingAngle 3000;
BA_REL_ "GenSigTimeoutTime" BU_SG_REL_ DACU SG_ 838 Clothoid06_HeadingAngle 120;
BA_REL_ "GenSigFirstTimeoutTime" BU_SG_REL_ DACU SG_ 838 Clothoid06_Counter 3000;
BA_REL_ "GenSigTimeoutTime" BU_SG_REL_ DACU SG_ 838 Clothoid06_Counter 120;
BA_REL_ "GenSigFirstTimeoutTime" BU_SG_REL_ DACU SG_ 838 Clothoid06_TrackStatus 3000;
BA_REL_ "GenSigTimeoutTime" BU_SG_REL_ DACU SG_ 838 Clothoid06_TrackStatus 120;
BA_REL_ "GenSigFirstTimeoutTime" BU_SG_REL_ DACU SG_ 838 Clothoid06_CRC 3000;
BA_REL_ "GenSigTimeoutTime" BU_SG_REL_ DACU SG_ 838 Clothoid06_CRC 120;
BA_REL_ "GenSigFirstTimeoutTime" BU_SG_REL_ DACU SG_ 838 Clothoid06_LifeTime 3000;
BA_REL_ "GenSigTimeoutTime" BU_SG_REL_ DACU SG_ 838 Clothoid06_LifeTime 120;
BA_REL_ "GenSigFirstTimeoutTime" BU_SG_REL_ DACU SG_ 838 Clothoid06_LatDist 3000;
BA_REL_ "GenSigTimeoutTime" BU_SG_REL_ DACU SG_ 838 Clothoid06_LatDist 120;
BA_REL_ "GenSigFirstTimeoutTime" BU_SG_REL_ DACU SG_ 838 Clothoid06_CoastIndex 3000;
BA_REL_ "GenSigTimeoutTime" BU_SG_REL_ DACU SG_ 838 Clothoid06_CoastIndex 120;
BA_REL_ "GenSigFirstTimeoutTime" BU_SG_REL_ DACU SG_ 838 Clothoid06_CurvatureRate 3000;
BA_REL_ "GenSigTimeoutTime" BU_SG_REL_ DACU SG_ 838 Clothoid06_CurvatureRate 120;
BA_REL_ "GenSigFirstTimeoutTime" BU_SG_REL_ DACU SG_ 838 Clothoid06_TimeStamp 3000;
BA_REL_ "GenSigTimeoutTime" BU_SG_REL_ DACU SG_ 838 Clothoid06_TimeStamp 120;
BA_REL_ "GenSigFirstTimeoutTime" BU_SG_REL_ DACU SG_ 838 Clothoid06_DxStart 3000;
BA_REL_ "GenSigTimeoutTime" BU_SG_REL_ DACU SG_ 838 Clothoid06_DxStart 120;
BA_REL_ "GenSigFirstTimeoutTime" BU_SG_REL_ DACU SG_ 838 Clothoid06_Confidence 3000;
BA_REL_ "GenSigTimeoutTime" BU_SG_REL_ DACU SG_ 838 Clothoid06_Confidence 120;
BA_REL_ "GenSigFirstTimeoutTime" BU_SG_REL_ DACU SG_ 837 Clothoid05_CurvatureRate 3000;
BA_REL_ "GenSigTimeoutTime" BU_SG_REL_ DACU SG_ 837 Clothoid05_CurvatureRate 120;
BA_REL_ "GenSigFirstTimeoutTime" BU_SG_REL_ DACU SG_ 837 Clothoid05_LifeTime 3000;
BA_REL_ "GenSigTimeoutTime" BU_SG_REL_ DACU SG_ 837 Clothoid05_LifeTime 120;
BA_REL_ "GenSigFirstTimeoutTime" BU_SG_REL_ DACU SG_ 837 Clothoid05_Counter 3000;
BA_REL_ "GenSigTimeoutTime" BU_SG_REL_ DACU SG_ 837 Clothoid05_Counter 120;
BA_REL_ "GenSigFirstTimeoutTime" BU_SG_REL_ DACU SG_ 837 Clothoid05_DxEnd 3000;
BA_REL_ "GenSigTimeoutTime" BU_SG_REL_ DACU SG_ 837 Clothoid05_DxEnd 120;
BA_REL_ "GenSigFirstTimeoutTime" BU_SG_REL_ DACU SG_ 837 Clothoid05_Curvature 3000;
BA_REL_ "GenSigTimeoutTime" BU_SG_REL_ DACU SG_ 837 Clothoid05_Curvature 120;
BA_REL_ "GenSigFirstTimeoutTime" BU_SG_REL_ DACU SG_ 837 Clothoid05_DxStart 3000;
BA_REL_ "GenSigTimeoutTime" BU_SG_REL_ DACU SG_ 837 Clothoid05_DxStart 120;
BA_REL_ "GenSigFirstTimeoutTime" BU_SG_REL_ DACU SG_ 837 Clothoid05_CRC 3000;
BA_REL_ "GenSigTimeoutTime" BU_SG_REL_ DACU SG_ 837 Clothoid05_CRC 120;
BA_REL_ "GenSigFirstTimeoutTime" BU_SG_REL_ DACU SG_ 837 Clothoid05_Color 3000;
BA_REL_ "GenSigTimeoutTime" BU_SG_REL_ DACU SG_ 837 Clothoid05_Color 120;
BA_REL_ "GenSigFirstTimeoutTime" BU_SG_REL_ DACU SG_ 837 Clothoid05_TimeStamp 3000;
BA_REL_ "GenSigTimeoutTime" BU_SG_REL_ DACU SG_ 837 Clothoid05_TimeStamp 120;
BA_REL_ "GenSigFirstTimeoutTime" BU_SG_REL_ DACU SG_ 837 Clothoid05_Confidence 3000;
BA_REL_ "GenSigTimeoutTime" BU_SG_REL_ DACU SG_ 837 Clothoid05_Confidence 120;
BA_REL_ "GenSigFirstTimeoutTime" BU_SG_REL_ DACU SG_ 837 Clothoid05_HeadingAngle 3000;
BA_REL_ "GenSigTimeoutTime" BU_SG_REL_ DACU SG_ 837 Clothoid05_HeadingAngle 120;
BA_REL_ "GenSigFirstTimeoutTime" BU_SG_REL_ DACU SG_ 837 Clothoid05_LatDistVar 3000;
BA_REL_ "GenSigTimeoutTime" BU_SG_REL_ DACU SG_ 837 Clothoid05_LatDistVar 120;
BA_REL_ "GenSigFirstTimeoutTime" BU_SG_REL_ DACU SG_ 837 Clothoid05_LatDist 3000;
BA_REL_ "GenSigTimeoutTime" BU_SG_REL_ DACU SG_ 837 Clothoid05_LatDist 120;
BA_REL_ "GenSigFirstTimeoutTime" BU_SG_REL_ DACU SG_ 837 Clothoid05_Location 3000;
BA_REL_ "GenSigTimeoutTime" BU_SG_REL_ DACU SG_ 837 Clothoid05_Location 120;
BA_REL_ "GenSigFirstTimeoutTime" BU_SG_REL_ DACU SG_ 837 Clothoid05_Type 3000;
BA_REL_ "GenSigTimeoutTime" BU_SG_REL_ DACU SG_ 837 Clothoid05_Type 120;
BA_REL_ "GenSigFirstTimeoutTime" BU_SG_REL_ DACU SG_ 837 Clothoid05_CoastIndex 3000;
BA_REL_ "GenSigTimeoutTime" BU_SG_REL_ DACU SG_ 837 Clothoid05_CoastIndex 120;
BA_REL_ "GenSigFirstTimeoutTime" BU_SG_REL_ DACU SG_ 837 Clothoid05_TrackStatus 3000;
BA_REL_ "GenSigTimeoutTime" BU_SG_REL_ DACU SG_ 837 Clothoid05_TrackStatus 120;
BA_REL_ "GenSigFirstTimeoutTime" BU_SG_REL_ DACU SG_ 837 Clothoid05_Width 3000;
BA_REL_ "GenSigTimeoutTime" BU_SG_REL_ DACU SG_ 837 Clothoid05_Width 120;
BA_REL_ "GenSigFirstTimeoutTime" BU_SG_REL_ DACU SG_ 836 Clothoid04_DxEnd 3000;
BA_REL_ "GenSigTimeoutTime" BU_SG_REL_ DACU SG_ 836 Clothoid04_DxEnd 120;
BA_REL_ "GenSigFirstTimeoutTime" BU_SG_REL_ DACU SG_ 836 Clothoid04_Width 3000;
BA_REL_ "GenSigTimeoutTime" BU_SG_REL_ DACU SG_ 836 Clothoid04_Width 120;
BA_REL_ "GenSigFirstTimeoutTime" BU_SG_REL_ DACU SG_ 836 Clothoid04_Counter 3000;
BA_REL_ "GenSigTimeoutTime" BU_SG_REL_ DACU SG_ 836 Clothoid04_Counter 120;
BA_REL_ "GenSigFirstTimeoutTime" BU_SG_REL_ DACU SG_ 836 Clothoid04_LifeTime 3000;
BA_REL_ "GenSigTimeoutTime" BU_SG_REL_ DACU SG_ 836 Clothoid04_LifeTime 120;
BA_REL_ "GenSigFirstTimeoutTime" BU_SG_REL_ DACU SG_ 836 Clothoid04_Confidence 3000;
BA_REL_ "GenSigTimeoutTime" BU_SG_REL_ DACU SG_ 836 Clothoid04_Confidence 120;
BA_REL_ "GenSigFirstTimeoutTime" BU_SG_REL_ DACU SG_ 836 Clothoid04_LatDist 3000;
BA_REL_ "GenSigTimeoutTime" BU_SG_REL_ DACU SG_ 836 Clothoid04_LatDist 120;
BA_REL_ "GenSigFirstTimeoutTime" BU_SG_REL_ DACU SG_ 836 Clothoid04_LatDistVar 3000;
BA_REL_ "GenSigTimeoutTime" BU_SG_REL_ DACU SG_ 836 Clothoid04_LatDistVar 120;
BA_REL_ "GenSigFirstTimeoutTime" BU_SG_REL_ DACU SG_ 836 Clothoid04_Type 3000;
BA_REL_ "GenSigTimeoutTime" BU_SG_REL_ DACU SG_ 836 Clothoid04_Type 120;
BA_REL_ "GenSigFirstTimeoutTime" BU_SG_REL_ DACU SG_ 836 Clothoid04_Location 3000;
BA_REL_ "GenSigTimeoutTime" BU_SG_REL_ DACU SG_ 836 Clothoid04_Location 120;
BA_REL_ "GenSigFirstTimeoutTime" BU_SG_REL_ DACU SG_ 836 Clothoid04_TrackStatus 3000;
BA_REL_ "GenSigTimeoutTime" BU_SG_REL_ DACU SG_ 836 Clothoid04_TrackStatus 120;
BA_REL_ "GenSigFirstTimeoutTime" BU_SG_REL_ DACU SG_ 836 Clothoid04_CRC 3000;
BA_REL_ "GenSigTimeoutTime" BU_SG_REL_ DACU SG_ 836 Clothoid04_CRC 120;
BA_REL_ "GenSigFirstTimeoutTime" BU_SG_REL_ DACU SG_ 836 Clothoid04_CoastIndex 3000;
BA_REL_ "GenSigTimeoutTime" BU_SG_REL_ DACU SG_ 836 Clothoid04_CoastIndex 120;
BA_REL_ "GenSigFirstTimeoutTime" BU_SG_REL_ DACU SG_ 836 Clothoid04_Curvature 3000;
BA_REL_ "GenSigTimeoutTime" BU_SG_REL_ DACU SG_ 836 Clothoid04_Curvature 120;
BA_REL_ "GenSigFirstTimeoutTime" BU_SG_REL_ DACU SG_ 836 Clothoid04_DxStart 3000;
BA_REL_ "GenSigTimeoutTime" BU_SG_REL_ DACU SG_ 836 Clothoid04_DxStart 120;
BA_REL_ "GenSigFirstTimeoutTime" BU_SG_REL_ DACU SG_ 836 Clothoid04_CurvatureRate 3000;
BA_REL_ "GenSigTimeoutTime" BU_SG_REL_ DACU SG_ 836 Clothoid04_CurvatureRate 120;
BA_REL_ "GenSigFirstTimeoutTime" BU_SG_REL_ DACU SG_ 836 Clothoid04_HeadingAngle 3000;
BA_REL_ "GenSigTimeoutTime" BU_SG_REL_ DACU SG_ 836 Clothoid04_HeadingAngle 120;
BA_REL_ "GenSigFirstTimeoutTime" BU_SG_REL_ DACU SG_ 836 Clothoid04_Color 3000;
BA_REL_ "GenSigTimeoutTime" BU_SG_REL_ DACU SG_ 836 Clothoid04_Color 120;
BA_REL_ "GenSigFirstTimeoutTime" BU_SG_REL_ DACU SG_ 836 Clothoid04_TimeStamp 3000;
BA_REL_ "GenSigTimeoutTime" BU_SG_REL_ DACU SG_ 836 Clothoid04_TimeStamp 120;
BA_REL_ "GenSigFirstTimeoutTime" BU_SG_REL_ DACU SG_ 835 Clothoid03_Curvature 3000;
BA_REL_ "GenSigTimeoutTime" BU_SG_REL_ DACU SG_ 835 Clothoid03_Curvature 120;
BA_REL_ "GenSigFirstTimeoutTime" BU_SG_REL_ DACU SG_ 835 Clothoid03_LatDist 3000;
BA_REL_ "GenSigTimeoutTime" BU_SG_REL_ DACU SG_ 835 Clothoid03_LatDist 120;
BA_REL_ "GenSigFirstTimeoutTime" BU_SG_REL_ DACU SG_ 835 Clothoid03_LifeTime 3000;
BA_REL_ "GenSigTimeoutTime" BU_SG_REL_ DACU SG_ 835 Clothoid03_LifeTime 120;
BA_REL_ "GenSigFirstTimeoutTime" BU_SG_REL_ DACU SG_ 835 Clothoid03_Location 3000;
BA_REL_ "GenSigTimeoutTime" BU_SG_REL_ DACU SG_ 835 Clothoid03_Location 120;
BA_REL_ "GenSigFirstTimeoutTime" BU_SG_REL_ DACU SG_ 835 Clothoid03_CurvatureRate 3000;
BA_REL_ "GenSigTimeoutTime" BU_SG_REL_ DACU SG_ 835 Clothoid03_CurvatureRate 120;
BA_REL_ "GenSigFirstTimeoutTime" BU_SG_REL_ DACU SG_ 835 Clothoid03_Width 3000;
BA_REL_ "GenSigTimeoutTime" BU_SG_REL_ DACU SG_ 835 Clothoid03_Width 120;
BA_REL_ "GenSigFirstTimeoutTime" BU_SG_REL_ DACU SG_ 835 Clothoid03_HeadingAngle 3000;
BA_REL_ "GenSigTimeoutTime" BU_SG_REL_ DACU SG_ 835 Clothoid03_HeadingAngle 120;
BA_REL_ "GenSigFirstTimeoutTime" BU_SG_REL_ DACU SG_ 835 Clothoid03_LatDistVar 3000;
BA_REL_ "GenSigTimeoutTime" BU_SG_REL_ DACU SG_ 835 Clothoid03_LatDistVar 120;
BA_REL_ "GenSigFirstTimeoutTime" BU_SG_REL_ DACU SG_ 835 Clothoid03_DxEnd 3000;
BA_REL_ "GenSigTimeoutTime" BU_SG_REL_ DACU SG_ 835 Clothoid03_DxEnd 120;
BA_REL_ "GenSigFirstTimeoutTime" BU_SG_REL_ DACU SG_ 835 Clothoid03_Counter 3000;
BA_REL_ "GenSigTimeoutTime" BU_SG_REL_ DACU SG_ 835 Clothoid03_Counter 120;
BA_REL_ "GenSigFirstTimeoutTime" BU_SG_REL_ DACU SG_ 835 Clothoid03_Color 3000;
BA_REL_ "GenSigTimeoutTime" BU_SG_REL_ DACU SG_ 835 Clothoid03_Color 120;
BA_REL_ "GenSigFirstTimeoutTime" BU_SG_REL_ DACU SG_ 835 Clothoid03_Type 3000;
BA_REL_ "GenSigTimeoutTime" BU_SG_REL_ DACU SG_ 835 Clothoid03_Type 120;
BA_REL_ "GenSigFirstTimeoutTime" BU_SG_REL_ DACU SG_ 835 Clothoid03_CoastIndex 3000;
BA_REL_ "GenSigTimeoutTime" BU_SG_REL_ DACU SG_ 835 Clothoid03_CoastIndex 120;
BA_REL_ "GenSigFirstTimeoutTime" BU_SG_REL_ DACU SG_ 835 Clothoid03_TimeStamp 3000;
BA_REL_ "GenSigTimeoutTime" BU_SG_REL_ DACU SG_ 835 Clothoid03_TimeStamp 120;
BA_REL_ "GenSigFirstTimeoutTime" BU_SG_REL_ DACU SG_ 835 Clothoid03_DxStart 3000;
BA_REL_ "GenSigTimeoutTime" BU_SG_REL_ DACU SG_ 835 Clothoid03_DxStart 120;
BA_REL_ "GenSigFirstTimeoutTime" BU_SG_REL_ DACU SG_ 835 Clothoid03_Confidence 3000;
BA_REL_ "GenSigTimeoutTime" BU_SG_REL_ DACU SG_ 835 Clothoid03_Confidence 120;
BA_REL_ "GenSigFirstTimeoutTime" BU_SG_REL_ DACU SG_ 835 Clothoid03_TrackStatus 3000;
BA_REL_ "GenSigTimeoutTime" BU_SG_REL_ DACU SG_ 835 Clothoid03_TrackStatus 120;
BA_REL_ "GenSigFirstTimeoutTime" BU_SG_REL_ DACU SG_ 835 Clothoid03_CRC 3000;
BA_REL_ "GenSigTimeoutTime" BU_SG_REL_ DACU SG_ 835 Clothoid03_CRC 120;
BA_REL_ "GenSigFirstTimeoutTime" BU_SG_REL_ DACU SG_ 834 Clothoid02_Confidence 3000;
BA_REL_ "GenSigTimeoutTime" BU_SG_REL_ DACU SG_ 834 Clothoid02_Confidence 120;
BA_REL_ "GenSigFirstTimeoutTime" BU_SG_REL_ DACU SG_ 834 Clothoid02_CurvatureRate 3000;
BA_REL_ "GenSigTimeoutTime" BU_SG_REL_ DACU SG_ 834 Clothoid02_CurvatureRate 120;
BA_REL_ "GenSigFirstTimeoutTime" BU_SG_REL_ DACU SG_ 834 Clothoid02_LifeTime 3000;
BA_REL_ "GenSigTimeoutTime" BU_SG_REL_ DACU SG_ 834 Clothoid02_LifeTime 120;
BA_REL_ "GenSigFirstTimeoutTime" BU_SG_REL_ DACU SG_ 834 Clothoid02_DxStart 3000;
BA_REL_ "GenSigTimeoutTime" BU_SG_REL_ DACU SG_ 834 Clothoid02_DxStart 120;
BA_REL_ "GenSigFirstTimeoutTime" BU_SG_REL_ DACU SG_ 834 Clothoid02_DxEnd 3000;
BA_REL_ "GenSigTimeoutTime" BU_SG_REL_ DACU SG_ 834 Clothoid02_DxEnd 120;
BA_REL_ "GenSigFirstTimeoutTime" BU_SG_REL_ DACU SG_ 834 Clothoid02_Color 3000;
BA_REL_ "GenSigTimeoutTime" BU_SG_REL_ DACU SG_ 834 Clothoid02_Color 120;
BA_REL_ "GenSigFirstTimeoutTime" BU_SG_REL_ DACU SG_ 834 Clothoid02_CoastIndex 3000;
BA_REL_ "GenSigTimeoutTime" BU_SG_REL_ DACU SG_ 834 Clothoid02_CoastIndex 120;
BA_REL_ "GenSigFirstTimeoutTime" BU_SG_REL_ DACU SG_ 834 Clothoid02_LatDistVar 3000;
BA_REL_ "GenSigTimeoutTime" BU_SG_REL_ DACU SG_ 834 Clothoid02_LatDistVar 120;
BA_REL_ "GenSigFirstTimeoutTime" BU_SG_REL_ DACU SG_ 834 Clothoid02_Width 3000;
BA_REL_ "GenSigTimeoutTime" BU_SG_REL_ DACU SG_ 834 Clothoid02_Width 120;
BA_REL_ "GenSigFirstTimeoutTime" BU_SG_REL_ DACU SG_ 834 Clothoid02_TrackStatus 3000;
BA_REL_ "GenSigTimeoutTime" BU_SG_REL_ DACU SG_ 834 Clothoid02_TrackStatus 120;
BA_REL_ "GenSigFirstTimeoutTime" BU_SG_REL_ DACU SG_ 834 Clothoid02_Curvature 3000;
BA_REL_ "GenSigTimeoutTime" BU_SG_REL_ DACU SG_ 834 Clothoid02_Curvature 120;
BA_REL_ "GenSigFirstTimeoutTime" BU_SG_REL_ DACU SG_ 834 Clothoid02_TimeStamp 3000;
BA_REL_ "GenSigTimeoutTime" BU_SG_REL_ DACU SG_ 834 Clothoid02_TimeStamp 120;
BA_REL_ "GenSigFirstTimeoutTime" BU_SG_REL_ DACU SG_ 834 Clothoid02_Type 3000;
BA_REL_ "GenSigTimeoutTime" BU_SG_REL_ DACU SG_ 834 Clothoid02_Type 120;
BA_REL_ "GenSigFirstTimeoutTime" BU_SG_REL_ DACU SG_ 834 Clothoid02_HeadingAngle 3000;
BA_REL_ "GenSigTimeoutTime" BU_SG_REL_ DACU SG_ 834 Clothoid02_HeadingAngle 120;
BA_REL_ "GenSigFirstTimeoutTime" BU_SG_REL_ DACU SG_ 834 Clothoid02_LatDist 3000;
BA_REL_ "GenSigTimeoutTime" BU_SG_REL_ DACU SG_ 834 Clothoid02_LatDist 120;
BA_REL_ "GenSigFirstTimeoutTime" BU_SG_REL_ DACU SG_ 834 Clothoid02_CRC 3000;
BA_REL_ "GenSigTimeoutTime" BU_SG_REL_ DACU SG_ 834 Clothoid02_CRC 120;
BA_REL_ "GenSigFirstTimeoutTime" BU_SG_REL_ DACU SG_ 834 Clothoid02_Counter 3000;
BA_REL_ "GenSigTimeoutTime" BU_SG_REL_ DACU SG_ 834 Clothoid02_Counter 120;
BA_REL_ "GenSigFirstTimeoutTime" BU_SG_REL_ DACU SG_ 834 Clothoid02_Location 3000;
BA_REL_ "GenSigTimeoutTime" BU_SG_REL_ DACU SG_ 834 Clothoid02_Location 120;
BA_REL_ "GenSigFirstTimeoutTime" BU_SG_REL_ DACU SG_ 833 Clothoid01_HeadingAngle 3000;
BA_REL_ "GenSigTimeoutTime" BU_SG_REL_ DACU SG_ 833 Clothoid01_HeadingAngle 120;
BA_REL_ "GenSigFirstTimeoutTime" BU_SG_REL_ DACU SG_ 833 Clothoid01_DxEnd 3000;
BA_REL_ "GenSigTimeoutTime" BU_SG_REL_ DACU SG_ 833 Clothoid01_DxEnd 120;
BA_REL_ "GenSigFirstTimeoutTime" BU_SG_REL_ DACU SG_ 833 Clothoid01_LatDist 3000;
BA_REL_ "GenSigTimeoutTime" BU_SG_REL_ DACU SG_ 833 Clothoid01_LatDist 120;
BA_REL_ "GenSigFirstTimeoutTime" BU_SG_REL_ DACU SG_ 833 Clothoid01_Width 3000;
BA_REL_ "GenSigTimeoutTime" BU_SG_REL_ DACU SG_ 833 Clothoid01_Width 120;
BA_REL_ "GenSigFirstTimeoutTime" BU_SG_REL_ DACU SG_ 833 Clothoid01_DxStart 3000;
BA_REL_ "GenSigTimeoutTime" BU_SG_REL_ DACU SG_ 833 Clothoid01_DxStart 120;
BA_REL_ "GenSigFirstTimeoutTime" BU_SG_REL_ DACU SG_ 833 Clothoid01_CurvatureRate 3000;
BA_REL_ "GenSigTimeoutTime" BU_SG_REL_ DACU SG_ 833 Clothoid01_CurvatureRate 120;
BA_REL_ "GenSigFirstTimeoutTime" BU_SG_REL_ DACU SG_ 833 Clothoid01_LifeTime 3000;
BA_REL_ "GenSigTimeoutTime" BU_SG_REL_ DACU SG_ 833 Clothoid01_LifeTime 120;
BA_REL_ "GenSigFirstTimeoutTime" BU_SG_REL_ DACU SG_ 833 Clothoid01_TrackStatus 3000;
BA_REL_ "GenSigTimeoutTime" BU_SG_REL_ DACU SG_ 833 Clothoid01_TrackStatus 120;
BA_REL_ "GenSigFirstTimeoutTime" BU_SG_REL_ DACU SG_ 833 Clothoid01_Type 3000;
BA_REL_ "GenSigTimeoutTime" BU_SG_REL_ DACU SG_ 833 Clothoid01_Type 120;
BA_REL_ "GenSigFirstTimeoutTime" BU_SG_REL_ DACU SG_ 833 Clothoid01_Curvature 3000;
BA_REL_ "GenSigTimeoutTime" BU_SG_REL_ DACU SG_ 833 Clothoid01_Curvature 120;
BA_REL_ "GenSigFirstTimeoutTime" BU_SG_REL_ DACU SG_ 833 Clothoid01_Location 3000;
BA_REL_ "GenSigTimeoutTime" BU_SG_REL_ DACU SG_ 833 Clothoid01_Location 120;
BA_REL_ "GenSigFirstTimeoutTime" BU_SG_REL_ DACU SG_ 833 Clothoid01_Color 3000;
BA_REL_ "GenSigTimeoutTime" BU_SG_REL_ DACU SG_ 833 Clothoid01_Color 120;
BA_REL_ "GenSigFirstTimeoutTime" BU_SG_REL_ DACU SG_ 833 Clothoid01_CoastIndex 3000;
BA_REL_ "GenSigTimeoutTime" BU_SG_REL_ DACU SG_ 833 Clothoid01_CoastIndex 120;
BA_REL_ "GenSigFirstTimeoutTime" BU_SG_REL_ DACU SG_ 833 Clothoid01_LatDistVar 3000;
BA_REL_ "GenSigTimeoutTime" BU_SG_REL_ DACU SG_ 833 Clothoid01_LatDistVar 120;
BA_REL_ "GenSigFirstTimeoutTime" BU_SG_REL_ DACU SG_ 833 Clothoid01_Counter 3000;
BA_REL_ "GenSigTimeoutTime" BU_SG_REL_ DACU SG_ 833 Clothoid01_Counter 120;
BA_REL_ "GenSigFirstTimeoutTime" BU_SG_REL_ DACU SG_ 833 Clothoid01_CRC 3000;
BA_REL_ "GenSigTimeoutTime" BU_SG_REL_ DACU SG_ 833 Clothoid01_CRC 120;
BA_REL_ "GenSigFirstTimeoutTime" BU_SG_REL_ DACU SG_ 833 Clothoid01_TimeStamp 3000;
BA_REL_ "GenSigTimeoutTime" BU_SG_REL_ DACU SG_ 833 Clothoid01_TimeStamp 120;
BA_REL_ "GenSigFirstTimeoutTime" BU_SG_REL_ DACU SG_ 833 Clothoid01_Confidence 3000;
BA_REL_ "GenSigTimeoutTime" BU_SG_REL_ DACU SG_ 833 Clothoid01_Confidence 120;
BA_REL_ "GenSigFirstTimeoutTime" BU_SG_REL_ DACU SG_ 832 Clothoid00_DxStart 3000;
BA_REL_ "GenSigTimeoutTime" BU_SG_REL_ DACU SG_ 832 Clothoid00_DxStart 120;
BA_REL_ "GenSigFirstTimeoutTime" BU_SG_REL_ DACU SG_ 832 Clothoid00_LatDistVar 3000;
BA_REL_ "GenSigTimeoutTime" BU_SG_REL_ DACU SG_ 832 Clothoid00_LatDistVar 120;
BA_REL_ "GenSigFirstTimeoutTime" BU_SG_REL_ DACU SG_ 832 Clothoid00_Width 3000;
BA_REL_ "GenSigTimeoutTime" BU_SG_REL_ DACU SG_ 832 Clothoid00_Width 120;
BA_REL_ "GenSigFirstTimeoutTime" BU_SG_REL_ DACU SG_ 832 Clothoid00_Confidence 3000;
BA_REL_ "GenSigTimeoutTime" BU_SG_REL_ DACU SG_ 832 Clothoid00_Confidence 120;
BA_REL_ "GenSigFirstTimeoutTime" BU_SG_REL_ DACU SG_ 832 Clothoid00_TimeStamp 3000;
BA_REL_ "GenSigTimeoutTime" BU_SG_REL_ DACU SG_ 832 Clothoid00_TimeStamp 120;
BA_REL_ "GenSigFirstTimeoutTime" BU_SG_REL_ DACU SG_ 832 Clothoid00_DxEnd 3000;
BA_REL_ "GenSigTimeoutTime" BU_SG_REL_ DACU SG_ 832 Clothoid00_DxEnd 120;
BA_REL_ "GenSigFirstTimeoutTime" BU_SG_REL_ DACU SG_ 832 Clothoid00_TrackStatus 3000;
BA_REL_ "GenSigTimeoutTime" BU_SG_REL_ DACU SG_ 832 Clothoid00_TrackStatus 120;
BA_REL_ "GenSigFirstTimeoutTime" BU_SG_REL_ DACU SG_ 832 Clothoid00_Color 3000;
BA_REL_ "GenSigTimeoutTime" BU_SG_REL_ DACU SG_ 832 Clothoid00_Color 120;
BA_REL_ "GenSigFirstTimeoutTime" BU_SG_REL_ DACU SG_ 832 Clothoid00_Curvature 3000;
BA_REL_ "GenSigTimeoutTime" BU_SG_REL_ DACU SG_ 832 Clothoid00_Curvature 120;
BA_REL_ "GenSigFirstTimeoutTime" BU_SG_REL_ DACU SG_ 832 Clothoid00_CurvatureRate 3000;
BA_REL_ "GenSigTimeoutTime" BU_SG_REL_ DACU SG_ 832 Clothoid00_CurvatureRate 120;
BA_REL_ "GenSigFirstTimeoutTime" BU_SG_REL_ DACU SG_ 832 Clothoid00_Type 3000;
BA_REL_ "GenSigTimeoutTime" BU_SG_REL_ DACU SG_ 832 Clothoid00_Type 120;
BA_REL_ "GenSigFirstTimeoutTime" BU_SG_REL_ DACU SG_ 832 Clothoid00_HeadingAngle 3000;
BA_REL_ "GenSigTimeoutTime" BU_SG_REL_ DACU SG_ 832 Clothoid00_HeadingAngle 120;
BA_REL_ "GenSigFirstTimeoutTime" BU_SG_REL_ DACU SG_ 832 Clothoid00_CRC 3000;
BA_REL_ "GenSigTimeoutTime" BU_SG_REL_ DACU SG_ 832 Clothoid00_CRC 120;
BA_REL_ "GenSigFirstTimeoutTime" BU_SG_REL_ DACU SG_ 832 Clothoid00_Location 3000;
BA_REL_ "GenSigTimeoutTime" BU_SG_REL_ DACU SG_ 832 Clothoid00_Location 120;
BA_REL_ "GenSigFirstTimeoutTime" BU_SG_REL_ DACU SG_ 832 Clothoid00_LifeTime 3000;
BA_REL_ "GenSigTimeoutTime" BU_SG_REL_ DACU SG_ 832 Clothoid00_LifeTime 120;
BA_REL_ "GenSigFirstTimeoutTime" BU_SG_REL_ DACU SG_ 832 Clothoid00_Counter 3000;
BA_REL_ "GenSigTimeoutTime" BU_SG_REL_ DACU SG_ 832 Clothoid00_Counter 120;
BA_REL_ "GenSigFirstTimeoutTime" BU_SG_REL_ DACU SG_ 832 Clothoid00_CoastIndex 3000;
BA_REL_ "GenSigTimeoutTime" BU_SG_REL_ DACU SG_ 832 Clothoid00_CoastIndex 120;
BA_REL_ "GenSigFirstTimeoutTime" BU_SG_REL_ DACU SG_ 832 Clothoid00_LatDist 3000;
BA_REL_ "GenSigTimeoutTime" BU_SG_REL_ DACU SG_ 832 Clothoid00_LatDist 120;
BA_REL_ "GenSigFirstTimeoutTime" BU_SG_REL_ DACU SG_ 824 Brightspot08_RightAngleVar 3000;
BA_REL_ "GenSigTimeoutTime" BU_SG_REL_ DACU SG_ 824 Brightspot08_RightAngleVar 120;
BA_REL_ "GenSigFirstTimeoutTime" BU_SG_REL_ DACU SG_ 824 Brightspot08_RightAngle 3000;
BA_REL_ "GenSigTimeoutTime" BU_SG_REL_ DACU SG_ 824 Brightspot08_RightAngle 120;
BA_REL_ "GenSigFirstTimeoutTime" BU_SG_REL_ DACU SG_ 824 Brightspot08_Direction 3000;
BA_REL_ "GenSigTimeoutTime" BU_SG_REL_ DACU SG_ 824 Brightspot08_Direction 120;
BA_REL_ "GenSigFirstTimeoutTime" BU_SG_REL_ DACU SG_ 824 Brightspot08_LifeTime 3000;
BA_REL_ "GenSigTimeoutTime" BU_SG_REL_ DACU SG_ 824 Brightspot08_LifeTime 120;
BA_REL_ "GenSigFirstTimeoutTime" BU_SG_REL_ DACU SG_ 824 Brightspot08_RightAngVelocity 3000;
BA_REL_ "GenSigTimeoutTime" BU_SG_REL_ DACU SG_ 824 Brightspot08_RightAngVelocity 120;
BA_REL_ "GenSigFirstTimeoutTime" BU_SG_REL_ DACU SG_ 824 Brightspot08_LeftAngleVar 3000;
BA_REL_ "GenSigTimeoutTime" BU_SG_REL_ DACU SG_ 824 Brightspot08_LeftAngleVar 120;
BA_REL_ "GenSigFirstTimeoutTime" BU_SG_REL_ DACU SG_ 824 Brightspot08_TrackStatus 3000;
BA_REL_ "GenSigTimeoutTime" BU_SG_REL_ DACU SG_ 824 Brightspot08_TrackStatus 120;
BA_REL_ "GenSigFirstTimeoutTime" BU_SG_REL_ DACU SG_ 824 Brightspot08_ID 3000;
BA_REL_ "GenSigTimeoutTime" BU_SG_REL_ DACU SG_ 824 Brightspot08_ID 120;
BA_REL_ "GenSigFirstTimeoutTime" BU_SG_REL_ DACU SG_ 824 Brightspot08_TimeStamp 3000;
BA_REL_ "GenSigTimeoutTime" BU_SG_REL_ DACU SG_ 824 Brightspot08_TimeStamp 120;
BA_REL_ "GenSigFirstTimeoutTime" BU_SG_REL_ DACU SG_ 824 Brightspot08_ExistConf 3000;
BA_REL_ "GenSigTimeoutTime" BU_SG_REL_ DACU SG_ 824 Brightspot08_ExistConf 120;
BA_REL_ "GenSigFirstTimeoutTime" BU_SG_REL_ DACU SG_ 824 Brightspot08_LeftAngVelocity 3000;
BA_REL_ "GenSigTimeoutTime" BU_SG_REL_ DACU SG_ 824 Brightspot08_LeftAngVelocity 120;
BA_REL_ "GenSigFirstTimeoutTime" BU_SG_REL_ DACU SG_ 824 Brightspot08_DistanceVar 3000;
BA_REL_ "GenSigTimeoutTime" BU_SG_REL_ DACU SG_ 824 Brightspot08_DistanceVar 120;
BA_REL_ "GenSigFirstTimeoutTime" BU_SG_REL_ DACU SG_ 824 Brightspot08_Distance 3000;
BA_REL_ "GenSigTimeoutTime" BU_SG_REL_ DACU SG_ 824 Brightspot08_Distance 120;
BA_REL_ "GenSigFirstTimeoutTime" BU_SG_REL_ DACU SG_ 824 Brightspot08_MergeObj 3000;
BA_REL_ "GenSigTimeoutTime" BU_SG_REL_ DACU SG_ 824 Brightspot08_MergeObj 120;
BA_REL_ "GenSigFirstTimeoutTime" BU_SG_REL_ DACU SG_ 824 Brightspot08_LeftAngle 3000;
BA_REL_ "GenSigTimeoutTime" BU_SG_REL_ DACU SG_ 824 Brightspot08_LeftAngle 120;
BA_REL_ "GenSigFirstTimeoutTime" BU_SG_REL_ DACU SG_ 823 Brightspot07_RightAngleVar 3000;
BA_REL_ "GenSigTimeoutTime" BU_SG_REL_ DACU SG_ 823 Brightspot07_RightAngleVar 120;
BA_REL_ "GenSigFirstTimeoutTime" BU_SG_REL_ DACU SG_ 823 Brightspot07_DistanceVar 3000;
BA_REL_ "GenSigTimeoutTime" BU_SG_REL_ DACU SG_ 823 Brightspot07_DistanceVar 120;
BA_REL_ "GenSigFirstTimeoutTime" BU_SG_REL_ DACU SG_ 823 Brightspot07_LeftAngVelocity 3000;
BA_REL_ "GenSigTimeoutTime" BU_SG_REL_ DACU SG_ 823 Brightspot07_LeftAngVelocity 120;
BA_REL_ "GenSigFirstTimeoutTime" BU_SG_REL_ DACU SG_ 823 Brightspot07_TimeStamp 3000;
BA_REL_ "GenSigTimeoutTime" BU_SG_REL_ DACU SG_ 823 Brightspot07_TimeStamp 120;
BA_REL_ "GenSigFirstTimeoutTime" BU_SG_REL_ DACU SG_ 823 Brightspot07_MergeObj 3000;
BA_REL_ "GenSigTimeoutTime" BU_SG_REL_ DACU SG_ 823 Brightspot07_MergeObj 120;
BA_REL_ "GenSigFirstTimeoutTime" BU_SG_REL_ DACU SG_ 823 Brightspot07_LifeTime 3000;
BA_REL_ "GenSigTimeoutTime" BU_SG_REL_ DACU SG_ 823 Brightspot07_LifeTime 120;
BA_REL_ "GenSigFirstTimeoutTime" BU_SG_REL_ DACU SG_ 823 Brightspot07_TrackStatus 3000;
BA_REL_ "GenSigTimeoutTime" BU_SG_REL_ DACU SG_ 823 Brightspot07_TrackStatus 120;
BA_REL_ "GenSigFirstTimeoutTime" BU_SG_REL_ DACU SG_ 823 Brightspot07_Direction 3000;
BA_REL_ "GenSigTimeoutTime" BU_SG_REL_ DACU SG_ 823 Brightspot07_Direction 120;
BA_REL_ "GenSigFirstTimeoutTime" BU_SG_REL_ DACU SG_ 823 Brightspot07_Distance 3000;
BA_REL_ "GenSigTimeoutTime" BU_SG_REL_ DACU SG_ 823 Brightspot07_Distance 120;
BA_REL_ "GenSigFirstTimeoutTime" BU_SG_REL_ DACU SG_ 823 Brightspot07_LeftAngleVar 3000;
BA_REL_ "GenSigTimeoutTime" BU_SG_REL_ DACU SG_ 823 Brightspot07_LeftAngleVar 120;
BA_REL_ "GenSigFirstTimeoutTime" BU_SG_REL_ DACU SG_ 823 Brightspot07_ExistConf 3000;
BA_REL_ "GenSigTimeoutTime" BU_SG_REL_ DACU SG_ 823 Brightspot07_ExistConf 120;
BA_REL_ "GenSigFirstTimeoutTime" BU_SG_REL_ DACU SG_ 823 Brightspot07_RightAngle 3000;
BA_REL_ "GenSigTimeoutTime" BU_SG_REL_ DACU SG_ 823 Brightspot07_RightAngle 120;
BA_REL_ "GenSigFirstTimeoutTime" BU_SG_REL_ DACU SG_ 823 Brightspot07_RightAngVelocity 3000;
BA_REL_ "GenSigTimeoutTime" BU_SG_REL_ DACU SG_ 823 Brightspot07_RightAngVelocity 120;
BA_REL_ "GenSigFirstTimeoutTime" BU_SG_REL_ DACU SG_ 823 Brightspot07_ID 3000;
BA_REL_ "GenSigTimeoutTime" BU_SG_REL_ DACU SG_ 823 Brightspot07_ID 120;
BA_REL_ "GenSigFirstTimeoutTime" BU_SG_REL_ DACU SG_ 823 Brightspot07_LeftAngle 3000;
BA_REL_ "GenSigTimeoutTime" BU_SG_REL_ DACU SG_ 823 Brightspot07_LeftAngle 120;
BA_REL_ "GenSigFirstTimeoutTime" BU_SG_REL_ DACU SG_ 822 Brightspot06_Distance 3000;
BA_REL_ "GenSigTimeoutTime" BU_SG_REL_ DACU SG_ 822 Brightspot06_Distance 120;
BA_REL_ "GenSigFirstTimeoutTime" BU_SG_REL_ DACU SG_ 822 Brightspot06_RightAngle 3000;
BA_REL_ "GenSigTimeoutTime" BU_SG_REL_ DACU SG_ 822 Brightspot06_RightAngle 120;
BA_REL_ "GenSigFirstTimeoutTime" BU_SG_REL_ DACU SG_ 822 Brightspot06_MergeObj 3000;
BA_REL_ "GenSigTimeoutTime" BU_SG_REL_ DACU SG_ 822 Brightspot06_MergeObj 120;
BA_REL_ "GenSigFirstTimeoutTime" BU_SG_REL_ DACU SG_ 822 Brightspot06_LeftAngleVar 3000;
BA_REL_ "GenSigTimeoutTime" BU_SG_REL_ DACU SG_ 822 Brightspot06_LeftAngleVar 120;
BA_REL_ "GenSigFirstTimeoutTime" BU_SG_REL_ DACU SG_ 822 Brightspot06_ExistConf 3000;
BA_REL_ "GenSigTimeoutTime" BU_SG_REL_ DACU SG_ 822 Brightspot06_ExistConf 120;
BA_REL_ "GenSigFirstTimeoutTime" BU_SG_REL_ DACU SG_ 822 Brightspot06_LeftAngle 3000;
BA_REL_ "GenSigTimeoutTime" BU_SG_REL_ DACU SG_ 822 Brightspot06_LeftAngle 120;
BA_REL_ "GenSigFirstTimeoutTime" BU_SG_REL_ DACU SG_ 822 Brightspot06_TrackStatus 3000;
BA_REL_ "GenSigTimeoutTime" BU_SG_REL_ DACU SG_ 822 Brightspot06_TrackStatus 120;
BA_REL_ "GenSigFirstTimeoutTime" BU_SG_REL_ DACU SG_ 822 Brightspot06_Direction 3000;
BA_REL_ "GenSigTimeoutTime" BU_SG_REL_ DACU SG_ 822 Brightspot06_Direction 120;
BA_REL_ "GenSigFirstTimeoutTime" BU_SG_REL_ DACU SG_ 822 Brightspot06_DistanceVar 3000;
BA_REL_ "GenSigTimeoutTime" BU_SG_REL_ DACU SG_ 822 Brightspot06_DistanceVar 120;
BA_REL_ "GenSigFirstTimeoutTime" BU_SG_REL_ DACU SG_ 822 Brightspot06_LeftAngVelocity 3000;
BA_REL_ "GenSigTimeoutTime" BU_SG_REL_ DACU SG_ 822 Brightspot06_LeftAngVelocity 120;
BA_REL_ "GenSigFirstTimeoutTime" BU_SG_REL_ DACU SG_ 822 Brightspot06_RightAngleVar 3000;
BA_REL_ "GenSigTimeoutTime" BU_SG_REL_ DACU SG_ 822 Brightspot06_RightAngleVar 120;
BA_REL_ "GenSigFirstTimeoutTime" BU_SG_REL_ DACU SG_ 822 Brightspot06_LifeTime 3000;
BA_REL_ "GenSigTimeoutTime" BU_SG_REL_ DACU SG_ 822 Brightspot06_LifeTime 120;
BA_REL_ "GenSigFirstTimeoutTime" BU_SG_REL_ DACU SG_ 822 Brightspot06_ID 3000;
BA_REL_ "GenSigTimeoutTime" BU_SG_REL_ DACU SG_ 822 Brightspot06_ID 120;
BA_REL_ "GenSigFirstTimeoutTime" BU_SG_REL_ DACU SG_ 822 Brightspot06_RightAngVelocity 3000;
BA_REL_ "GenSigTimeoutTime" BU_SG_REL_ DACU SG_ 822 Brightspot06_RightAngVelocity 120;
BA_REL_ "GenSigFirstTimeoutTime" BU_SG_REL_ DACU SG_ 822 Brightspot06_TimeStamp 3000;
BA_REL_ "GenSigTimeoutTime" BU_SG_REL_ DACU SG_ 822 Brightspot06_TimeStamp 120;
BA_REL_ "GenSigFirstTimeoutTime" BU_SG_REL_ DACU SG_ 821 Brightspot05_LeftAngleVar 3000;
BA_REL_ "GenSigTimeoutTime" BU_SG_REL_ DACU SG_ 821 Brightspot05_LeftAngleVar 120;
BA_REL_ "GenSigFirstTimeoutTime" BU_SG_REL_ DACU SG_ 821 Brightspot05_LeftAngVelocity 3000;
BA_REL_ "GenSigTimeoutTime" BU_SG_REL_ DACU SG_ 821 Brightspot05_LeftAngVelocity 120;
BA_REL_ "GenSigFirstTimeoutTime" BU_SG_REL_ DACU SG_ 821 Brightspot05_LeftAngle 3000;
BA_REL_ "GenSigTimeoutTime" BU_SG_REL_ DACU SG_ 821 Brightspot05_LeftAngle 120;
BA_REL_ "GenSigFirstTimeoutTime" BU_SG_REL_ DACU SG_ 821 Brightspot05_TrackStatus 3000;
BA_REL_ "GenSigTimeoutTime" BU_SG_REL_ DACU SG_ 821 Brightspot05_TrackStatus 120;
BA_REL_ "GenSigFirstTimeoutTime" BU_SG_REL_ DACU SG_ 821 Brightspot05_TimeStamp 3000;
BA_REL_ "GenSigTimeoutTime" BU_SG_REL_ DACU SG_ 821 Brightspot05_TimeStamp 120;
BA_REL_ "GenSigFirstTimeoutTime" BU_SG_REL_ DACU SG_ 821 Brightspot05_Distance 3000;
BA_REL_ "GenSigTimeoutTime" BU_SG_REL_ DACU SG_ 821 Brightspot05_Distance 120;
BA_REL_ "GenSigFirstTimeoutTime" BU_SG_REL_ DACU SG_ 821 Brightspot05_Direction 3000;
BA_REL_ "GenSigTimeoutTime" BU_SG_REL_ DACU SG_ 821 Brightspot05_Direction 120;
BA_REL_ "GenSigFirstTimeoutTime" BU_SG_REL_ DACU SG_ 821 Brightspot05_ID 3000;
BA_REL_ "GenSigTimeoutTime" BU_SG_REL_ DACU SG_ 821 Brightspot05_ID 120;
BA_REL_ "GenSigFirstTimeoutTime" BU_SG_REL_ DACU SG_ 821 Brightspot05_ExistConf 3000;
BA_REL_ "GenSigTimeoutTime" BU_SG_REL_ DACU SG_ 821 Brightspot05_ExistConf 120;
BA_REL_ "GenSigFirstTimeoutTime" BU_SG_REL_ DACU SG_ 821 Brightspot05_LifeTime 3000;
BA_REL_ "GenSigTimeoutTime" BU_SG_REL_ DACU SG_ 821 Brightspot05_LifeTime 120;
BA_REL_ "GenSigFirstTimeoutTime" BU_SG_REL_ DACU SG_ 821 Brightspot05_DistanceVar 3000;
BA_REL_ "GenSigTimeoutTime" BU_SG_REL_ DACU SG_ 821 Brightspot05_DistanceVar 120;
BA_REL_ "GenSigFirstTimeoutTime" BU_SG_REL_ DACU SG_ 821 Brightspot05_RightAngle 3000;
BA_REL_ "GenSigTimeoutTime" BU_SG_REL_ DACU SG_ 821 Brightspot05_RightAngle 120;
BA_REL_ "GenSigFirstTimeoutTime" BU_SG_REL_ DACU SG_ 821 Brightspot05_MergeObj 3000;
BA_REL_ "GenSigTimeoutTime" BU_SG_REL_ DACU SG_ 821 Brightspot05_MergeObj 120;
BA_REL_ "GenSigFirstTimeoutTime" BU_SG_REL_ DACU SG_ 821 Brightspot05_RightAngleVar 3000;
BA_REL_ "GenSigTimeoutTime" BU_SG_REL_ DACU SG_ 821 Brightspot05_RightAngleVar 120;
BA_REL_ "GenSigFirstTimeoutTime" BU_SG_REL_ DACU SG_ 821 Brightspot05_RightAngVelocity 3000;
BA_REL_ "GenSigTimeoutTime" BU_SG_REL_ DACU SG_ 821 Brightspot05_RightAngVelocity 120;
BA_REL_ "GenSigFirstTimeoutTime" BU_SG_REL_ DACU SG_ 820 Brightspot04_Direction 3000;
BA_REL_ "GenSigTimeoutTime" BU_SG_REL_ DACU SG_ 820 Brightspot04_Direction 120;
BA_REL_ "GenSigFirstTimeoutTime" BU_SG_REL_ DACU SG_ 820 Brightspot04_TrackStatus 3000;
BA_REL_ "GenSigTimeoutTime" BU_SG_REL_ DACU SG_ 820 Brightspot04_TrackStatus 120;
BA_REL_ "GenSigFirstTimeoutTime" BU_SG_REL_ DACU SG_ 820 Brightspot04_LeftAngleVar 3000;
BA_REL_ "GenSigTimeoutTime" BU_SG_REL_ DACU SG_ 820 Brightspot04_LeftAngleVar 120;
BA_REL_ "GenSigFirstTimeoutTime" BU_SG_REL_ DACU SG_ 820 Brightspot04_RightAngleVar 3000;
BA_REL_ "GenSigTimeoutTime" BU_SG_REL_ DACU SG_ 820 Brightspot04_RightAngleVar 120;
BA_REL_ "GenSigFirstTimeoutTime" BU_SG_REL_ DACU SG_ 820 Brightspot04_ID 3000;
BA_REL_ "GenSigTimeoutTime" BU_SG_REL_ DACU SG_ 820 Brightspot04_ID 120;
BA_REL_ "GenSigFirstTimeoutTime" BU_SG_REL_ DACU SG_ 820 Brightspot04_LeftAngVelocity 3000;
BA_REL_ "GenSigTimeoutTime" BU_SG_REL_ DACU SG_ 820 Brightspot04_LeftAngVelocity 120;
BA_REL_ "GenSigFirstTimeoutTime" BU_SG_REL_ DACU SG_ 820 Brightspot04_RightAngVelocity 3000;
BA_REL_ "GenSigTimeoutTime" BU_SG_REL_ DACU SG_ 820 Brightspot04_RightAngVelocity 120;
BA_REL_ "GenSigFirstTimeoutTime" BU_SG_REL_ DACU SG_ 820 Brightspot04_ExistConf 3000;
BA_REL_ "GenSigTimeoutTime" BU_SG_REL_ DACU SG_ 820 Brightspot04_ExistConf 120;
BA_REL_ "GenSigFirstTimeoutTime" BU_SG_REL_ DACU SG_ 820 Brightspot04_RightAngle 3000;
BA_REL_ "GenSigTimeoutTime" BU_SG_REL_ DACU SG_ 820 Brightspot04_RightAngle 120;
BA_REL_ "GenSigFirstTimeoutTime" BU_SG_REL_ DACU SG_ 820 Brightspot04_LifeTime 3000;
BA_REL_ "GenSigTimeoutTime" BU_SG_REL_ DACU SG_ 820 Brightspot04_LifeTime 120;
BA_REL_ "GenSigFirstTimeoutTime" BU_SG_REL_ DACU SG_ 820 Brightspot04_Distance 3000;
BA_REL_ "GenSigTimeoutTime" BU_SG_REL_ DACU SG_ 820 Brightspot04_Distance 120;
BA_REL_ "GenSigFirstTimeoutTime" BU_SG_REL_ DACU SG_ 820 Brightspot04_DistanceVar 3000;
BA_REL_ "GenSigTimeoutTime" BU_SG_REL_ DACU SG_ 820 Brightspot04_DistanceVar 120;
BA_REL_ "GenSigFirstTimeoutTime" BU_SG_REL_ DACU SG_ 820 Brightspot04_MergeObj 3000;
BA_REL_ "GenSigTimeoutTime" BU_SG_REL_ DACU SG_ 820 Brightspot04_MergeObj 120;
BA_REL_ "GenSigFirstTimeoutTime" BU_SG_REL_ DACU SG_ 820 Brightspot04_LeftAngle 3000;
BA_REL_ "GenSigTimeoutTime" BU_SG_REL_ DACU SG_ 820 Brightspot04_LeftAngle 120;
BA_REL_ "GenSigFirstTimeoutTime" BU_SG_REL_ DACU SG_ 820 Brightspot04_TimeStamp 3000;
BA_REL_ "GenSigTimeoutTime" BU_SG_REL_ DACU SG_ 820 Brightspot04_TimeStamp 120;
BA_REL_ "GenSigFirstTimeoutTime" BU_SG_REL_ DACU SG_ 819 Brightspot03_ID 3000;
BA_REL_ "GenSigTimeoutTime" BU_SG_REL_ DACU SG_ 819 Brightspot03_ID 120;
BA_REL_ "GenSigFirstTimeoutTime" BU_SG_REL_ DACU SG_ 819 Brightspot03_DistanceVar 3000;
BA_REL_ "GenSigTimeoutTime" BU_SG_REL_ DACU SG_ 819 Brightspot03_DistanceVar 120;
BA_REL_ "GenSigFirstTimeoutTime" BU_SG_REL_ DACU SG_ 819 Brightspot03_Distance 3000;
BA_REL_ "GenSigTimeoutTime" BU_SG_REL_ DACU SG_ 819 Brightspot03_Distance 120;
BA_REL_ "GenSigFirstTimeoutTime" BU_SG_REL_ DACU SG_ 819 Brightspot03_RightAngVelocity 3000;
BA_REL_ "GenSigTimeoutTime" BU_SG_REL_ DACU SG_ 819 Brightspot03_RightAngVelocity 120;
BA_REL_ "GenSigFirstTimeoutTime" BU_SG_REL_ DACU SG_ 819 Brightspot03_RightAngleVar 3000;
BA_REL_ "GenSigTimeoutTime" BU_SG_REL_ DACU SG_ 819 Brightspot03_RightAngleVar 120;
BA_REL_ "GenSigFirstTimeoutTime" BU_SG_REL_ DACU SG_ 819 Brightspot03_RightAngle 3000;
BA_REL_ "GenSigTimeoutTime" BU_SG_REL_ DACU SG_ 819 Brightspot03_RightAngle 120;
BA_REL_ "GenSigFirstTimeoutTime" BU_SG_REL_ DACU SG_ 819 Brightspot03_ExistConf 3000;
BA_REL_ "GenSigTimeoutTime" BU_SG_REL_ DACU SG_ 819 Brightspot03_ExistConf 120;
BA_REL_ "GenSigFirstTimeoutTime" BU_SG_REL_ DACU SG_ 819 Brightspot03_Direction 3000;
BA_REL_ "GenSigTimeoutTime" BU_SG_REL_ DACU SG_ 819 Brightspot03_Direction 120;
BA_REL_ "GenSigFirstTimeoutTime" BU_SG_REL_ DACU SG_ 819 Brightspot03_MergeObj 3000;
BA_REL_ "GenSigTimeoutTime" BU_SG_REL_ DACU SG_ 819 Brightspot03_MergeObj 120;
BA_REL_ "GenSigFirstTimeoutTime" BU_SG_REL_ DACU SG_ 819 Brightspot03_TrackStatus 3000;
BA_REL_ "GenSigTimeoutTime" BU_SG_REL_ DACU SG_ 819 Brightspot03_TrackStatus 120;
BA_REL_ "GenSigFirstTimeoutTime" BU_SG_REL_ DACU SG_ 819 Brightspot03_LifeTime 3000;
BA_REL_ "GenSigTimeoutTime" BU_SG_REL_ DACU SG_ 819 Brightspot03_LifeTime 120;
BA_REL_ "GenSigFirstTimeoutTime" BU_SG_REL_ DACU SG_ 819 Brightspot03_LeftAngleVar 3000;
BA_REL_ "GenSigTimeoutTime" BU_SG_REL_ DACU SG_ 819 Brightspot03_LeftAngleVar 120;
BA_REL_ "GenSigFirstTimeoutTime" BU_SG_REL_ DACU SG_ 819 Brightspot03_TimeStamp 3000;
BA_REL_ "GenSigTimeoutTime" BU_SG_REL_ DACU SG_ 819 Brightspot03_TimeStamp 120;
BA_REL_ "GenSigFirstTimeoutTime" BU_SG_REL_ DACU SG_ 819 Brightspot03_LeftAngVelocity 3000;
BA_REL_ "GenSigTimeoutTime" BU_SG_REL_ DACU SG_ 819 Brightspot03_LeftAngVelocity 120;
BA_REL_ "GenSigFirstTimeoutTime" BU_SG_REL_ DACU SG_ 819 Brightspot03_LeftAngle 3000;
BA_REL_ "GenSigTimeoutTime" BU_SG_REL_ DACU SG_ 819 Brightspot03_LeftAngle 120;
BA_REL_ "GenSigFirstTimeoutTime" BU_SG_REL_ DACU SG_ 818 Brightspot02_RightAngVelocity 3000;
BA_REL_ "GenSigTimeoutTime" BU_SG_REL_ DACU SG_ 818 Brightspot02_RightAngVelocity 120;
BA_REL_ "GenSigFirstTimeoutTime" BU_SG_REL_ DACU SG_ 818 Brightspot02_LeftAngle 3000;
BA_REL_ "GenSigTimeoutTime" BU_SG_REL_ DACU SG_ 818 Brightspot02_LeftAngle 120;
BA_REL_ "GenSigFirstTimeoutTime" BU_SG_REL_ DACU SG_ 818 Brightspot02_Distance 3000;
BA_REL_ "GenSigTimeoutTime" BU_SG_REL_ DACU SG_ 818 Brightspot02_Distance 120;
BA_REL_ "GenSigFirstTimeoutTime" BU_SG_REL_ DACU SG_ 818 Brightspot02_TrackStatus 3000;
BA_REL_ "GenSigTimeoutTime" BU_SG_REL_ DACU SG_ 818 Brightspot02_TrackStatus 120;
BA_REL_ "GenSigFirstTimeoutTime" BU_SG_REL_ DACU SG_ 818 Brightspot02_ID 3000;
BA_REL_ "GenSigTimeoutTime" BU_SG_REL_ DACU SG_ 818 Brightspot02_ID 120;
BA_REL_ "GenSigFirstTimeoutTime" BU_SG_REL_ DACU SG_ 818 Brightspot02_Direction 3000;
BA_REL_ "GenSigTimeoutTime" BU_SG_REL_ DACU SG_ 818 Brightspot02_Direction 120;
BA_REL_ "GenSigFirstTimeoutTime" BU_SG_REL_ DACU SG_ 818 Brightspot02_RightAngle 3000;
BA_REL_ "GenSigTimeoutTime" BU_SG_REL_ DACU SG_ 818 Brightspot02_RightAngle 120;
BA_REL_ "GenSigFirstTimeoutTime" BU_SG_REL_ DACU SG_ 818 Brightspot02_MergeObj 3000;
BA_REL_ "GenSigTimeoutTime" BU_SG_REL_ DACU SG_ 818 Brightspot02_MergeObj 120;
BA_REL_ "GenSigFirstTimeoutTime" BU_SG_REL_ DACU SG_ 818 Brightspot02_LeftAngleVar 3000;
BA_REL_ "GenSigTimeoutTime" BU_SG_REL_ DACU SG_ 818 Brightspot02_LeftAngleVar 120;
BA_REL_ "GenSigFirstTimeoutTime" BU_SG_REL_ DACU SG_ 818 Brightspot02_DistanceVar 3000;
BA_REL_ "GenSigTimeoutTime" BU_SG_REL_ DACU SG_ 818 Brightspot02_DistanceVar 120;
BA_REL_ "GenSigFirstTimeoutTime" BU_SG_REL_ DACU SG_ 818 Brightspot02_ExistConf 3000;
BA_REL_ "GenSigTimeoutTime" BU_SG_REL_ DACU SG_ 818 Brightspot02_ExistConf 120;
BA_REL_ "GenSigFirstTimeoutTime" BU_SG_REL_ DACU SG_ 818 Brightspot02_LifeTime 3000;
BA_REL_ "GenSigTimeoutTime" BU_SG_REL_ DACU SG_ 818 Brightspot02_LifeTime 120;
BA_REL_ "GenSigFirstTimeoutTime" BU_SG_REL_ DACU SG_ 818 Brightspot02_RightAngleVar 3000;
BA_REL_ "GenSigTimeoutTime" BU_SG_REL_ DACU SG_ 818 Brightspot02_RightAngleVar 120;
BA_REL_ "GenSigFirstTimeoutTime" BU_SG_REL_ DACU SG_ 818 Brightspot02_LeftAngVelocity 3000;
BA_REL_ "GenSigTimeoutTime" BU_SG_REL_ DACU SG_ 818 Brightspot02_LeftAngVelocity 120;
BA_REL_ "GenSigFirstTimeoutTime" BU_SG_REL_ DACU SG_ 818 Brightspot02_TimeStamp 3000;
BA_REL_ "GenSigTimeoutTime" BU_SG_REL_ DACU SG_ 818 Brightspot02_TimeStamp 120;
BA_REL_ "GenSigFirstTimeoutTime" BU_SG_REL_ DACU SG_ 817 Brightspot01_TrackStatus 3000;
BA_REL_ "GenSigTimeoutTime" BU_SG_REL_ DACU SG_ 817 Brightspot01_TrackStatus 120;
BA_REL_ "GenSigFirstTimeoutTime" BU_SG_REL_ DACU SG_ 817 Brightspot01_MergeObj 3000;
BA_REL_ "GenSigTimeoutTime" BU_SG_REL_ DACU SG_ 817 Brightspot01_MergeObj 120;
BA_REL_ "GenSigFirstTimeoutTime" BU_SG_REL_ DACU SG_ 817 Brightspot01_LifeTime 3000;
BA_REL_ "GenSigTimeoutTime" BU_SG_REL_ DACU SG_ 817 Brightspot01_LifeTime 120;
BA_REL_ "GenSigFirstTimeoutTime" BU_SG_REL_ DACU SG_ 817 Brightspot01_RightAngle 3000;
BA_REL_ "GenSigTimeoutTime" BU_SG_REL_ DACU SG_ 817 Brightspot01_RightAngle 120;
BA_REL_ "GenSigFirstTimeoutTime" BU_SG_REL_ DACU SG_ 817 Brightspot01_ID 3000;
BA_REL_ "GenSigTimeoutTime" BU_SG_REL_ DACU SG_ 817 Brightspot01_ID 120;
BA_REL_ "GenSigFirstTimeoutTime" BU_SG_REL_ DACU SG_ 817 Brightspot01_Distance 3000;
BA_REL_ "GenSigTimeoutTime" BU_SG_REL_ DACU SG_ 817 Brightspot01_Distance 120;
BA_REL_ "GenSigFirstTimeoutTime" BU_SG_REL_ DACU SG_ 817 Brightspot01_TimeStamp 3000;
BA_REL_ "GenSigTimeoutTime" BU_SG_REL_ DACU SG_ 817 Brightspot01_TimeStamp 120;
BA_REL_ "GenSigFirstTimeoutTime" BU_SG_REL_ DACU SG_ 817 Brightspot01_LeftAngleVar 3000;
BA_REL_ "GenSigTimeoutTime" BU_SG_REL_ DACU SG_ 817 Brightspot01_LeftAngleVar 120;
BA_REL_ "GenSigFirstTimeoutTime" BU_SG_REL_ DACU SG_ 817 Brightspot01_RightAngVelocity 3000;
BA_REL_ "GenSigTimeoutTime" BU_SG_REL_ DACU SG_ 817 Brightspot01_RightAngVelocity 120;
BA_REL_ "GenSigFirstTimeoutTime" BU_SG_REL_ DACU SG_ 817 Brightspot01_ExistConf 3000;
BA_REL_ "GenSigTimeoutTime" BU_SG_REL_ DACU SG_ 817 Brightspot01_ExistConf 120;
BA_REL_ "GenSigFirstTimeoutTime" BU_SG_REL_ DACU SG_ 817 Brightspot01_Direction 3000;
BA_REL_ "GenSigTimeoutTime" BU_SG_REL_ DACU SG_ 817 Brightspot01_Direction 120;
BA_REL_ "GenSigFirstTimeoutTime" BU_SG_REL_ DACU SG_ 817 Brightspot01_RightAngleVar 3000;
BA_REL_ "GenSigTimeoutTime" BU_SG_REL_ DACU SG_ 817 Brightspot01_RightAngleVar 120;
BA_REL_ "GenSigFirstTimeoutTime" BU_SG_REL_ DACU SG_ 817 Brightspot01_DistanceVar 3000;
BA_REL_ "GenSigTimeoutTime" BU_SG_REL_ DACU SG_ 817 Brightspot01_DistanceVar 120;
BA_REL_ "GenSigFirstTimeoutTime" BU_SG_REL_ DACU SG_ 817 Brightspot01_LeftAngVelocity 3000;
BA_REL_ "GenSigTimeoutTime" BU_SG_REL_ DACU SG_ 817 Brightspot01_LeftAngVelocity 120;
BA_REL_ "GenSigFirstTimeoutTime" BU_SG_REL_ DACU SG_ 817 Brightspot01_LeftAngle 3000;
BA_REL_ "GenSigTimeoutTime" BU_SG_REL_ DACU SG_ 817 Brightspot01_LeftAngle 120;
BA_REL_ "GenSigFirstTimeoutTime" BU_SG_REL_ DACU SG_ 816 Brightspot00_DistanceVar 3000;
BA_REL_ "GenSigTimeoutTime" BU_SG_REL_ DACU SG_ 816 Brightspot00_DistanceVar 120;
BA_REL_ "GenSigFirstTimeoutTime" BU_SG_REL_ DACU SG_ 816 Brightspot00_MergeObj 3000;
BA_REL_ "GenSigTimeoutTime" BU_SG_REL_ DACU SG_ 816 Brightspot00_MergeObj 120;
BA_REL_ "GenSigFirstTimeoutTime" BU_SG_REL_ DACU SG_ 816 Brightspot00_LeftAngle 3000;
BA_REL_ "GenSigTimeoutTime" BU_SG_REL_ DACU SG_ 816 Brightspot00_LeftAngle 120;
BA_REL_ "GenSigFirstTimeoutTime" BU_SG_REL_ DACU SG_ 816 Brightspot00_LeftAngVelocity 3000;
BA_REL_ "GenSigTimeoutTime" BU_SG_REL_ DACU SG_ 816 Brightspot00_LeftAngVelocity 120;
BA_REL_ "GenSigFirstTimeoutTime" BU_SG_REL_ DACU SG_ 816 Brightspot00_RightAngVelocity 3000;
BA_REL_ "GenSigTimeoutTime" BU_SG_REL_ DACU SG_ 816 Brightspot00_RightAngVelocity 120;
BA_REL_ "GenSigFirstTimeoutTime" BU_SG_REL_ DACU SG_ 816 Brightspot00_TrackStatus 3000;
BA_REL_ "GenSigTimeoutTime" BU_SG_REL_ DACU SG_ 816 Brightspot00_TrackStatus 120;
BA_REL_ "GenSigFirstTimeoutTime" BU_SG_REL_ DACU SG_ 816 Brightspot00_Distance 3000;
BA_REL_ "GenSigTimeoutTime" BU_SG_REL_ DACU SG_ 816 Brightspot00_Distance 120;
BA_REL_ "GenSigFirstTimeoutTime" BU_SG_REL_ DACU SG_ 816 Brightspot00_RightAngleVar 3000;
BA_REL_ "GenSigTimeoutTime" BU_SG_REL_ DACU SG_ 816 Brightspot00_RightAngleVar 120;
BA_REL_ "GenSigFirstTimeoutTime" BU_SG_REL_ DACU SG_ 816 Brightspot00_RightAngle 3000;
BA_REL_ "GenSigTimeoutTime" BU_SG_REL_ DACU SG_ 816 Brightspot00_RightAngle 120;
BA_REL_ "GenSigFirstTimeoutTime" BU_SG_REL_ DACU SG_ 816 Brightspot00_Direction 3000;
BA_REL_ "GenSigTimeoutTime" BU_SG_REL_ DACU SG_ 816 Brightspot00_Direction 120;
BA_REL_ "GenSigFirstTimeoutTime" BU_SG_REL_ DACU SG_ 816 Brightspot00_ExistConf 3000;
BA_REL_ "GenSigTimeoutTime" BU_SG_REL_ DACU SG_ 816 Brightspot00_ExistConf 120;
BA_REL_ "GenSigFirstTimeoutTime" BU_SG_REL_ DACU SG_ 816 Brightspot00_TimeStamp 3000;
BA_REL_ "GenSigTimeoutTime" BU_SG_REL_ DACU SG_ 816 Brightspot00_TimeStamp 120;
BA_REL_ "GenSigFirstTimeoutTime" BU_SG_REL_ DACU SG_ 816 Brightspot00_LifeTime 3000;
BA_REL_ "GenSigTimeoutTime" BU_SG_REL_ DACU SG_ 816 Brightspot00_LifeTime 120;
BA_REL_ "GenSigFirstTimeoutTime" BU_SG_REL_ DACU SG_ 816 Brightspot00_LeftAngleVar 3000;
BA_REL_ "GenSigTimeoutTime" BU_SG_REL_ DACU SG_ 816 Brightspot00_LeftAngleVar 120;
BA_REL_ "GenSigFirstTimeoutTime" BU_SG_REL_ DACU SG_ 816 Brightspot00_ID 3000;
BA_REL_ "GenSigTimeoutTime" BU_SG_REL_ DACU SG_ 816 Brightspot00_ID 120;
BA_REL_ "GenSigFirstTimeoutTime" BU_SG_REL_ DACU SG_ 512 FwdCam_CalibPausedSpeed 3000;
BA_REL_ "GenSigTimeoutTime" BU_SG_REL_ DACU SG_ 512 FwdCam_CalibPausedSpeed 300;
BA_REL_ "GenSigFirstTimeoutTime" BU_SG_REL_ DACU SG_ 512 FwdSensingCamStat_CRC 3000;
BA_REL_ "GenSigTimeoutTime" BU_SG_REL_ DACU SG_ 512 FwdSensingCamStat_CRC 300;
BA_REL_ "GenSigFirstTimeoutTime" BU_SG_REL_ DACU SG_ 512 FwdLookingCamStat3_SqC 3000;
BA_REL_ "GenSigTimeoutTime" BU_SG_REL_ DACU SG_ 512 FwdLookingCamStat3_SqC 300;
BA_REL_ "GenSigFirstTimeoutTime" BU_SG_REL_ DACU SG_ 512 FwdSensingCamStat_TSRDetect 3000;
BA_REL_ "GenSigTimeoutTime" BU_SG_REL_ DACU SG_ 512 FwdSensingCamStat_TSRDetect 300;
BA_REL_ "GenSigFirstTimeoutTime" BU_SG_REL_ DACU SG_ 512 FwdSensingCamStat_ClothoidDetect 3000;
BA_REL_ "GenSigTimeoutTime" BU_SG_REL_ DACU SG_ 512 FwdSensingCamStat_ClothoidDetect 300;
BA_REL_ "GenSigFirstTimeoutTime" BU_SG_REL_ DACU SG_ 512 FwdSensingCamStat_DecalibDetect 3000;
BA_REL_ "GenSigTimeoutTime" BU_SG_REL_ DACU SG_ 512 FwdSensingCamStat_DecalibDetect 300;
BA_REL_ "GenSigFirstTimeoutTime" BU_SG_REL_ DACU SG_ 512 FwdSensingCamStat_BrighSpot 3000;
BA_REL_ "GenSigTimeoutTime" BU_SG_REL_ DACU SG_ 512 FwdSensingCamStat_BrighSpot 300;
BA_REL_ "GenSigFirstTimeoutTime" BU_SG_REL_ DACU SG_ 512 FwdCam_CalibState 3000;
BA_REL_ "GenSigTimeoutTime" BU_SG_REL_ DACU SG_ 512 FwdCam_CalibState 300;
BA_REL_ "GenSigFirstTimeoutTime" BU_SG_REL_ DACU SG_ 512 FwdLookingCamStat3_CRC 3000;
BA_REL_ "GenSigTimeoutTime" BU_SG_REL_ DACU SG_ 512 FwdLookingCamStat3_CRC 300;
BA_REL_ "GenSigFirstTimeoutTime" BU_SG_REL_ DACU SG_ 512 ForwardLookingCameraStatus2 3000;
BA_REL_ "GenSigTimeoutTime" BU_SG_REL_ DACU SG_ 512 ForwardLookingCameraStatus2 300;
BA_REL_ "GenSigFirstTimeoutTime" BU_SG_REL_ DACU SG_ 512 FwdSensingCamStat_TimeStamp 3000;
BA_REL_ "GenSigTimeoutTime" BU_SG_REL_ DACU SG_ 512 FwdSensingCamStat_TimeStamp 300;
BA_REL_ "GenSigFirstTimeoutTime" BU_SG_REL_ DACU SG_ 512 FwdCam_CalibProgress 3000;
BA_REL_ "GenSigTimeoutTime" BU_SG_REL_ DACU SG_ 512 FwdCam_CalibProgress 300;
BA_REL_ "GenSigFirstTimeoutTime" BU_SG_REL_ DACU SG_ 512 FwdSensingCamStat_TimeSynch 3000;
BA_REL_ "GenSigTimeoutTime" BU_SG_REL_ DACU SG_ 512 FwdSensingCamStat_TimeSynch 300;
BA_REL_ "GenSigFirstTimeoutTime" BU_SG_REL_ DACU SG_ 512 FwdCam_CalibPausedYaw 3000;
BA_REL_ "GenSigTimeoutTime" BU_SG_REL_ DACU SG_ 512 FwdCam_CalibPausedYaw 300;
BA_REL_ "GenSigFirstTimeoutTime" BU_SG_REL_ DACU SG_ 512 FwdSensingCamStat_Counter 3000;
BA_REL_ "GenSigTimeoutTime" BU_SG_REL_ DACU SG_ 512 FwdSensingCamStat_Counter 300;
BA_REL_ "GenSigFirstTimeoutTime" BU_SG_REL_ DACU SG_ 512 FwdCam_CalibPausedAcc 3000;
BA_REL_ "GenSigTimeoutTime" BU_SG_REL_ DACU SG_ 512 FwdCam_CalibPausedAcc 300;
BA_REL_ "GenSigFirstTimeoutTime" BU_SG_REL_ DACU SG_ 512 FwdLookingCamStat3_Status 3000;
BA_REL_ "GenSigTimeoutTime" BU_SG_REL_ DACU SG_ 512 FwdLookingCamStat3_Status 300;
BA_REL_ "GenSigFirstTimeoutTime" BU_SG_REL_ DACU SG_ 512 FwdSensingCamStat_TargetDetect 3000;
BA_REL_ "GenSigTimeoutTime" BU_SG_REL_ DACU SG_ 512 FwdSensingCamStat_TargetDetect 300;
BA_REL_ "GenSigFirstTimeoutTime" BU_SG_REL_ DACU SG_ 807 FLCObject23_LongVel 3000;
BA_REL_ "GenSigTimeoutTime" BU_SG_REL_ DACU SG_ 807 FLCObject23_LongVel 120;
BA_REL_ "GenSigFirstTimeoutTime" BU_SG_REL_ DACU SG_ 807 FLCObject23_DstRightVar 3000;
BA_REL_ "GenSigTimeoutTime" BU_SG_REL_ DACU SG_ 807 FLCObject23_DstRightVar 120;
BA_REL_ "GenSigFirstTimeoutTime" BU_SG_REL_ DACU SG_ 807 FLCObject23_TrackStatus 3000;
BA_REL_ "GenSigTimeoutTime" BU_SG_REL_ DACU SG_ 807 FLCObject23_TrackStatus 120;
BA_REL_ "GenSigFirstTimeoutTime" BU_SG_REL_ DACU SG_ 807 FLCObject23_Counter 3000;
BA_REL_ "GenSigTimeoutTime" BU_SG_REL_ DACU SG_ 807 FLCObject23_Counter 120;
BA_REL_ "GenSigFirstTimeoutTime" BU_SG_REL_ DACU SG_ 807 FLCObject23_BrakeLight 3000;
BA_REL_ "GenSigTimeoutTime" BU_SG_REL_ DACU SG_ 807 FLCObject23_BrakeLight 120;
BA_REL_ "GenSigFirstTimeoutTime" BU_SG_REL_ DACU SG_ 807 FLCObject23_CoastIndex 3000;
BA_REL_ "GenSigTimeoutTime" BU_SG_REL_ DACU SG_ 807 FLCObject23_CoastIndex 120;
BA_REL_ "GenSigFirstTimeoutTime" BU_SG_REL_ DACU SG_ 807 FLCObject23_DstFarVar 3000;
BA_REL_ "GenSigTimeoutTime" BU_SG_REL_ DACU SG_ 807 FLCObject23_DstFarVar 120;
BA_REL_ "GenSigFirstTimeoutTime" BU_SG_REL_ DACU SG_ 807 FLCObject23_LifeTime 3000;
BA_REL_ "GenSigTimeoutTime" BU_SG_REL_ DACU SG_ 807 FLCObject23_LifeTime 120;
BA_REL_ "GenSigFirstTimeoutTime" BU_SG_REL_ DACU SG_ 807 FLCObject23_AnglFarCorner 3000;
BA_REL_ "GenSigTimeoutTime" BU_SG_REL_ DACU SG_ 807 FLCObject23_AnglFarCorner 120;
BA_REL_ "GenSigFirstTimeoutTime" BU_SG_REL_ DACU SG_ 807 FLCObject23_ReliabilityConf 3000;
BA_REL_ "GenSigTimeoutTime" BU_SG_REL_ DACU SG_ 807 FLCObject23_ReliabilityConf 120;
BA_REL_ "GenSigFirstTimeoutTime" BU_SG_REL_ DACU SG_ 807 FLCObject23_AnglLeftCorner 3000;
BA_REL_ "GenSigTimeoutTime" BU_SG_REL_ DACU SG_ 807 FLCObject23_AnglLeftCorner 120;
BA_REL_ "GenSigFirstTimeoutTime" BU_SG_REL_ DACU SG_ 807 FLCObject23_DistRightCorner 3000;
BA_REL_ "GenSigTimeoutTime" BU_SG_REL_ DACU SG_ 807 FLCObject23_DistRightCorner 120;
BA_REL_ "GenSigFirstTimeoutTime" BU_SG_REL_ DACU SG_ 807 FLCObject23_AngLeftVar 3000;
BA_REL_ "GenSigTimeoutTime" BU_SG_REL_ DACU SG_ 807 FLCObject23_AngLeftVar 120;
BA_REL_ "GenSigFirstTimeoutTime" BU_SG_REL_ DACU SG_ 807 FLCObject23_TargetToLine 3000;
BA_REL_ "GenSigTimeoutTime" BU_SG_REL_ DACU SG_ 807 FLCObject23_TargetToLine 120;
BA_REL_ "GenSigFirstTimeoutTime" BU_SG_REL_ DACU SG_ 807 FLCObject23_ScaleChange 3000;
BA_REL_ "GenSigTimeoutTime" BU_SG_REL_ DACU SG_ 807 FLCObject23_ScaleChange 120;
BA_REL_ "GenSigFirstTimeoutTime" BU_SG_REL_ DACU SG_ 807 FLCObject23_ObjDynClass 3000;
BA_REL_ "GenSigTimeoutTime" BU_SG_REL_ DACU SG_ 807 FLCObject23_ObjDynClass 120;
BA_REL_ "GenSigFirstTimeoutTime" BU_SG_REL_ DACU SG_ 807 FLCObject23_CRC 3000;
BA_REL_ "GenSigTimeoutTime" BU_SG_REL_ DACU SG_ 807 FLCObject23_CRC 120;
BA_REL_ "GenSigFirstTimeoutTime" BU_SG_REL_ DACU SG_ 807 FLCObject23_ExistConf 3000;
BA_REL_ "GenSigTimeoutTime" BU_SG_REL_ DACU SG_ 807 FLCObject23_ExistConf 120;
BA_REL_ "GenSigFirstTimeoutTime" BU_SG_REL_ DACU SG_ 807 FLCObject23_TurnIndication 3000;
BA_REL_ "GenSigTimeoutTime" BU_SG_REL_ DACU SG_ 807 FLCObject23_TurnIndication 120;
BA_REL_ "GenSigFirstTimeoutTime" BU_SG_REL_ DACU SG_ 807 FLCObject23_AngFarVar 3000;
BA_REL_ "GenSigTimeoutTime" BU_SG_REL_ DACU SG_ 807 FLCObject23_AngFarVar 120;
BA_REL_ "GenSigFirstTimeoutTime" BU_SG_REL_ DACU SG_ 807 FLCObject23_LongPos 3000;
BA_REL_ "GenSigTimeoutTime" BU_SG_REL_ DACU SG_ 807 FLCObject23_LongPos 120;
BA_REL_ "GenSigFirstTimeoutTime" BU_SG_REL_ DACU SG_ 807 FLCObject23_ObjID 3000;
BA_REL_ "GenSigTimeoutTime" BU_SG_REL_ DACU SG_ 807 FLCObject23_ObjID 120;
BA_REL_ "GenSigFirstTimeoutTime" BU_SG_REL_ DACU SG_ 807 FLCObject23_LongVelVar 3000;
BA_REL_ "GenSigTimeoutTime" BU_SG_REL_ DACU SG_ 807 FLCObject23_LongVelVar 120;
BA_REL_ "GenSigFirstTimeoutTime" BU_SG_REL_ DACU SG_ 807 FLCObject23_LatVelVar 3000;
BA_REL_ "GenSigTimeoutTime" BU_SG_REL_ DACU SG_ 807 FLCObject23_LatVelVar 120;
BA_REL_ "GenSigFirstTimeoutTime" BU_SG_REL_ DACU SG_ 807 FLCObject23_ObjClass 3000;
BA_REL_ "GenSigTimeoutTime" BU_SG_REL_ DACU SG_ 807 FLCObject23_ObjClass 120;
BA_REL_ "GenSigFirstTimeoutTime" BU_SG_REL_ DACU SG_ 807 FLCObject23_DistFarCorner 3000;
BA_REL_ "GenSigTimeoutTime" BU_SG_REL_ DACU SG_ 807 FLCObject23_DistFarCorner 120;
BA_REL_ "GenSigFirstTimeoutTime" BU_SG_REL_ DACU SG_ 807 FLCObject23_AngRightVar 3000;
BA_REL_ "GenSigTimeoutTime" BU_SG_REL_ DACU SG_ 807 FLCObject23_AngRightVar 120;
BA_REL_ "GenSigFirstTimeoutTime" BU_SG_REL_ DACU SG_ 807 FLCObject23_LatVel 3000;
BA_REL_ "GenSigTimeoutTime" BU_SG_REL_ DACU SG_ 807 FLCObject23_LatVel 120;
BA_REL_ "GenSigFirstTimeoutTime" BU_SG_REL_ DACU SG_ 807 FLCObject23_TimeStamp 3000;
BA_REL_ "GenSigTimeoutTime" BU_SG_REL_ DACU SG_ 807 FLCObject23_TimeStamp 120;
BA_REL_ "GenSigFirstTimeoutTime" BU_SG_REL_ DACU SG_ 807 FLCObject23_HeadingVar 3000;
BA_REL_ "GenSigTimeoutTime" BU_SG_REL_ DACU SG_ 807 FLCObject23_HeadingVar 120;
BA_REL_ "GenSigFirstTimeoutTime" BU_SG_REL_ DACU SG_ 807 FLCObject23_DstLeftVar 3000;
BA_REL_ "GenSigTimeoutTime" BU_SG_REL_ DACU SG_ 807 FLCObject23_DstLeftVar 120;
BA_REL_ "GenSigFirstTimeoutTime" BU_SG_REL_ DACU SG_ 807 FLCObject23_DistLeftCorner 3000;
BA_REL_ "GenSigTimeoutTime" BU_SG_REL_ DACU SG_ 807 FLCObject23_DistLeftCorner 120;
BA_REL_ "GenSigFirstTimeoutTime" BU_SG_REL_ DACU SG_ 807 FLCObject23_LatPosVar 3000;
BA_REL_ "GenSigTimeoutTime" BU_SG_REL_ DACU SG_ 807 FLCObject23_LatPosVar 120;
BA_REL_ "GenSigFirstTimeoutTime" BU_SG_REL_ DACU SG_ 807 FLCObject23_LongPosVar 3000;
BA_REL_ "GenSigTimeoutTime" BU_SG_REL_ DACU SG_ 807 FLCObject23_LongPosVar 120;
BA_REL_ "GenSigFirstTimeoutTime" BU_SG_REL_ DACU SG_ 807 FLCObject23_LongAcc 3000;
BA_REL_ "GenSigTimeoutTime" BU_SG_REL_ DACU SG_ 807 FLCObject23_LongAcc 120;
BA_REL_ "GenSigFirstTimeoutTime" BU_SG_REL_ DACU SG_ 807 FLCObject23_LatPos 3000;
BA_REL_ "GenSigTimeoutTime" BU_SG_REL_ DACU SG_ 807 FLCObject23_LatPos 120;
BA_REL_ "GenSigFirstTimeoutTime" BU_SG_REL_ DACU SG_ 807 FLCObject23_LatAcc 3000;
BA_REL_ "GenSigTimeoutTime" BU_SG_REL_ DACU SG_ 807 FLCObject23_LatAcc 120;
BA_REL_ "GenSigFirstTimeoutTime" BU_SG_REL_ DACU SG_ 807 FLCObject23_Height 3000;
BA_REL_ "GenSigTimeoutTime" BU_SG_REL_ DACU SG_ 807 FLCObject23_Height 120;
BA_REL_ "GenSigFirstTimeoutTime" BU_SG_REL_ DACU SG_ 807 FLCObject23_Heading 3000;
BA_REL_ "GenSigTimeoutTime" BU_SG_REL_ DACU SG_ 807 FLCObject23_Heading 120;
BA_REL_ "GenSigFirstTimeoutTime" BU_SG_REL_ DACU SG_ 807 FLCObject23_AnglRightCorner 3000;
BA_REL_ "GenSigTimeoutTime" BU_SG_REL_ DACU SG_ 807 FLCObject23_AnglRightCorner 120;
VAL_ 839 Clothoid07_TrackStatus 7 "TrackStatus_NotAvailable" 6 "TrackStatus_Error" 5 "TrackStatus_Spare3" 4 "TrackStatus_Spare2" 3 "TrackStatus_Spare1" 2 "TrackStatus_Invalid" 1 "TrackStatus_Predicted" 0 "TrackStatus_Tracked" ;
VAL_ 839 Clothoid07_Type 31 "Clothoid_Type_NotAvailable" 30 "Clothoid_Type_Error" 29 "Clothoid_Type_Spare10" 28 "Clothoid_Type_Spare9" 27 "Clothoid_Type_Spare8" 26 "Clothoid_Type_Spare7" 25 "Clothoid_Type_Spare6" 24 "Clothoid_Type_Spare5" 23 "Clothoid_Type_Spare4" 22 "Clothoid_Type_Spare3" 21 "Clothoid_Type_Spare2" 20 "Clothoid_Type_Spare1" 19 "Clothoid_Type_Unknown" 18 "Clothoid_Type_UnknownRaised" 17 "Clothoid_Type_ParkedCar" 16 "Clothoid_Type_DelineatorPost" 15 "Clothoid_Type_TrafficCone" 14 "Clothoid_Type_Wall" 13 "Clothoid_Type_Curbstone" 12 "Clothoid_Type_Guardrail" 11 "Clothoid_Type_RoadEdge" 10 "Clothoid_Type_BottsDots" 9 "Clothoid_Type_AsphaltJoint" 8 "Clothoid_Type_CarPool" 7 "Clothoid_Type_MultipleWarning" 6 "Clothoid_Type_Multiple" 5 "Clothoid_Type_DoubleSolid_Solid" 4 "Clothoid_Type_DoubleSolid_Dashed" 3 "Clothoid_Type_DoubleDashed_Solid" 2 "Clothoid_Type_DoubleDashed_Dashed" 1 "Clothoid_Type_DashedLine" 0 "Clothoid_Type_SolidLine" ;
VAL_ 839 Clothoid07_Location 15 "Clothoid_Location_NotAvailable" 14 "Clothoid_Location_Error" 13 "Clothoid_Location_Spare6" 12 "Clothoid_Location_Spare5" 11 "Clothoid_Location_Spare4" 10 "Clothoid_Location_Spare3" 9 "Clothoid_Location_Spare2" 8 "Clothoid_Location_Spare1" 7 "Clothoid_Location_RaisedRight" 6 "Clothoid_Location_RaisedLeft" 5 "Clothoid_Location_RoadEdgeRight" 4 "Clothoid_Location_RoadEdgeLeft" 3 "Clothoid_Location_RightRightLine" 2 "Clothoid_Location_LeftLeftLine" 1 "Clothoid_Location_RightEgoLine" 0 "Clothoid_Location_LeftEgoLine" ;
VAL_ 839 Clothoid07_Color 7 "Color3bit_NotAvailable" 6 "Color3bit_Error" 5 "Color3bit_Unknow" 4 "Color3bit_Spare" 3 "Color3bit_Blue" 2 "Color3bit_Red" 1 "Color3bit_Yellow" 0 "Color3bit_White" ;
VAL_ 838 Clothoid06_Type 31 "Clothoid_Type_NotAvailable" 30 "Clothoid_Type_Error" 29 "Clothoid_Type_Spare10" 28 "Clothoid_Type_Spare9" 27 "Clothoid_Type_Spare8" 26 "Clothoid_Type_Spare7" 25 "Clothoid_Type_Spare6" 24 "Clothoid_Type_Spare5" 23 "Clothoid_Type_Spare4" 22 "Clothoid_Type_Spare3" 21 "Clothoid_Type_Spare2" 20 "Clothoid_Type_Spare1" 19 "Clothoid_Type_Unknown" 18 "Clothoid_Type_UnknownRaised" 17 "Clothoid_Type_ParkedCar" 16 "Clothoid_Type_DelineatorPost" 15 "Clothoid_Type_TrafficCone" 14 "Clothoid_Type_Wall" 13 "Clothoid_Type_Curbstone" 12 "Clothoid_Type_Guardrail" 11 "Clothoid_Type_RoadEdge" 10 "Clothoid_Type_BottsDots" 9 "Clothoid_Type_AsphaltJoint" 8 "Clothoid_Type_CarPool" 7 "Clothoid_Type_MultipleWarning" 6 "Clothoid_Type_Multiple" 5 "Clothoid_Type_DoubleSolid_Solid" 4 "Clothoid_Type_DoubleSolid_Dashed" 3 "Clothoid_Type_DoubleDashed_Solid" 2 "Clothoid_Type_DoubleDashed_Dashed" 1 "Clothoid_Type_DashedLine" 0 "Clothoid_Type_SolidLine" ;
VAL_ 838 Clothoid06_Location 15 "Clothoid_Location_NotAvailable" 14 "Clothoid_Location_Error" 13 "Clothoid_Location_Spare6" 12 "Clothoid_Location_Spare5" 11 "Clothoid_Location_Spare4" 10 "Clothoid_Location_Spare3" 9 "Clothoid_Location_Spare2" 8 "Clothoid_Location_Spare1" 7 "Clothoid_Location_RaisedRight" 6 "Clothoid_Location_RaisedLeft" 5 "Clothoid_Location_RoadEdgeRight" 4 "Clothoid_Location_RoadEdgeLeft" 3 "Clothoid_Location_RightRightLine" 2 "Clothoid_Location_LeftLeftLine" 1 "Clothoid_Location_RightEgoLine" 0 "Clothoid_Location_LeftEgoLine" ;
VAL_ 838 Clothoid06_Color 7 "Color3bit_NotAvailable" 6 "Color3bit_Error" 5 "Color3bit_Unknow" 4 "Color3bit_Spare" 3 "Color3bit_Blue" 2 "Color3bit_Red" 1 "Color3bit_Yellow" 0 "Color3bit_White" ;
VAL_ 838 Clothoid06_TrackStatus 7 "TrackStatus_NotAvailable" 6 "TrackStatus_Error" 5 "TrackStatus_Spare3" 4 "TrackStatus_Spare2" 3 "TrackStatus_Spare1" 2 "TrackStatus_Invalid" 1 "TrackStatus_Predicted" 0 "TrackStatus_Tracked" ;
VAL_ 837 Clothoid05_Color 7 "Color3bit_NotAvailable" 6 "Color3bit_Error" 5 "Color3bit_Unknow" 4 "Color3bit_Spare" 3 "Color3bit_Blue" 2 "Color3bit_Red" 1 "Color3bit_Yellow" 0 "Color3bit_White" ;
VAL_ 837 Clothoid05_Location 15 "Clothoid_Location_NotAvailable" 14 "Clothoid_Location_Error" 13 "Clothoid_Location_Spare6" 12 "Clothoid_Location_Spare5" 11 "Clothoid_Location_Spare4" 10 "Clothoid_Location_Spare3" 9 "Clothoid_Location_Spare2" 8 "Clothoid_Location_Spare1" 7 "Clothoid_Location_RaisedRight" 6 "Clothoid_Location_RaisedLeft" 5 "Clothoid_Location_RoadEdgeRight" 4 "Clothoid_Location_RoadEdgeLeft" 3 "Clothoid_Location_RightRightLine" 2 "Clothoid_Location_LeftLeftLine" 1 "Clothoid_Location_RightEgoLine" 0 "Clothoid_Location_LeftEgoLine" ;
VAL_ 837 Clothoid05_Type 31 "Clothoid_Type_NotAvailable" 30 "Clothoid_Type_Error" 29 "Clothoid_Type_Spare10" 28 "Clothoid_Type_Spare9" 27 "Clothoid_Type_Spare8" 26 "Clothoid_Type_Spare7" 25 "Clothoid_Type_Spare6" 24 "Clothoid_Type_Spare5" 23 "Clothoid_Type_Spare4" 22 "Clothoid_Type_Spare3" 21 "Clothoid_Type_Spare2" 20 "Clothoid_Type_Spare1" 19 "Clothoid_Type_Unknown" 18 "Clothoid_Type_UnknownRaised" 17 "Clothoid_Type_ParkedCar" 16 "Clothoid_Type_DelineatorPost" 15 "Clothoid_Type_TrafficCone" 14 "Clothoid_Type_Wall" 13 "Clothoid_Type_Curbstone" 12 "Clothoid_Type_Guardrail" 11 "Clothoid_Type_RoadEdge" 10 "Clothoid_Type_BottsDots" 9 "Clothoid_Type_AsphaltJoint" 8 "Clothoid_Type_CarPool" 7 "Clothoid_Type_MultipleWarning" 6 "Clothoid_Type_Multiple" 5 "Clothoid_Type_DoubleSolid_Solid" 4 "Clothoid_Type_DoubleSolid_Dashed" 3 "Clothoid_Type_DoubleDashed_Solid" 2 "Clothoid_Type_DoubleDashed_Dashed" 1 "Clothoid_Type_DashedLine" 0 "Clothoid_Type_SolidLine" ;
VAL_ 837 Clothoid05_TrackStatus 7 "TrackStatus_NotAvailable" 6 "TrackStatus_Error" 5 "TrackStatus_Spare3" 4 "TrackStatus_Spare2" 3 "TrackStatus_Spare1" 2 "TrackStatus_Invalid" 1 "TrackStatus_Predicted" 0 "TrackStatus_Tracked" ;
VAL_ 836 Clothoid04_Type 31 "Clothoid_Type_NotAvailable" 30 "Clothoid_Type_Error" 29 "Clothoid_Type_Spare10" 28 "Clothoid_Type_Spare9" 27 "Clothoid_Type_Spare8" 26 "Clothoid_Type_Spare7" 25 "Clothoid_Type_Spare6" 24 "Clothoid_Type_Spare5" 23 "Clothoid_Type_Spare4" 22 "Clothoid_Type_Spare3" 21 "Clothoid_Type_Spare2" 20 "Clothoid_Type_Spare1" 19 "Clothoid_Type_Unknown" 18 "Clothoid_Type_UnknownRaised" 17 "Clothoid_Type_ParkedCar" 16 "Clothoid_Type_DelineatorPost" 15 "Clothoid_Type_TrafficCone" 14 "Clothoid_Type_Wall" 13 "Clothoid_Type_Curbstone" 12 "Clothoid_Type_Guardrail" 11 "Clothoid_Type_RoadEdge" 10 "Clothoid_Type_BottsDots" 9 "Clothoid_Type_AsphaltJoint" 8 "Clothoid_Type_CarPool" 7 "Clothoid_Type_MultipleWarning" 6 "Clothoid_Type_Multiple" 5 "Clothoid_Type_DoubleSolid_Solid" 4 "Clothoid_Type_DoubleSolid_Dashed" 3 "Clothoid_Type_DoubleDashed_Solid" 2 "Clothoid_Type_DoubleDashed_Dashed" 1 "Clothoid_Type_DashedLine" 0 "Clothoid_Type_SolidLine" ;
VAL_ 836 Clothoid04_Location 15 "Clothoid_Location_NotAvailable" 14 "Clothoid_Location_Error" 13 "Clothoid_Location_Spare6" 12 "Clothoid_Location_Spare5" 11 "Clothoid_Location_Spare4" 10 "Clothoid_Location_Spare3" 9 "Clothoid_Location_Spare2" 8 "Clothoid_Location_Spare1" 7 "Clothoid_Location_RaisedRight" 6 "Clothoid_Location_RaisedLeft" 5 "Clothoid_Location_RoadEdgeRight" 4 "Clothoid_Location_RoadEdgeLeft" 3 "Clothoid_Location_RightRightLine" 2 "Clothoid_Location_LeftLeftLine" 1 "Clothoid_Location_RightEgoLine" 0 "Clothoid_Location_LeftEgoLine" ;
VAL_ 836 Clothoid04_TrackStatus 7 "TrackStatus_NotAvailable" 6 "TrackStatus_Error" 5 "TrackStatus_Spare3" 4 "TrackStatus_Spare2" 3 "TrackStatus_Spare1" 2 "TrackStatus_Invalid" 1 "TrackStatus_Predicted" 0 "TrackStatus_Tracked" ;
VAL_ 836 Clothoid04_Color 7 "Color3bit_NotAvailable" 6 "Color3bit_Error" 5 "Color3bit_Unknow" 4 "Color3bit_Spare" 3 "Color3bit_Blue" 2 "Color3bit_Red" 1 "Color3bit_Yellow" 0 "Color3bit_White" ;
VAL_ 835 Clothoid03_Location 15 "Clothoid_Location_NotAvailable" 14 "Clothoid_Location_Error" 13 "Clothoid_Location_Spare6" 12 "Clothoid_Location_Spare5" 11 "Clothoid_Location_Spare4" 10 "Clothoid_Location_Spare3" 9 "Clothoid_Location_Spare2" 8 "Clothoid_Location_Spare1" 7 "Clothoid_Location_RaisedRight" 6 "Clothoid_Location_RaisedLeft" 5 "Clothoid_Location_RoadEdgeRight" 4 "Clothoid_Location_RoadEdgeLeft" 3 "Clothoid_Location_RightRightLine" 2 "Clothoid_Location_LeftLeftLine" 1 "Clothoid_Location_RightEgoLine" 0 "Clothoid_Location_LeftEgoLine" ;
VAL_ 835 Clothoid03_Color 7 "Color3bit_NotAvailable" 6 "Color3bit_Error" 5 "Color3bit_Unknow" 4 "Color3bit_Spare" 3 "Color3bit_Blue" 2 "Color3bit_Red" 1 "Color3bit_Yellow" 0 "Color3bit_White" ;
VAL_ 835 Clothoid03_Type 31 "Clothoid_Type_NotAvailable" 30 "Clothoid_Type_Error" 29 "Clothoid_Type_Spare10" 28 "Clothoid_Type_Spare9" 27 "Clothoid_Type_Spare8" 26 "Clothoid_Type_Spare7" 25 "Clothoid_Type_Spare6" 24 "Clothoid_Type_Spare5" 23 "Clothoid_Type_Spare4" 22 "Clothoid_Type_Spare3" 21 "Clothoid_Type_Spare2" 20 "Clothoid_Type_Spare1" 19 "Clothoid_Type_Unknown" 18 "Clothoid_Type_UnknownRaised" 17 "Clothoid_Type_ParkedCar" 16 "Clothoid_Type_DelineatorPost" 15 "Clothoid_Type_TrafficCone" 14 "Clothoid_Type_Wall" 13 "Clothoid_Type_Curbstone" 12 "Clothoid_Type_Guardrail" 11 "Clothoid_Type_RoadEdge" 10 "Clothoid_Type_BottsDots" 9 "Clothoid_Type_AsphaltJoint" 8 "Clothoid_Type_CarPool" 7 "Clothoid_Type_MultipleWarning" 6 "Clothoid_Type_Multiple" 5 "Clothoid_Type_DoubleSolid_Solid" 4 "Clothoid_Type_DoubleSolid_Dashed" 3 "Clothoid_Type_DoubleDashed_Solid" 2 "Clothoid_Type_DoubleDashed_Dashed" 1 "Clothoid_Type_DashedLine" 0 "Clothoid_Type_SolidLine" ;
VAL_ 835 Clothoid03_TrackStatus 7 "TrackStatus_NotAvailable" 6 "TrackStatus_Error" 5 "TrackStatus_Spare3" 4 "TrackStatus_Spare2" 3 "TrackStatus_Spare1" 2 "TrackStatus_Invalid" 1 "TrackStatus_Predicted" 0 "TrackStatus_Tracked" ;
VAL_ 834 Clothoid02_Color 7 "Color3bit_NotAvailable" 6 "Color3bit_Error" 5 "Color3bit_Unknow" 4 "Color3bit_Spare" 3 "Color3bit_Blue" 2 "Color3bit_Red" 1 "Color3bit_Yellow" 0 "Color3bit_White" ;
VAL_ 834 Clothoid02_TrackStatus 7 "TrackStatus_NotAvailable" 6 "TrackStatus_Error" 5 "TrackStatus_Spare3" 4 "TrackStatus_Spare2" 3 "TrackStatus_Spare1" 2 "TrackStatus_Invalid" 1 "TrackStatus_Predicted" 0 "TrackStatus_Tracked" ;
VAL_ 834 Clothoid02_Type 31 "Clothoid_Type_NotAvailable" 30 "Clothoid_Type_Error" 29 "Clothoid_Type_Spare10" 28 "Clothoid_Type_Spare9" 27 "Clothoid_Type_Spare8" 26 "Clothoid_Type_Spare7" 25 "Clothoid_Type_Spare6" 24 "Clothoid_Type_Spare5" 23 "Clothoid_Type_Spare4" 22 "Clothoid_Type_Spare3" 21 "Clothoid_Type_Spare2" 20 "Clothoid_Type_Spare1" 19 "Clothoid_Type_Unknown" 18 "Clothoid_Type_UnknownRaised" 17 "Clothoid_Type_ParkedCar" 16 "Clothoid_Type_DelineatorPost" 15 "Clothoid_Type_TrafficCone" 14 "Clothoid_Type_Wall" 13 "Clothoid_Type_Curbstone" 12 "Clothoid_Type_Guardrail" 11 "Clothoid_Type_RoadEdge" 10 "Clothoid_Type_BottsDots" 9 "Clothoid_Type_AsphaltJoint" 8 "Clothoid_Type_CarPool" 7 "Clothoid_Type_MultipleWarning" 6 "Clothoid_Type_Multiple" 5 "Clothoid_Type_DoubleSolid_Solid" 4 "Clothoid_Type_DoubleSolid_Dashed" 3 "Clothoid_Type_DoubleDashed_Solid" 2 "Clothoid_Type_DoubleDashed_Dashed" 1 "Clothoid_Type_DashedLine" 0 "Clothoid_Type_SolidLine" ;
VAL_ 834 Clothoid02_Location 15 "Clothoid_Location_NotAvailable" 14 "Clothoid_Location_Error" 13 "Clothoid_Location_Spare6" 12 "Clothoid_Location_Spare5" 11 "Clothoid_Location_Spare4" 10 "Clothoid_Location_Spare3" 9 "Clothoid_Location_Spare2" 8 "Clothoid_Location_Spare1" 7 "Clothoid_Location_RaisedRight" 6 "Clothoid_Location_RaisedLeft" 5 "Clothoid_Location_RoadEdgeRight" 4 "Clothoid_Location_RoadEdgeLeft" 3 "Clothoid_Location_RightRightLine" 2 "Clothoid_Location_LeftLeftLine" 1 "Clothoid_Location_RightEgoLine" 0 "Clothoid_Location_LeftEgoLine" ;
VAL_ 833 Clothoid01_TrackStatus 7 "TrackStatus_NotAvailable" 6 "TrackStatus_Error" 5 "TrackStatus_Spare3" 4 "TrackStatus_Spare2" 3 "TrackStatus_Spare1" 2 "TrackStatus_Invalid" 1 "TrackStatus_Predicted" 0 "TrackStatus_Tracked" ;
VAL_ 833 Clothoid01_Type 31 "Clothoid_Type_NotAvailable" 30 "Clothoid_Type_Error" 29 "Clothoid_Type_Spare10" 28 "Clothoid_Type_Spare9" 27 "Clothoid_Type_Spare8" 26 "Clothoid_Type_Spare7" 25 "Clothoid_Type_Spare6" 24 "Clothoid_Type_Spare5" 23 "Clothoid_Type_Spare4" 22 "Clothoid_Type_Spare3" 21 "Clothoid_Type_Spare2" 20 "Clothoid_Type_Spare1" 19 "Clothoid_Type_Unknown" 18 "Clothoid_Type_UnknownRaised" 17 "Clothoid_Type_ParkedCar" 16 "Clothoid_Type_DelineatorPost" 15 "Clothoid_Type_TrafficCone" 14 "Clothoid_Type_Wall" 13 "Clothoid_Type_Curbstone" 12 "Clothoid_Type_Guardrail" 11 "Clothoid_Type_RoadEdge" 10 "Clothoid_Type_BottsDots" 9 "Clothoid_Type_AsphaltJoint" 8 "Clothoid_Type_CarPool" 7 "Clothoid_Type_MultipleWarning" 6 "Clothoid_Type_Multiple" 5 "Clothoid_Type_DoubleSolid_Solid" 4 "Clothoid_Type_DoubleSolid_Dashed" 3 "Clothoid_Type_DoubleDashed_Solid" 2 "Clothoid_Type_DoubleDashed_Dashed" 1 "Clothoid_Type_DashedLine" 0 "Clothoid_Type_SolidLine" ;
VAL_ 833 Clothoid01_Location 15 "Clothoid_Location_NotAvailable" 14 "Clothoid_Location_Error" 13 "Clothoid_Location_Spare6" 12 "Clothoid_Location_Spare5" 11 "Clothoid_Location_Spare4" 10 "Clothoid_Location_Spare3" 9 "Clothoid_Location_Spare2" 8 "Clothoid_Location_Spare1" 7 "Clothoid_Location_RaisedRight" 6 "Clothoid_Location_RaisedLeft" 5 "Clothoid_Location_RoadEdgeRight" 4 "Clothoid_Location_RoadEdgeLeft" 3 "Clothoid_Location_RightRightLine" 2 "Clothoid_Location_LeftLeftLine" 1 "Clothoid_Location_RightEgoLine" 0 "Clothoid_Location_LeftEgoLine" ;
VAL_ 833 Clothoid01_Color 7 "Color3bit_NotAvailable" 6 "Color3bit_Error" 5 "Color3bit_Unknow" 4 "Color3bit_Spare" 3 "Color3bit_Blue" 2 "Color3bit_Red" 1 "Color3bit_Yellow" 0 "Color3bit_White" ;
VAL_ 832 Clothoid00_TrackStatus 7 "TrackStatus_NotAvailable" 6 "TrackStatus_Error" 5 "TrackStatus_Spare3" 4 "TrackStatus_Spare2" 3 "TrackStatus_Spare1" 2 "TrackStatus_Invalid" 1 "TrackStatus_Predicted" 0 "TrackStatus_Tracked" ;
VAL_ 832 Clothoid00_Color 7 "Color3bit_NotAvailable" 6 "Color3bit_Error" 5 "Color3bit_Unknow" 4 "Color3bit_Spare" 3 "Color3bit_Blue" 2 "Color3bit_Red" 1 "Color3bit_Yellow" 0 "Color3bit_White" ;
VAL_ 832 Clothoid00_Type 31 "Clothoid_Type_NotAvailable" 30 "Clothoid_Type_Error" 29 "Clothoid_Type_Spare10" 28 "Clothoid_Type_Spare9" 27 "Clothoid_Type_Spare8" 26 "Clothoid_Type_Spare7" 25 "Clothoid_Type_Spare6" 24 "Clothoid_Type_Spare5" 23 "Clothoid_Type_Spare4" 22 "Clothoid_Type_Spare3" 21 "Clothoid_Type_Spare2" 20 "Clothoid_Type_Spare1" 19 "Clothoid_Type_Unknown" 18 "Clothoid_Type_UnknownRaised" 17 "Clothoid_Type_ParkedCar" 16 "Clothoid_Type_DelineatorPost" 15 "Clothoid_Type_TrafficCone" 14 "Clothoid_Type_Wall" 13 "Clothoid_Type_Curbstone" 12 "Clothoid_Type_Guardrail" 11 "Clothoid_Type_RoadEdge" 10 "Clothoid_Type_BottsDots" 9 "Clothoid_Type_AsphaltJoint" 8 "Clothoid_Type_CarPool" 7 "Clothoid_Type_MultipleWarning" 6 "Clothoid_Type_Multiple" 5 "Clothoid_Type_DoubleSolid_Solid" 4 "Clothoid_Type_DoubleSolid_Dashed" 3 "Clothoid_Type_DoubleDashed_Solid" 2 "Clothoid_Type_DoubleDashed_Dashed" 1 "Clothoid_Type_DashedLine" 0 "Clothoid_Type_SolidLine" ;
VAL_ 832 Clothoid00_Location 15 "Clothoid_Location_NotAvailable" 14 "Clothoid_Location_Error" 13 "Clothoid_Location_Spare6" 12 "Clothoid_Location_Spare5" 11 "Clothoid_Location_Spare4" 10 "Clothoid_Location_Spare3" 9 "Clothoid_Location_Spare2" 8 "Clothoid_Location_Spare1" 7 "Clothoid_Location_RaisedRight" 6 "Clothoid_Location_RaisedLeft" 5 "Clothoid_Location_RoadEdgeRight" 4 "Clothoid_Location_RoadEdgeLeft" 3 "Clothoid_Location_RightRightLine" 2 "Clothoid_Location_LeftLeftLine" 1 "Clothoid_Location_RightEgoLine" 0 "Clothoid_Location_LeftEgoLine" ;
VAL_ 824 Brightspot08_Direction 3 "BrightSpotDirection_Error" 2 "BrightSpotDirection_Undetermined" 1 "BrightSpotDirection_Oncoming" 0 "BrightSpotDirection_Preceding" ;
VAL_ 824 Brightspot08_TrackStatus 7 "TrackStatus_NotAvailable" 6 "TrackStatus_Error" 5 "TrackStatus_Spare3" 4 "TrackStatus_Spare2" 3 "TrackStatus_Spare1" 2 "TrackStatus_Invalid" 1 "TrackStatus_Predicted" 0 "TrackStatus_Tracked" ;
VAL_ 824 Brightspot08_MergeObj 3 "MergeObj_NotAvailable" 2 "MergeObj_GreaterThan2BrightSpotObjectMerged" 1 "MergeObj_2BrightSpotObjetMerged" 0 "MergeObj_NotMerged" ;
VAL_ 823 Brightspot07_MergeObj 3 "MergeObj_NotAvailable" 2 "MergeObj_GreaterThan2BrightSpotObjectMerged" 1 "MergeObj_2BrightSpotObjetMerged" 0 "MergeObj_NotMerged" ;
VAL_ 823 Brightspot07_TrackStatus 7 "TrackStatus_NotAvailable" 6 "TrackStatus_Error" 5 "TrackStatus_Spare3" 4 "TrackStatus_Spare2" 3 "TrackStatus_Spare1" 2 "TrackStatus_Invalid" 1 "TrackStatus_Predicted" 0 "TrackStatus_Tracked" ;
VAL_ 823 Brightspot07_Direction 3 "BrightSpotDirection_Error" 2 "BrightSpotDirection_Undetermined" 1 "BrightSpotDirection_Oncoming" 0 "BrightSpotDirection_Preceding" ;
VAL_ 822 Brightspot06_MergeObj 3 "MergeObj_NotAvailable" 2 "MergeObj_GreaterThan2BrightSpotObjectMerged" 1 "MergeObj_2BrightSpotObjetMerged" 0 "MergeObj_NotMerged" ;
VAL_ 822 Brightspot06_TrackStatus 7 "TrackStatus_NotAvailable" 6 "TrackStatus_Error" 5 "TrackStatus_Spare3" 4 "TrackStatus_Spare2" 3 "TrackStatus_Spare1" 2 "TrackStatus_Invalid" 1 "TrackStatus_Predicted" 0 "TrackStatus_Tracked" ;
VAL_ 822 Brightspot06_Direction 3 "BrightSpotDirection_Error" 2 "BrightSpotDirection_Undetermined" 1 "BrightSpotDirection_Oncoming" 0 "BrightSpotDirection_Preceding" ;
VAL_ 821 Brightspot05_TrackStatus 7 "TrackStatus_NotAvailable" 6 "TrackStatus_Error" 5 "TrackStatus_Spare3" 4 "TrackStatus_Spare2" 3 "TrackStatus_Spare1" 2 "TrackStatus_Invalid" 1 "TrackStatus_Predicted" 0 "TrackStatus_Tracked" ;
VAL_ 821 Brightspot05_Direction 3 "BrightSpotDirection_Error" 2 "BrightSpotDirection_Undetermined" 1 "BrightSpotDirection_Oncoming" 0 "BrightSpotDirection_Preceding" ;
VAL_ 821 Brightspot05_MergeObj 3 "MergeObj_NotAvailable" 2 "MergeObj_GreaterThan2BrightSpotObjectMerged" 1 "MergeObj_2BrightSpotObjetMerged" 0 "MergeObj_NotMerged" ;
VAL_ 820 Brightspot04_Direction 3 "BrightSpotDirection_Error" 2 "BrightSpotDirection_Undetermined" 1 "BrightSpotDirection_Oncoming" 0 "BrightSpotDirection_Preceding" ;
VAL_ 820 Brightspot04_TrackStatus 7 "TrackStatus_NotAvailable" 6 "TrackStatus_Error" 5 "TrackStatus_Spare3" 4 "TrackStatus_Spare2" 3 "TrackStatus_Spare1" 2 "TrackStatus_Invalid" 1 "TrackStatus_Predicted" 0 "TrackStatus_Tracked" ;
VAL_ 820 Brightspot04_MergeObj 3 "MergeObj_NotAvailable" 2 "MergeObj_GreaterThan2BrightSpotObjectMerged" 1 "MergeObj_2BrightSpotObjetMerged" 0 "MergeObj_NotMerged" ;
VAL_ 819 Brightspot03_Direction 3 "BrightSpotDirection_Error" 2 "BrightSpotDirection_Undetermined" 1 "BrightSpotDirection_Oncoming" 0 "BrightSpotDirection_Preceding" ;
VAL_ 819 Brightspot03_MergeObj 3 "MergeObj_NotAvailable" 2 "MergeObj_GreaterThan2BrightSpotObjectMerged" 1 "MergeObj_2BrightSpotObjetMerged" 0 "MergeObj_NotMerged" ;
VAL_ 819 Brightspot03_TrackStatus 7 "TrackStatus_NotAvailable" 6 "TrackStatus_Error" 5 "TrackStatus_Spare3" 4 "TrackStatus_Spare2" 3 "TrackStatus_Spare1" 2 "TrackStatus_Invalid" 1 "TrackStatus_Predicted" 0 "TrackStatus_Tracked" ;
VAL_ 818 Brightspot02_TrackStatus 7 "TrackStatus_NotAvailable" 6 "TrackStatus_Error" 5 "TrackStatus_Spare3" 4 "TrackStatus_Spare2" 3 "TrackStatus_Spare1" 2 "TrackStatus_Invalid" 1 "TrackStatus_Predicted" 0 "TrackStatus_Tracked" ;
VAL_ 818 Brightspot02_Direction 3 "BrightSpotDirection_Error" 2 "BrightSpotDirection_Undetermined" 1 "BrightSpotDirection_Oncoming" 0 "BrightSpotDirection_Preceding" ;
VAL_ 818 Brightspot02_MergeObj 3 "MergeObj_NotAvailable" 2 "MergeObj_GreaterThan2BrightSpotObjectMerged" 1 "MergeObj_2BrightSpotObjetMerged" 0 "MergeObj_NotMerged" ;
VAL_ 817 Brightspot01_TrackStatus 7 "TrackStatus_NotAvailable" 6 "TrackStatus_Error" 5 "TrackStatus_Spare3" 4 "TrackStatus_Spare2" 3 "TrackStatus_Spare1" 2 "TrackStatus_Invalid" 1 "TrackStatus_Predicted" 0 "TrackStatus_Tracked" ;
VAL_ 817 Brightspot01_MergeObj 3 "MergeObj_NotAvailable" 2 "MergeObj_GreaterThan2BrightSpotObjectMerged" 1 "MergeObj_2BrightSpotObjetMerged" 0 "MergeObj_NotMerged" ;
VAL_ 817 Brightspot01_Direction 3 "BrightSpotDirection_Error" 2 "BrightSpotDirection_Undetermined" 1 "BrightSpotDirection_Oncoming" 0 "BrightSpotDirection_Preceding" ;
VAL_ 816 Brightspot00_MergeObj 3 "MergeObj_NotAvailable" 2 "MergeObj_GreaterThan2BrightSpotObjectMerged" 1 "MergeObj_2BrightSpotObjetMerged" 0 "MergeObj_NotMerged" ;
VAL_ 816 Brightspot00_TrackStatus 7 "TrackStatus_NotAvailable" 6 "TrackStatus_Error" 5 "TrackStatus_Spare3" 4 "TrackStatus_Spare2" 3 "TrackStatus_Spare1" 2 "TrackStatus_Invalid" 1 "TrackStatus_Predicted" 0 "TrackStatus_Tracked" ;
VAL_ 816 Brightspot00_Direction 3 "BrightSpotDirection_Error" 2 "BrightSpotDirection_Undetermined" 1 "BrightSpotDirection_Oncoming" 0 "BrightSpotDirection_Preceding" ;
VAL_ 512 FwdCam_CalibPausedSpeed 1 "FalseTrue1bit_True" 0 "FalseTrue1bit_False" ;
VAL_ 512 FwdSensingCamStat_TSRDetect 7 "SensorStatus3bit_NotAvailable" 6 "SensorStatus3bit_Error" 5 "SensorStatus3bit_Spare2" 4 "SensorStatus3bit_Spare1" 3 "SensorStatus3bit_NotOperational" 2 "SensorStatus3bit_Initialisation" 1 "SensorStatus3bit_ReducedMode" 0 "SensorStatus3bit_FullyOperational" ;
VAL_ 512 FwdSensingCamStat_ClothoidDetect 7 "SensorStatus3bit_NotAvailable" 6 "SensorStatus3bit_Error" 5 "SensorStatus3bit_Spare2" 4 "SensorStatus3bit_Spare1" 3 "SensorStatus3bit_NotOperational" 2 "SensorStatus3bit_Initialisation" 1 "SensorStatus3bit_ReducedMode" 0 "SensorStatus3bit_FullyOperational" ;
VAL_ 512 FwdSensingCamStat_DecalibDetect 7 "DecalibrationDetection_NotAvailable" 6 "DecalibrationDetection_Error" 5 "DecalibrationDetection_CalibrationNotVerified" 4 "DecalibrationDetection_Spare3" 3 "DecalibrationDetection_Spare2" 2 "DecalibrationDetection_Spare1" 1 "DecalibrationDetection_NotCalibrated" 0 "DecalibrationDetection_FullyCalibrated" ;
VAL_ 512 FwdSensingCamStat_BrighSpot 7 "SensorStatus3bit_NotAvailable" 6 "SensorStatus3bit_Error" 5 "SensorStatus3bit_Spare2" 4 "SensorStatus3bit_Spare1" 3 "SensorStatus3bit_NotOperational" 2 "SensorStatus3bit_Initialisation" 1 "SensorStatus3bit_ReducedMode" 0 "SensorStatus3bit_FullyOperational" ;
VAL_ 512 FwdCam_CalibState 3 "CalibState_NotAvailable" 2 "CalibState_Failure" 1 "CalibState_Running" 0 "CalibState_Success" ;
VAL_ 512 ForwardLookingCameraStatus2 15 "CameraStatus2_NotAvailable" 14 "CameraStatus2_Error" 13 "CameraStatus2_Spare05" 12 "CameraStatus2_Spare04" 11 "CameraStatus2_Spare03" 10 "CameraStatus2_Spare02" 9 "CameraStatus2_ReducedMode" 8 "CameraStatus2_Spare01" 7 "CameraStatus2_ShutDownCompleted" 6 "CameraStatus2_ShutDownInitiated" 5 "CameraStatus2_CalibrationOngoing" 4 "CameraStatus2_NotCalibrated" 3 "CameraStatus2_Misaligned" 2 "CameraStatus2_Blocked" 1 "CameraStatus2_WarmingUp" 0 "CameraStatus2_FullyOperational" ;
VAL_ 512 FwdCam_CalibPausedYaw 1 "FalseTrue1bit_True" 0 "FalseTrue1bit_False" ;
VAL_ 512 FwdCam_CalibPausedAcc 1 "FalseTrue1bit_True" 0 "FalseTrue1bit_False" ;
VAL_ 512 FwdLookingCamStat3_Status 15 "CameraStatus2_NotAvailable" 14 "CameraStatus2_Error" 13 "CameraStatus2_Spare05" 12 "CameraStatus2_Spare04" 11 "CameraStatus2_Spare03" 10 "CameraStatus2_Spare02" 9 "CameraStatus2_ReducedMode" 8 "CameraStatus2_Spare01" 7 "CameraStatus2_ShutDownCompleted" 6 "CameraStatus2_ShutDownInitiated" 5 "CameraStatus2_CalibrationOngoing" 4 "CameraStatus2_NotCalibrated" 3 "CameraStatus2_Misaligned" 2 "CameraStatus2_Blocked" 1 "CameraStatus2_WarmingUp" 0 "CameraStatus2_FullyOperational" ;
VAL_ 512 FwdSensingCamStat_TargetDetect 7 "SensorStatus3bit_NotAvailable" 6 "SensorStatus3bit_Error" 5 "SensorStatus3bit_Spare2" 4 "SensorStatus3bit_Spare1" 3 "SensorStatus3bit_NotOperational" 2 "SensorStatus3bit_Initialisation" 1 "SensorStatus3bit_ReducedMode" 0 "SensorStatus3bit_FullyOperational" ;
VAL_ 807 FLCObject23_TrackStatus 7 "TrackStatus_NotAvailable" 6 "TrackStatus_Error" 5 "TrackStatus_Spare3" 4 "TrackStatus_Spare2" 3 "TrackStatus_Spare1" 2 "TrackStatus_Invalid" 1 "TrackStatus_Predicted" 0 "TrackStatus_Tracked" ;
VAL_ 807 FLCObject23_BrakeLight 7 "BrakeLight_NotAvailable" 6 "BrakeLight_Error" 5 "BrakeLight_Spare" 4 "BrakeLight_BrakeLightThree" 3 "BrakeLight_BrakeLightTwo" 2 "BrakeLight_BrakeLightOne" 1 "BrakeLight_NoBrakeLight" 0 "BrakeLight_BrakeLightUnknown" ;
VAL_ 807 FLCObject23_ReliabilityConf 7 "ReliabilityConf_NotAvailable" 6 "ReliabilityConf_Error" 5 "ReliabilityConf_Spare2" 4 "ReliabilityConf_Spare1" 3 "ReliabilityConf_Restricted" 2 "ReliabilityConf_ASIL_B" 1 "ReliabilityConf_CNNConfirmed_ObjectShape" 0 "ReliabilityConf_ConfirmedbyGenericStream" ;
VAL_ 807 FLCObject23_TargetToLine 7 "TargetToLine_NotAvailable" 6 "TargetToLine_Error" 5 "TargetToLine_Unknown" 4 "TargetToLine_OnTheLeftEgoLine" 3 "TargetToLine_OnTheRightEgoLine" 2 "TargetToLine_BetweenRightAndLeftEgoLine" 1 "TargetToLine_LeftSideOfTheLeftEgoLine" 0 "TargetToLine_RightSideOfTheRightEgoLine" ;
VAL_ 807 FLCObject23_ObjDynClass 3 "ObjDynClass_Error" 2 "ObjDynClass_Movable" 1 "ObjDynClass_Stationary" 0 "ObjDynClass_Reserved" ;
VAL_ 807 FLCObject23_TurnIndication 7 "TurnIndication_NotAvailable" 6 "TurnIndication_Error" 5 "TurnIndication_Spare" 4 "TurnIndication_DirectionIndicatorBoth" 3 "TurnIndication_DirectionIndicatorRight" 2 "TurnIndication_DirectionIndicatorLeft" 1 "TurnIndication_NoDirectionIndicator" 0 "TurnIndication_Unknown" ;
VAL_ 807 FLCObject23_ObjClass 15 "ObjClassSideS_NotAvailable" 14 "ObjClassSideS_Error" 13 "ObjClassSideS_Spare4" 12 "ObjClassSideS_Spare3" 11 "ObjClassSideS_Motorcycle" 10 "ObjClassSideS_Bicycle" 9 "ObjClassSideS_UnidentifiedMovableObject" 8 "ObjClassSideS_UnidentifiedVRU" 7 "ObjClassSideS_UnidentifiedVehicle" 6 "ObjClassSideS_StaticObject" 5 "ObjClassSideS_Pedestrian" 4 "ObjClassSideS_2Wheeler" 3 "ObjClassSideS_HeavyVehicle" 2 "ObjClassSideS_Car" 1 "ObjClassSideS_Obstacle" 0 "ObjClassSideS_Undetermined" ;
SIG_GROUP_ 839 Clothoid07_sg 1 : Clothoid07_TrackStatus Clothoid07_Curvature Clothoid07_LifeTime Clothoid07_CRC Clothoid07_Counter Clothoid07_CurvatureRate Clothoid07_Confidence Clothoid07_LatDistVar Clothoid07_Type Clothoid07_HeadingAngle Clothoid07_LatDist Clothoid07_CoastIndex Clothoid07_TimeStamp Clothoid07_DxStart Clothoid07_Location Clothoid07_Color Clothoid07_DxEnd Clothoid07_Width;
SIG_GROUP_ 838 Clothoid06_sg 1 : Clothoid06_Type Clothoid06_Width Clothoid06_LatDistVar Clothoid06_Location Clothoid06_Color Clothoid06_Curvature Clothoid06_DxEnd Clothoid06_HeadingAngle Clothoid06_Counter Clothoid06_TrackStatus Clothoid06_CRC Clothoid06_LifeTime Clothoid06_LatDist Clothoid06_CoastIndex Clothoid06_CurvatureRate Clothoid06_TimeStamp Clothoid06_DxStart Clothoid06_Confidence;
SIG_GROUP_ 837 Clothoid05_sg 1 : Clothoid05_CurvatureRate Clothoid05_LifeTime Clothoid05_Counter Clothoid05_DxEnd Clothoid05_Curvature Clothoid05_DxStart Clothoid05_CRC Clothoid05_Color Clothoid05_TimeStamp Clothoid05_Confidence Clothoid05_HeadingAngle Clothoid05_LatDistVar Clothoid05_LatDist Clothoid05_Location Clothoid05_Type Clothoid05_CoastIndex Clothoid05_TrackStatus Clothoid05_Width;
SIG_GROUP_ 836 Clothoid04_sg 1 : Clothoid04_DxEnd Clothoid04_Width Clothoid04_Counter Clothoid04_LifeTime Clothoid04_Confidence Clothoid04_LatDist Clothoid04_LatDistVar Clothoid04_Type Clothoid04_Location Clothoid04_TrackStatus Clothoid04_CRC Clothoid04_CoastIndex Clothoid04_Curvature Clothoid04_DxStart Clothoid04_CurvatureRate Clothoid04_HeadingAngle Clothoid04_Color Clothoid04_TimeStamp;
SIG_GROUP_ 835 Clothoid03_sg 1 : Clothoid03_Curvature Clothoid03_LatDist Clothoid03_LifeTime Clothoid03_Location Clothoid03_CurvatureRate Clothoid03_Width Clothoid03_HeadingAngle Clothoid03_LatDistVar Clothoid03_DxEnd Clothoid03_Counter Clothoid03_Color Clothoid03_Type Clothoid03_CoastIndex Clothoid03_TimeStamp Clothoid03_DxStart Clothoid03_Confidence Clothoid03_TrackStatus Clothoid03_CRC;
SIG_GROUP_ 834 Clothoid02_sg 1 : Clothoid02_Confidence Clothoid02_CurvatureRate Clothoid02_LifeTime Clothoid02_DxStart Clothoid02_DxEnd Clothoid02_Color Clothoid02_CoastIndex Clothoid02_LatDistVar Clothoid02_Width Clothoid02_TrackStatus Clothoid02_Curvature Clothoid02_TimeStamp Clothoid02_Type Clothoid02_HeadingAngle Clothoid02_LatDist Clothoid02_CRC Clothoid02_Counter Clothoid02_Location;
SIG_GROUP_ 833 Clothoid01_sg 1 : Clothoid01_HeadingAngle Clothoid01_DxEnd Clothoid01_LatDist Clothoid01_Width Clothoid01_DxStart Clothoid01_CurvatureRate Clothoid01_LifeTime Clothoid01_TrackStatus Clothoid01_Type Clothoid01_Curvature Clothoid01_Location Clothoid01_Color Clothoid01_CoastIndex Clothoid01_LatDistVar Clothoid01_Counter Clothoid01_CRC Clothoid01_TimeStamp Clothoid01_Confidence;
SIG_GROUP_ 832 Clothoid00_sg 1 : Clothoid00_DxStart Clothoid00_LatDistVar Clothoid00_Width Clothoid00_Confidence Clothoid00_TimeStamp Clothoid00_DxEnd Clothoid00_TrackStatus Clothoid00_Color Clothoid00_Curvature Clothoid00_CurvatureRate Clothoid00_Type Clothoid00_HeadingAngle Clothoid00_CRC Clothoid00_Location Clothoid00_LifeTime Clothoid00_Counter Clothoid00_CoastIndex Clothoid00_LatDist;
SIG_GROUP_ 824 Brightspot08_sg 1 : Brightspot08_RightAngleVar Brightspot08_RightAngle Brightspot08_Direction Brightspot08_LifeTime Brightspot08_RightAngVelocity Brightspot08_LeftAngleVar Brightspot08_TrackStatus Brightspot08_ID Brightspot08_TimeStamp Brightspot08_ExistConf Brightspot08_LeftAngVelocity Brightspot08_DistanceVar Brightspot08_Distance Brightspot08_MergeObj Brightspot08_LeftAngle;
SIG_GROUP_ 823 Brightspot07_sg 1 : Brightspot07_RightAngleVar Brightspot07_DistanceVar Brightspot07_LeftAngVelocity Brightspot07_TimeStamp Brightspot07_MergeObj Brightspot07_LifeTime Brightspot07_TrackStatus Brightspot07_Direction Brightspot07_Distance Brightspot07_LeftAngleVar Brightspot07_ExistConf Brightspot07_RightAngle Brightspot07_RightAngVelocity Brightspot07_ID Brightspot07_LeftAngle;
SIG_GROUP_ 822 Brightspot06_sg 1 : Brightspot06_Distance Brightspot06_RightAngle Brightspot06_MergeObj Brightspot06_LeftAngleVar Brightspot06_ExistConf Brightspot06_LeftAngle Brightspot06_TrackStatus Brightspot06_Direction Brightspot06_DistanceVar Brightspot06_LeftAngVelocity Brightspot06_RightAngleVar Brightspot06_LifeTime Brightspot06_ID Brightspot06_RightAngVelocity Brightspot06_TimeStamp;
SIG_GROUP_ 821 Brightspot05_sg 1 : Brightspot05_LeftAngleVar Brightspot05_LeftAngVelocity Brightspot05_LeftAngle Brightspot05_TrackStatus Brightspot05_TimeStamp Brightspot05_Distance Brightspot05_Direction Brightspot05_ID Brightspot05_ExistConf Brightspot05_LifeTime Brightspot05_DistanceVar Brightspot05_RightAngle Brightspot05_MergeObj Brightspot05_RightAngleVar Brightspot05_RightAngVelocity;
SIG_GROUP_ 820 Brightspot04_sg 1 : Brightspot04_Direction Brightspot04_TrackStatus Brightspot04_LeftAngleVar Brightspot04_RightAngleVar Brightspot04_ID Brightspot04_LeftAngVelocity Brightspot04_RightAngVelocity Brightspot04_ExistConf Brightspot04_RightAngle Brightspot04_LifeTime Brightspot04_Distance Brightspot04_DistanceVar Brightspot04_MergeObj Brightspot04_LeftAngle Brightspot04_TimeStamp;
SIG_GROUP_ 819 Brightspot03_sg 1 : Brightspot03_ID Brightspot03_DistanceVar Brightspot03_Distance Brightspot03_RightAngVelocity Brightspot03_RightAngleVar Brightspot03_RightAngle Brightspot03_ExistConf Brightspot03_Direction Brightspot03_MergeObj Brightspot03_TrackStatus Brightspot03_LifeTime Brightspot03_LeftAngleVar Brightspot03_TimeStamp Brightspot03_LeftAngVelocity Brightspot03_LeftAngle;
SIG_GROUP_ 818 Brightspot02_sg 1 : Brightspot02_RightAngVelocity Brightspot02_LeftAngle Brightspot02_Distance Brightspot02_TrackStatus Brightspot02_ID Brightspot02_Direction Brightspot02_RightAngle Brightspot02_MergeObj Brightspot02_LeftAngleVar Brightspot02_DistanceVar Brightspot02_ExistConf Brightspot02_LifeTime Brightspot02_RightAngleVar Brightspot02_LeftAngVelocity Brightspot02_TimeStamp;
SIG_GROUP_ 817 Brightspot01_sg 1 : Brightspot01_TrackStatus Brightspot01_MergeObj Brightspot01_LifeTime Brightspot01_RightAngle Brightspot01_ID Brightspot01_Distance Brightspot01_TimeStamp Brightspot01_LeftAngleVar Brightspot01_RightAngVelocity Brightspot01_ExistConf Brightspot01_Direction Brightspot01_RightAngleVar Brightspot01_DistanceVar Brightspot01_LeftAngVelocity Brightspot01_LeftAngle;
SIG_GROUP_ 816 Brightspot00_sg 1 : Brightspot00_DistanceVar Brightspot00_MergeObj Brightspot00_LeftAngle Brightspot00_LeftAngVelocity Brightspot00_RightAngVelocity Brightspot00_TrackStatus Brightspot00_Distance Brightspot00_RightAngleVar Brightspot00_RightAngle Brightspot00_Direction Brightspot00_ExistConf Brightspot00_TimeStamp Brightspot00_LifeTime Brightspot00_LeftAngleVar Brightspot00_ID;
SIG_GROUP_ 512 FwdCam_sg 1 : FwdCam_CalibPausedSpeed FwdCam_CalibState FwdCam_CalibProgress FwdCam_CalibPausedYaw FwdCam_CalibPausedAcc;
SIG_GROUP_ 512 FwdSensingCamStat_sg 1 : FwdSensingCamStat_CRC FwdSensingCamStat_TSRDetect FwdSensingCamStat_ClothoidDetect FwdSensingCamStat_DecalibDetect FwdSensingCamStat_BrighSpot FwdSensingCamStat_TimeStamp FwdSensingCamStat_TimeSynch FwdSensingCamStat_Counter FwdSensingCamStat_TargetDetect;
SIG_GROUP_ 512 FwdLookingCamStat3_sg 1 : FwdLookingCamStat3_SqC FwdLookingCamStat3_CRC FwdLookingCamStat3_Status;
SIG_GROUP_ 1553 FLCSwVersion_sg 1 : FLCSwVersion_Substring4 FLCSwVersion_Substring5 FLCSwVersion_Substring1 FLCSwVersion_Substring3 FLCSwVersion_Substring6 FLCSwVersion_Substring2 FLCSwVersion_Substring7 FLCSwVersion_Substring0;
SIG_GROUP_ 807 FLCObject23_sg 1 : FLCObject23_LongVel FLCObject23_DstRightVar FLCObject23_TrackStatus FLCObject23_Counter FLCObject23_BrakeLight FLCObject23_CoastIndex FLCObject23_DstFarVar FLCObject23_LifeTime FLCObject23_AnglFarCorner FLCObject23_ReliabilityConf FLCObject23_AnglLeftCorner FLCObject23_DistRightCorner FLCObject23_AngLeftVar FLCObject23_TargetToLine FLCObject23_ScaleChange FLCObject23_ObjDynClass FLCObject23_CRC FLCObject23_ExistConf FLCObject23_TurnIndication FLCObject23_AngFarVar FLCObject23_LongPos FLCObject23_ObjID FLCObject23_LongVelVar FLCObject23_LatVelVar FLCObject23_ObjClass FLCObject23_DistFarCorner FLCObject23_AngRightVar FLCObject23_LatVel FLCObject23_TimeStamp FLCObject23_HeadingVar FLCObject23_DstLeftVar FLCObject23_DistLeftCorner FLCObject23_LatPosVar FLCObject23_LongPosVar FLCObject23_LongAcc FLCObject23_LatPos FLCObject23_LatAcc FLCObject23_Height FLCObject23_Heading FLCObject23_AnglRightCorner;
