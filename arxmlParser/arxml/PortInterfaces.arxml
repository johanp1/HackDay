AUTOSAR XML (schema 00046)
package /Predefined_DEV/PortInterfaces
  22 x client server interface, all with is-service=true:
    NvMAdministration
      operation SetBlockProtection: possible-error=NvMAdministration/E_NOT_OK
        arg ProtectionEnabled: type=boolean, direction=IN, server-argument-impl-policy=USE-ARGUMENT-TYPE
      error E_NOT_OK: error-code=1
    NvMNotifyInitBlock
      operation InitBlock
    NvMNotifyJobFinished
      operation JobFinished
        arg ServiceId: type=NvM_ServiceIdType, direction=IN, server-argument-impl-policy=USE-ARGUMENT-TYPE
        arg JobResult: type=NvM_RequestResultType, direction=IN, server-argument-impl-policy=USE-ARGUMENT-TYPE
    NvMService
      operation GetErrorStatus: possible-error=NvMService/E_NOT_OK
        arg ErrorStatus: type=NvM_RequestResultType, direction=OUT, server-argument-impl-policy=USE-ARGUMENT-TYPE
      error E_NOT_OK: error-code=1
    NvMService_AC2
      operation GetErrorStatus: possible-error=NvMService_AC2/E_NOT_OK
        arg ErrorStatus: type=NvM_RequestResultType, direction=OUT, server-argument-impl-policy=USE-ARGUMENT-TYPE
      operation ReadBlock: possible-error=NvMService_AC2/E_NOT_OK
        arg DstPtr: type=dtRef_VOID, direction=IN, server-argument-impl-policy=USE-ARGUMENT-TYPE
      operation WriteBlock: possible-error=NvMService_AC2/E_NOT_OK
        arg SrcPtr: type=dtRef_const_VOID, direction=IN, server-argument-impl-policy=USE-ARGUMENT-TYPE
      error E_NOT_OK: error-code=1
    NvMService_AC2_Defs
      4 x operation, all with possible-error=NvMService_AC2_Defs/E_NOT_OK:
        GetErrorStatus
          arg ErrorStatus: type=NvM_RequestResultType, direction=OUT, server-argument-impl-policy=USE-ARGUMENT-TYPE
        ReadBlock
          arg DstPtr: type=dtRef_VOID, direction=IN, server-argument-impl-policy=USE-ARGUMENT-TYPE
        RestoreBlockDefaults
          arg DstPtr: type=dtRef_VOID, direction=IN, server-argument-impl-policy=USE-ARGUMENT-TYPE
        WriteBlock
          arg SrcPtr: type=dtRef_const_VOID, direction=IN, server-argument-impl-policy=USE-ARGUMENT-TYPE
      error E_NOT_OK: error-code=1
    NvMService_AC2_DS
      5 x operation, all with possible-error=NvMService_AC2_DS/E_NOT_OK:
        GetDataIndex
          arg DataIndex: type=uint8, direction=OUT, server-argument-impl-policy=USE-ARGUMENT-TYPE
        GetErrorStatus
          arg ErrorStatus: type=NvM_RequestResultType, direction=OUT, server-argument-impl-policy=USE-ARGUMENT-TYPE
        ReadBlock
          arg DstPtr: type=dtRef_VOID, direction=IN, server-argument-impl-policy=USE-ARGUMENT-TYPE
        SetDataIndex
          arg DataIndex: type=uint8, direction=IN, server-argument-impl-policy=USE-ARGUMENT-TYPE
        WriteBlock
          arg SrcPtr: type=dtRef_const_VOID, direction=IN, server-argument-impl-policy=USE-ARGUMENT-TYPE
      error E_NOT_OK: error-code=1
    NvMService_AC2_DS_Defs
      6 x operation, all with possible-error=NvMService_AC2_DS_Defs/E_NOT_OK:
        GetDataIndex
          arg DataIndex: type=uint8, direction=OUT, server-argument-impl-policy=USE-ARGUMENT-TYPE
        GetErrorStatus
          arg ErrorStatus: type=NvM_RequestResultType, direction=OUT, server-argument-impl-policy=USE-ARGUMENT-TYPE
        ReadBlock
          arg DstPtr: type=dtRef_VOID, direction=IN, server-argument-impl-policy=USE-ARGUMENT-TYPE
        RestoreBlockDefaults
          arg DstPtr: type=dtRef_VOID, direction=IN, server-argument-impl-policy=USE-ARGUMENT-TYPE
        SetDataIndex
          arg DataIndex: type=uint8, direction=IN, server-argument-impl-policy=USE-ARGUMENT-TYPE
        WriteBlock
          arg SrcPtr: type=dtRef_const_VOID, direction=IN, server-argument-impl-policy=USE-ARGUMENT-TYPE
      error E_NOT_OK: error-code=1
    NvMService_AC2_SRBS
      4 x operation, all with possible-error=NvMService_AC2_SRBS/E_NOT_OK:
        GetErrorStatus
          arg ErrorStatus: type=NvM_RequestResultType, direction=OUT, server-argument-impl-policy=USE-ARGUMENT-TYPE
        ReadBlock
          arg DstPtr: type=dtRef_VOID, direction=IN, server-argument-impl-policy=USE-ARGUMENT-TYPE
        SetRamBlockStatus
          arg RamBlockStatus: type=boolean, direction=IN, server-argument-impl-policy=USE-ARGUMENT-TYPE
        WriteBlock
          arg SrcPtr: type=dtRef_const_VOID, direction=IN, server-argument-impl-policy=USE-ARGUMENT-TYPE
      error E_NOT_OK: error-code=1
    NvMService_AC2_SRBS_Defs
      5 x operation, all with possible-error=NvMService_AC2_SRBS_Defs/E_NOT_OK:
        GetErrorStatus
          arg ErrorStatus: type=NvM_RequestResultType, direction=OUT, server-argument-impl-policy=USE-ARGUMENT-TYPE
        ReadBlock
          arg DstPtr: type=dtRef_VOID, direction=IN, server-argument-impl-policy=USE-ARGUMENT-TYPE
        RestoreBlockDefaults
          arg DstPtr: type=dtRef_VOID, direction=IN, server-argument-impl-policy=USE-ARGUMENT-TYPE
        SetRamBlockStatus
          arg RamBlockStatus: type=boolean, direction=IN, server-argument-impl-policy=USE-ARGUMENT-TYPE
        WriteBlock
          arg SrcPtr: type=dtRef_const_VOID, direction=IN, server-argument-impl-policy=USE-ARGUMENT-TYPE
      error E_NOT_OK: error-code=1
    NvMService_AC2_SRBS_DS
      6 x operation, all with possible-error=NvMService_AC2_SRBS_DS/E_NOT_OK:
        GetDataIndex
          arg DataIndex: type=uint8, direction=OUT, server-argument-impl-policy=USE-ARGUMENT-TYPE
        GetErrorStatus
          arg ErrorStatus: type=NvM_RequestResultType, direction=OUT, server-argument-impl-policy=USE-ARGUMENT-TYPE
        ReadBlock
          arg DstPtr: type=dtRef_VOID, direction=IN, server-argument-impl-policy=USE-ARGUMENT-TYPE
        SetDataIndex
          arg DataIndex: type=uint8, direction=IN, server-argument-impl-policy=USE-ARGUMENT-TYPE
        SetRamBlockStatus
          arg RamBlockStatus: type=boolean, direction=IN, server-argument-impl-policy=USE-ARGUMENT-TYPE
        WriteBlock
          arg SrcPtr: type=dtRef_const_VOID, direction=IN, server-argument-impl-policy=USE-ARGUMENT-TYPE
      error E_NOT_OK: error-code=1
    NvMService_AC2_SRBS_DS_Defs
      7 x operation, all with possible-error=NvMService_AC2_SRBS_DS_Defs/E_NOT_OK:
        GetDataIndex
          arg DataIndex: type=uint8, direction=OUT, server-argument-impl-policy=USE-ARGUMENT-TYPE
        GetErrorStatus
          arg ErrorStatus: type=NvM_RequestResultType, direction=OUT, server-argument-impl-policy=USE-ARGUMENT-TYPE
        ReadBlock
          arg DstPtr: type=dtRef_VOID, direction=IN, server-argument-impl-policy=USE-ARGUMENT-TYPE
        RestoreBlockDefaults
          arg DstPtr: type=dtRef_VOID, direction=IN, server-argument-impl-policy=USE-ARGUMENT-TYPE
        SetDataIndex
          arg DataIndex: type=uint8, direction=IN, server-argument-impl-policy=USE-ARGUMENT-TYPE
        SetRamBlockStatus
          arg RamBlockStatus: type=boolean, direction=IN, server-argument-impl-policy=USE-ARGUMENT-TYPE
        WriteBlock
          arg SrcPtr: type=dtRef_const_VOID, direction=IN, server-argument-impl-policy=USE-ARGUMENT-TYPE
      error E_NOT_OK: error-code=1
    NvMService_AC3
      5 x operation, all with possible-error=NvMService_AC3/E_NOT_OK:
        EraseBlock
        GetErrorStatus
          arg ErrorStatus: type=NvM_RequestResultType, direction=OUT, server-argument-impl-policy=USE-ARGUMENT-TYPE
        InvalidateNvBlock
        ReadBlock
          arg DstPtr: type=dtRef_VOID, direction=IN, server-argument-impl-policy=USE-ARGUMENT-TYPE
        WriteBlock
          arg SrcPtr: type=dtRef_const_VOID, direction=IN, server-argument-impl-policy=USE-ARGUMENT-TYPE
      error E_NOT_OK: error-code=1
    NvMService_AC3_Defs
      6 x operation, all with possible-error=NvMService_AC3_Defs/E_NOT_OK:
        EraseBlock
        GetErrorStatus
          arg ErrorStatus: type=NvM_RequestResultType, direction=OUT, server-argument-impl-policy=USE-ARGUMENT-TYPE
        InvalidateNvBlock
        ReadBlock
          arg DstPtr: type=dtRef_VOID, direction=IN, server-argument-impl-policy=USE-ARGUMENT-TYPE
        RestoreBlockDefaults
          arg DstPtr: type=dtRef_VOID, direction=IN, server-argument-impl-policy=USE-ARGUMENT-TYPE
        WriteBlock
          arg SrcPtr: type=dtRef_const_VOID, direction=IN, server-argument-impl-policy=USE-ARGUMENT-TYPE
      error E_NOT_OK: error-code=1
    NvMService_AC3_DS
      7 x operation, all with possible-error=NvMService_AC3_DS/E_NOT_OK:
        EraseBlock
        GetDataIndex
          arg DataIndex: type=uint8, direction=OUT, server-argument-impl-policy=USE-ARGUMENT-TYPE
        GetErrorStatus
          arg ErrorStatus: type=NvM_RequestResultType, direction=OUT, server-argument-impl-policy=USE-ARGUMENT-TYPE
        InvalidateNvBlock
        ReadBlock
          arg DstPtr: type=dtRef_VOID, direction=IN, server-argument-impl-policy=USE-ARGUMENT-TYPE
        SetDataIndex
          arg DataIndex: type=uint8, direction=IN, server-argument-impl-policy=USE-ARGUMENT-TYPE
        WriteBlock
          arg SrcPtr: type=dtRef_const_VOID, direction=IN, server-argument-impl-policy=USE-ARGUMENT-TYPE
      error E_NOT_OK: error-code=1
    NvMService_AC3_DS_Defs
      8 x operation, all with possible-error=NvMService_AC3_DS_Defs/E_NOT_OK:
        EraseBlock
        GetDataIndex
          arg DataIndex: type=uint8, direction=OUT, server-argument-impl-policy=USE-ARGUMENT-TYPE
        GetErrorStatus
          arg ErrorStatus: type=NvM_RequestResultType, direction=OUT, server-argument-impl-policy=USE-ARGUMENT-TYPE
        InvalidateNvBlock
        ReadBlock
          arg DstPtr: type=dtRef_VOID, direction=IN, server-argument-impl-policy=USE-ARGUMENT-TYPE
        RestoreBlockDefaults
          arg DstPtr: type=dtRef_VOID, direction=IN, server-argument-impl-policy=USE-ARGUMENT-TYPE
        SetDataIndex
          arg DataIndex: type=uint8, direction=IN, server-argument-impl-policy=USE-ARGUMENT-TYPE
        WriteBlock
          arg SrcPtr: type=dtRef_const_VOID, direction=IN, server-argument-impl-policy=USE-ARGUMENT-TYPE
      error E_NOT_OK: error-code=1
    NvMService_AC3_SRBS
      6 x operation, all with possible-error=NvMService_AC3_SRBS/E_NOT_OK:
        EraseBlock
        GetErrorStatus
          arg ErrorStatus: type=NvM_RequestResultType, direction=OUT, server-argument-impl-policy=USE-ARGUMENT-TYPE
        InvalidateNvBlock
        ReadBlock
          arg DstPtr: type=dtRef_VOID, direction=IN, server-argument-impl-policy=USE-ARGUMENT-TYPE
        SetRamBlockStatus
          arg RamBlockStatus: type=boolean, direction=IN, server-argument-impl-policy=USE-ARGUMENT-TYPE
        WriteBlock
          arg SrcPtr: type=dtRef_const_VOID, direction=IN, server-argument-impl-policy=USE-ARGUMENT-TYPE
      error E_NOT_OK: error-code=1
    NvMService_AC3_SRBS_Defs
      7 x operation, all with possible-error=NvMService_AC3_SRBS_Defs/E_NOT_OK:
        EraseBlock
        GetErrorStatus
          arg ErrorStatus: type=NvM_RequestResultType, direction=OUT, server-argument-impl-policy=USE-ARGUMENT-TYPE
        InvalidateNvBlock
        ReadBlock
          arg DstPtr: type=dtRef_VOID, direction=IN, server-argument-impl-policy=USE-ARGUMENT-TYPE
        RestoreBlockDefaults
          arg DstPtr: type=dtRef_VOID, direction=IN, server-argument-impl-policy=USE-ARGUMENT-TYPE
        SetRamBlockStatus
          arg RamBlockStatus: type=boolean, direction=IN, server-argument-impl-policy=USE-ARGUMENT-TYPE
        WriteBlock
          arg SrcPtr: type=dtRef_const_VOID, direction=IN, server-argument-impl-policy=USE-ARGUMENT-TYPE
      error E_NOT_OK: error-code=1
    NvMService_AC3_SRBS_DS
      8 x operation, all with possible-error=NvMService_AC3_SRBS_DS/E_NOT_OK:
        EraseBlock
        GetDataIndex
          arg DataIndex: type=uint8, direction=OUT, server-argument-impl-policy=USE-ARGUMENT-TYPE
        GetErrorStatus
          arg ErrorStatus: type=NvM_RequestResultType, direction=OUT, server-argument-impl-policy=USE-ARGUMENT-TYPE
        InvalidateNvBlock
        ReadBlock
          arg DstPtr: type=dtRef_VOID, direction=IN, server-argument-impl-policy=USE-ARGUMENT-TYPE
        SetDataIndex
          arg DataIndex: type=uint8, direction=IN, server-argument-impl-policy=USE-ARGUMENT-TYPE
        SetRamBlockStatus
          arg RamBlockStatus: type=boolean, direction=IN, server-argument-impl-policy=USE-ARGUMENT-TYPE
        WriteBlock
          arg SrcPtr: type=dtRef_const_VOID, direction=IN, server-argument-impl-policy=USE-ARGUMENT-TYPE
      error E_NOT_OK: error-code=1
    NvMService_AC3_SRBS_DS_Defs
      9 x operation, all with possible-error=NvMService_AC3_SRBS_DS_Defs/E_NOT_OK:
        EraseBlock
        GetDataIndex
          arg DataIndex: type=uint8, direction=OUT, server-argument-impl-policy=USE-ARGUMENT-TYPE
        GetErrorStatus
          arg ErrorStatus: type=NvM_RequestResultType, direction=OUT, server-argument-impl-policy=USE-ARGUMENT-TYPE
        InvalidateNvBlock
        ReadBlock
          arg DstPtr: type=dtRef_VOID, direction=IN, server-argument-impl-policy=USE-ARGUMENT-TYPE
        RestoreBlockDefaults
          arg DstPtr: type=dtRef_VOID, direction=IN, server-argument-impl-policy=USE-ARGUMENT-TYPE
        SetDataIndex
          arg DataIndex: type=uint8, direction=IN, server-argument-impl-policy=USE-ARGUMENT-TYPE
        SetRamBlockStatus
          arg RamBlockStatus: type=boolean, direction=IN, server-argument-impl-policy=USE-ARGUMENT-TYPE
        WriteBlock
          arg SrcPtr: type=dtRef_const_VOID, direction=IN, server-argument-impl-policy=USE-ARGUMENT-TYPE
      error E_NOT_OK: error-code=1
    NvMService_SRBS
      operation GetErrorStatus: possible-error=NvMService_SRBS/E_NOT_OK
        arg ErrorStatus: type=NvM_RequestResultType, direction=OUT, server-argument-impl-policy=USE-ARGUMENT-TYPE
      operation SetRamBlockStatus: possible-error=NvMService_SRBS/E_NOT_OK
        arg RamBlockStatus: type=boolean, direction=IN, server-argument-impl-policy=USE-ARGUMENT-TYPE
      error E_NOT_OK: error-code=1
    CallbackDTCStatusChange: service-kind=DIAGNOSTIC-EVENT-MANAGER
      operation DTCStatusChanged: possible-error=CallbackDTCStatusChange/E_NOT_OK
        arg DTC: type=uint32, direction=IN, server-argument-impl-policy=USE-ARGUMENT-TYPE
        arg DTCStatusOld: type=Dem_UdsStatusByteType, direction=IN, server-argument-impl-policy=USE-ARGUMENT-TYPE
        arg DTCStatusNew: type=Dem_UdsStatusByteType, direction=IN, server-argument-impl-policy=USE-ARGUMENT-TYPE
      error E_NOT_OK: error-code=1
package /Volvo_SEWS/Interfaces
  98 x parameter interface:
    X1C68_D_FltHndlgPrimSigFltScaFac
      parameter data prototype v: sw-calibration-access=READ-WRITE, type=SEWS_D_FltHndlgPrimSigFltScaFac_X1C68_ADT
    P1A59_ConfigAxle_1_axle_type_liftable
      parameter data prototype v: sw-calibration-access=READ-WRITE, type=SEWS_ConfigAxle_1_axle_type_liftable_P1A59_ADT
    P1A62_ConfigAxle_2_wh_rollingcircu
      parameter data prototype v: sw-calibration-access=READ-WRITE, type=SEWS_ConfigAxle_2_wh_rollingcircu_P1A62_ADT
    P1A71_ConfigAxle_4_axle_type_steered
      parameter data prototype v: sw-calibration-access=READ-WRITE, type=SEWS_ConfigAxle_4_axle_type_steered_P1A71_ADT
    X1C60_T_interventionNoTrustTime
      parameter data prototype v: sw-calibration-access=READ-WRITE, type=SEWS_T_interventionNoTrustTime_X1C60_ADT
    X1C3E_D_precLongVelRateInit
      parameter data prototype v: sw-calibration-access=READ-WRITE, type=SEWS_D_precLongVelRateInit_X1C3E_ADT
    P1AFC_BrandType
      parameter data prototype v: sw-calibration-access=READ-WRITE, type=SEWS_BrandType_P1AFC_ADT
    P1BGV_SteeringRatio
      parameter data prototype v: sw-calibration-access=READ-WRITE, type=SEWS_SteeringRatio_P1BGV_ADT
    X1C49_Frq_lowSpdSnsrSelnSpdFilFrq
      parameter data prototype v: sw-calibration-access=READ-WRITE, type=SEWS_Frq_lowSpdSnsrSelnSpdFilFrq_X1C49_ADT
    P1L1L_VehicleType
      parameter data prototype v: sw-calibration-access=READ-WRITE, type=SEWS_VehicleType_P1L1L_ADT
    X1C5C_D_lowSpdSnsrSelnYawRateScaFac
      parameter data prototype v: sw-calibration-access=READ-WRITE, type=SEWS_D_lowSpdSnsrSelnYawRateScaFac_X1C5C_ADT
    P1A6U_ConfigAxle_2_axle_type_liftable
      parameter data prototype v: sw-calibration-access=READ-WRITE, type=SEWS_ConfigAxle_2_axle_type_liftable_P1A6U_ADT
    P1BGZ_SteeringRatioRight2
      parameter data prototype v: sw-calibration-access=READ-WRITE, type=SEWS_SteeringRatioRight2_P1BGZ_ADT
    X1C63_D_absTracCompLgtAScaFac
      parameter data prototype v: sw-calibration-access=READ-WRITE, type=SEWS_D_absTracCompLgtAScaFac_X1C63_ADT
    P1A7N_ConfigAxle_3_wh_rollingcircu
      parameter data prototype v: sw-calibration-access=READ-WRITE, type=SEWS_ConfigAxle_3_wh_rollingcircu_P1A7N_ADT
    X1DCG_B_enaAbsAsrDetn
      parameter data prototype v: sw-calibration-access=READ-WRITE, type=Boolean_ADT
    P10VU_D_precLatJerkDueToBankAngleInput
      parameter data prototype v: sw-calibration-access=READ-WRITE, type=SEWS_D_precLatJerkDueToBankAngleInput_P10VU_ADT
    P10V2_V_lowSpdSnsrSelnSpdThldUp
      parameter data prototype v: sw-calibration-access=READ-WRITE, type=SEWS_V_lowSpdSnsrSelnSpdThldUp_P10V2_ADT
    X1C8Y_Tq_minEngineWheelTorque
      parameter data prototype v: sw-calibration-access=READ-WRITE, type=SEWS_Tq_minEngineWheelTorque_X1C8Y_ADT
    X1C6V_D_FltHndlgIndirAltvSigFltScaFac
      parameter data prototype v: sw-calibration-access=READ-WRITE, type=SEWS_D_FltHndlgIndirAltvSigFltScaFac_X1C6V_ADT
    X1C8Z_D_wheelSpeedTrustFac_vec
      parameter data prototype v: sw-calibration-access=READ-WRITE, type=SEWS_D_wheelSpeedTrustFac_vec_X1C8Z_a_ADT
    P10WE_D_normSlipStfnAxle3
      parameter data prototype v: sw-calibration-access=READ-WRITE, type=SEWS_D_normSlipStfnAxle3_P10WE_ADT
    P1CNJ_DistRA2ToRA3
      parameter data prototype v: sw-calibration-access=READ-WRITE, type=SEWS_DistRA2ToRA3_P1CNJ_ADT
    P1CNH_DistRA1ToRA2
      parameter data prototype v: sw-calibration-access=READ-WRITE, type=SEWS_DistRA1ToRA2_P1CNH_ADT
    P1A7B_ConfigAxle_2_axle_load_min
      parameter data prototype v: sw-calibration-access=READ-WRITE, type=SEWS_ConfigAxle_2_axle_load_min_P1A7B_ADT
    X1DBH_D_precLatAccDueToBankAngleInit
      parameter data prototype v: sw-calibration-access=READ-WRITE, type=SEWS_D_precLatAccDueToBankAngleInit_X1DBH_ADT
    P10WH_L_imuToFrontAxle
      parameter data prototype v: sw-calibration-access=READ-WRITE, type=SEWS_L_imuToFrontAxle_P10WH_ADT
    P10W0_M_Axle4SuspVertLoads
      parameter data prototype v: sw-calibration-access=READ-WRITE, type=SEWS_M_Axle4SuspVertLoads_P10W0_a_ADT
    P10W1_Stfn_Axle4SuspVertStfns
      parameter data prototype v: sw-calibration-access=READ-WRITE, type=SEWS_Stfn_Axle4SuspVertStfns_P10W1_a_ADT
    P10VX_D_precLatAccMeas
      parameter data prototype v: sw-calibration-access=READ-WRITE, type=SEWS_D_precLatAccMeas_P10VX_ADT
    X1C3A_L_trackWidthDrivenAxle
      parameter data prototype v: sw-calibration-access=READ-WRITE, type=SEWS_L_trackWidthDrivenAxle_X1C3A_ADT
    X1C6T_D_FltHndlgAltvSigFltScaFac
      parameter data prototype v: sw-calibration-access=READ-WRITE, type=SEWS_D_FltHndlgAltvSigFltScaFac_X1C6T_ADT
    P1A78_ConfigAxle_4_wh_rollingcircu
      parameter data prototype v: sw-calibration-access=READ-WRITE, type=SEWS_ConfigAxle_4_wh_rollingcircu_P1A78_ADT
    P1A6A_ConfigAxle_1_axle_type_steered
      parameter data prototype v: sw-calibration-access=READ-WRITE, type=SEWS_ConfigAxle_1_axle_type_steered_P1A6A_ADT
    P11DU_E_BusAxleType
      parameter data prototype v: sw-calibration-access=READ-WRITE, type=SEWS_E_BusAxleType_P11DU_ADT
    P1A65_ConfigAxle_2_brake_factor
      parameter data prototype v: sw-calibration-access=READ-WRITE, type=SEWS_ConfigAxle_2_brake_factor_P1A65_ADT
    P10WS_L_maxCogHeightFullyLaden
      parameter data prototype v: sw-calibration-access=READ-WRITE, type=SEWS_L_maxCogHeightFullyLaden_P10WS_ADT
    P1B8V_VehicleTargetGeneratorSpeedLimits2
      parameter data prototype v: sw-calibration-access=READ-WRITE, type=SEWS_VehicleTargetGeneratorSpeedLimits2_P1B8V_ADT
    X1C69_D_maxWheelSpeedTrustFac_vec
      parameter data prototype v: sw-calibration-access=READ-WRITE, type=SEWS_D_maxWheelSpeedTrustFac_vec_X1C69_a_ADT
    P1K5K_E_EbsSwPackage
      parameter data prototype v: sw-calibration-access=READ-WRITE, type=SEWS_E_EbsSwPackage_P1K5K_ADT
    X1DBQ_D_absTracCompLongJerkScaFac
      parameter data prototype v: sw-calibration-access=READ-WRITE, type=SEWS_D_absTracCompLongJerkScaFac_X1DBQ_ADT
    X1C4U_B_enaLowSpdSnsrSeln
      parameter data prototype v: sw-calibration-access=READ-WRITE, type=Boolean_ADT
    X1C5A_D_lowSpdSnsrSelnLgtAScaFac
      parameter data prototype v: sw-calibration-access=READ-WRITE, type=SEWS_D_lowSpdSnsrSelnLgtAScaFac_X1C5A_ADT
    X1C46_Tq_lowSpdSnsrSelnTqThldUp
      parameter data prototype v: sw-calibration-access=READ-WRITE, type=SEWS_Tq_lowSpdSnsrSelnTqThldUp_X1C46_ADT
    X1C61_T_interventionRampUpTime
      parameter data prototype v: sw-calibration-access=READ-WRITE, type=SEWS_T_interventionRampUpTime_X1C61_ADT
    P10WV_Stfn_Axle1SuspVertStfns
      parameter data prototype v: sw-calibration-access=READ-WRITE, type=SEWS_Stfn_Axle1SuspVertStfns_P10WV_a_ADT
    P1A7W_ConfigAxle_3_axle_load_min
      parameter data prototype v: sw-calibration-access=READ-WRITE, type=SEWS_ConfigAxle_3_axle_load_min_P1A7W_ADT
    P10VS_D_precLongJerkInput
      parameter data prototype v: sw-calibration-access=READ-WRITE, type=SEWS_D_precLongJerkInput_P10VS_ADT
    X1C47_Tq_lowSpdSnsrSelnTqThldLo
      parameter data prototype v: sw-calibration-access=READ-WRITE, type=SEWS_Tq_lowSpdSnsrSelnTqThldLo_X1C47_ADT
    P1BGW_SteeringRatioLeft1
      parameter data prototype v: sw-calibration-access=READ-WRITE, type=SEWS_SteeringRatioLeft1_P1BGW_ADT
    P1A8H_ConfigAxle_4_axle_load_min
      parameter data prototype v: sw-calibration-access=READ-WRITE, type=SEWS_ConfigAxle_4_axle_load_min_P1A8H_ADT
    P1A7X_ConfigAxle_3_axle_load_max
      parameter data prototype v: sw-calibration-access=READ-WRITE, type=SEWS_ConfigAxle_3_axle_load_max_P1A7X_ADT
    X1C5P_D_precWhlSpdMeas
      parameter data prototype v: sw-calibration-access=READ-WRITE, type=SEWS_D_precWhlSpdMeas_X1C5P_ADT
    P1KME_DistFA1ToFA2
      parameter data prototype v: sw-calibration-access=READ-WRITE, type=SEWS_DistFA1ToFA2_P1KME_ADT
    P1A6K_ConfigAxle_1_brake_factor
      parameter data prototype v: sw-calibration-access=READ-WRITE, type=SEWS_ConfigAxle_1_brake_factor_P1A6K_ADT
    X1DBO_D_absTracCompLatAScaFac
      parameter data prototype v: sw-calibration-access=READ-WRITE, type=SEWS_D_absTracCompLatAScaFac_X1DBO_ADT
    P1A6V_ConfigAxle_2_axle_type_steered
      parameter data prototype v: sw-calibration-access=READ-WRITE, type=SEWS_ConfigAxle_2_axle_type_steered_P1A6V_ADT
    X1DCF_T_mtnLowConfTolrTi
      parameter data prototype v: sw-calibration-access=READ-WRITE, type=SEWS_T_mtnLowConfTolrTi_X1DCF_ADT
    X1C5T_D_lowSpdSnsrSelnLgtJerkScaFacSpd
      parameter data prototype v: sw-calibration-access=READ-WRITE, type=SEWS_D_lowSpdSnsrSelnLgtJerkScaFacSpd_X1C5T_ADT
    X1C5W_T_zeroSpdFltrTurnOffDly
      parameter data prototype v: sw-calibration-access=READ-WRITE, type=SEWS_T_zeroSpdFltrTurnOffDly_X1C5W_ADT
    P1A6Q_ConfigAxle_1_axle_load_min
      parameter data prototype v: sw-calibration-access=READ-WRITE, type=SEWS_ConfigAxle_1_axle_load_min_P1A6Q_ADT
    P10WY_M_Axle3SuspVertLoads
      parameter data prototype v: sw-calibration-access=READ-WRITE, type=SEWS_M_Axle3SuspVertLoads_P10WY_a_ADT
    P1CSH_FrontAxleArrangement
      parameter data prototype v: sw-calibration-access=READ-WRITE, type=SEWS_FrontAxleArrangement_P1CSH_ADT
    P1A8B_ConfigAxle_4_brake_factor
      parameter data prototype v: sw-calibration-access=READ-WRITE, type=SEWS_ConfigAxle_4_brake_factor_P1A8B_ADT
    P1A82_ConfigAxle_5_axle_load_min
      parameter data prototype v: sw-calibration-access=READ-WRITE, type=SEWS_ConfigAxle_5_axle_load_min_P1A82_ADT
    X1C8W_B_enaWheelDeselection
      parameter data prototype v: sw-calibration-access=READ-WRITE, type=Boolean_ADT
    X1DU0_T_absAsrDetnDelayTime
      parameter data prototype v: sw-calibration-access=READ-WRITE, type=SEWS_T_absAsrDetnDelayTime_X1DU0_ADT
    P1A7G_ConfigAxle_3_axle_type_steered
      parameter data prototype v: sw-calibration-access=READ-WRITE, type=SEWS_ConfigAxle_3_axle_type_steered_P1A7G_ADT
    P1AT2_SelfSteeredTagAxleSpeedHysteresis
      parameter data prototype v: sw-calibration-access=READ-WRITE, type=SEWS_SelfSteeredTagAxleSpeedHysteresis_P1AT2_ADT
    X1C3F_D_precYawRateInit
      parameter data prototype v: sw-calibration-access=READ-WRITE, type=SEWS_D_precYawRateInit_X1C3F_ADT
    P10WT_AgV_maxPitchRate
      parameter data prototype v: sw-calibration-access=READ-WRITE, type=SEWS_AgV_maxPitchRate_P10WT_ADT
    P1A6H_ConfigAxle_1_wh_rollingcircu
      parameter data prototype v: sw-calibration-access=READ-WRITE, type=SEWS_ConfigAxle_1_wh_rollingcircu_P1A6H_ADT
    P10WW_M_Axle2SuspVertLoads
      parameter data prototype v: sw-calibration-access=READ-WRITE, type=SEWS_M_Axle2SuspVertLoads_P10WW_a_ADT
    P1A70_ConfigAxle_4_axle_type_liftable
      parameter data prototype v: sw-calibration-access=READ-WRITE, type=SEWS_ConfigAxle_4_axle_type_liftable_P1A70_ADT
    P1BGX_SteeringRatioLeft2
      parameter data prototype v: sw-calibration-access=READ-WRITE, type=SEWS_SteeringRatioLeft2_P1BGX_ADT
    X1DCH_A_whlRateAbsAsrDetnThd
      parameter data prototype v: sw-calibration-access=READ-WRITE, type=SEWS_A_whlRateAbsAsrDetnThd_X1DCH_ADT
    X1C9T_V_mtnDetnHysSpd
      parameter data prototype v: sw-calibration-access=READ-WRITE, type=SEWS_V_mtnDetnHysSpd_X1C9T_ADT
    P1A8V_ConfigAxle_5_p_thres
      parameter data prototype v: sw-calibration-access=READ-WRITE, type=SEWS_ConfigAxle_5_p_thres_P1A8V_ADT
    X1C6Z_B_enaAbsComp
      parameter data prototype v: sw-calibration-access=READ-WRITE, type=Boolean_ADT
    P1A7P_ConfigAxle_3_p_thres
      parameter data prototype v: sw-calibration-access=READ-WRITE, type=SEWS_ConfigAxle_3_p_thres_P1A7P_ADT
    P1BGY_SteeringRatioRight1
      parameter data prototype v: sw-calibration-access=READ-WRITE, type=SEWS_SteeringRatioRight1_P1BGY_ADT
    P1RPH_NetworkArchitecture
      parameter data prototype v: sw-calibration-access=READ-WRITE, type=SEWS_NetworkArchitecture_P1RPH_ADT
    P10V1_V_lowSpdSnsrSelnSpdThldLo
      parameter data prototype v: sw-calibration-access=READ-WRITE, type=SEWS_V_lowSpdSnsrSelnSpdThldLo_P10V1_ADT
    P10VY_D_precYawRateMeas
      parameter data prototype v: sw-calibration-access=READ-WRITE, type=SEWS_D_precYawRateMeas_P10VY_ADT
    P1A8T_ConfigAxle_5_wh_rollingcircu
      parameter data prototype v: sw-calibration-access=READ-WRITE, type=SEWS_ConfigAxle_5_wh_rollingcircu_P1A8T_ADT
    X1C5D_D_lowSpdSnsrSelnTrsmSpdScaFac
      parameter data prototype v: sw-calibration-access=READ-WRITE, type=SEWS_D_lowSpdSnsrSelnTrsmSpdScaFac_X1C5D_ADT
    P1A0N_B_EspNotAvailable
      parameter data prototype v: sw-calibration-access=READ-WRITE, type=Boolean_ADT
    P1CSI_TagAxleFeatures
      parameter data prototype v: sw-calibration-access=READ-WRITE, type=SEWS_TagAxleFeatures_P1CSI_ADT
    P1AZQ_WheelBase
      parameter data prototype v: sw-calibration-access=READ-WRITE, type=SEWS_WheelBase_P1AZQ_ADT
    P10WF_D_normSlipStfnAxle4
      parameter data prototype v: sw-calibration-access=READ-WRITE, type=SEWS_D_normSlipStfnAxle4_P10WF_ADT
    P1E50_VehicleWidth_mm
      parameter data prototype v: sw-calibration-access=READ-WRITE, type=SEWS_VehicleWidth_mm_P1E50_ADT
    X1C62_B_enaTracComp
      parameter data prototype v: sw-calibration-access=READ-WRITE, type=Boolean_ADT
    P1M6I_NoOfPulsesPerRevolution
      parameter data prototype v: sw-calibration-access=READ-WRITE, type=SEWS_NoOfPulsesPerRevolution_P1M6I_ADT
    X1DBP_D_absTracCompYawRateScaFac
      parameter data prototype v: sw-calibration-access=READ-WRITE, type=SEWS_D_absTracCompYawRateScaFac_X1DBP_ADT
    P1C54_FactoryModeActive
      parameter data prototype v: sw-calibration-access=READ-WRITE, type=Boolean_ADT
    X1C7C_V_maxWheelSpeedTrustBreakPoints_vec
      parameter data prototype v: sw-calibration-access=READ-WRITE, type=SEWS_V_maxWheelSpeedTrustBreakPoints_vec_X1C7C_a_ADT
    X1C5U_Frq_lowSpdSnsrSelnSpdFilFrq
      parameter data prototype v: sw-calibration-access=READ-WRITE, type=SEWS_Frq_lowSpdSnsrSelnSpdFilFrq_X1C5U_ADT
    P10WZ_Stfn_Axle3SuspVertStfns
      parameter data prototype v: sw-calibration-access=READ-WRITE, type=SEWS_Stfn_Axle3SuspVertStfns_P10WZ_a_ADT
  client server interface DiagnosticMonitor: is-service=true, service-kind=DIAGNOSTIC-EVENT-MANAGER
    11 x operation:
      SetEventStatus: possible-error=DiagnosticMonitor/E_NOT_OK
        arg EventStatus: type=Dem_EventStatusType, direction=IN, server-argument-impl-policy=USE-ARGUMENT-TYPE
      GetDTCOfEvent: possible-error=[DEM_E_NO_DTC_AVAILABLE, DiagnosticMonitor/E_NOT_OK]
        arg DTCFormat: type=Dem_DTCFormatType, direction=IN, server-argument-impl-policy=USE-ARGUMENT-TYPE
        arg DTCOfEvent: type=uint32, direction=OUT, server-argument-impl-policy=USE-ARGUMENT-TYPE
      GetEventExtendedDataRecordEx: possible-error=[DEM_BUFFER_TOO_SMALL, DEM_NO_SUCH_ELEMENT, DiagnosticMonitor/E_NOT_OK]
        arg RecordNumber: type=uint8, direction=IN, server-argument-impl-policy=USE-ARGUMENT-TYPE
        arg DestBuffer: type=Dem_MaxDataValueType, direction=OUT, server-argument-impl-policy=USE-ARGUMENT-TYPE
        arg BufSize: type=uint16, direction=INOUT, server-argument-impl-policy=USE-ARGUMENT-TYPE
      GetEventFailed: possible-error=DiagnosticMonitor/E_NOT_OK
        arg EventFailed: type=boolean, direction=OUT, server-argument-impl-policy=USE-ARGUMENT-TYPE
      GetEventFreezeFrameDataEx: possible-error=[DEM_BUFFER_TOO_SMALL, DEM_NO_SUCH_ELEMENT, DiagnosticMonitor/E_NOT_OK]
        4 x arg, all with server-argument-impl-policy=USE-ARGUMENT-TYPE:
          RecordNumber: type=uint8, direction=IN
          DataId: type=uint16, direction=IN
          DestBuffer: type=Dem_MaxDataValueType, direction=OUT
          BufSize: type=uint16, direction=INOUT
      GetEventStatus: possible-error=DiagnosticMonitor/E_NOT_OK
        arg UDSStatusByte: type=Dem_UdsStatusByteType, direction=OUT, server-argument-impl-policy=USE-ARGUMENT-TYPE
      GetEventTested: possible-error=DiagnosticMonitor/E_NOT_OK
        arg EventTested: type=boolean, direction=OUT, server-argument-impl-policy=USE-ARGUMENT-TYPE
      GetFaultDetectionCounter: possible-error=[DEM_E_NO_FDC_AVAILABLE, DiagnosticMonitor/E_NOT_OK]
        arg FaultDetectionCounter: type=sint8, direction=OUT, server-argument-impl-policy=USE-ARGUMENT-TYPE
      ResetEventStatus: possible-error=DiagnosticMonitor/E_NOT_OK
      ResetEventDebounceStatus: possible-error=DiagnosticMonitor/E_NOT_OK
        arg DebounceResetStatus: type=Dem_DebounceResetStatusType, direction=IN, server-argument-impl-policy=USE-ARGUMENT-TYPE
      GetEventUdsStatus: possible-error=DiagnosticMonitor/E_NOT_OK
        arg UDSStatusByte: type=Dem_UdsStatusByteType, direction=OUT, server-argument-impl-policy=USE-ARGUMENT-TYPE
    5 x error:
      E_NOT_OK: error-code=1
      DEM_E_NO_DTC_AVAILABLE: error-code=10
      DEM_E_NO_FDC_AVAILABLE: error-code=14
      DEM_BUFFER_TOO_SMALL: error-code=21
      DEM_NO_SUCH_ELEMENT: error-code=48
  47 x parameter interface:
    X1C29_L_trackWidthNonDrivenAxle
      parameter data prototype v: sw-calibration-access=READ-WRITE, type=SEWS_L_trackWidthNonDrivenAxle_X1C29_ADT
    X1C8X_Tq_minTotalBrakeTorque
      parameter data prototype v: sw-calibration-access=READ-WRITE, type=SEWS_Tq_minTotalBrakeTorque_X1C8X_ADT
    X1C3G_D_precYawAccInit
      parameter data prototype v: sw-calibration-access=READ-WRITE, type=SEWS_D_precYawAccInit_X1C3G_ADT
    P1A64_ConfigAxle_2_p_thres
      parameter data prototype v: sw-calibration-access=READ-WRITE, type=SEWS_ConfigAxle_2_p_thres_P1A64_ADT
    P1E5Z_Radar2FrontAxleDist
      parameter data prototype v: sw-calibration-access=READ-WRITE, type=SEWS_Radar2FrontAxleDist_P1E5Z_ADT
    P1A8W_ConfigAxle_5_brake_factor
      parameter data prototype v: sw-calibration-access=READ-WRITE, type=SEWS_ConfigAxle_5_brake_factor_P1A8W_ADT
    P10WC_D_normSlipStfnAxle1
      parameter data prototype v: sw-calibration-access=READ-WRITE, type=SEWS_D_normSlipStfnAxle1_P10WC_ADT
    X1DCI_Frq_whlRateFilFrq
      parameter data prototype v: sw-calibration-access=READ-WRITE, type=SEWS_Frq_whlRateFilFrq_X1DCI_ADT
    X1C5Q_D_lowSpdSnsrSelnLgtJerkScaFacTrq
      parameter data prototype v: sw-calibration-access=READ-WRITE, type=SEWS_D_lowSpdSnsrSelnLgtJerkScaFacTrq_X1C5Q_ADT
    P10WR_L_minCogHeightUnladen
      parameter data prototype v: sw-calibration-access=READ-WRITE, type=SEWS_L_minCogHeightUnladen_P10WR_ADT
    X1C80_V_speedDifferenceBreakPoints_vec
      parameter data prototype v: sw-calibration-access=READ-WRITE, type=SEWS_V_speedDifferenceBreakPoints_vec_X1C80_a_ADT
    P1IJ3_EquivalentWheelbaseTurning
      parameter data prototype v: sw-calibration-access=READ-WRITE, type=SEWS_EquivalentWheelbaseTurning_P1IJ3_ADT
    X1DCM_A_whlRateAbsAsrRstThd
      parameter data prototype v: sw-calibration-access=READ-WRITE, type=SEWS_A_whlRateAbsAsrRstThd_X1DCM_ADT
    X1C3D_D_precLongVelInit
      parameter data prototype v: sw-calibration-access=READ-WRITE, type=SEWS_D_precLongVelInit_X1C3D_ADT
    X1C5E_D_lowSpdSnsrSelnWhlSpdScaFac
      parameter data prototype v: sw-calibration-access=READ-WRITE, type=SEWS_D_lowSpdSnsrSelnWhlSpdScaFac_X1C5E_ADT
    P10WG_D_normSlipStfnAxle5
      parameter data prototype v: sw-calibration-access=READ-WRITE, type=SEWS_D_normSlipStfnAxle5_P10WG_ADT
    X1DCK_T_absAsrTurnOffDly
      parameter data prototype v: sw-calibration-access=READ-WRITE, type=SEWS_T_absAsrTurnOffDly_X1DCK_ADT
    P10W2_M_Axle5SuspVertLoads
      parameter data prototype v: sw-calibration-access=READ-WRITE, type=SEWS_M_Axle5SuspVertLoads_P10W2_a_ADT
    P1A7C_ConfigAxle_2_axle_load_max
      parameter data prototype v: sw-calibration-access=READ-WRITE, type=SEWS_ConfigAxle_2_axle_load_max_P1A7C_ADT
    P10WU_M_Axle1SuspVertLoads
      parameter data prototype v: sw-calibration-access=READ-WRITE, type=SEWS_M_Axle1SuspVertLoads_P10WU_a_ADT
    P1A8L_ConfigAxle_5_axle_type_liftable
      parameter data prototype v: sw-calibration-access=READ-WRITE, type=SEWS_ConfigAxle_5_axle_type_liftable_P1A8L_ADT
    X1C48_Frq_lowSpdSnsrSelnTqFilFrq
      parameter data prototype v: sw-calibration-access=READ-WRITE, type=SEWS_Frq_lowSpdSnsrSelnTqFilFrq_X1C48_ADT
    P1A6J_ConfigAxle_1_p_thres
      parameter data prototype v: sw-calibration-access=READ-WRITE, type=SEWS_ConfigAxle_1_p_thres_P1A6J_ADT
    P1A6R_ConfigAxle_1_axle_load_max
      parameter data prototype v: sw-calibration-access=READ-WRITE, type=SEWS_ConfigAxle_1_axle_load_max_P1A6R_ADT
    P10WD_D_normSlipStfnAxle2
      parameter data prototype v: sw-calibration-access=READ-WRITE, type=SEWS_D_normSlipStfnAxle2_P10WD_ADT
    P1A83_ConfigAxle_5_axle_load_max
      parameter data prototype v: sw-calibration-access=READ-WRITE, type=SEWS_ConfigAxle_5_axle_load_max_P1A83_ADT
    P1KJ7_FAxleContactPatchOutside2OutsideDist
      parameter data prototype v: sw-calibration-access=READ-WRITE, type=SEWS_FAxleContactPatchOutside2OutsideDist_P1KJ7_ADT
    P1CSG_RearAxleArrangement
      parameter data prototype v: sw-calibration-access=READ-WRITE, type=SEWS_RearAxleArrangement_P1CSG_ADT
    P1A7Q_ConfigAxle_3_brake_factor
      parameter data prototype v: sw-calibration-access=READ-WRITE, type=SEWS_ConfigAxle_3_brake_factor_P1A7Q_ADT
    X1DU3_T_absAsrRstDelayTime
      parameter data prototype v: sw-calibration-access=READ-WRITE, type=SEWS_T_absAsrRstDelayTime_X1DU3_ADT
    P1B8U_VehicleTargetGeneratorSpeedLimits1
      parameter data prototype v: sw-calibration-access=READ-WRITE, type=SEWS_VehicleTargetGeneratorSpeedLimits1_P1B8U_ADT
    X1BWH_YawRateMonitoringActivation
      parameter data prototype v: sw-calibration-access=READ-WRITE, type=Boolean_ADT
    P10W3_Stfn_Axle5SuspVertStfns
      parameter data prototype v: sw-calibration-access=READ-WRITE, type=SEWS_Stfn_Axle5SuspVertStfns_P10W3_a_ADT
    X1C4J_B_enaSlipCmp
      parameter data prototype v: sw-calibration-access=READ-WRITE, type=Boolean_ADT
    P10VW_D_precLongAccMeas
      parameter data prototype v: sw-calibration-access=READ-WRITE, type=SEWS_D_precLongAccMeas_P10VW_ADT
    P10WX_Stfn_Axle2SuspVertStfns
      parameter data prototype v: sw-calibration-access=READ-WRITE, type=SEWS_Stfn_Axle2SuspVertStfns_P10WX_a_ADT
    P1AK9_SelfSteeredTagAxleThreshSpeed
      parameter data prototype v: sw-calibration-access=READ-WRITE, type=SEWS_SelfSteeredTagAxleThreshSpeed_P1AK9_ADT
    X1C3K_D_precTrsmOutpShaftSpdMeas
      parameter data prototype v: sw-calibration-access=READ-WRITE, type=SEWS_D_precTrsmOutpShaftSpdMeas_X1C3K_ADT
    X1C5B_D_lowSpdSnsrSelnLatAScaFac
      parameter data prototype v: sw-calibration-access=READ-WRITE, type=SEWS_D_lowSpdSnsrSelnLatAScaFac_X1C5B_ADT
    P1A7F_ConfigAxle_3_axle_type_liftable
      parameter data prototype v: sw-calibration-access=READ-WRITE, type=SEWS_ConfigAxle_3_axle_type_liftable_P1A7F_ADT
    X1C6U_D_FltHndlgIndirPrimSigFltScaFac
      parameter data prototype v: sw-calibration-access=READ-WRITE, type=SEWS_D_FltHndlgIndirPrimSigFltScaFac_X1C6U_ADT
    P1A8M_ConfigAxle_5_axle_type_steered
      parameter data prototype v: sw-calibration-access=READ-WRITE, type=SEWS_ConfigAxle_5_axle_type_steered_P1A8M_ADT
    P1A8I_ConfigAxle_4_axle_load_max
      parameter data prototype v: sw-calibration-access=READ-WRITE, type=SEWS_ConfigAxle_4_axle_load_max_P1A8I_ADT
    X1C9S_V_mtnDetnThdSpd
      parameter data prototype v: sw-calibration-access=READ-WRITE, type=SEWS_V_mtnDetnThdSpd_X1C9S_ADT
    X1DBJ_A_mtnDetnThdLongAcc
      parameter data prototype v: sw-calibration-access=READ-WRITE, type=SEWS_A_mtnDetnThdLongAcc_X1DBJ_ADT
    P10VT_D_precYawJerkInput
      parameter data prototype v: sw-calibration-access=READ-WRITE, type=SEWS_D_precYawJerkInput_P10VT_ADT
    P1A8A_ConfigAxle_4_p_thres
      parameter data prototype v: sw-calibration-access=READ-WRITE, type=SEWS_ConfigAxle_4_p_thres_P1A8A_ADT
package /ModeDclrGroups
  mode declaration group ESH_Mode: category=ALPHABETIC_ORDER, initial-mode=STARTUP
    5 x mode:
      POSTRUN
      RUN
      SHUTDOWN
      STARTUP
      WAKEUP
package /PortInterface
  mode switch interface BswM_MSI_ESH_Mode: is-service=true
    mode group BswM_MDGP_ESH_Mode: type=ESH_Mode
  95 x sender receiver interface:
    XPRsystemstate_I
      data XPRsystemstate: type=XPRsystemstate_T
    FrontRoadWheelAngleEstimate_I
      data FrontRoadWheelAngleEstimate: type=RWhlAg_T
    RearAxleSteeringFunctionStatus_I
      data RearAxleSteeringFunctionStatus: type=RearAxleSteeringFunctionStatus_T
    ActualTagWheelAngle_I
      data ActualTagWheelAngle: type=ActualTagWheelAngle_T
    ASRBrakeControlActive_I
      data ASRBrakeControlActive: type=PassiveActive2_T
    AxleLoad_I
      data AxleLoad: type=AxleLoad_T
    FrAxleLtWhlBrakeApplPrsHiRng_I
      data FrAxleLtWhlBrakeApplPrsHiRng: type=PressureFactor5_T
    FrAxleRtWhlBrakeApplPrsHiRng_I
      data FrAxleRtWhlBrakeApplPrsHiRng: type=PressureFactor5_T
    FrontAxleLeftWheelSpeed_I
      data FrontAxleLeftWheelSpeed: type=Speed16bit_T
    FrontAxleRightWheelSpeed_I
      data FrontAxleRightWheelSpeed: type=Speed16bit_T
    KFactor_I
      data KFactor: type=KFactor_T
    LiftAxle1PositionStatus_I
      data LiftAxle1PositionStatus: type=LiftAxlePositionStatus_T
    LiftAxle2PositionStatus_I
      data LiftAxle2PositionStatus: type=LiftAxlePositionStatus_T
    LongitudinalAcceleration_I
      data LongitudinalAcceleration: type=Acceleration16bit_T
    RearAxleLeftWheelSpeed_I
      data RearAxleLeftWheelSpeed: type=Speed16bit_T
    RearAxleRightWheelSpeed_I
      data RearAxleRightWheelSpeed: type=Speed16bit_T
    RrAxle1LtWhlBrakeApplPrsHiRng_I
      data RrAxle1LtWhlBrakeApplPrsHiRng: type=PressureFactor5_T
    RrAxle2LtWhlBrakeApplPrsHiRng_I
      data RrAxle2LtWhlBrakeApplPrsHiRng: type=PressureFactor5_T
    RrAxle3LtWhlBrakeApplPrsHiRng_I
      data RrAxle3LtWhlBrakeApplPrsHiRng: type=PressureFactor5_T
    SteeringWheelAngle_I
      data SteeringWheelAngle: type=SteeringWheelAngle_T
    TransmissionDrivelineEngaged_I
      data TransmissionDrivelineEngaged: type=DisengageEngage_T
    TransmOutputShaftSpeedSigned_I
      data TransmOutputShaftSpeedSigned: type=SpeedRpm16bitMinus4000_T
    RrAxle1RtWhlBrakeApplPrsHiRng_I
      data RrAxle1RtWhlBrakeApplPrsHiRng: type=PressureFactor5_T
    RrAxle2RtWhlBrakeApplPrsHiRng_I
      data RrAxle2RtWhlBrakeApplPrsHiRng: type=PressureFactor5_T
    RrAxle3RtWhlBrakeApplPrsHiRng_I
      data RrAxle3RtWhlBrakeApplPrsHiRng: type=PressureFactor5_T
    ActualEHPusherWheelAngle_I
      data ActuaEHPusherWheelAngle: type=uint16
    ActualEHTagWheelAngle_I
      data ActualEHTagWheelAngle: type=uint16
    YawRate_I
      data YawRate: type=uint16
    RoadInclinationPerc_I
      data RoadInclinationPerc: type=RoadInclinationPerc_T
    VehicleMode_I  # SE-Tool ref: There exists no such signal in SE-TOOL.
      data VehicleMode: type=VehicleMode_T
    ActualDrvlnRetdrPercentTorque_I
      data ActualDrvlnRetdrPercentTorque: type=Percent8bit125NegOffset_T
    ActualEnginePercentTorque_I
      data ActualEnginePercentTorque: type=Percent8bit125NegOffset_T
    ASREngineControlActive_I
      data ASREngineControlActive: type=PassiveActive2_T
    EngineReferenceTorque_I
      data EngineReferenceTorque: sw-impl-policy=QUEUED, type=Torque16bit_T
    TransmissionActualGearRatio_I
      data TransmissionActualGearRatio: type=TransmissionActualGearRatio_T
    SpdXRefPoint_I
      data SpdXRefPoint: type=Speed_T
    SpdYRefPoint_I
      data SpdYRefPoint: type=Speed_T
    AccXRefPoint_I
      data AccXRefPoint: type=Acceleration_T
    AccYRefPoint_I
      data AccYRefPoint: type=Acceleration_T
    SideslipRefPoint_I
      data SideslipRefPoint: type=Angle_T
    CrvtPathRefPoint_I
      data CrvtPathRefPoint: type=Curvature_T
    CrvtFacRefPoint_I
      data CrvtFacRefPoint: type=CurvatureFac_T
    EquivalentRearAxlePos_I
      data EquivalentRearAxlePos: type=EquivalentRearAxlePos_T
    MotionEstStatus_I
      data MotionEstStatus: type=MotionEstStatus_T
    YawRateVari_I
      data YawRateVari: type=Variance_T
    YawAccVari_I
      data YawAccVari: type=Variance_T
    SpdXVari_I
      data SpdXVari: type=Variance_T
    SpdYVari_I
      data SpdYVari: type=Variance_T
    AccXVari_I
      data AccXVari: type=Variance_T
    AccYVari_I
      data AccYVari: type=Variance_T
    SideslipVari_I
      data SideslipVari: type=Variance_T
    TotalFilterLatencyEst_I
      data TotalFilterLatencyEst: type=Latency_T
    RollAngleChassisEst_I
      data RollAngleChassisEst: type=Angle_T
    RollAngleChassisEstQuality_I
      data RollAngleChassisEstQuality: type=RollAngleEstQly_T
    SpdXRateRefPoint_I
      data SpdXRateRefPoint: type=Acceleration_T
    SpdYRateRefPoint_I
      data SpdYRateRefPoint: type=Acceleration_T
    RoadWheelAngle_I
      data RoadWheelAngle: type=RoadWheelAngle_T2
    AccYDueToBankAngle_I
      data AccYDueToBankAngle: type=Acceleration_T
    LongMotionDirection_I
      data LongMotionDirection: type=LongMotionDirection_sg_T
    LongMotionDirectionQuality_I
      data LongMotionDirectionQuality: type=LongMotionDirectionQuality_T
    LongMotionDirection_ErrorStatus_I
      data LongMotionDirection_ErrorStatus: type=LongMotionDirErrorSts_T
    NonlinearSteeringRatio_I
      data NonlinearSteeringRatio: type=SteeringRatio_T
    AccYRefPointQly_I
      data AccYRefPointQly: type=SignalQuality_T
    YawRateRearAxleQly_I
      data YawRateRearAxleQly: type=SignalQuality_T
    YawAccRearAxleQly_I
      data YawAccRearAxleQly: type=SignalQuality_T
    SideslipRefPointQly_I
      data SideslipRefPointQly: type=SignalQuality_T
    RoadWheelAngleQly_I
      data RoadWheelAngleQly: type=SignalQuality_T
    CrvtPathRefPointQly_I
      data CrvtPathRefPointQly: type=SignalQuality_T
    EquivalentRearAxlePositionQly_I
      data EquivalentRearAxlePositionQly: type=SignalQuality_T
    YawRateChassis_I
      data YawRateChassis: type=YawRateChassis_T
    YawAccChassis_I
      data YawAccChassis: type=YawAccChassis_T
    SpdXRefPointQly_I
      data SpdXRefPointQly: type=SignalQuality_T
    SpdYRefPointQly_I
      data SpdYRefPointQly: type=SignalQuality_T
    AccXRefPointQly_I
      data AccXRefPointQly: type=SignalQuality_T
    V_spdAtWhl_Ax1L_I
      data V_spdAtWhl_Ax1L: type=V_spdAtWhl_Ax1L_T
    V_spdAtWhl_Ax1R_I
      data V_spdAtWhl_Ax1R: type=V_spdAtWhl_Ax1R_T
    V_spdAtWhl_Ax2L_I
      data V_spdAtWhl_Ax2L: type=V_spdAtWhl_Ax2L_T
    V_spdAtWhl_Ax2R_I
      data V_spdAtWhl_Ax2R: type=V_spdAtWhl_Ax2R_T
    V_spdAtWhl_Ax3L_I
      data V_spdAtWhl_Ax3L: type=V_spdAtWhl_Ax3L_T
    V_spdAtWhl_Ax3R_I
      data V_spdAtWhl_Ax3R: type=V_spdAtWhl_Ax3R_T
    V_spdAtWhl_Ax4L_I
      data V_spdAtWhl_Ax4L: type=V_spdAtWhl_Ax4L_T
    V_spdAtWhl_Ax4R_I
      data V_spdAtWhl_Ax4R: type=V_spdAtWhl_Ax4R_T
    V_spdAtWhl_Ax5L_I
      data V_spdAtWhl_Ax5L: type=V_spdAtWhl_Ax5L_T
    V_spdAtWhl_Ax5R_I
      data V_spdAtWhl_Ax5R: type=V_spdAtWhl_Ax5R_T
    E_spdAtWhlQly_Ax1L_I
      data E_spdAtWhlQly_Ax1L: type=SignalQuality_T
    E_spdAtWhlQly_Ax1R_I
      data E_spdAtWhlQly_Ax1R: type=SignalQuality_T
    E_spdAtWhlQly_Ax2L_I
      data E_spdAtWhlQly_Ax2L: type=SignalQuality_T
    E_spdAtWhlQly_Ax2R_I
      data E_spdAtWhlQly_Ax2R: type=SignalQuality_T
    E_spdAtWhlQly_Ax3L_I
      data E_spdAtWhlQly_Ax3L: type=SignalQuality_T
    E_spdAtWhlQly_Ax3R_I
      data E_spdAtWhlQly_Ax3R: type=SignalQuality_T
    E_spdAtWhlQly_Ax4L_I
      data E_spdAtWhlQly_Ax4L: type=SignalQuality_T
    E_spdAtWhlQly_Ax4R_I
      data E_spdAtWhlQly_Ax4R: type=SignalQuality_T
    E_spdAtWhlQly_Ax5L_I
      data E_spdAtWhlQly_Ax5L: type=SignalQuality_T
    E_spdAtWhlQly_Ax5R_I
      data E_spdAtWhlQly_Ax5R: type=SignalQuality_T
    ActualEngineRetarderPercentTrq_I
      data ActualEngineRetarderPercentTrq: type=Percent8bit125NegOffset_T
package /SwAddrMethod
  sw addr method NoValueSelected
  sw addr method SA_lvl_0x29
  sw addr method SA_lvl_0x2F
