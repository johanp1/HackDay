AUTOSAR XML (schema 00046)
package /Predefined_DEV/PortInterfaces
  22 x client server interface, all with is-service=true:
    NvMAdministration
      operation SetBlockProtection: possible-error=NvMAdministration/E_NOT_OK
        arg ProtectionEnabled: type=boolean, direction=IN, server-argument-impl-policy=USE-ARGUMENT-TYPE
      error E_NOT_OK: error-code=1
    NvMNotifyInitBlock
      operation InitBlock
    NvMNotifyJobFinished
      operation JobFinished
        arg ServiceId: type=NvM_ServiceIdType, direction=IN, server-argument-impl-policy=USE-ARGUMENT-TYPE
        arg JobResult: type=NvM_RequestResultType, direction=IN, server-argument-impl-policy=USE-ARGUMENT-TYPE
    NvMService
      operation GetErrorStatus: possible-error=NvMService/E_NOT_OK
        arg ErrorStatus: type=NvM_RequestResultType, direction=OUT, server-argument-impl-policy=USE-ARGUMENT-TYPE
      error E_NOT_OK: error-code=1
    NvMService_AC2
      operation GetErrorStatus: possible-error=NvMService_AC2/E_NOT_OK
        arg ErrorStatus: type=NvM_RequestResultType, direction=OUT, server-argument-impl-policy=USE-ARGUMENT-TYPE
      operation ReadBlock: possible-error=NvMService_AC2/E_NOT_OK
        arg DstPtr: type=dtRef_VOID, direction=IN, server-argument-impl-policy=USE-ARGUMENT-TYPE
      operation WriteBlock: possible-error=NvMService_AC2/E_NOT_OK
        arg SrcPtr: type=dtRef_const_VOID, direction=IN, server-argument-impl-policy=USE-ARGUMENT-TYPE
      error E_NOT_OK: error-code=1
    NvMService_AC2_Defs
      4 x operation, all with possible-error=NvMService_AC2_Defs/E_NOT_OK:
        GetErrorStatus
          arg ErrorStatus: type=NvM_RequestResultType, direction=OUT, server-argument-impl-policy=USE-ARGUMENT-TYPE
        ReadBlock
          arg DstPtr: type=dtRef_VOID, direction=IN, server-argument-impl-policy=USE-ARGUMENT-TYPE
        RestoreBlockDefaults
          arg DstPtr: type=dtRef_VOID, direction=IN, server-argument-impl-policy=USE-ARGUMENT-TYPE
        WriteBlock
          arg SrcPtr: type=dtRef_const_VOID, direction=IN, server-argument-impl-policy=USE-ARGUMENT-TYPE
      error E_NOT_OK: error-code=1
    NvMService_AC2_DS
      5 x operation, all with possible-error=NvMService_AC2_DS/E_NOT_OK:
        GetDataIndex
          arg DataIndex: type=uint8, direction=OUT, server-argument-impl-policy=USE-ARGUMENT-TYPE
        GetErrorStatus
          arg ErrorStatus: type=NvM_RequestResultType, direction=OUT, server-argument-impl-policy=USE-ARGUMENT-TYPE
        ReadBlock
          arg DstPtr: type=dtRef_VOID, direction=IN, server-argument-impl-policy=USE-ARGUMENT-TYPE
        SetDataIndex
          arg DataIndex: type=uint8, direction=IN, server-argument-impl-policy=USE-ARGUMENT-TYPE
        WriteBlock
          arg SrcPtr: type=dtRef_const_VOID, direction=IN, server-argument-impl-policy=USE-ARGUMENT-TYPE
      error E_NOT_OK: error-code=1
    NvMService_AC2_DS_Defs
      6 x operation, all with possible-error=NvMService_AC2_DS_Defs/E_NOT_OK:
        GetDataIndex
          arg DataIndex: type=uint8, direction=OUT, server-argument-impl-policy=USE-ARGUMENT-TYPE
        GetErrorStatus
          arg ErrorStatus: type=NvM_RequestResultType, direction=OUT, server-argument-impl-policy=USE-ARGUMENT-TYPE
        ReadBlock
          arg DstPtr: type=dtRef_VOID, direction=IN, server-argument-impl-policy=USE-ARGUMENT-TYPE
        RestoreBlockDefaults
          arg DstPtr: type=dtRef_VOID, direction=IN, server-argument-impl-policy=USE-ARGUMENT-TYPE
        SetDataIndex
          arg DataIndex: type=uint8, direction=IN, server-argument-impl-policy=USE-ARGUMENT-TYPE
        WriteBlock
          arg SrcPtr: type=dtRef_const_VOID, direction=IN, server-argument-impl-policy=USE-ARGUMENT-TYPE
      error E_NOT_OK: error-code=1
    NvMService_AC2_SRBS
      4 x operation, all with possible-error=NvMService_AC2_SRBS/E_NOT_OK:
        GetErrorStatus
          arg ErrorStatus: type=NvM_RequestResultType, direction=OUT, server-argument-impl-policy=USE-ARGUMENT-TYPE
        ReadBlock
          arg DstPtr: type=dtRef_VOID, direction=IN, server-argument-impl-policy=USE-ARGUMENT-TYPE
        SetRamBlockStatus
          arg RamBlockStatus: type=boolean, direction=IN, server-argument-impl-policy=USE-ARGUMENT-TYPE
        WriteBlock
          arg SrcPtr: type=dtRef_const_VOID, direction=IN, server-argument-impl-policy=USE-ARGUMENT-TYPE
      error E_NOT_OK: error-code=1
    NvMService_AC2_SRBS_Defs
      5 x operation, all with possible-error=NvMService_AC2_SRBS_Defs/E_NOT_OK:
        GetErrorStatus
          arg ErrorStatus: type=NvM_RequestResultType, direction=OUT, server-argument-impl-policy=USE-ARGUMENT-TYPE
        ReadBlock
          arg DstPtr: type=dtRef_VOID, direction=IN, server-argument-impl-policy=USE-ARGUMENT-TYPE
        RestoreBlockDefaults
          arg DstPtr: type=dtRef_VOID, direction=IN, server-argument-impl-policy=USE-ARGUMENT-TYPE
        SetRamBlockStatus
          arg RamBlockStatus: type=boolean, direction=IN, server-argument-impl-policy=USE-ARGUMENT-TYPE
        WriteBlock
          arg SrcPtr: type=dtRef_const_VOID, direction=IN, server-argument-impl-policy=USE-ARGUMENT-TYPE
      error E_NOT_OK: error-code=1
    NvMService_AC2_SRBS_DS
      6 x operation, all with possible-error=NvMService_AC2_SRBS_DS/E_NOT_OK:
        GetDataIndex
          arg DataIndex: type=uint8, direction=OUT, server-argument-impl-policy=USE-ARGUMENT-TYPE
        GetErrorStatus
          arg ErrorStatus: type=NvM_RequestResultType, direction=OUT, server-argument-impl-policy=USE-ARGUMENT-TYPE
        ReadBlock
          arg DstPtr: type=dtRef_VOID, direction=IN, server-argument-impl-policy=USE-ARGUMENT-TYPE
        SetDataIndex
          arg DataIndex: type=uint8, direction=IN, server-argument-impl-policy=USE-ARGUMENT-TYPE
        SetRamBlockStatus
          arg RamBlockStatus: type=boolean, direction=IN, server-argument-impl-policy=USE-ARGUMENT-TYPE
        WriteBlock
          arg SrcPtr: type=dtRef_const_VOID, direction=IN, server-argument-impl-policy=USE-ARGUMENT-TYPE
      error E_NOT_OK: error-code=1
    NvMService_AC2_SRBS_DS_Defs
      7 x operation, all with possible-error=NvMService_AC2_SRBS_DS_Defs/E_NOT_OK:
        GetDataIndex
          arg DataIndex: type=uint8, direction=OUT, server-argument-impl-policy=USE-ARGUMENT-TYPE
        GetErrorStatus
          arg ErrorStatus: type=NvM_RequestResultType, direction=OUT, server-argument-impl-policy=USE-ARGUMENT-TYPE
        ReadBlock
          arg DstPtr: type=dtRef_VOID, direction=IN, server-argument-impl-policy=USE-ARGUMENT-TYPE
        RestoreBlockDefaults
          arg DstPtr: type=dtRef_VOID, direction=IN, server-argument-impl-policy=USE-ARGUMENT-TYPE
        SetDataIndex
          arg DataIndex: type=uint8, direction=IN, server-argument-impl-policy=USE-ARGUMENT-TYPE
        SetRamBlockStatus
          arg RamBlockStatus: type=boolean, direction=IN, server-argument-impl-policy=USE-ARGUMENT-TYPE
        WriteBlock
          arg SrcPtr: type=dtRef_const_VOID, direction=IN, server-argument-impl-policy=USE-ARGUMENT-TYPE
      error E_NOT_OK: error-code=1
    NvMService_AC3
      5 x operation, all with possible-error=NvMService_AC3/E_NOT_OK:
        EraseBlock
        GetErrorStatus
          arg ErrorStatus: type=NvM_RequestResultType, direction=OUT, server-argument-impl-policy=USE-ARGUMENT-TYPE
        InvalidateNvBlock
        ReadBlock
          arg DstPtr: type=dtRef_VOID, direction=IN, server-argument-impl-policy=USE-ARGUMENT-TYPE
        WriteBlock
          arg SrcPtr: type=dtRef_const_VOID, direction=IN, server-argument-impl-policy=USE-ARGUMENT-TYPE
      error E_NOT_OK: error-code=1
    NvMService_AC3_Defs
      6 x operation, all with possible-error=NvMService_AC3_Defs/E_NOT_OK:
        EraseBlock
        GetErrorStatus
          arg ErrorStatus: type=NvM_RequestResultType, direction=OUT, server-argument-impl-policy=USE-ARGUMENT-TYPE
        InvalidateNvBlock
        ReadBlock
          arg DstPtr: type=dtRef_VOID, direction=IN, server-argument-impl-policy=USE-ARGUMENT-TYPE
        RestoreBlockDefaults
          arg DstPtr: type=dtRef_VOID, direction=IN, server-argument-impl-policy=USE-ARGUMENT-TYPE
        WriteBlock
          arg SrcPtr: type=dtRef_const_VOID, direction=IN, server-argument-impl-policy=USE-ARGUMENT-TYPE
      error E_NOT_OK: error-code=1
    NvMService_AC3_DS
      7 x operation, all with possible-error=NvMService_AC3_DS/E_NOT_OK:
        EraseBlock
        GetDataIndex
          arg DataIndex: type=uint8, direction=OUT, server-argument-impl-policy=USE-ARGUMENT-TYPE
        GetErrorStatus
          arg ErrorStatus: type=NvM_RequestResultType, direction=OUT, server-argument-impl-policy=USE-ARGUMENT-TYPE
        InvalidateNvBlock
        ReadBlock
          arg DstPtr: type=dtRef_VOID, direction=IN, server-argument-impl-policy=USE-ARGUMENT-TYPE
        SetDataIndex
          arg DataIndex: type=uint8, direction=IN, server-argument-impl-policy=USE-ARGUMENT-TYPE
        WriteBlock
          arg SrcPtr: type=dtRef_const_VOID, direction=IN, server-argument-impl-policy=USE-ARGUMENT-TYPE
      error E_NOT_OK: error-code=1
    NvMService_AC3_DS_Defs
      8 x operation, all with possible-error=NvMService_AC3_DS_Defs/E_NOT_OK:
        EraseBlock
        GetDataIndex
          arg DataIndex: type=uint8, direction=OUT, server-argument-impl-policy=USE-ARGUMENT-TYPE
        GetErrorStatus
          arg ErrorStatus: type=NvM_RequestResultType, direction=OUT, server-argument-impl-policy=USE-ARGUMENT-TYPE
        InvalidateNvBlock
        ReadBlock
          arg DstPtr: type=dtRef_VOID, direction=IN, server-argument-impl-policy=USE-ARGUMENT-TYPE
        RestoreBlockDefaults
          arg DstPtr: type=dtRef_VOID, direction=IN, server-argument-impl-policy=USE-ARGUMENT-TYPE
        SetDataIndex
          arg DataIndex: type=uint8, direction=IN, server-argument-impl-policy=USE-ARGUMENT-TYPE
        WriteBlock
          arg SrcPtr: type=dtRef_const_VOID, direction=IN, server-argument-impl-policy=USE-ARGUMENT-TYPE
      error E_NOT_OK: error-code=1
    NvMService_AC3_SRBS
      6 x operation, all with possible-error=NvMService_AC3_SRBS/E_NOT_OK:
        EraseBlock
        GetErrorStatus
          arg ErrorStatus: type=NvM_RequestResultType, direction=OUT, server-argument-impl-policy=USE-ARGUMENT-TYPE
        InvalidateNvBlock
        ReadBlock
          arg DstPtr: type=dtRef_VOID, direction=IN, server-argument-impl-policy=USE-ARGUMENT-TYPE
        SetRamBlockStatus
          arg RamBlockStatus: type=boolean, direction=IN, server-argument-impl-policy=USE-ARGUMENT-TYPE
        WriteBlock
          arg SrcPtr: type=dtRef_const_VOID, direction=IN, server-argument-impl-policy=USE-ARGUMENT-TYPE
      error E_NOT_OK: error-code=1
    NvMService_AC3_SRBS_Defs
      7 x operation, all with possible-error=NvMService_AC3_SRBS_Defs/E_NOT_OK:
        EraseBlock
        GetErrorStatus
          arg ErrorStatus: type=NvM_RequestResultType, direction=OUT, server-argument-impl-policy=USE-ARGUMENT-TYPE
        InvalidateNvBlock
        ReadBlock
          arg DstPtr: type=dtRef_VOID, direction=IN, server-argument-impl-policy=USE-ARGUMENT-TYPE
        RestoreBlockDefaults
          arg DstPtr: type=dtRef_VOID, direction=IN, server-argument-impl-policy=USE-ARGUMENT-TYPE
        SetRamBlockStatus
          arg RamBlockStatus: type=boolean, direction=IN, server-argument-impl-policy=USE-ARGUMENT-TYPE
        WriteBlock
          arg SrcPtr: type=dtRef_const_VOID, direction=IN, server-argument-impl-policy=USE-ARGUMENT-TYPE
      error E_NOT_OK: error-code=1
    NvMService_AC3_SRBS_DS
      8 x operation, all with possible-error=NvMService_AC3_SRBS_DS/E_NOT_OK:
        EraseBlock
        GetDataIndex
          arg DataIndex: type=uint8, direction=OUT, server-argument-impl-policy=USE-ARGUMENT-TYPE
        GetErrorStatus
          arg ErrorStatus: type=NvM_RequestResultType, direction=OUT, server-argument-impl-policy=USE-ARGUMENT-TYPE
        InvalidateNvBlock
        ReadBlock
          arg DstPtr: type=dtRef_VOID, direction=IN, server-argument-impl-policy=USE-ARGUMENT-TYPE
        SetDataIndex
          arg DataIndex: type=uint8, direction=IN, server-argument-impl-policy=USE-ARGUMENT-TYPE
        SetRamBlockStatus
          arg RamBlockStatus: type=boolean, direction=IN, server-argument-impl-policy=USE-ARGUMENT-TYPE
        WriteBlock
          arg SrcPtr: type=dtRef_const_VOID, direction=IN, server-argument-impl-policy=USE-ARGUMENT-TYPE
      error E_NOT_OK: error-code=1
    NvMService_AC3_SRBS_DS_Defs
      9 x operation, all with possible-error=NvMService_AC3_SRBS_DS_Defs/E_NOT_OK:
        EraseBlock
        GetDataIndex
          arg DataIndex: type=uint8, direction=OUT, server-argument-impl-policy=USE-ARGUMENT-TYPE
        GetErrorStatus
          arg ErrorStatus: type=NvM_RequestResultType, direction=OUT, server-argument-impl-policy=USE-ARGUMENT-TYPE
        InvalidateNvBlock
        ReadBlock
          arg DstPtr: type=dtRef_VOID, direction=IN, server-argument-impl-policy=USE-ARGUMENT-TYPE
        RestoreBlockDefaults
          arg DstPtr: type=dtRef_VOID, direction=IN, server-argument-impl-policy=USE-ARGUMENT-TYPE
        SetDataIndex
          arg DataIndex: type=uint8, direction=IN, server-argument-impl-policy=USE-ARGUMENT-TYPE
        SetRamBlockStatus
          arg RamBlockStatus: type=boolean, direction=IN, server-argument-impl-policy=USE-ARGUMENT-TYPE
        WriteBlock
          arg SrcPtr: type=dtRef_const_VOID, direction=IN, server-argument-impl-policy=USE-ARGUMENT-TYPE
      error E_NOT_OK: error-code=1
    NvMService_SRBS
      operation GetErrorStatus: possible-error=NvMService_SRBS/E_NOT_OK
        arg ErrorStatus: type=NvM_RequestResultType, direction=OUT, server-argument-impl-policy=USE-ARGUMENT-TYPE
      operation SetRamBlockStatus: possible-error=NvMService_SRBS/E_NOT_OK
        arg RamBlockStatus: type=boolean, direction=IN, server-argument-impl-policy=USE-ARGUMENT-TYPE
      error E_NOT_OK: error-code=1
    CallbackDTCStatusChange: service-kind=DIAGNOSTIC-EVENT-MANAGER
      operation DTCStatusChanged: possible-error=CallbackDTCStatusChange/E_NOT_OK
        arg DTC: type=uint32, direction=IN, server-argument-impl-policy=USE-ARGUMENT-TYPE
        arg DTCStatusOld: type=Dem_UdsStatusByteType, direction=IN, server-argument-impl-policy=USE-ARGUMENT-TYPE
        arg DTCStatusNew: type=Dem_UdsStatusByteType, direction=IN, server-argument-impl-policy=USE-ARGUMENT-TYPE
      error E_NOT_OK: error-code=1
package /ModeDclrGroups
  mode declaration group ESH_Mode: category=ALPHABETIC_ORDER, initial-mode=STARTUP
    5 x mode:
      POSTRUN
      RUN
      SHUTDOWN
      STARTUP
      WAKEUP
package /PortInterfaces
  sender receiver interface IfcDwnstreamVerMajorNumStatus_I
    data IfcDwnstreamVerMajorNumStatus: type=SwNumberStatus_T
  sender receiver interface IfcDwnstreamVerMinorNumStatus_I
    data IfcDwnstreamVerMinorNumStatus: type=SwNumberStatus_T
package /PortInterface
  mode switch interface BswM_MSI_ESH_Mode: is-service=true
    mode group BswM_MDGP_ESH_Mode: type=ESH_Mode
  134 x sender receiver interface:
    ABSFullyOperational_I
      data ABSFullyOperational: type=FullyOperational_T
    HazardLightsExternalRequest_I
      data HazardLightsExternalRequest: type=InactiveActive_T
    DirectionIndicatorLightsExtReq_I
      data DirectionIndicatorLightsExtReq: type=DirectionIndicatorLightsExtReq_T
    AutomationDoorLockUnlockReq_I
      data AutomationDoorLockUnlockReq: type=AutomationDoorLockUnlockReq_T
    ADMSwNumber_I
      data ADMSwNumber: type=ADMSwNumber_T
    VcmMajorSwNumber_I
      data VcmMajorSwNumber: type=SwNumberStatus_T
    VcmMinorSwNumber_I
      data VcmMinorSwNumber: type=SwNumberStatus_T
    VcmPatchSwNumber_I
      data VcmPatchSwNumber: type=SwNumberStatus_T
    IfcUpstreamVerMajorNumStatus_I
      data IfcUpstreamVerMajorNumStatus: type=SwNumberStatus_T
    IfcUpstreamVerMinorNumStatus_I
      data IfcUpstreamVerMinorNumStatus: type=SwNumberStatus_T
    GearShiftInProgress_I
      data GearShiftInProgress: type=InactiveActive_T
    RoadWheelAngleRateCapability_I
      data RoadWheelAngleRateCapability: type=RoadWheelAngleRateCapability_T
    RoadWheelAngleMaxCapability_I
      data RoadWheelAngleMaxCapability: type=RoadWheelAngleMaxCapability_T
    RoadWheelAngleMinCapability_I
      data RoadWheelAngleMinCapability: type=RoadWheelAngleMinCapability_T
    WheelSpeedStatus_I
      data WheelSpeedStatus: type=WheelSpeedStatus_T
    RoadInclinationAngleStatus_I
      data RoadInclinationAngleStatus: type=RoadInclinationAngleStatus_T
    SteeringWheelTorqueEstimate_I
      data SteeringWheelTorqueEstimate: type=SteeringWheelTorqueEstimate_T
    PermittedHSAPressure_I
      data PermittedHSAPressure: type=PermittedHSAPressure_T
    FullBrakes_ind_I
      data FullBrakes_ind: type=FullBrakes_ind_T
    XPRRequest_I
      data XPRRequest: type=XPRRequest_T
    FASRoadWheelAngleRequest_I
      data FASRoadWheelAngleRequest: type=FASRoadWheelAngleRequest_T
    CtaBs_HSABbRequest_I
      data CtaBs_HSABbRequest: type=CtaBs_HSABbRequest_T
    XBRMessageChecksum_I
      data XBRMessageChecksum: type=XBRMessageChecksum_T
    ABSAxle1Active_I
      data ABSAxle1Active: type=OffOn_T
    ABSAxle2Active_I
      data ABSAxle2Active: type=OffOn_T
    ABSAxle3Active_I
      data ABSAxle3Active: type=OffOn_T
    ABSAxle4Active_I
      data ABSAxle4Active: type=OffOn_T
    XBRSystemState_I
      data XBRSystemState: type=XBRSystemState_T
    XPRsystemstate_I
      data XPRsystemstate: type=XPRsystemstate_T
    FASFunctionInControl_I
      data FASFunctionInControl: type=FASFunctionInControl_T
    FrontRoadWheelAngleEstimate_I
      data FrontRoadWheelAngleEstimate: type=RoadWheelAngle_T
    RearAxleSteeringFunctionStatus_I
      data RearAxleSteeringFunctionStatus: type=RearAxleSteeringFunctionStatus_T
    CondVehicleMode_I
      data CondVehicleMode: type=InactiveActive_T
    ActualTagWheelAngle_I
      data ActualTagWheelAngle: type=ActualTagWheelAngle_T
    DriverSteeringTorqueEstimate_I
      data DriverSteeringTorqueEstimate: type=DriverSteeringTorqueEstimate_T
    FASSaturated_I
      data FASSaturated: type=FASSaturated_T
    ABSAxle5Active_I
      data ABSAxle5Active: type=OffOn_T
    XBRMessageCounter_I
      data XBRMessageCounter: type=XBRMessageCounter_T
    FASControlMode_I
      data FASControlMode: type=FASControlMode_T
    RoadWheelAngleStatus_I
      data RoadWheelAngleStatus: type=RoadWheelAngleStatus_T
    TrailerConnectedStatus_I
      data TrailerConnectedStatus: type=TrailerConnectedStatus_T
    DirectionIndicatorLightsStatus_I
      data DirectionIndicatorLightsStatus: type=DirectionIndicatorLightsStatus_T
    VehicleIdentifierStatus_I
      data VehicleIdentifierStatus: type=VehicleIdentifierStatus_T
    Tractor1MassStatus_I
      data Tractor1MassStatus: type=MassStatus_T
    Trailer1IdentifierStatus_I
      data Trailer1IdentifierStatus: type=Trailer1IdentifierStatus_T
    DoorLockStatus_I
      data DoorLockStatus: type=DoorLockStatus_T
    AcceleratorPedalPosition1_I
      data AcceleratorPedalPosition1: type=Percent8bitFactor04_T
    ASRBrakeControlActive_I
      data ASRBrakeControlActive: type=PassiveActive2_T
    AxleLoad_I
      data AxleLoad: type=AxleLoad_T
    RelativeLevel_I
      data RelativeLevel: type=RelativeLevel_T
    BrakeAndPark_ind_I
      data BrakeAndPark_ind: type=BrakeAndPark_ind_T
    BrakePedalPosition_I
      data BrakePedalPosition: type=Percent8bitFactor04_T
    BrakeSwitch_I
      data BrakeSwitch: type=BrakeSwitch_T
    DoorsAjar_stat_I
      data DoorsAjar_stat: type=DoorsAjar_stat_T
    DriverRetarderRequest_I
      data DriverRetarderRequest: type=DriverRetarderRequest_T
    DriverSeatBeltSwitch_I
      data DriverSeatBeltSwitch: type=DriverSeatBeltSwitch_T
    DrvrRetarderBrakeProgram_rqst_I
      data DrvrRetarderBrakeProgram_rqst: type=OffOn_T
    FoundationBrakeUse_I
      data FoundationBrakeUse: type=FoundationBrakeUse_T
    FrAxleLtWhlBrakeApplPrsHiRng_I
      data FrAxleLtWhlBrakeApplPrsHiRng: type=PressureFactor5_T
    FrAxleRtWhlBrakeApplPrsHiRng_I
      data FrAxleRtWhlBrakeApplPrsHiRng: type=PressureFactor5_T
    FrontAxleLeftWheelSpeed_I
      data FrontAxleLeftWheelSpeed: type=Speed16bit_T
    FrontAxleRightWheelSpeed_I
      data FrontAxleRightWheelSpeed: type=Speed16bit_T
    KFactor_I
      data KFactor: type=KFactor_T
    LateralAcceleration_I
      data LateralAcceleration: type=Acceleration16bit_T
    LiftAxle1PositionStatus_I
      data LiftAxle1PositionStatus: type=LiftAxlePositionStatus_T
    LiftAxle2PositionStatus_I
      data LiftAxle2PositionStatus: type=LiftAxlePositionStatus_T
    LongitudinalAcceleration_I
      data LongitudinalAcceleration: type=Acceleration16bit_T
    ParkingBrake_stat_I
      data ParkingBrake_stat: type=ParkingBrake_stat_T
    PBReleaseInhibit_rqst_I
      data PBReleaseInhibit_rqst: type=Request_T
    PreTSC1BsTr_I
      data PreTSC1BsTr: type=PreTSC1Torque_T
    PusherAxleLeftWheelSpeed_I
      data PusherAxleLeftWheelSpeed: type=Speed16bit_T
    RearAxleLeftWheelSpeed_I
      data RearAxleLeftWheelSpeed: type=Speed16bit_T
    RearAxleRightWheelSpeed_I
      data RearAxleRightWheelSpeed: type=Speed16bit_T
    RFBEngineStopAllowed_I
      data RFBEngineStopAllowed: type=NotAllowedAllowed_T
    VehicleLatMotionReq_I
      data VehicleLatMotionReq: type=VehicleLatMotionReq_T
    VehicleModeReq_I
      data VehicleModeReq: type=VehicleModeReq_T
    RoadInclinationAngleDriverSts_I
      data RoadInclinationAngleDriverSts: type=RoadInclinationAngleStatus_T
    RrAxle1LtWhlBrakeApplPrsHiRng_I
      data RrAxle1LtWhlBrakeApplPrsHiRng: type=PressureFactor5_T
    RrAxle2LtWhlBrakeApplPrsHiRng_I
      data RrAxle2LtWhlBrakeApplPrsHiRng: type=PressureFactor5_T
    RrAxle3LtWhlBrakeApplPrsHiRng_I
      data RrAxle3LtWhlBrakeApplPrsHiRng: type=PressureFactor5_T
    ScndRrDriveAxleLeftWheelSpeed_I
      data ScndRrDriveAxleLeftWheelSpeed: type=Speed16bit_T
    ScndRrDriveAxleRightWheelSpeed_I
      data ScndRrDriveAxleRightWheelSpeed: type=Speed16bit_T
    SteeringWheelAngle_I
      data SteeringWheelAngle: type=SteeringWheelAngle_T
    TagAxleLeftWheelSpeed_I
      data TagAxleLeftWheelSpeed: type=Speed16bit_T
    TransmissionCurrentGear_I
      data TransmissionCurrentGear: type=TransmissionGear_T
    TransmissionDrivelineEngaged_I
      data TransmissionDrivelineEngaged: type=DisengageEngage_T
    TransmOutputShaftSpeedSigned_I
      data TransmOutputShaftSpeedSigned: type=SpeedRpm16bitMinus4000_T
    VehicleImmobilization_ind_I
      data VehicleImmobilization_ind: type=InactiveActive_T
    XBRBBM_I
      data XBRBBM: type=XBRBBM_T
    RrAxle1RtWhlBrakeApplPrsHiRng_I
      data RrAxle1RtWhlBrakeApplPrsHiRng: type=PressureFactor5_T
    RrAxle2RtWhlBrakeApplPrsHiRng_I
      data RrAxle2RtWhlBrakeApplPrsHiRng: type=PressureFactor5_T
    RrAxle3RtWhlBrakeApplPrsHiRng_I
      data RrAxle3RtWhlBrakeApplPrsHiRng: type=PressureFactor5_T
    FASFullyOperational_I
      data FASFullyOperational: type=FASFullyOperational_T
    ActualEHPusherWheelAngle_I
      data ActuaEHPusherWheelAngle: type=uint16
    VehModeSts_I
      data VehModeSts: type=VehModeSts_T
    VehicleLgtMotionSts2_I
      data VehicleLgtMotionSts2: type=VehicleLgtMotionSts2_T
    VehicleLgtMotionReq_I
      data VehicleLgtMotionReq: type=VehicleLgtMotionReq_T
    IntvBySftyDrvrDetd_I
      data IntvBySftyDrvrDetd: type=IntvBySftyDrvrDetd_T
    VehicleMotionChInCmdSts_I
      data VehicleMotionChInCmdSts: type=VehicleMotionChInCmdSts_T
    ADSModeReq_I
      data ADSModeReq: type=ADSModeReq_T
    VehicleLgtMotionCpby_I
      data VehicleLgtMotionCpby: type=VehicleLgtMotionCpby_T
    VehicleModeCpby_I
      data VehicleModeCpby: type=VehicleModeCpby_T
    VehCombRetardtnSts_I
      data VehCombRetardtnSts: type=VehCombRetardtnSts_T
    VehicleLgtMotionSts1_I
      data VehicleLgtMotionSts1: type=VehicleLgtMotionSts1_T
    VehicleStructureSts_I
      data VehicleStructureSts: type=VehicleStructureSts_T
    ActualEHTagWheelAngle_I
      data ActualEHTagWheelAngle: type=uint16
    PusherAxleRightWheelSpeed_I
      data PusherAxleRightWheelSpeed: type=Speed16bit_T
    ScndFrAxleLeftWheelSpeed_I
      data ScndFrAxleLeftWheelSpeed: type=Speed16bit_T
    ScndFrAxleRightWheelSpeed_I
      data ScndFrAxleRightWheelSpeed: type=Speed16bit_T
    TagAxleRightWheelSpeed_I
      data TagAxleRightWheelSpeed: type=Speed16bit_T
    YawRate_I
      data YawRate: type=uint16
    RoadInclinationPerc_I
      data RoadInclinationPerc: type=RoadInclinationPerc_T
    VehicleMode_I  # SE-Tool ref: There exists no such signal in SE-TOOL.
      data VehicleMode: type=VehicleMode_T
    ACC_SGO_Status_I
      data ACC_SGO_Status: type=ACC_SGO_Status_T
    ActualDrvlnRetdrPercentTorque_I
      data ActualDrvlnRetdrPercentTorque: type=Percent8bit125NegOffset_T
    ActualEnginePercentTorque_I
      data ActualEnginePercentTorque: type=Percent8bit125NegOffset_T
    ASREngineControlActive_I
      data ASREngineControlActive: type=PassiveActive2_T
    EngineReferenceTorque_I
      data EngineReferenceTorque: type=Torque16bit_T
    EngineSpeed_I
      data EngineSpeed: type=SpeedRpm16bit_T
    TransmissionShiftInProcess_I
      data TransmissionShiftInProcess: type=TransmissionShiftInProcess_T
    TransmissionActualGearRatio_I
      data TransmissionActualGearRatio: type=TransmissionActualGearRatio_T
    VehicleYawInertia_I
      data VehicleYawInertia: type=InertiaQ_T
    VehicleRollInertia_I
      data VehicleRollInertia: type=InertiaQ_T
    VehiclePitchInertia_I
      data VehiclePitchInertia: type=InertiaQ_T
    RearAxleCurvature_I
      data RearAxleCurvature: type=AxleCurvature_T
    SpeedOverGround_I
      data SpeedOverGround: type=SpeedQ_T
    LongitudinalAccelerationQ_I
      data LongitudinalAccelerationQ: type=AccelerationQ_T
    ArticulationAngle_I
      data ArticulationAngle: type=AngleQ_T
    AxleLoadQ_I
      data AxleLoadQ_I: type=LoadQ_T
    RearAxleLifted_I
      data RearAxleLifted_I: type=LiftedQ_T
    MotionState_I
      data MotionState_I: type=MotionStateQ_T
    TrailerConnected_I
      data TrailerConnected: type=TrailerConnectedQ_T
    VehicleStandstill_I
      data VehicleStandstill: type=StandstillQ_T
    FrontAxleSpeed_I
      data FrontAxleSpeed: type=Speed16bit_T
package /SwAddrMethod
  sw addr method NoValueSelected
  sw addr method SA_lvl_0x29
  sw addr method SA_lvl_0x2F
