AUTOSAR XML (schema 4-2-2)
package /Simulink_VASP/Modes
  mode declaration group ESH_Mode: category=ALPHABETIC_ORDER, initial-mode=STARTUP
    5 x mode:
      POSTRUN
      RUN
      SHUTDOWN
      STARTUP
      WAKEUP
package /Simulink_VASP/PortInterfaces
  mode switch interface BswM_MSI_ESH_Mode: is-service=true
    mode group BswM_MDGP_ESH_Mode: type=ESH_Mode
  581 x sender receiver interface:
    ABSFullyOperational_I
      data ABSFullyOperational: type=FullyOperational_ADT
    ACC_Debug_I
      data ACC_Debug: type=ACC_Debug_T
    ACC_Out_I
      data ACC_Out: type=ACC_OutBus
    ACC_SGO_Status_I
      data ACC_SGO_Status: type=ACC_SGO_Status_ADT
    ACC_SGO_TransmissionStatus_I
      data ACC_SGO_TransmissionStatus: type=ACC_SGO_TransmissionStatus_ADT
    ACC_SGOFaultCondStat_I
      data ACC_SGOFaultCondStat: type=ACC_SGOFaultCondStat_ADT
    ACC_Status_BB1_X_D_I
      data ACC_Status_BB1_X_D: type=ACC_Status_BB1_X_D_ADT
    ACC_Status_I
      data ACC_Status: type=ACC_Status_ADT
    ACCBrakeCapacityWarning_I
      data ACCBrakeCapacityWarning: type=ACCBrakeCapacityWarning_ADT
    ACCBrakeRequestStatus_I
      data ACCBrakeRequestStatus: type=InactiveActive_ADT
    AcceleratorPedalPosition1_I
      data AcceleratorPedalPosition1: type=Percent8bitFactor04_ADT
    ACCEnableRqst_BB1_X_D_I
      data ACCEnableRqst_BB1_X_D: type=DisableEnable_ADT
    ACCEnableRqst_I
      data ACCEnableRqst: type=DisableEnable_ADT
    ACCForwardVehicleDistance_I
      data ACCForwardVehicleDistance: type=ACCForwardVehicleDistance_ADT
    ACCForwardVehicleSpeed_I
      data ACCForwardVehicleSpeed: type=Speed8bit_ADT
    ACCHMIStatus_I
      data ACCHMIStatus: type=ACCHMIStatus_ADT
    ACCHSARequest_I
      data ACCHSARequest: type=ACCHSARequest_ADT
    ACCiRollInhibit_I
      data ACCiRollInhibit: type=Inhibit_ADT
    ACCiSeeDistanceGap_I
      data ACCiSeeDistanceGap: type=ACCiSeeDistanceGap_ADT
    ACCstatus
      data ACCstatus: type=ACCstatus
    ACCTargetDetected_I
      data ACCTargetDetected: type=ACCTargetDetected_ADT
    ACCTargetRelLongSpeed_I
      data ACCTargetRelLongSpeed: type=SpeedTarget8bit_ADT
    ACCTimeGapRqst_I
      data ACCTimeGapRqst: type=ACCTimeGapRqst_ADT
    AcctrPedalKickDownSw_stat_I
      data AcctrPedalKickDownSw_stat: type=PassiveActive_ADT
    ActiveSafetySystemsDisableByRoutine_I
      data ActiveSafetySystemsDisableByRoutine: type=InactiveActive_ADT
    ActualEnginePercentTorque_I
      data ActualEnginePercentTorque: type=Percent8bit125NegOffset_ADT
    AdaptiveCruiseControlMode_I
      data AdaptiveCruiseControlMode: type=AdaptiveCruiseControlMode_ADT
    AdaptiveCruiseControlSetDistan_I
      data AdaptiveCruiseControlSetDistan: type=AdaptiveCruiseControlSetDistan_ADT
    AntiLockBrakingActive_I
      data AntiLockBrakingActive: type=AntiLockBrakingActive_ADT
    AutomaticCMenableStatus_I
      data AutomaticCMenableStatus: type=OffOn_ADT
    AxleLoad_I
      data AxleLoad: type=AxleLoad_ADT
    BB_XBR_RqstActive_I
      data BB_XBR_RqstActive: type=FalseTrue_ADT
    BBSteeringStatus_I
      data BBSteeringStatus: type=InactiveActive_ADT
    BlackOutandConvoyMode_rqst_I
      data BlackOutandConvoyMode_rqst: type=BlackOutandConvoyMode_rqst_ADT
    BrakePedalPosition_I
      data BrakePedalPosition: type=Percent8bitFactor04_ADT
    BrakeSwitch_I
      data BrakeSwitch: type=BrakeSwitch_ADT
    BrakeTempWarningLevel_I
      data BrakeTempWarningLevel: type=Percent8bitNoOffset_ADT
    CCActive_I
      data CCActive: type=OffOn_ADT
    CCBSetSpeed_I
      data CCBSetSpeed: type=Speed16bit_ADT
    CCBSetSpeedApplied_I
      data CCBSetSpeedApplied: type=Speed8bit_ADT
    CCDeactivationWarning_I
      data CCDeactivationWarning: type=OffOn_ADT
    CCSetSpeed_I
      data CCSetSpeed: type=Speed16bit_ADT
    CCSetSpeedApplied_I
      data CCSetSpeedApplied: type=Speed8bit_ADT
    CM_DisengageDrivelineRequest_I
      data CM_DisengageDrivelineRequest: type=CM_DisengageDrivelineRequest_ADT
    CM_Status_I
      data CM_Status: type=CM_Status_ADT
    CMReducedAbilityStatus_I
      data CMReducedAbilityStatus: type=ReducedAbilityStatus_ADT
    CMTelltale_stat_I
      data CMTelltale_stat: type=Telltale_cmd_ADT
    CMTellTaleStatus
      data CMTellTaleStatus: type=CMTellTaleStatus
    CollisionSituationAliveAck_I
      data CollisionSituationAliveAck: type=Count4bitOperMax13_ADT
    CollisionSituationAliveRequest_I
      data CollisionSituationAliveRequest: type=Count4bitOperMax13_ADT
    CollisionSituationAliveStatus_I
      data CollisionSituationAliveStatus: type=Count4bitOperMax13_ADT
    CruiseCtrlActive
      data CruiseCtrlActive: type=CruiseCtrlActive
    CruiseCtrlSetSpeed
      data CruiseCtrlSetSpeed: type=CruiseCtrlSetSpeed
    CWEB_Debug_I
      data CWEB_Debug: type=CWEB_Debug_T
    CWEB_Out_I
      data CWEB_Out: type=CWEB_OutBus
    DASActivation_rqst_I
      data DASActivation_rqst: type=OffOn_ADT
    DASApplicationStatus_I
      data DASApplicationStatus: type=DASSystemStatus_ADT
    DASWarning_BB1_X_D_I
      data DASWarning_BB1_X_D: type=DASWarning_BB1_X_D_ADT
    DelphiRaCamObjects_I
      data DelphiRaCamObjects: type=DelphiRaCamObjectsInterface_bus
    DelphiSensorStatus_I
      data DelphiSensorStatus: type=DelphiSensorStatus_bus
    DiffLockInteraxelStatus
      data DiffLockInteraxelStatus: type=DiffLockInteraxelStatus
    DiffLockWheelsInput1
      data DiffLockWheelsInput1: type=DiffLockWheelsInput1
    DiffLockWheelsInput2
      data DiffLockWheelsInput2: type=DiffLockWheelsInput2
    DisengageDrivelineRequest_I
      data DisengageDrivelineRequest: type=DisengageDrivelineRequest_ADT
    DoorsAjar_stat_I
      data DoorsAjar_stat: type=DoorsAjar_stat_ADT
    DrivelineRetarderLocation_I
      data DrivelineRetarderLocation: sw-impl-policy=QUEUED, type=DrivelineRetarderLocation_ADT
    DrivelineRetarderRefTorque_I
      data DrivelineRetarderRefTorque: sw-impl-policy=QUEUED, type=Torque16bit_ADT
    DriverCardDriver1_I
      data DriverCardDriver1: type=NotPresentPresent_ADT
    DriverImpairedDriverAlert_I
      data DriverImpairedDriverAlert: type=DASImpairmentWarningStatus_ADT
    DriverSeatBeltSwitch_I
      data DriverSeatBeltSwitch: type=DriverSeatBeltSwitch_ADT
    DriverSteeringTorqueEstimate_I
      data DriverSteeringTorqueEstimate: type=DriverSteeringTorqueEstimate_ADT
    DriverSteeringTqEstimateConf_I
      data DriverSteeringTqEstimateConf: type=Confidence3bit_ADT
    DriverVigilanceLevel_BB1_X_D_I
      data DriverVigilanceLevel_BB1_X_D: type=DriverVigilanceLevel_BB1_X_D_ADT
    DriverVigilanceLevel_I
      data DriverVigilanceLevel: type=DASVigilanceLevelStatus_ADT
    DVE_Debug_I
      data DVE_Debug: type=DVE_Debug_T
    DVE_Out_I
      data DVE_Out: type=DVE_OutBus
    EBSXBRStatusInformation_I
      data EBSXBRStatusInformation: type=EBSXBRStatusInformation_ADT
    EgoVehicleTrajectoryPlanner_Out_I
      data EgoVehicleTrajectoryPlanner_Out: type=EgoVehicleTrajectoryPlanner_OutBus
    EmergencyBrakingInhibition
      data EmergencyBrakingInhibition: type=EmergencyBrakingInhibition
    EngineReferenceTorque_I
      data EngineReferenceTorque: sw-impl-policy=QUEUED, type=Torque16bit_ADT
    EngineSpeed_I
      data EngineSpeed: type=SpeedRpm16bit_ADT
    EngineTorqueMode
      data EngineTorqueMode: type=EngineTorqueMode
    ERC1ERActualEngineRetPercentTrq_I
      data ERC1ERActualEngineRetPercentTrq: type=ERC1ERActualEngineRetPercentTrq_ADT
    ERC1RActualRetarderPercentTorque_I
      data ERC1RActualRetarderPercentTorque: type=ERC1RActualRetarderPercentTorque_ADT
    ETC2_TransActualGearRatio
      data ETC2_TransActualGearRatio: type=ETC2_TransActualGearRatio_ADT
    ETC2_TransActualGearRatio_I
      data ETC2_TransActualGearRatio: type=ETC2_TransActualGearRatio_ADT
    ETC2_TransCurrentGear
      data ETC2_TransCurrentGear: type=ETC2_TransCurrentGear
    FASControlMode_I
      data FASControlMode: type=FASControlMode_ADT
    FASCurvatureRequest_I
      data FASCurvatureRequest: type=Curvature_per_M_ADT
    FASFullyOperational_I
      data FASFullyOperational: type=FASFullyOperational_ADT
    FASFunctionInControl_I
      data FASFunctionInControl: type=FASFunctionInControl_ADT
    FASHapticFeedbackRequest_I
      data FASHapticFeedbackRequest: type=FASHapticFeedbackRequest_ADT
    FASRoadWheelAngleRequest_I
      data FASRoadWheelAngleRequest: type=RoadWheelAngle_ADT
    FASSaturated_I
      data FASSaturated: type=FASSaturated_ADT
    FCW_OpticalWarningStatus_I
      data FCW_OpticalWarningStatus: type=FCW_OpticalWarningStatus_ADT
    FCW_Status_I
      data FCW_Status: type=DisableEnable_ADT
    FoundationBrakeUse_I
      data FoundationBrakeUse: type=FoundationBrakeUse_ADT
    FrontalCollisionDriverAlert_I
      data FrontalCollisionDriverAlert: type=FCW_Warning_ADT
    FrontAxleLeftWheelSpeed_I
      data FrontAxleLeftWheelSpeed: type=Speed16bit_ADT
    FrontAxleRightWheelSpeed_I
      data FrontAxleRightWheelSpeed: type=Speed16bit_ADT
    FrontAxleSpeed_I
      data FrontAxleSpeed: type=Speed16bit_ADT
    FrontCollisionDriverAlrt_BB1_X_D_I
      data FrontCollisionDriverAlrt_BB1_X_D: type=FCW_Warning_ADT
    FrontRoadWheelAngleEstimate_I
      data FrontRoadWheelAngleEstimate: type=RoadWheelAngle_ADT
    GlareFreeArea_I
      data GlareFreeArea: type=GlareFreeArea_ADT
    GrossCombinationVehicleWeight_I
      data GrossCombinationVehicleWeight: type=VehicleWeight16bit_ADT
    HazardLightRequest_I
      data HazardLightRequest: type=ActivateDeactivateRqst3bit_ADT
    HillHolderMode_I
      data HillHolderMode: type=HillHolderMode_ADT
    HOA_Out_I
      data HOA_Out: type=HOA_Out_bus
    HSAState_I
      data HSAState: type=HSAState_ADT
    KFactor_I
      data KFactor: type=KFactor_ADT
    LaneChangeStatus_I
      data LaneChangeStatus: type=LaneChangeStatus_ADT
    LateralAcceleration_I
      data LateralAcceleration: type=Acceleration16bit_ADT
    LateralAccOffset_BB1_X_A_I
      data LateralAccOffset_BB1_X_A: type=LateralAccOffset_BB1_X_A_ADT
    LCS_EnableSwitch_rqst_I
      data LCS_EnableSwitch_rqst: type=OffOn_ADT
    LCS_WarningStatus_I
      data LCS_WarningStatus: type=LCS_WarningStatus_ADT
    LCSSoundSettingRequest_I
      data LCSSoundSettingRequest: type=LCSSoundSettingRequest_ADT
    LCSSoundSettingStatus_I
      data LCSSoundSettingStatus: type=LCSSoundSettingStatus_ADT
    LCSSystemStatus_I
      data LCSSystemStatus: type=LCSSystemStatus_ADT
    LeftFlash_Truck
      data LeftFlash_Truck: type=LeftFlash_Truck
    LiftAxle1PositionStatus_I
      data LiftAxle1PositionStatus: type=LiftAxlePositionStatus_ADT
    LKS_Enable_I
      data LKS_Enable: type=OffOn_ADT
    LKSApplicationStatus_BB1_X_D_I
      data LKSApplicationStatus_BB1_X_D: type=LKSStatus_ADT
    LKSApplicationStatus_I
      data LKSApplicationStatus: type=LKSStatus_ADT
    LKSCorrectiveSteeringStatus_I
      data LKSCorrectiveSteeringStatus: type=LKSCorrectiveSteeringStatus_ADT
    LKSEnableSwitch_rqst_I
      data LKSEnableSwitch_rqst: type=OffOn_ADT
    LoadTruck_I
      data LoadTruck: type=Load16bit_ADT
    LongitudinalAcceleration_I
      data LongitudinalAcceleration: type=Acceleration16bit_ADT
    LongMotionDirection_I
      data LongMotionDirection: type=LongMotionDirection_ADT
    LPOSBlocked_I
      data LPOSBlocked: type=FalseTrue_ADT
    LPS_Debug_I
      data LPS_Debug: type=LPS_Debug_T
    LPS_Out_I
      data LPS_Out: type=LPS_OutBus
    MUM_Debug_I
      data MUM_Debug: type=MUM_Debug_T
    MUM_Out_I
      data MUM_Out: type=MUM_Out_bus
    NominalFrictionPercentTorque_I
      data NominalFrictionPercentTorque: type=Percent8bit125NegOffset_ADT
    NonDrivableRegionSituation_Out_I
      data NonDrivableRegionSituation_Out: type=NonDrivableRegionSituation_OutBus
    ObserveRoadRestriction_OpCap_I
      data ObserveRoadRestriction_OpCap: type=ObserveRoadRestriction_ADT
    ObserveRoadRestrictionStatus_I
      data ObserveRoadRestrictionStatus: type=OffOn_ADT
    ParkBrakeActuationStatus_I
      data ParkBrakeActuationStatus: type=ParkBrakeActuationStatus_ADT
    ParkingBrkSwitch
      data ParkingBrkSwitch: type=Boolean_SL_ADT
    PathDeviationDriverAlert_BB1_X_D_I
      data PathDeviationDriverAlert_BB1_X_D: type=LKSDepartureWarningStatus_ADT
    PathDeviationDriverAlert_I
      data PathDeviationDriverAlert: type=LKSDepartureWarningStatus_ADT
    PercentageOfBrakeTemperatureWa
      data PercentageOfBrakeTemperatureWa: type=PercentageOfBrakeTemperatureWa
    PloughLampModeStatus_I
      data PloughLampModeStatus: type=InactiveActive_ADT
    PoweredVehicleWeight_I
      data PoweredVehicleWeight: type=VehicleWeight16bit_ADT
    PropulsionStat_I
      data PropulsionStat: type=PropulsionStat_ADT
    RASstatus
      data RASstatus: type=RASstatus
    RCERReferenceRetarderTorque_I
      data RCERReferenceRetarderTorque: type=RCERReferenceRetarderTorque_ADT
    RCRReferenceRetarderTorque
      data RCRReferenceRetarderTorque: type=RCRReferenceRetarderTorque
    RCRRetarderLocation
      data RCRRetarderLocation: type=RCRRetarderLocation
    RearAxleLeftWheelSpeed_I
      data RearAxleLeftWheelSpeed: type=Speed16bit_ADT
    RearAxleRightWheelSpeed_I
      data RearAxleRightWheelSpeed: type=Speed16bit_ADT
    RearAxleSteeringFunctionStatus_I
      data RearAxleSteeringFunctionStatus: type=RearAxleSteeringFunctionStatus_ADT
    ReferenceEngineRetarderTorque_I
      data ReferenceEngineRetarderTorque: sw-impl-policy=QUEUED, type=Torque16bit_ADT
    ReferencePathCurvature_I
      data ReferencePathCurvature: type=Curvature_per_M_ADT
    RelativeSpdFrntAxleLeftWheel
      data RelativeSpdFrntAxleLeftWheel: type=RelativeSpdFrntAxleLeftWheel
    RelativeSpdRearAxle1LeftWheel
      data RelativeSpdRearAxle1LeftWheel: type=RelativeSpdRearAxle1LeftWheel
    RequestedACCDistanceMode
      data RequestedACCDistanceMode: type=RequestedACCDistanceMode
    ResumeRequestForACC_I
      data ResumeRequestForACC: type=OffOn_ADT
    RetarderStalkArmPosition
      data RetarderStalkArmPosition: type=RetarderStalkArmPosition
    ReverseGearEngaged_I
      data ReverseGearEngaged: type=ReverseGearEngaged_ADT
    ReverseGearStatus
      data ReverseGearStatus: type=ReverseGearStatus
    RightFlash_Truck
      data RightFlash_Truck: type=RightFlash_Truck
    RlativeSpdFrntAxleRightWheel
      data RlativeSpdFrntAxleRightWheel: type=RlativeSpdFrntAxleRightWheel
    RlativeSpdRearAxle1RightWheel
      data RlativeSpdRearAxle1RightWheel: type=RlativeSpdRearAxle1RightWheel
    RoadInclination_I
      data RoadInclination: type=RoadInclination_ADT
    RoadInclinationVP15
      data RoadInclinationVP15: type=RoadInclinationVP15
    RoadOvertakingRestriction_I
      data RoadOvertakingRestriction: type=RoadOvertakingRestriction_ADT
    RoadSpeedRestriction_I
      data RoadSpeedRestriction: type=RoadSpeedRestriction_ADT
    RoadTypeSpeedRestriction_I
      data RoadTypeSpeedRestriction: type=RoadTypeSpeedRestriction_ADT
    RollerBenchModeStatus_I
      data RollerBenchModeStatus: type=InactiveActive_ADT
    ROPBrakeControlActive_I
      data ROPBrakeControlActive: type=PassiveActive2_ADT
    ROPBrakeCtrlActive
      data ROPBrakeCtrlActive: type=ROPBrakeCtrlActive
    RSBBM_I
      data RSBBM: type=RSBBM_ADT
    RteStatus_I
      data RteStatus: type=uint8
    SCS_Debug_I
      data SCS_Debug: type=SCS_Debug_T
    SCS_Out_I
      data SCS_Out: type=SCS_OutBus
    SDF_Debug_I
      data SDF_Debug: type=SDF_Debug_T
    SDF_Out_I
      data SDF_Out: type=FusionOutputInterface_bus
    SecondThrottle_I
      data SecondThrottle: type=InactiveActive_ADT
    SelectedEcoCruiseLevel_I
      data SelectedEcoCruiseLevel: type=SelectedEcoCruiseLevel_ADT
    SetCMOperation_I
      data SetCMOperation: type=SetCMOperation_ADT
    SetFCWOperation_I
      data SetFCWOperation: type=SetFCWOperation_ADT
    sideObject_I
      data sideObject: type=InactiveActive_ADT
    SideObjectDetected_I
      data SideObjectDetected: type=InactiveActive_ADT
    SpeedOverGround_I
      data SpeedOverGround: type=SpeedMS16bit00108507_ADT
    SteeringWheelAngle_I
      data SteeringWheelAngle: type=SteeringWheelAngle_ADT
    SteeringWheelAngle1
      data SteeringWheelAngle1: type=SteeringWheelAngle1
    SteeringWheelAngleOffset
      data SteeringWheelAngleOffset: type=SteeringWheelAngleOffset
    TargetID_I
      data TargetID: type=TargetID_ADT
    TrafficSit_XAR_I
      data TrafficSit_XAR: type=TSAM_XAR_bus
    TrafficSit_XBR_I
      data TrafficSit_XBR: type=TSAM_XBR_bus
    TrafficSit_XSR_I
      data TrafficSit_XSR: type=TSAM_XSR_bus
    TrafficSituationCriticality_I
      data TrafficSituationCriticality: type=Int3Bit_Error_ADT
    TrailerABSStatus_I
      data TrailerABSStatus: type=TrailerABSStatus_ADT
    TrailerConnected_I
      data TrailerConnected: type=NoYes_ADT
    TrailerWithoutABS_I
      data TrailerWithoutABS: type=TrailerWithoutABS_ADT
    TrailerWoABS
      data TrailerWoABS: type=TrailerWoABS
    TransmissionActualGearRatio_I
      data TransmissionActualGearRatio: type=TransmissionActualGearRatio_ADT
    TransmissionDrivelineEngaged_I
      data TransmissionDrivelineEngaged: type=DisengageEngage_ADT
    TransmissionShiftInProcess_I
      data TransmissionShiftInProcess: type=TransmissionShiftInProcess_ADT
    TransmOutputShaftSpeedSigned_I
      data TransmOutputShaftSpeedSigned: type=SpeedRpm16bitMinus4000_ADT
    TSC1_E_D_sg_I
      data TSC1_E_D_sg: type=TSC1_E_D_sg_ADT
    TSC1EMSDACU_I
      data TSC1EMSDACU: type=TSC1Rec_ADT
    TSM_Debug_I
      data TSM_Debug: type=TSM_Debug_T
    TSM_Out_I
      data TSM_Out: type=TSM_OutBus
    TSR_Out_I
      data TSR_Out: type=TSR_Out_bus
    VDCFullyOperational_I
      data VDCFullyOperational: type=FullyOperational_ADT
    VehicleCalibratedLoad_I
      data VehicleCalibratedLoad: type=Load16bit_ADT
    VehicleMode_I
      data VehicleMode: type=VehicleMode_T
    WheelBasedVehicleSpeed_I
      data WheelBasedVehicleSpeed: type=Speed16bit_ADT
    VisionLight_stat_I
      data VisionLight_stat: type=VisionLight_stat_ADT
    VP40TrailerABSStatus
      data VP40TrailerABSStatus: type=VP40TrailerABSStatus
    VSI_Dynamic_Out_I
      data VSI_Dynamic_Out: type=VSI_Dynamic_Out_bus
    VSI_Out_I
      data VSI_Out: type=VSI_Out_bus
    XARActiveControlMode_I
      data XARActiveControlMode: type=XARActiveControlMode_ADT
    XARDACU_I
      data XARDACU: type=XARDACU_ADT
    XARSystemState_I
      data XARSystemState: type=XARSystemState_ADT
    XBR_A_D_sg_I
      data XBR_A_D_sg: type=XBR_A_D_sg_ADT
    XBR_A_V_ControlMode
      data XBR_A_V_ControlMode: type=XBR_A_V_ControlMode
    XBRActiveControlMode_I
      data XBRActiveControlMode: type=XBRActiveControlMode_ADT
    XBRBrakingCapacityTemperature_I
      data XBRBrakingCapacityTemperature: type=Percent8bitFactor04_ADT
    XBRBrakingCapacityTime_I
      data XBRBrakingCapacityTime: type=Seconds8bitFact1_ADT
    XBRDACU_I
      data XBRDACU: type=XBRDACU_ADT
    XBRMessageChecksum_I
      data XBRMessageChecksum: type=UInt4_ADT
    XBRMessageCounter_I
      data XBRMessageCounter: type=UInt4_ADT
    XBRSystemInformation_I
      data XBRSystemInformation: type=XBRSystemInformation_ADT
    XBRSystemState_I
      data XBRSystemState: type=XBRSystemState_ADT
    XPRRequest_I
      data XPRRequest: type=XPRRequest_ADT
    XPRsystemstate_I
      data XPRsystemstate: type=XPRsystemstate_ADT
    YawRate_I
      data YawRate: type=YawRate16bit_ADT
    YawRateCompensated_I
      data YawRateCompensated: type=YawRate16bit_ADT
    YawRateOffset
      data YawRateOffset: type=YawRateOffset
    YCBrakeControlActive_I
      data YCBrakeControlActive: type=PassiveActive2_ADT
    GPSData_I
      data GPSData: sw-impl-policy=QUEUED, type=GPSData_ADT
    RoadSpeedUnitType_I
      data RoadSpeedUnitType: type=SpeedUnitType_ADT
    LKS_DriverOverride_I
      data LKS_DriverOverride: type=FalseTrue_ADT
    PathDeviationSteeringStatus_I
      data PathDeviationSteeringStatus: type=PathDeviationSteeringStatus_ADT
    TSAMIntervntionCapabilityLeft_I
      data TSAMIntervntionCapabilityLeft: type=TSAMIntervntionCapability_ADT
    TSAMIntervntionCapabilityRight_I
      data TSAMIntervntionCapabilityRight: type=TSAMIntervntionCapability_ADT
    TrailerGeometricData_I
      data TrailerGeometricData: type=TrailerGeometricData_ADT
    TrailersConnected_I
      data TrailersConnected: type=Count3bit_ADT
    TransmissionCurrentGear_I
      data TransmissionCurrentGear: type=TransmissionGear_ADT
    AdasisMapData_I
      data AdasisMapData: type=AdasisMapData_ADT
    LSMS_KnobAngle_I
      data LSMS_KnobAngle: type=LSMS_KnobAngle_ADT
    LSMS_KnobButtonStatus_I
      data LSMS_KnobButtonStatus: type=NeutralPushed_ADT
    LSMS_LED_IndicationCmd_I
      data LSMS_LED_IndicationCmd: type=OffOn_ADT
    RoadObjApprox2_a0_I
      data RoadObjApprox2_a0: type=RoadObjApprox2_a0_ADT
    V2V_BrakeCapacity_I
      data V2V_BrakeCapacity: type=V2V_BrakeCapacity_ADT
    V2V_EgoPositionData_I
      data V2V_EgoPositionData: type=V2V_EgoPositionData_ADT
    V2V_IdentificationRequest_I
      data V2V_IdentificationRequest: type=VehicleID8bit_ADT
    V2V_IdentificationRequested_I
      data V2V_IdentificationRequested: type=VehicleID8bit_ADT
    V2V_IdentificationStatus_I
      data V2V_IdentificationStatus: type=V2V_IdentificationStatus_ADT
    V2V_IsJoinable_I
      data V2V_IsJoinable: type=V2V_IsJoinable_ADT
    V2V_IsPlatoonable_I
      data V2V_IsPlatoonable: type=NotAllowedAllowed_ADT
    V2V_JoinRqstPlatooningLevel_I
      data V2V_JoinRqstPlatooningLevel: type=V2V_JoinRqstPlatooningLevel_ADT
    V2V_LateralAccConfidence_I
      data V2V_LateralAccConfidence: type=Acceleration7bit01f_ADT
    V2V_LeaveRequest_I
      data V2V_LeaveRequest: type=V2V_LeaveRequest_ADT
    V2V_LeaveRequestReason_I
      data V2V_LeaveRequestReason: type=V2V_LeaveRequestReason_ADT
    V2V_PlatoonLength_I
      data V2V_PlatoonLength: type=Count4bitOperMax13_ADT
    V2V_PlatoonPosition_I
      data V2V_PlatoonPosition: type=V2V_PlatoonPosition_ADT
    V2V_StationType_I
      data V2V_StationType: type=V2V_StationType_ADT
    V2V_SteeringWheelAngleConf_I
      data V2V_SteeringWheelAngleConf: type=SteeringWheelAngleConf_ADT
    V2V_VehicleAheadDistance_I
      data V2V_VehicleAheadDistance: type=Distance16b01fm_ADT
    V2V_VehicleLengthConfidence_I
      data V2V_VehicleLengthConfidence: type=V2V_VehLengthConfidence_ADT
    V2V_VehiclePowerToMassRatio_I
      data V2V_VehiclePowerToMassRatio: type=VehiclePowerToMassRatio_ADT
    V2V_YawRateConfidence_I
      data V2V_YawRateConfidence: type=V2V_YawRateConfidence_ADT
    ACC_SGOBrakeAlert_I
      data ACC_SGOBrakeAlert: type=Alert_ADT
    CACCSuitability_I
      data CACCSuitability: type=Suitable_ADT
    CACCTimeGapRqst_I
      data CACCTimeGapRqst: type=Selected_ADT
    SpeedAdaptationLevelRqst_I
      data SpeedAdaptationLevelRqst: type=LowMidHigh_ADT
    SpeedAdaptEnableRqst_I
      data SpeedAdaptEnableRqst: type=SpeedAdaptEnableRqst_ADT
    CACCStatus_I
      data CACCStatus: type=CACCStatus_ADT
    LSMS_AngleMatch_I
      data LSMS_AngleMatch: type=LSMS_AngleMatch_ADT
    LSMS_JackKnifeWarning_I
      data LSMS_JackKnifeWarning: type=InactiveActive_ADT
    LSMS_KnbSteerUAPreCon_I
      data LSMS_KnbSteerUAPreCon: type=KnobSteerFunction_ADT
    LSMS_KnbSteerUASens_I
      data LSMS_KnbSteerUASens: type=KnobSteerFunction_ADT
    LSMS_RecordedPathLeft_I
      data LSMS_RecordedPathLeft: type=Distance16b1fm_ADT
    LSMS_RevDirSupportUAPreCon_I
      data LSMS_RevDirSupportUAPreCon: type=ReverseDirectionSupport_ADT
    LSMS_RevDirSupportUASens_I
      data LSMS_RevDirSupportUASens: type=ReverseDirectionSupport_ADT
    LSMS_SpeedLimit_I
      data LSMS_SpeedLimit: type=LSMS_SpeedLimit_ADT
    LSMS_UndoUAPreCon_I
      data LSMS_UndoUAPreCon: type=LSMS_UndoUAPreCon_ADT
    LSMS_UndoUASens_I
      data LSMS_UndoUASens: type=LSMS_UndoUASens_ADT
    SlopeBuffer_Out_I
      data SlopeBuffer_Out: type=SlopeBufferOutputBus
    CurvatureBuffer_Out_I
      data CurvatureBuffer_Out: type=CurvatureBufferOutputBus
    SpeedLimitBuffer_Out_I
      data SpeedLimitBuffer_Out: sw-calibration-access=READ-ONLY, type=SpeedLimitBufferOutputBus
    RoadEventBuffer_Out_I
      data RoadEventBuffer_Out: type=RoadEventBufferOutputBus
    EgoPosition_Out_I
      data EgoPosition_Out: type=PositionOutputBus
    ISeeStatus_I
      data ISeeStatus: type=ISeeStatus_ADT
    LKSCSActiveBoxStatus_GUIrqst_I
      data LKSCSActiveBoxStatus_GUIrqst: type=DisableEnable_ADT
    TransmissionDrivingMode_I
      data TransmissionDrivingMode: type=TransmissionDrivingMode_ADT
    DebugFrame_I
      data FrameData: type=DebugFrame_T
    EngineActiveStatus_I
      data EngineActiveStatus: type=EngineActiveStatus_ADT
    PSC_DriverBrakingAllowed_I
      data PSC_DriverBrakingAllowed: type=NotAllowedAllowed_ADT
    PSC_RequestedPresetSpeed_I
      data PSC_RequestedPresetSpeed: type=Speed16bit_ADT
    PSC_SetSpeedChangeRqst_I
      data PSC_SetSpeedChangeRqst: type=NoChangeChange_ADT
    RelativeLevelFrontAxleLeftRaw_I
      data RelativeLevelFrontAxleLeftRaw: type=Level16bit_ADT
    RelativeLevelFrontAxleRightRaw_I
      data RelativeLevelFrontAxleRightRaw: type=Level16bit_ADT
    TrafficSitPathEvent_I
      data TrafficSitPathEvent: type=TrafficSitPathEvent_ADT
    TrafficSitSpdProfile_I
      data TrafficSitSpdProfile: type=TrafficSitSpdProfile_ADT
    LongitudinalPathPlanner_OutBus_I
      data LongitudinalPathPlanner_Out: type=LongitudinalPathPlanner_OutBus
    ActualDrvlnRetdrPercentTorque_I
      data ActualDrvlnRetdrPercentTorque: type=Percent8bit125NegOffset_ADT
    ActualEngineRetarderPercentTrq_I
      data ActualEngineRetarderPercentTrq: type=Percent8bit125NegOffset_ADT
    ActualMaxAvailDrvlnRetPrctTrq_I
      data ActualMaxAvailDrvlnRetPrctTrq: type=Percent8bit125NegOffset_ADT
    AmbientAirTemperature_I
      data AmbientAirTemperature: type=Temperature16bit_ADT
    ASRBrakeControlActive_I
      data ASRBrakeControlActive: type=PassiveActive2_ADT
    CabLightIntensity_stat_I
      data CabLightIntensity_stat: type=Percent8bitFactor04_ADT
    DriveAssistEnableRqst_I
      data DriveAssistEnableRqst: type=DriveAssistEnableRqst_ADT
    DriveAssistStatus_I
      data DriveAssistStatus: type=DriveAssistStatus_ADT
    DriverRetarderRequest_I
      data DriverRetarderRequest: type=DriverRetarderRequest_ADT
    DriverTakeControlRqst_I
      data DriverTakeControlRqst: type=DriverTakeControlRqst_ADT
    FogLight_Front_cmd_I
      data FogLight_Front_cmd: type=InactiveActive_ADT
    FrAxleLtWhlBrakeApplPrsHiRng_I
      data FrAxleLtWhlBrakeApplPrsHiRng: type=PressureFactor5_ADT
    FrAxleRtWhlBrakeApplPrsHiRng_I
      data FrAxleRtWhlBrakeApplPrsHiRng: type=PressureFactor5_ADT
    MainBeam_cmd_I
      data MainBeam_cmd: type=MainBeam_cmd_ADT
    RelativeLevelFrontAxleLeft_I
      data RelativeLevelFrontAxleLeft: type=Level16bit_ADT
    RelativeLevelFrontAxleRight_I
      data RelativeLevelFrontAxleRight: type=Level16bit_ADT
    RelativeLevelRearAxleLeft_I
      data RelativeLevelRearAxleLeft: type=Level16bit_ADT
    RelativeLevelRearAxleRight_I
      data RelativeLevelRearAxleRight: type=Level16bit_ADT
    RrAxle1LtWhlBrakeApplPrsHiRng_I
      data RrAxle1LtWhlBrakeApplPrsHiRng: type=PressureFactor5_ADT
    RrAxle1RtWhlBrakeApplPrsHiRng_I
      data RrAxle1RtWhlBrakeApplPrsHiRng: type=PressureFactor5_ADT
    RrAxle2LtWhlBrakeApplPrsHiRng_I
      data RrAxle2LtWhlBrakeApplPrsHiRng: type=PressureFactor5_ADT
    RrAxle2RtWhlBrakeApplPrsHiRng_I
      data RrAxle2RtWhlBrakeApplPrsHiRng: type=PressureFactor5_ADT
    RrAxle3LtWhlBrakeApplPrsHiRng_I
      data RrAxle3LtWhlBrakeApplPrsHiRng: type=PressureFactor5_ADT
    RrAxle3RtWhlBrakeApplPrsHiRng_I
      data RrAxle3RtWhlBrakeApplPrsHiRng: type=PressureFactor5_ADT
    ScndRrDriveAxleLeftWheelSpeed_I
      data ScndRrDriveAxleLeftWheelSpeed: type=Speed16bit_ADT
    ScndRrDriveAxleRightWheelSpeed_I
      data ScndRrDriveAxleRightWheelSpeed: type=Speed16bit_ADT
    SideSensorPowerDownAck_I
      data SideSensorPowerDownAck: type=NotConfirmedConfirmed_ADT
    TachographLocalHourOffset_I
      data TachographLocalHourOffset: type=Hours8bit125NegOffset_ADT
    TachographLocalMinuteOffset_I
      data TachographLocalMinuteOffset: type=Minutes8bit125NegOffset_ADT
    TachographVehicleSpeed_I
      data TachographVehicleSpeed: type=Speed16bit_ADT
    TotalVehicleDistanceHighRes_I
      data TotalVehicleDistanceHighRes: type=Distance32bit_ADT
    TSMEngineOnRecommended_I
      data TSMEngineOnRecommended: type=TSMEngineOnRecommended_ADT
    V2V_BackSplitRqst_I
      data V2V_BackSplitRqst: type=V2V_BackSplitRqst_ADT
    V2V_Event_ABI_I
      data V2V_Event_ABI: type=V2V_Event_ABI_ADT
    V2V_Event_BDV_I
      data V2V_Event_BDV: type=V2V_Event_BDV_ADT
    V2V_Event_DEOQ_I
      data V2V_Event_DEOQ: type=V2V_Event_DEOQ_ADT
    V2V_Event_EEBL_I
      data V2V_Event_EEBL: type=V2V_Event_EEBL_ADT
    V2V_Event_EVIO_I
      data V2V_Event_EVIO: type=V2V_Event_EVIO_ADT
    V2V_Event_PC_I
      data V2V_Event_PC: type=V2V_Event_PC_ADT
    V2V_Event_RORSI_I
      data V2V_Event_RORSI: type=V2V_Event_RORSI_ADT
    V2V_Event_SRSW_I
      data V2V_Event_SRSW: type=V2V_Event_SRSW_ADT
    V2V_Event_SSEV_I
      data V2V_Event_SSEV: type=V2V_Event_SSEV_ADT
    V2V_Event_SV_I
      data V2V_Event_SV: type=V2V_Event_SV_ADT
    V2V_Event_TJA_I
      data V2V_Event_TJA: type=V2V_Event_TJA_ADT
    V2V_FrontReasonForGapAdj_I
      data V2V_FrontReasonForGapAdj: type=V2V_FrontReasonForGapAdj_ADT
    V2V_FrontSplitRqst_I
      data V2V_FrontSplitRqst: type=V2V_FrontSplitRqst_ADT
    V2V_LongSpeedConf_I
      data V2V_LongSpeedConf: type=V2V_LongSpeedConf_ADT
    V2V_PlatoonCandidate_I
      data V2V_PlatoonCandidate: type=V2V_PlatoonCandidate_ADT
    V2V_PlatooningEnabled_I
      data V2V_PlatooningEnabled: type=DisableEnable_ADT
    V2V_PlatoonStatus_I
      data V2V_PlatoonStatus: type=V2V_PlatoonStatus_ADT
    V2V_RoadCurvature_I
      data V2V_RoadCurvature: type=Curvature_per_M_ADT
    V2V_Station_ID_I
      data V2V_Station_ID: type=Number32bit2_ADT
    V2V_VehicleLength_I
      data V2V_VehicleLength: type=VehicleLength_ADT
    SideSensorObjects_I
      data SideSensorObjects: type=BoschSideSensorOutput_bus
    SDF_Side_Out_I
      data SDF_Side_Out: sw-calibration-access=READ-ONLY, type=SDFBoschSideTracksInterfaceOutput_bus
    FrontFLRSensorObjects_I
      data FrontFLRSensorObjects: type=BoschFLRSensorOutput_bus
    FrontFLCSensorObjects_I
      data FrontFLCSensorObjects: type=BoschFLCSensorOutput_bus
    NewSDF_Out_I
      data NewSDF_Out: type=NewFusionOutputInterface_bus
    ABSAxle1Active_I
      data ABSAxle1Active: type=OffOn_ADT
    ABSAxle2Active_I
      data ABSAxle2Active: type=OffOn_ADT
    ABSAxle3Active_I
      data ABSAxle3Active: type=OffOn_ADT
    ABSAxle4Active_I
      data ABSAxle4Active: type=OffOn_ADT
    ABSAxle5Active_I
      data ABSAxle5Active: type=OffOn_ADT
    ActualTagWheelAngle_I
      data ActualTagWheelAngle: type=ActualTagWheelAngle_ADT
    ASREngineControlActive_I
      data ASREngineControlActive: type=PassiveActive2_ADT
    CountryCode_I
      data CountryCode: type=CountryCode_ADT
    EHActualPusherWheelAngle_I
      data EHActualPusherWheelAngle: type=WheelAngle_ADT
    EHActualTagWheelAngle_I
      data EHActualTagWheelAngle: type=WheelAngle_ADT
    LiftAxle2PositionStatus_I
      data LiftAxle2PositionStatus: type=LiftAxlePositionStatus_ADT
    PusherAxleLeftWheelSpeed_I
      data PusherAxleLeftWheelSpeed: type=Speed16bit_ADT
    PusherAxleRightWheelSpeed_I
      data PusherAxleRightWheelSpeed: type=Speed16bit_ADT
    ScndFrAxleLeftWheelSpeed_I
      data ScndFrAxleLeftWheelSpeed: type=Speed16bit_ADT
    ScndFrAxleRightWheelSpeed_I
      data ScndFrAxleRightWheelSpeed: type=Speed16bit_ADT
    TagAxleLeftWheelSpeed_I
      data TagAxleLeftWheelSpeed: type=Speed16bit_ADT
    TagAxleRightWheelSpeed_I
      data TagAxleRightWheelSpeed: type=Speed16bit_ADT
    Clothoid_I
      data Clothoid: type=Clothoid_ADT
    EgoAssumpt_I
      data EgoAssumpt: type=EgoAssumpt_ADT
    EgoPathPrediction_I
      data EgoPathPrediction: type=EgoPathPrediction_ADT
    FLCPowerDemand_I
      data FLCPowerDemand: type=PowerDemand_ADT
    FLRPowerDemand_I
      data FLRPowerDemand: type=PowerDemand_ADT
    FrontWheelAngle_Local_I
      data FrontWheelAngle_Local: type=RoadWheelAngle_ADT
    FwdSensingCamStat_I
      data FwdSensingCamStat: type=FwdSensingCamStat_ADT
    FwdSensingRadarStat_I
      data FwdSensingRadarStat: type=FwdSensingRadarStat_ADT
    LCS_WarningStatusLeft_I
      data LCS_WarningStatusLeft: type=LCS_WarningStatus2_ADT
    LCS_WarningStatusRight_I
      data LCS_WarningStatusRight: type=LCS_WarningStatus2_ADT
    LongMotionDirectionQual_Local_I
      data LongMotionDirectionQual_Local: type=longitudinalMotionDirection_ADT
    RadarSensorStatus_I
      data RadarSensorStatus: type=RadarSensorStatus_ADT
    ShadowArea_I
      data ShadowArea: type=ShadowArea_ADT
    SideSensingRadarStat_I
      data SideSensingRadarStat: type=SideSensingRadarStat_ADT
    SideSensorPowerDownReq_I
      data SideSensorPowerDownReq: type=NotRequested_ADT
    SideSensorPowerMode_I
      data SideSensorPowerMode: type=Request_ADT
    SpeedOverGroundQuality_I
      data SpeedOverGroundQuality: type=SpeedOverGroundQuality_ADT
    SwVersion_I
      data SwVersion: type=SwVersionRecord_ADT
    TimeSyncFup_I
      data TimeSyncFup: type=TimeSyncFup_ADT
    TimeSyncOFNS_I
      data TimeSyncOFNS: type=TimeSyncOFNS_ADT
    TimeSyncOFS_I
      data TimeSyncOFS: type=TimeSyncOFS_ADT
    VIN_stat_I
      data VIN_stat: type=VIN_stat_ADT
    WiperModeStatus_I
      data WiperModeStatus: type=WiperModeStatus_ADT
    VisionProperties_I
      data VisionProperties: type=VisionProperties_ADT
    YawRateQuality_I
      data YawRateQuality: type=YawRateQuality_ADT
    Brightspot_I
      data Brightspot: type=Brightspot_ADT
    DynamicAngle_I
      data DynamicAngle: type=DynamicAngle_ADT
    EgoMotionRaw_I
      data EgoMotionRaw: type=EgoMotionRaw_ADT
    EgoMotionXYplane_I
      data EgoMotionXYplane: type=EgoMotionXYplane_ADT
    FLCEgoAssumption_I
      data FLCEgoAssumption: type=FLCEgoAssumption_ADT
    FLCObject_I
      data FLCObject: type=FLCObject_ADT
    FLRObject_I
      data FLRObject: type=FLRObject_ADT
    RaisedEdge_I
      data RaisedEdge: type=RaisedEdge_ADT
    RegionCode_I
      data RegionCode: type=RegionCode_ADT
    SideSensorObject_I
      data SideSensorObject: type=SideSensorObject_ADT
    SideSensorTrlrObj_I
      data SideSensorTrlrObj: type=SideSensorTrlrObj_ADT
    TimeSynchStat_I
      data TimeSynchStat: type=String1Ch_ADT
    TrafficSign_I
      data TrafficSign: type=TrafficSign_ADT
    TrailerData_I
      data TrailerData: type=TrailerData_ADT
    VIN_I
      data VIN: type=VIN_ADT
    ForwardLookingCameraStatus_I
      data ForwardLookingCameraStatus: type=CameraStatus_ADT
    ActualEHPusherWheelAngle_I
      data ActualEHPusherWheelAngle: type=WheelAngle_ADT
    ActualEHTagWheelAngle_I
      data ActualEHTagWheelAngle: type=WheelAngle_ADT
    AngleType_I
      data AngleType: type=AngleType_ADT
    CalibStat_I
      data CalibStat: type=CalibStat_ADT
    CentralRearDiffLock_stat_I
      data CentralRearDiffLock_stat: type=DisengageEngage_ADT
    CountryCodeLocal_I
      data CountryCodeLocal: type=CountryCodeLocal_ADT
    DifferentialLockStateCentral_I
      data DifferentialLockStateCentral: type=DisengageEngage_ADT
    DifferentialLockStateCentral2_I
      data DifferentialLockStateCentral2: type=DisengagedEngaged_ADT
    DifferentialLockStateFrAxle1_I
      data DifferentialLockStateFrAxle1: type=DisengageEngage_ADT
    DifferentialLockStateFrAxle2_I
      data DifferentialLockStateFrAxle2: type=DisengagedEngaged_ADT
    EHERearAxleSteeringFuncStatus_I
      data EHERearAxleSteeringFuncStatus: type=FunctionStatus3bit_ADT
    EHRearAxleSteeringFuncStatus_I
      data EHRearAxleSteeringFuncStatus: type=FunctionStatus3bit_ADT
    FLCVideoOutStatus_I
      data FLCVideoOutStatus: type=FLCVideoOutStatus_ADT
    ForwardLookingCameraStatus2_I
      data ForwardLookingCameraStatus2: type=CameraStatus2_ADT
    RadarCalibrationProgress_I
      data RadarCalibrationProgress: type=Percent7bit_ADT
    RadarCalibrationStatus_I
      data RadarCalibrationStatus: type=RadarCalibrationStatus_ADT
    RearAxle1DiffLock_stat_I
      data RearAxle1DiffLock_stat: type=OffOn_ADT
    RearAxle2DiffLock_stat_I
      data RearAxle2DiffLock_stat: type=OffOn_ADT
    RearAxle3DiffLock_stat_I
      data RearAxle3DiffLock_stat: type=OffOn_ADT
    SensorLoggingTrigger_I
      data SensorLoggingTrigger: type=SensorLoggingTrigger_ADT
    SideRadarsStatus_I
      data SideRadarsStatus: type=SideRadarsStatus_ADT
    VideoOutConfFLC_I
      data VideoOutConfFLC: type=VideoOutConfFLC_ADT
    WheelCircumference_I
      data WheelCircumference: type=WheelCircumference_ADT
    LiftAxle2Pos_I
      data LiftAxle2Pos: type=LiftAxle2Pos_ADT
    WheelBasedVehicleSpeed_BB1_X_V_I
      data WheelBasedVehicleSpeed_BB1_X_V: type=WheelBasedVehicleSpeed_BB1_X_V_ADT
    ASRBrakeControlActive_BB1_X_EBS_I
      data ASRBrakeControlActive_BB1_X_EBS: type=ASRBrakeControlActive_BB1_X_EBS_ADT
    AntiLockBrakingActive_BB1_X_EBS_I
      data AntiLockBrakingActive_BB1_X_EBS: type=AntiLockBrakingActive_BB1_X_EBS_ADT
    LiftAxle1Pos_I
      data LiftAxle1Pos: type=LiftAxle1Pos_ADT
    RelativeSpeedRearAxle2LeftWheel_I
      data RelativeSpeedRearAxle2LeftWheel: type=RelativeSpeedRearAxle2LeftWheel_ADT
    YCBrakeControlActive_BB1_X_EBS_I
      data YCBrakeControlActive_BB1_X_EBS: type=YCBrakeControlActive_BB1_X_EBS_ADT
    BrkApplPressHiRaRearAxle1L_I
      data BrkApplPressHiRaRearAxle1L: type=BrkApplPressHiRaRearAxle1L_ADT
    BrkApplPressHiRaRearAxle1R_I
      data BrkApplPressHiRaRearAxle1R: type=BrkApplPressHiRaRearAxle1R_ADT
    AxleLocation_I
      data AxleLocation: type=AxleLocation_ADT
    BrkApplPressHiRaRearAxle2R_I
      data BrkApplPressHiRaRearAxle2R: type=BrkApplPressHiRaRearAxle2R_ADT
    BrkApplPressHiRaRearAxle2L_I
      data BrkApplPressHiRaRearAxle2L: type=BrkApplPressHiRaRearAxle2L_ADT
    TERoadinclination_BB1_X_V_I
      data TERoadinclination_BB1_X_V: type=TERoadinclination_BB1_X_V_ADT
    BrkApplPressHiRaRearAxle3L_I
      data BrkApplPressHiRaRearAxle3L: type=BrkApplPressHiRaRearAxle3L_ADT
    BrkApplPressHiRaRearAxle3R_I
      data BrkApplPressHiRaRearAxle3R: type=BrkApplPressHiRaRearAxle3R_ADT
    TPDT_SeqNo_EMS_EE_I
      data TPDT_SeqNo_EMS_EE: type=TPDT_SeqNo_EMS_EE_ADT
    BrkApplPressHiRaFrAxleR_I
      data BrkApplPressHiRaFrAxleR: type=BrkApplPressHiRaFrAxleR_ADT
    BrkApplPressHiRaFrAxleL_I
      data BrkApplPressHiRaFrAxleL: type=BrkApplPressHiRaFrAxleL_ADT
    AxleWeight_I
      data AxleWeight: type=AxleWeight_ADT
    TPCM_ControlByte_EMS_EE_I
      data TPCM_ControlByte_EMS_EE: type=TPCM_ControlByte_EMS_EE_ADT
    ActAvailPwtRegenStatus_I
      data ActAvailPwtRegenStatus: type=ActAvailPwtRegenStatus_ADT
    RlativeSpeedRearAxle2RightWheel_I
      data RlativeSpeedRearAxle2RightWheel: type=RlativeSpeedRearAxle2RightWheel_ADT
    ReferenceEngineTorque_I
      data ReferenceEngineTorque: type=ReferenceEngineTorque_ADT
    PEMTimeGapRequest_I
      data PEMTimeGapRequest: type=Time6bitFactor0P2_ADT
    TrafficSitOverspeedWarn_I
      data TrafficSitOverspeedWarn: type=OverspeedWarn_ADT
    TrafficSitPathInfo_I
      data TrafficSitPathInfo: type=TrafficSitPathInfo_ADT
    TrafficSitSpeedNotify_I
      data TrafficSitSpeedNotify: type=TrafficSitSpeedNotify_ADT
    UpcomingRoadSpeedRestriction_I
      data UpcomingRoadSpeedRestriction: type=RoadSpeedRestriction_ADT
    SDF_Debug_Local
      data SDF_Debug_Local: sw-calibration-access=READ-ONLY, type=SDF_Debug_Local_T
    LongitudinalAcceleration_BP_I
      data LongitudinalAcceleration_BP: type=LongitudinalAcceleration_BP_ADT
    TransOutputShaftSpdSignd_BB1_X_T_I
      data TransOutputShaftSpdSignd_BB1_X_T: type=TransOutputShaftSpdSignd_BB1_X_T_ADT
    SCS_OpticalWarningStatus_I
      data SCS_OpticalWarningStatus: type=UInt8_ADT
    SDF_Trigger_I
      data SDF_Trigger: type=UInt8_ADT
    BendingAngle_I
      data BendingAngle: type=BendingAngle_ADT
    ForwardDistanceAlert_I
      data ForwardDistanceAlert: type=ForwardDistanceAlert_ADT
    MOISDriverAlert_I
      data MOISDriverAlert: type=MOISDriverAlert_ADT
    RelativeLevelRearAxleLeftRaw_I
      data RelativeLevelRearAxleLeftRaw: type=Level16bit_ADT
    RelativeLevelRearAxleRightRaw_I
      data RelativeLevelRearAxleRightRaw: type=Level16bit_ADT
    SideCollSituationEnableRqst_I
      data SideCollSituationEnableRqst: type=OffOn_ADT
    LightIntensity_I
      data LightIntensity: sw-calibration-access=READ-ONLY, type=Percent8bitFactor04_ADT
    FormOfWayBuffer_Out
      data FormOfWayBuffer_Out: sw-calibration-access=READ-ONLY, type=FormOfWayBufferOutputBus
    AccPedal_I
      data AccPedal: type=AccPedal_ADT
    AmbientLight_stat_I
      data AmbientLight_stat: type=AmbientLight_stat_ADT
    CMSLCSWarningStatus_stat_I
      data CMSLCSWarningStatus_stat: type=Warning3bit_4_ADT
    DayOfWeek_stat_I
      data DayOfWeek_stat: type=DayOfWeek_ADT
    HoursLocal_I
      data HoursLocal: type=Hours8bit_ADT
    MinutesLocal_I
      data MinutesLocal: type=Minutes8bit_ADT
    PositionLightRequest_status_I
      data PositionLightRequest_status: type=OffOn_ADT
    PSCTimeGapRequest_I
      data PSCTimeGapRequest: type=Time6bitFactor0P2_ADT
    SideSensorMALAzimuth_I
      data SideSensorMALAzimuth: type=SideSensorMALElevation_ADT
    SideSensorMALElevation_I
      data SideSensorMALElevation: type=SideSensorMALElevation_ADT
    YawRateOffset_I
      data YawRateOffset: type=YawRateOffset_ADT
    DiffLockInteraxelStatus_I
      data DiffLockInteraxelStatus: type=DiffLockInteraxelStatus_ADT
    DaigFaultStat_VP232_FLS_sg_I
      data DaigFaultStat_VP232_FLS_sg: type=DaigFaultStat_VP232_FLS_sg_ADT
    TrailerWoABS_I
      data TrailerWoABS: type=TrailerWoABS_ADT
    HighBeam_BB1_X_LCM_I
      data HighBeam_BB1_X_LCM: type=HighBeam_BB1_X_LCM_ADT
    WiperParkStatusGlobal_BB1_X_LCM_I
      data WiperParkStatusGlobal_BB1_X_LCM: type=WiperParkStatusGlobal_BB1_X_LCM_ADT
    CMTellTaleStatus_I
      data CMTellTaleStatus: type=CMTellTaleStatus_ADT
    RelativeSpdFrntAxleLeftWheel_I
      data RelativeSpdFrntAxleLeftWheel: type=RelativeSpdFrntAxleLeftWheel_ADT
    CC_ACC_pos_BB1_X_V_I
      data CC_ACC_pos_BB1_X_V: type=CC_ACC_pos_BB1_X_V_ADT
    RequestDrivingDirection_BB1_X_D_I
      data RequestDrivingDirection_BB1_X_D: type=RequestDrivingDirection_BB1_X_D_ADT
    ACC_SGO_Status_BB1_X_D_I
      data ACC_SGO_Status_BB1_X_D: type=ACC_SGO_Status_BB1_X_D_ADT
    DiagFaultStat_DACU_UB_I
      data DiagFaultStat_DACU_UB: type=DiagFaultStat_DACU_UB_ADT
    Autonomous_PwtStatus_BB1_X_T_I
      data Autonomous_PwtStatus_BB1_X_T: type=Autonomous_PwtStatus_BB1_X_T_ADT
    SteeringWheelAngleOffset_I
      data SteeringWheelAngleOffset: type=SteeringWheelAngleOffset_ADT
    SteeringWheelAngle1_I
      data SteeringWheelAngle1: type=SteeringWheelAngle1_ADT
    ACC_TG_Switch_State_BB1_X_D_I
      data ACC_TG_Switch_State_BB1_X_D: type=ACC_TG_Switch_State_BB1_X_D_ADT
    RCRRetarderLocation_I
      data RCRRetarderLocation: type=RCRRetarderLocation_ADT
    VP40TrailerABSStatus_I
      data VP40TrailerABSStatus: type=VP40TrailerABSStatus_ADT
    RlativeSpdRearAxle1RightWheel_I
      data RlativeSpdRearAxle1RightWheel: type=RlativeSpdRearAxle1RightWheel_ADT
    ACCDistanceAlertSignal_BB1_X_D_I
      data ACCDistanceAlertSignal_BB1_X_D: type=ACCDistanceAlertSignal_BB1_X_D_ADT
    PowerSupplyKeyPos_I
      data PowerSupplyKeyPos: type=PowerSupplyKeyPos_ADT
    DaigFaultStat_VP232_DACU_sg_I
      data DaigFaultStat_VP232_DACU_sg: type=DaigFaultStat_VP232_DACU_sg_ADT
    CruiseControlState_I
      data CruiseControlState: type=CruiseControlState_ADT
    RightFlash_Truck_BB1_X_LCM_I
      data RightFlash_Truck_BB1_X_LCM: type=RightFlash_Truck_BB1_X_LCM_ADT
    ACCHSARequest_BB1_X_D_I
      data ACCHSARequest_BB1_X_D: type=ACCHSARequest_BB1_X_D_ADT
    CruiseCtrlActive_I
      data CruiseCtrlActive: type=CruiseCtrlActive_ADT
    DaigFaultStat_VP232_LPOS_sg_I
      data DaigFaultStat_VP232_LPOS_sg: type=DaigFaultStat_VP232_LPOS_sg_ADT
    ShutdownRequest_I
      data ShutdownRequest: type=ShutdownRequest_ADT
    LKSStatus_BB1_X_D_I
      data LKSStatus_BB1_X_D: type=LKSStatus_BB1_X_D_ADT
    XBR_A_V_ControlMode_I
      data XBR_A_V_ControlMode: type=XBR_A_V_ControlMode_ADT
    RequestedACCDistanceMode_I
      data RequestedACCDistanceMode: type=RequestedACCDistanceMode_ADT
    ACCstatus_I
      data ACCstatus: type=ACCstatus_ADT
    FrontVRU_EnableSwitch_rqst_I
      data FrontVRU_EnableSwitch_rqst: type=FrontVRU_EnableSwitch_rqst_ADT
    DrowsyDriverWarning_BB1_X_D_I
      data DrowsyDriverWarning_BB1_X_D: type=DrowsyDriverWarning_BB1_X_D_ADT
    DiffLockWheelsInput1_I
      data DiffLockWheelsInput1: type=DiffLockWheelsInput1_ADT
    DiffLockWheelsInput2_I
      data DiffLockWheelsInput2: type=DiffLockWheelsInput2_ADT
    WheelDistToStopTolerance_BB1_X_D_I
      data WheelDistToStopTolerance_BB1_X_D: type=WheelDistToStopTolerance_BB1_X_D_ADT
    CollSituationHMICtrlRequestVM_I
      data CollSituationHMICtrlRequestVM: type=CollSituationHMICtrlRequestVM_ADT
    WheelSpdForwardCapMin_BB1_X_T_I
      data WheelSpdForwardCapMin_BB1_X_T: type=WheelSpdForwardCapMin_BB1_X_T_ADT
    RCRReferenceRetarderTorque_I
      data RCRReferenceRetarderTorque: type=RCRReferenceRetarderTorque_ADT
    TPDT_SeqNo_R_I
      data TPDT_SeqNo_R: type=TPDT_SeqNo_R_ADT
    RetarderStalkArmPosition_I
      data RetarderStalkArmPosition: type=RetarderStalkArmPosition_ADT
    DiagFaultStat_LPOS_UB_I
      data DiagFaultStat_LPOS_UB: type=DiagFaultStat_LPOS_UB_ADT
    ETC2_TransCurrentGear_I
      data ETC2_TransCurrentGear: type=ETC2_TransCurrentGear_ADT
    AdaptiveCCSetSpeed_BB1_X_DACU_I
      data AdaptiveCCSetSpeed_BB1_X_DACU: type=AdaptiveCCSetSpeed_BB1_X_DACU_ADT
    Autonomous_State_BB1_X_D_I
      data Autonomous_State_BB1_X_D: type=Autonomous_State_BB1_X_D_ADT
    ACC_SGO_TransmissionStat_BB1_X_T_I
      data ACC_SGO_TransmissionStat_BB1_X_T: type=ACC_SGO_TransmissionStat_BB1_X_T_ADT
    LDWSDisableSwitchStatus_BB1_X_D_I
      data LDWSDisableSwitchStatus_BB1_X_D: type=LDWSDisableSwitchStatus_BB1_X_D_ADT
    XPRRequest_BB1_X_D_I
      data XPRRequest_BB1_X_D: type=XPRRequest_BB1_X_D_ADT
    RASstatus_I
      data RASstatus: type=RASstatus_ADT
    WheelDistanceToStopReq_BB1_X_D_I
      data WheelDistanceToStopReq_BB1_X_D: type=WheelDistanceToStopReq_BB1_X_D_ADT
    ReverseGearStatus_I
      data ReverseGearStatus: type=ReverseGearStatus_ADT
    ForwardLookingRadarStat_BB1_X_D_I
      data ForwardLookingRadarStat_BB1_X_D: type=ForwardLookingRadarStat_BB1_X_D_ADT
    EngineTorqueMode_I
      data EngineTorqueMode: type=EngineTorqueMode_ADT
    ParkingBrkSwitch_I
      data ParkingBrkSwitch: type=ParkingBrkSwitch_ADT
    LCSStatus_BB1_X_D_I
      data LCSStatus_BB1_X_D: type=LCSStatus_BB1_X_D_ADT
    RoadInclinationVP15_I
      data RoadInclinationVP15: type=RoadInclinationVP15_ADT
    LeftFlash_Truck_BB1_X_LCM_I
      data LeftFlash_Truck_BB1_X_LCM: type=LeftFlash_Truck_BB1_X_LCM_ADT
    EmergencyBrakingInhibition_I
      data EmergencyBrakingInhibition: type=EmergencyBrakingInhibition_ADT
    TrailerConnected_BB1_X_LCM_I
      data TrailerConnected_BB1_X_LCM: type=TrailerConnected_BB1_X_LCM_ADT
    LCSHazardDetectedInRange_BB1_X_D_I
      data LCSHazardDetectedInRange_BB1_X_D: type=LCSHazardDetectedInRange_BB1_X_D_ADT
    ForwardLookingCameraStat_BB1_X_D_I
      data ForwardLookingCameraStat_BB1_X_D: type=ForwardLookingCameraStat_BB1_X_D_ADT
    TD_V_sg_I
      data TD_V_sg: type=TD_V_sg_ADT
    TD_I_sg_I
      data TD_I_sg: type=TD_I_sg_ADT
    RlativeSpdFrntAxleRightWheel_I
      data RlativeSpdFrntAxleRightWheel: type=RlativeSpdFrntAxleRightWheel_ADT
    DepartureAlert_BB1_X_D_I
      data DepartureAlert_BB1_X_D: type=DepartureAlert_BB1_X_D_ADT
    PercentageOfBrakeTemperatureWa_I
      data PercentageOfBrakeTemperatureWa: type=PercentageOfBrakeTemperatureWa_ADT
    WheelSpdReverseCapMin_BB1_X_T_I
      data WheelSpdReverseCapMin_BB1_X_T: type=WheelSpdReverseCapMin_BB1_X_T_ADT
    RelativeSpdRearAxle1LeftWheel_I
      data RelativeSpdRearAxle1LeftWheel: type=RelativeSpdRearAxle1LeftWheel_ADT
    HRVD_I_TotalVehiclDistancHighRes_I
      data HRVD_I_TotalVehiclDistancHighRes: type=HRVD_I_TotalVehiclDistancHighRes_ADT
    WheelSpdAccPreviewCapMax_BB1_X_T_I
      data WheelSpdAccPreviewCapMax_BB1_X_T: type=WheelSpdAccPreviewCapMax_BB1_X_T_ADT
    AmbientAirTemp_I
      data AmbientAirTemp: type=AmbientAirTemp_ADT
    DiagFaultStat_FLS_UB_I
      data DiagFaultStat_FLS_UB: type=DiagFaultStat_FLS_UB_ADT
    WheelSpdAccCapMax_BB1_X_T_I
      data WheelSpdAccCapMax_BB1_X_T: type=WheelSpdAccCapMax_BB1_X_T_ADT
    AmbientLight_I
      data AmbientLight: type=AmbientLight_ADT
    DASMuteRadioRequest_BB1_X_D_I
      data DASMuteRadioRequest_BB1_X_D: type=DASMuteRadioRequest_BB1_X_D_ADT
    CruiseCtrlSetSpeed_I
      data CruiseCtrlSetSpeed: type=CruiseCtrlSetSpeed_ADT
    ROPBrakeCtrlActive_I
      data ROPBrakeCtrlActive: type=ROPBrakeCtrlActive_ADT
    PerformSafeStop_I
      data PerformSafeStop: type=UInt8
    LatControlFactor_I
      data LatControlFactor: type=Float
    FwdLookingCamStat3_I
      data FwdLookingCamStat3: type=FwdLookingCamStat3_ADT
    FwdRadarStatus2_I
      data FwdRadarStatus2: type=FwdRadarStatus2_ADT
    MOIS_Status_I
      data MOIS_Status: type=MOIS_Status_ADT
    SetFwdDistanceAlert_Rqst_I
      data SetFwdDistanceAlert_Rqst: type=SetFwdDistanceAlert_Rqst_ADT
    SetMOISOperation_I
      data SetMOISOperation: type=SetMOISOperation_ADT
    SideSensorSafeState_I
      data SideSensorSafeState: type=InactiveActive_ADT
    IlluminationBrightnessPercent_SL_I
      data IlluminationBrightnessPercent_SLCM08: type=IlluminationBrightnessPercent_SL_ADT
    NightOrDay_BB1_X_LCM_I
      data NightOrDay_BB1_X_LCM: type=NightOrDay_BB1_X_LCM_ADT
    LongitudinalAcceleration_8b_I
      data LongitudinalAcceleration_8b: type=LongitudinalAcceleration_8b_ADT
    FuncIndIlluminationLevel_I
      data FuncIndIlluminationLevel: type=FuncIndIlluminationLevel_ADT
    NewSDF_Out_Clone_I
      data NewSDF_Out: type=NewFusionOutputInterface_bus
package /Predefined_DEV/PortInterfaces
  43 x client server interface:
    NvMAdministration: is-service=true
      operation SetBlockProtection: possible-error=NvMAdministration/E_NOT_OK
        arg ProtectionEnabled: type=boolean, direction=IN, server-argument-impl-policy=USE-ARGUMENT-TYPE
      error E_NOT_OK: error-code=1
    NvMNotifyInitBlock: is-service=true
      operation InitBlock
    NvMNotifyJobFinished: is-service=true
      operation JobFinished
        arg ServiceId: type=NvM_ServiceIdType, direction=IN, server-argument-impl-policy=USE-ARGUMENT-TYPE
        arg JobResult: type=NvM_RequestResultType, direction=IN, server-argument-impl-policy=USE-ARGUMENT-TYPE
    NvMService: is-service=true
      operation GetErrorStatus: possible-error=NvMService/E_NOT_OK
        arg ErrorStatus: type=NvM_RequestResultType, direction=OUT, server-argument-impl-policy=USE-ARGUMENT-TYPE
      error E_NOT_OK: error-code=1
    NvMService_AC2: is-service=true
      operation GetErrorStatus: possible-error=NvMService_AC2/E_NOT_OK
        arg ErrorStatus: type=NvM_RequestResultType, direction=OUT, server-argument-impl-policy=USE-ARGUMENT-TYPE
      operation ReadBlock: possible-error=NvMService_AC2/E_NOT_OK
        arg DstPtr: type=dtRef_VOID, direction=IN, server-argument-impl-policy=USE-ARGUMENT-TYPE
      operation WriteBlock: possible-error=NvMService_AC2/E_NOT_OK
        arg SrcPtr: type=dtRef_const_VOID, direction=IN, server-argument-impl-policy=USE-ARGUMENT-TYPE
      error E_NOT_OK: error-code=1
    NvMService_AC2_Defs: is-service=true
      4 x operation, all with possible-error=NvMService_AC2_Defs/E_NOT_OK:
        GetErrorStatus
          arg ErrorStatus: type=NvM_RequestResultType, direction=OUT, server-argument-impl-policy=USE-ARGUMENT-TYPE
        ReadBlock
          arg DstPtr: type=dtRef_VOID, direction=IN, server-argument-impl-policy=USE-ARGUMENT-TYPE
        RestoreBlockDefaults
          arg DstPtr: type=dtRef_VOID, direction=IN, server-argument-impl-policy=USE-ARGUMENT-TYPE
        WriteBlock
          arg SrcPtr: type=dtRef_const_VOID, direction=IN, server-argument-impl-policy=USE-ARGUMENT-TYPE
      error E_NOT_OK: error-code=1
    NvMService_AC2_DS: is-service=true
      5 x operation, all with possible-error=NvMService_AC2_DS/E_NOT_OK:
        GetDataIndex
          arg DataIndex: type=uint8, direction=OUT, server-argument-impl-policy=USE-ARGUMENT-TYPE
        GetErrorStatus
          arg ErrorStatus: type=NvM_RequestResultType, direction=OUT, server-argument-impl-policy=USE-ARGUMENT-TYPE
        ReadBlock
          arg DstPtr: type=dtRef_VOID, direction=IN, server-argument-impl-policy=USE-ARGUMENT-TYPE
        SetDataIndex
          arg DataIndex: type=uint8, direction=IN, server-argument-impl-policy=USE-ARGUMENT-TYPE
        WriteBlock
          arg SrcPtr: type=dtRef_const_VOID, direction=IN, server-argument-impl-policy=USE-ARGUMENT-TYPE
      error E_NOT_OK: error-code=1
    NvMService_AC2_DS_Defs: is-service=true
      6 x operation, all with possible-error=NvMService_AC2_DS_Defs/E_NOT_OK:
        GetDataIndex
          arg DataIndex: type=uint8, direction=OUT, server-argument-impl-policy=USE-ARGUMENT-TYPE
        GetErrorStatus
          arg ErrorStatus: type=NvM_RequestResultType, direction=OUT, server-argument-impl-policy=USE-ARGUMENT-TYPE
        ReadBlock
          arg DstPtr: type=dtRef_VOID, direction=IN, server-argument-impl-policy=USE-ARGUMENT-TYPE
        RestoreBlockDefaults
          arg DstPtr: type=dtRef_VOID, direction=IN, server-argument-impl-policy=USE-ARGUMENT-TYPE
        SetDataIndex
          arg DataIndex: type=uint8, direction=IN, server-argument-impl-policy=USE-ARGUMENT-TYPE
        WriteBlock
          arg SrcPtr: type=dtRef_const_VOID, direction=IN, server-argument-impl-policy=USE-ARGUMENT-TYPE
      error E_NOT_OK: error-code=1
    NvMService_AC2_SRBS: is-service=true
      4 x operation, all with possible-error=NvMService_AC2_SRBS/E_NOT_OK:
        GetErrorStatus
          arg ErrorStatus: type=NvM_RequestResultType, direction=OUT, server-argument-impl-policy=USE-ARGUMENT-TYPE
        ReadBlock
          arg DstPtr: type=dtRef_VOID, direction=IN, server-argument-impl-policy=USE-ARGUMENT-TYPE
        SetRamBlockStatus
          arg RamBlockStatus: type=boolean, direction=IN, server-argument-impl-policy=USE-ARGUMENT-TYPE
        WriteBlock
          arg SrcPtr: type=dtRef_const_VOID, direction=IN, server-argument-impl-policy=USE-ARGUMENT-TYPE
      error E_NOT_OK: error-code=1
    NvMService_AC2_SRBS_Defs: is-service=true
      5 x operation, all with possible-error=NvMService_AC2_SRBS_Defs/E_NOT_OK:
        GetErrorStatus
          arg ErrorStatus: type=NvM_RequestResultType, direction=OUT, server-argument-impl-policy=USE-ARGUMENT-TYPE
        ReadBlock
          arg DstPtr: type=dtRef_VOID, direction=IN, server-argument-impl-policy=USE-ARGUMENT-TYPE
        RestoreBlockDefaults
          arg DstPtr: type=dtRef_VOID, direction=IN, server-argument-impl-policy=USE-ARGUMENT-TYPE
        SetRamBlockStatus
          arg RamBlockStatus: type=boolean, direction=IN, server-argument-impl-policy=USE-ARGUMENT-TYPE
        WriteBlock
          arg SrcPtr: type=dtRef_const_VOID, direction=IN, server-argument-impl-policy=USE-ARGUMENT-TYPE
      error E_NOT_OK: error-code=1
    NvMService_AC2_SRBS_DS: is-service=true
      6 x operation, all with possible-error=NvMService_AC2_SRBS_DS/E_NOT_OK:
        GetDataIndex
          arg DataIndex: type=uint8, direction=OUT, server-argument-impl-policy=USE-ARGUMENT-TYPE
        GetErrorStatus
          arg ErrorStatus: type=NvM_RequestResultType, direction=OUT, server-argument-impl-policy=USE-ARGUMENT-TYPE
        ReadBlock
          arg DstPtr: type=dtRef_VOID, direction=IN, server-argument-impl-policy=USE-ARGUMENT-TYPE
        SetDataIndex
          arg DataIndex: type=uint8, direction=IN, server-argument-impl-policy=USE-ARGUMENT-TYPE
        SetRamBlockStatus
          arg RamBlockStatus: type=boolean, direction=IN, server-argument-impl-policy=USE-ARGUMENT-TYPE
        WriteBlock
          arg SrcPtr: type=dtRef_const_VOID, direction=IN, server-argument-impl-policy=USE-ARGUMENT-TYPE
      error E_NOT_OK: error-code=1
    NvMService_AC2_SRBS_DS_Defs: is-service=true
      7 x operation, all with possible-error=NvMService_AC2_SRBS_DS_Defs/E_NOT_OK:
        GetDataIndex
          arg DataIndex: type=uint8, direction=OUT, server-argument-impl-policy=USE-ARGUMENT-TYPE
        GetErrorStatus
          arg ErrorStatus: type=NvM_RequestResultType, direction=OUT, server-argument-impl-policy=USE-ARGUMENT-TYPE
        ReadBlock
          arg DstPtr: type=dtRef_VOID, direction=IN, server-argument-impl-policy=USE-ARGUMENT-TYPE
        RestoreBlockDefaults
          arg DstPtr: type=dtRef_VOID, direction=IN, server-argument-impl-policy=USE-ARGUMENT-TYPE
        SetDataIndex
          arg DataIndex: type=uint8, direction=IN, server-argument-impl-policy=USE-ARGUMENT-TYPE
        SetRamBlockStatus
          arg RamBlockStatus: type=boolean, direction=IN, server-argument-impl-policy=USE-ARGUMENT-TYPE
        WriteBlock
          arg SrcPtr: type=dtRef_const_VOID, direction=IN, server-argument-impl-policy=USE-ARGUMENT-TYPE
      error E_NOT_OK: error-code=1
    NvMService_AC3: is-service=true
      5 x operation, all with possible-error=NvMService_AC3/E_NOT_OK:
        EraseBlock
        GetErrorStatus
          arg ErrorStatus: type=NvM_RequestResultType, direction=OUT, server-argument-impl-policy=USE-ARGUMENT-TYPE
        InvalidateNvBlock
        ReadBlock
          arg DstPtr: type=dtRef_VOID, direction=IN, server-argument-impl-policy=USE-ARGUMENT-TYPE
        WriteBlock
          arg SrcPtr: type=dtRef_const_VOID, direction=IN, server-argument-impl-policy=USE-ARGUMENT-TYPE
      error E_NOT_OK: error-code=1
    NvMService_AC3_Defs: is-service=true
      6 x operation, all with possible-error=NvMService_AC3_Defs/E_NOT_OK:
        EraseBlock
        GetErrorStatus
          arg ErrorStatus: type=NvM_RequestResultType, direction=OUT, server-argument-impl-policy=USE-ARGUMENT-TYPE
        InvalidateNvBlock
        ReadBlock
          arg DstPtr: type=dtRef_VOID, direction=IN, server-argument-impl-policy=USE-ARGUMENT-TYPE
        RestoreBlockDefaults
          arg DstPtr: type=dtRef_VOID, direction=IN, server-argument-impl-policy=USE-ARGUMENT-TYPE
        WriteBlock
          arg SrcPtr: type=dtRef_const_VOID, direction=IN, server-argument-impl-policy=USE-ARGUMENT-TYPE
      error E_NOT_OK: error-code=1
    NvMService_AC3_DS: is-service=true
      7 x operation, all with possible-error=NvMService_AC3_DS/E_NOT_OK:
        EraseBlock
        GetDataIndex
          arg DataIndex: type=uint8, direction=OUT, server-argument-impl-policy=USE-ARGUMENT-TYPE
        GetErrorStatus
          arg ErrorStatus: type=NvM_RequestResultType, direction=OUT, server-argument-impl-policy=USE-ARGUMENT-TYPE
        InvalidateNvBlock
        ReadBlock
          arg DstPtr: type=dtRef_VOID, direction=IN, server-argument-impl-policy=USE-ARGUMENT-TYPE
        SetDataIndex
          arg DataIndex: type=uint8, direction=IN, server-argument-impl-policy=USE-ARGUMENT-TYPE
        WriteBlock
          arg SrcPtr: type=dtRef_const_VOID, direction=IN, server-argument-impl-policy=USE-ARGUMENT-TYPE
      error E_NOT_OK: error-code=1
    NvMService_AC3_DS_Defs: is-service=true
      8 x operation, all with possible-error=NvMService_AC3_DS_Defs/E_NOT_OK:
        EraseBlock
        GetDataIndex
          arg DataIndex: type=uint8, direction=OUT, server-argument-impl-policy=USE-ARGUMENT-TYPE
        GetErrorStatus
          arg ErrorStatus: type=NvM_RequestResultType, direction=OUT, server-argument-impl-policy=USE-ARGUMENT-TYPE
        InvalidateNvBlock
        ReadBlock
          arg DstPtr: type=dtRef_VOID, direction=IN, server-argument-impl-policy=USE-ARGUMENT-TYPE
        RestoreBlockDefaults
          arg DstPtr: type=dtRef_VOID, direction=IN, server-argument-impl-policy=USE-ARGUMENT-TYPE
        SetDataIndex
          arg DataIndex: type=uint8, direction=IN, server-argument-impl-policy=USE-ARGUMENT-TYPE
        WriteBlock
          arg SrcPtr: type=dtRef_const_VOID, direction=IN, server-argument-impl-policy=USE-ARGUMENT-TYPE
      error E_NOT_OK: error-code=1
    NvMService_AC3_SRBS: is-service=true
      6 x operation, all with possible-error=NvMService_AC3_SRBS/E_NOT_OK:
        EraseBlock
        GetErrorStatus
          arg ErrorStatus: type=NvM_RequestResultType, direction=OUT, server-argument-impl-policy=USE-ARGUMENT-TYPE
        InvalidateNvBlock
        ReadBlock
          arg DstPtr: type=dtRef_VOID, direction=IN, server-argument-impl-policy=USE-ARGUMENT-TYPE
        SetRamBlockStatus
          arg RamBlockStatus: type=boolean, direction=IN, server-argument-impl-policy=USE-ARGUMENT-TYPE
        WriteBlock
          arg SrcPtr: type=dtRef_const_VOID, direction=IN, server-argument-impl-policy=USE-ARGUMENT-TYPE
      error E_NOT_OK: error-code=1
    NvMService_AC3_SRBS_Defs: is-service=true
      7 x operation, all with possible-error=NvMService_AC3_SRBS_Defs/E_NOT_OK:
        EraseBlock
        GetErrorStatus
          arg ErrorStatus: type=NvM_RequestResultType, direction=OUT, server-argument-impl-policy=USE-ARGUMENT-TYPE
        InvalidateNvBlock
        ReadBlock
          arg DstPtr: type=dtRef_VOID, direction=IN, server-argument-impl-policy=USE-ARGUMENT-TYPE
        RestoreBlockDefaults
          arg DstPtr: type=dtRef_VOID, direction=IN, server-argument-impl-policy=USE-ARGUMENT-TYPE
        SetRamBlockStatus
          arg RamBlockStatus: type=boolean, direction=IN, server-argument-impl-policy=USE-ARGUMENT-TYPE
        WriteBlock
          arg SrcPtr: type=dtRef_const_VOID, direction=IN, server-argument-impl-policy=USE-ARGUMENT-TYPE
      error E_NOT_OK: error-code=1
    NvMService_AC3_SRBS_DS: is-service=true
      8 x operation, all with possible-error=NvMService_AC3_SRBS_DS/E_NOT_OK:
        EraseBlock
        GetDataIndex
          arg DataIndex: type=uint8, direction=OUT, server-argument-impl-policy=USE-ARGUMENT-TYPE
        GetErrorStatus
          arg ErrorStatus: type=NvM_RequestResultType, direction=OUT, server-argument-impl-policy=USE-ARGUMENT-TYPE
        InvalidateNvBlock
        ReadBlock
          arg DstPtr: type=dtRef_VOID, direction=IN, server-argument-impl-policy=USE-ARGUMENT-TYPE
        SetDataIndex
          arg DataIndex: type=uint8, direction=IN, server-argument-impl-policy=USE-ARGUMENT-TYPE
        SetRamBlockStatus
          arg RamBlockStatus: type=boolean, direction=IN, server-argument-impl-policy=USE-ARGUMENT-TYPE
        WriteBlock
          arg SrcPtr: type=dtRef_const_VOID, direction=IN, server-argument-impl-policy=USE-ARGUMENT-TYPE
      error E_NOT_OK: error-code=1
    NvMService_AC3_SRBS_DS_Defs: is-service=true
      9 x operation, all with possible-error=NvMService_AC3_SRBS_DS_Defs/E_NOT_OK:
        EraseBlock
        GetDataIndex
          arg DataIndex: type=uint8, direction=OUT, server-argument-impl-policy=USE-ARGUMENT-TYPE
        GetErrorStatus
          arg ErrorStatus: type=NvM_RequestResultType, direction=OUT, server-argument-impl-policy=USE-ARGUMENT-TYPE
        InvalidateNvBlock
        ReadBlock
          arg DstPtr: type=dtRef_VOID, direction=IN, server-argument-impl-policy=USE-ARGUMENT-TYPE
        RestoreBlockDefaults
          arg DstPtr: type=dtRef_VOID, direction=IN, server-argument-impl-policy=USE-ARGUMENT-TYPE
        SetDataIndex
          arg DataIndex: type=uint8, direction=IN, server-argument-impl-policy=USE-ARGUMENT-TYPE
        SetRamBlockStatus
          arg RamBlockStatus: type=boolean, direction=IN, server-argument-impl-policy=USE-ARGUMENT-TYPE
        WriteBlock
          arg SrcPtr: type=dtRef_const_VOID, direction=IN, server-argument-impl-policy=USE-ARGUMENT-TYPE
      error E_NOT_OK: error-code=1
    NvMService_SRBS: is-service=true
      operation GetErrorStatus: possible-error=NvMService_SRBS/E_NOT_OK
        arg ErrorStatus: type=NvM_RequestResultType, direction=OUT, server-argument-impl-policy=USE-ARGUMENT-TYPE
      operation SetRamBlockStatus: possible-error=NvMService_SRBS/E_NOT_OK
        arg RamBlockStatus: type=boolean, direction=IN, server-argument-impl-policy=USE-ARGUMENT-TYPE
      error E_NOT_OK: error-code=1
    CallbackDTCStatusChange: is-service=true, service-kind=DIAGNOSTIC-EVENT-MANAGER
      operation DTCStatusChanged: possible-error=CallbackDTCStatusChange/E_NOT_OK
        arg DTC: type=uint32, direction=IN, server-argument-impl-policy=USE-ARGUMENT-TYPE
        arg DTCStatusOld: type=Dem_UdsStatusByteType, direction=IN, server-argument-impl-policy=USE-ARGUMENT-TYPE
        arg DTCStatusNew: type=Dem_UdsStatusByteType, direction=IN, server-argument-impl-policy=USE-ARGUMENT-TYPE
      error E_NOT_OK: error-code=1
    NvSWC_NvMAdministration
      operation SetBlockProtection: possible-error=NvSWC_NvMAdministration/E_NOT_OK
        arg ProtectionEnabled: type=boolean, direction=IN, server-argument-impl-policy=USE-ARGUMENT-TYPE
      error E_NOT_OK: error-code=1
    NvSWC_NvMNotifyInitBlock
      operation InitBlock
    NvSWC_NvMNotifyJobFinished
      operation JobFinished
        arg ServiceId: type=NvM_ServiceIdType, direction=IN, server-argument-impl-policy=USE-ARGUMENT-TYPE
        arg JobResult: type=NvM_RequestResultType, direction=IN, server-argument-impl-policy=USE-ARGUMENT-TYPE
    NvSWC_NvMService
      operation GetErrorStatus: possible-error=NvSWC_NvMService/E_NOT_OK
        arg ErrorStatus: type=NvM_RequestResultType, direction=OUT, server-argument-impl-policy=USE-ARGUMENT-TYPE
      error E_NOT_OK: error-code=1
    NvSWC_NvMService_AC2
      operation GetErrorStatus: possible-error=NvSWC_NvMService_AC2/E_NOT_OK
        arg ErrorStatus: type=NvM_RequestResultType, direction=OUT, server-argument-impl-policy=USE-ARGUMENT-TYPE
      operation ReadBlock: possible-error=NvSWC_NvMService_AC2/E_NOT_OK
        arg DstPtr: type=dtRef_VOID, direction=IN, server-argument-impl-policy=USE-ARGUMENT-TYPE
      operation WriteBlock: possible-error=NvSWC_NvMService_AC2/E_NOT_OK
        arg SrcPtr: type=dtRef_const_VOID, direction=IN, server-argument-impl-policy=USE-ARGUMENT-TYPE
      error E_NOT_OK: error-code=1
    NvSWC_NvMService_AC2_Defs
      4 x operation, all with possible-error=NvSWC_NvMService_AC2_Defs/E_NOT_OK:
        GetErrorStatus
          arg ErrorStatus: type=NvM_RequestResultType, direction=OUT, server-argument-impl-policy=USE-ARGUMENT-TYPE
        ReadBlock
          arg DstPtr: type=dtRef_VOID, direction=IN, server-argument-impl-policy=USE-ARGUMENT-TYPE
        RestoreBlockDefaults
          arg DstPtr: type=dtRef_VOID, direction=IN, server-argument-impl-policy=USE-ARGUMENT-TYPE
        WriteBlock
          arg SrcPtr: type=dtRef_const_VOID, direction=IN, server-argument-impl-policy=USE-ARGUMENT-TYPE
      error E_NOT_OK: error-code=1
    NvSWC_NvMService_AC2_DS
      5 x operation, all with possible-error=NvSWC_NvMService_AC2_DS/E_NOT_OK:
        GetDataIndex
          arg DataIndex: type=uint8, direction=OUT, server-argument-impl-policy=USE-ARGUMENT-TYPE
        GetErrorStatus
          arg ErrorStatus: type=NvM_RequestResultType, direction=OUT, server-argument-impl-policy=USE-ARGUMENT-TYPE
        ReadBlock
          arg DstPtr: type=dtRef_VOID, direction=IN, server-argument-impl-policy=USE-ARGUMENT-TYPE
        SetDataIndex
          arg DataIndex: type=uint8, direction=IN, server-argument-impl-policy=USE-ARGUMENT-TYPE
        WriteBlock
          arg SrcPtr: type=dtRef_const_VOID, direction=IN, server-argument-impl-policy=USE-ARGUMENT-TYPE
      error E_NOT_OK: error-code=1
    NvSWC_NvMService_AC2_DS_Defs
      6 x operation, all with possible-error=NvSWC_NvMService_AC2_DS_Defs/E_NOT_OK:
        GetDataIndex
          arg DataIndex: type=uint8, direction=OUT, server-argument-impl-policy=USE-ARGUMENT-TYPE
        GetErrorStatus
          arg ErrorStatus: type=NvM_RequestResultType, direction=OUT, server-argument-impl-policy=USE-ARGUMENT-TYPE
        ReadBlock
          arg DstPtr: type=dtRef_VOID, direction=IN, server-argument-impl-policy=USE-ARGUMENT-TYPE
        RestoreBlockDefaults
          arg DstPtr: type=dtRef_VOID, direction=IN, server-argument-impl-policy=USE-ARGUMENT-TYPE
        SetDataIndex
          arg DataIndex: type=uint8, direction=IN, server-argument-impl-policy=USE-ARGUMENT-TYPE
        WriteBlock
          arg SrcPtr: type=dtRef_const_VOID, direction=IN, server-argument-impl-policy=USE-ARGUMENT-TYPE
      error E_NOT_OK: error-code=1
    NvSWC_NvMService_AC2_SRBS
      4 x operation, all with possible-error=NvSWC_NvMService_AC2_SRBS/E_NOT_OK:
        GetErrorStatus
          arg ErrorStatus: type=NvM_RequestResultType, direction=OUT, server-argument-impl-policy=USE-ARGUMENT-TYPE
        ReadBlock
          arg DstPtr: type=dtRef_VOID, direction=IN, server-argument-impl-policy=USE-ARGUMENT-TYPE
        SetRamBlockStatus
          arg RamBlockStatus: type=boolean, direction=IN, server-argument-impl-policy=USE-ARGUMENT-TYPE
        WriteBlock
          arg SrcPtr: type=dtRef_const_VOID, direction=IN, server-argument-impl-policy=USE-ARGUMENT-TYPE
      error E_NOT_OK: error-code=1
    NvSWC_NvMService_AC2_SRBS_Defs
      5 x operation, all with possible-error=NvSWC_NvMService_AC2_SRBS_Defs/E_NOT_OK:
        GetErrorStatus
          arg ErrorStatus: type=NvM_RequestResultType, direction=OUT, server-argument-impl-policy=USE-ARGUMENT-TYPE
        ReadBlock
          arg DstPtr: type=dtRef_VOID, direction=IN, server-argument-impl-policy=USE-ARGUMENT-TYPE
        RestoreBlockDefaults
          arg DstPtr: type=dtRef_VOID, direction=IN, server-argument-impl-policy=USE-ARGUMENT-TYPE
        SetRamBlockStatus
          arg RamBlockStatus: type=boolean, direction=IN, server-argument-impl-policy=USE-ARGUMENT-TYPE
        WriteBlock
          arg SrcPtr: type=dtRef_const_VOID, direction=IN, server-argument-impl-policy=USE-ARGUMENT-TYPE
      error E_NOT_OK: error-code=1
    NvSWC_NvMService_AC2_SRBS_DS
      6 x operation, all with possible-error=NvSWC_NvMService_AC2_SRBS_DS/E_NOT_OK:
        GetDataIndex
          arg DataIndex: type=uint8, direction=OUT, server-argument-impl-policy=USE-ARGUMENT-TYPE
        GetErrorStatus
          arg ErrorStatus: type=NvM_RequestResultType, direction=OUT, server-argument-impl-policy=USE-ARGUMENT-TYPE
        ReadBlock
          arg DstPtr: type=dtRef_VOID, direction=IN, server-argument-impl-policy=USE-ARGUMENT-TYPE
        SetDataIndex
          arg DataIndex: type=uint8, direction=IN, server-argument-impl-policy=USE-ARGUMENT-TYPE
        SetRamBlockStatus
          arg RamBlockStatus: type=boolean, direction=IN, server-argument-impl-policy=USE-ARGUMENT-TYPE
        WriteBlock
          arg SrcPtr: type=dtRef_const_VOID, direction=IN, server-argument-impl-policy=USE-ARGUMENT-TYPE
      error E_NOT_OK: error-code=1
    NvSWC_NvMService_AC2_SRBS_DS_Defs
      7 x operation, all with possible-error=NvSWC_NvMService_AC2_SRBS_DS_Defs/E_NOT_OK:
        GetDataIndex
          arg DataIndex: type=uint8, direction=OUT, server-argument-impl-policy=USE-ARGUMENT-TYPE
        GetErrorStatus
          arg ErrorStatus: type=NvM_RequestResultType, direction=OUT, server-argument-impl-policy=USE-ARGUMENT-TYPE
        ReadBlock
          arg DstPtr: type=dtRef_VOID, direction=IN, server-argument-impl-policy=USE-ARGUMENT-TYPE
        RestoreBlockDefaults
          arg DstPtr: type=dtRef_VOID, direction=IN, server-argument-impl-policy=USE-ARGUMENT-TYPE
        SetDataIndex
          arg DataIndex: type=uint8, direction=IN, server-argument-impl-policy=USE-ARGUMENT-TYPE
        SetRamBlockStatus
          arg RamBlockStatus: type=boolean, direction=IN, server-argument-impl-policy=USE-ARGUMENT-TYPE
        WriteBlock
          arg SrcPtr: type=dtRef_const_VOID, direction=IN, server-argument-impl-policy=USE-ARGUMENT-TYPE
      error E_NOT_OK: error-code=1
    NvSWC_NvMService_AC3
      5 x operation, all with possible-error=NvSWC_NvMService_AC3/E_NOT_OK:
        EraseBlock
        GetErrorStatus
          arg ErrorStatus: type=NvM_RequestResultType, direction=OUT, server-argument-impl-policy=USE-ARGUMENT-TYPE
        InvalidateNvBlock
        ReadBlock
          arg DstPtr: type=dtRef_VOID, direction=IN, server-argument-impl-policy=USE-ARGUMENT-TYPE
        WriteBlock
          arg SrcPtr: type=dtRef_const_VOID, direction=IN, server-argument-impl-policy=USE-ARGUMENT-TYPE
      error E_NOT_OK: error-code=1
    NvSWC_NvMService_AC3_Defs
      6 x operation, all with possible-error=NvSWC_NvMService_AC3_Defs/E_NOT_OK:
        EraseBlock
        GetErrorStatus
          arg ErrorStatus: type=NvM_RequestResultType, direction=OUT, server-argument-impl-policy=USE-ARGUMENT-TYPE
        InvalidateNvBlock
        ReadBlock
          arg DstPtr: type=dtRef_VOID, direction=IN, server-argument-impl-policy=USE-ARGUMENT-TYPE
        RestoreBlockDefaults
          arg DstPtr: type=dtRef_VOID, direction=IN, server-argument-impl-policy=USE-ARGUMENT-TYPE
        WriteBlock
          arg SrcPtr: type=dtRef_const_VOID, direction=IN, server-argument-impl-policy=USE-ARGUMENT-TYPE
      error E_NOT_OK: error-code=1
    NvSWC_NvMService_AC3_DS
      7 x operation, all with possible-error=NvSWC_NvMService_AC3_DS/E_NOT_OK:
        EraseBlock
        GetDataIndex
          arg DataIndex: type=uint8, direction=OUT, server-argument-impl-policy=USE-ARGUMENT-TYPE
        GetErrorStatus
          arg ErrorStatus: type=NvM_RequestResultType, direction=OUT, server-argument-impl-policy=USE-ARGUMENT-TYPE
        InvalidateNvBlock
        ReadBlock
          arg DstPtr: type=dtRef_VOID, direction=IN, server-argument-impl-policy=USE-ARGUMENT-TYPE
        SetDataIndex
          arg DataIndex: type=uint8, direction=IN, server-argument-impl-policy=USE-ARGUMENT-TYPE
        WriteBlock
          arg SrcPtr: type=dtRef_const_VOID, direction=IN, server-argument-impl-policy=USE-ARGUMENT-TYPE
      error E_NOT_OK: error-code=1
    NvSWC_NvMService_AC3_DS_Defs
      8 x operation, all with possible-error=NvSWC_NvMService_AC3_DS_Defs/E_NOT_OK:
        EraseBlock
        GetDataIndex
          arg DataIndex: type=uint8, direction=OUT, server-argument-impl-policy=USE-ARGUMENT-TYPE
        GetErrorStatus
          arg ErrorStatus: type=NvM_RequestResultType, direction=OUT, server-argument-impl-policy=USE-ARGUMENT-TYPE
        InvalidateNvBlock
        ReadBlock
          arg DstPtr: type=dtRef_VOID, direction=IN, server-argument-impl-policy=USE-ARGUMENT-TYPE
        RestoreBlockDefaults
          arg DstPtr: type=dtRef_VOID, direction=IN, server-argument-impl-policy=USE-ARGUMENT-TYPE
        SetDataIndex
          arg DataIndex: type=uint8, direction=IN, server-argument-impl-policy=USE-ARGUMENT-TYPE
        WriteBlock
          arg SrcPtr: type=dtRef_const_VOID, direction=IN, server-argument-impl-policy=USE-ARGUMENT-TYPE
      error E_NOT_OK: error-code=1
    NvSWC_NvMService_AC3_SRBS
      6 x operation, all with possible-error=NvSWC_NvMService_AC3_SRBS/E_NOT_OK:
        EraseBlock
        GetErrorStatus
          arg ErrorStatus: type=NvM_RequestResultType, direction=OUT, server-argument-impl-policy=USE-ARGUMENT-TYPE
        InvalidateNvBlock
        ReadBlock
          arg DstPtr: type=dtRef_VOID, direction=IN, server-argument-impl-policy=USE-ARGUMENT-TYPE
        SetRamBlockStatus
          arg RamBlockStatus: type=boolean, direction=IN, server-argument-impl-policy=USE-ARGUMENT-TYPE
        WriteBlock
          arg SrcPtr: type=dtRef_const_VOID, direction=IN, server-argument-impl-policy=USE-ARGUMENT-TYPE
      error E_NOT_OK: error-code=1
    NvSWC_NvMService_AC3_SRBS_Defs
      7 x operation, all with possible-error=NvSWC_NvMService_AC3_SRBS_Defs/E_NOT_OK:
        EraseBlock
        GetErrorStatus
          arg ErrorStatus: type=NvM_RequestResultType, direction=OUT, server-argument-impl-policy=USE-ARGUMENT-TYPE
        InvalidateNvBlock
        ReadBlock
          arg DstPtr: type=dtRef_VOID, direction=IN, server-argument-impl-policy=USE-ARGUMENT-TYPE
        RestoreBlockDefaults
          arg DstPtr: type=dtRef_VOID, direction=IN, server-argument-impl-policy=USE-ARGUMENT-TYPE
        SetRamBlockStatus
          arg RamBlockStatus: type=boolean, direction=IN, server-argument-impl-policy=USE-ARGUMENT-TYPE
        WriteBlock
          arg SrcPtr: type=dtRef_const_VOID, direction=IN, server-argument-impl-policy=USE-ARGUMENT-TYPE
      error E_NOT_OK: error-code=1
    NvSWC_NvMService_AC3_SRBS_DS
      8 x operation, all with possible-error=NvSWC_NvMService_AC3_SRBS_DS/E_NOT_OK:
        EraseBlock
        GetDataIndex
          arg DataIndex: type=uint8, direction=OUT, server-argument-impl-policy=USE-ARGUMENT-TYPE
        GetErrorStatus
          arg ErrorStatus: type=NvM_RequestResultType, direction=OUT, server-argument-impl-policy=USE-ARGUMENT-TYPE
        InvalidateNvBlock
        ReadBlock
          arg DstPtr: type=dtRef_VOID, direction=IN, server-argument-impl-policy=USE-ARGUMENT-TYPE
        SetDataIndex
          arg DataIndex: type=uint8, direction=IN, server-argument-impl-policy=USE-ARGUMENT-TYPE
        SetRamBlockStatus
          arg RamBlockStatus: type=boolean, direction=IN, server-argument-impl-policy=USE-ARGUMENT-TYPE
        WriteBlock
          arg SrcPtr: type=dtRef_const_VOID, direction=IN, server-argument-impl-policy=USE-ARGUMENT-TYPE
      error E_NOT_OK: error-code=1
    NvSWC_NvMService_AC3_SRBS_DS_Defs
      9 x operation, all with possible-error=NvSWC_NvMService_AC3_SRBS_DS_Defs/E_NOT_OK:
        EraseBlock
        GetDataIndex
          arg DataIndex: type=uint8, direction=OUT, server-argument-impl-policy=USE-ARGUMENT-TYPE
        GetErrorStatus
          arg ErrorStatus: type=NvM_RequestResultType, direction=OUT, server-argument-impl-policy=USE-ARGUMENT-TYPE
        InvalidateNvBlock
        ReadBlock
          arg DstPtr: type=dtRef_VOID, direction=IN, server-argument-impl-policy=USE-ARGUMENT-TYPE
        RestoreBlockDefaults
          arg DstPtr: type=dtRef_VOID, direction=IN, server-argument-impl-policy=USE-ARGUMENT-TYPE
        SetDataIndex
          arg DataIndex: type=uint8, direction=IN, server-argument-impl-policy=USE-ARGUMENT-TYPE
        SetRamBlockStatus
          arg RamBlockStatus: type=boolean, direction=IN, server-argument-impl-policy=USE-ARGUMENT-TYPE
        WriteBlock
          arg SrcPtr: type=dtRef_const_VOID, direction=IN, server-argument-impl-policy=USE-ARGUMENT-TYPE
      error E_NOT_OK: error-code=1
    NvSWC_NvMService_SRBS
      operation GetErrorStatus: possible-error=NvSWC_NvMService_SRBS/E_NOT_OK
        arg ErrorStatus: type=NvM_RequestResultType, direction=OUT, server-argument-impl-policy=USE-ARGUMENT-TYPE
      operation SetRamBlockStatus: possible-error=NvSWC_NvMService_SRBS/E_NOT_OK
        arg RamBlockStatus: type=boolean, direction=IN, server-argument-impl-policy=USE-ARGUMENT-TYPE
      error E_NOT_OK: error-code=1
