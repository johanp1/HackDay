AUTOSAR XML (schema 00046)
standard types defined: dtRef_const_VOID, dtRef_VOID, boolean, float32, float64, sint16, sint16_least, sint32, sint32_least, sint64, sint8, sint8_least, uint16, uint16_least, uint32, uint32_least, uint64, uint8, uint8_least, boolean_CompuMethod, boolean_DataConstr, uint16_DataConstr, uint32_DataConstr, uint8_DataConstr, float64_DataConstr, float32_DataConstr, sint16_DataConstr, sint16_least_DataConstr, sint32_DataConstr, sint32_least_DataConstr, sint64_DataConstr, sint8_DataConstr, sint8_least_DataConstr, uint16_least_DataConstr, uint64_DataConstr, uint32_least_DataConstr, uint8_least_DataConstr
package /GCWCalculatorCtrl/DataType/DataConstrs
  range TransmissionActualGearRatio_T_DataConstr: raw 0..65535
package /GCWCalculatorCtrl/DataType/Units
  unit NotApplicable: display-name=NotApplicable, factor-si-to-unit=1, offset-si-to-unit=0
package /AUTOSAR_Platform/ImplementationDataTypes
  range TrailerConnectedStatus_T_DataConstr: raw 0..3
package /Predefined_DEV/ImplementationDataTypes
  impl type NvM_RequestResultType: compu {0=NVM_REQ_OK, 1=NVM_REQ_NOT_OK, 2=NVM_REQ_PENDING, 3=NVM_REQ_INTEGRITY_FAILED, 4=NVM_REQ_BLOCK_SKIPPED, 5=NVM_REQ_NV_INVALIDATED, 6=NVM_REQ_CANCELED, 7=NVM_REQ_REDUNDANCY_FAILED, 8=NVM_REQ_RESTORED_FROM_ROM}, implementation-data-type=uint8
  impl type NvM_ServiceIdType: compu {6=NVM_READ_BLOCK, 7=NVM_WRITE_BLOCK, 8=NVM_RESTORE_BLOCK_DEFAULTS, 9=NVM_ERASE_BLOCK, 11=NVM_INVALIDATE_NV_BLOCK, 12=NVM_READ_ALL}, implementation-data-type=uint8
  impl type Dem_UdsStatusByteType: compu {mask 1: 1=DEM_UDS_STATUS_TF, mask 2: 2=DEM_UDS_STATUS_TFTOC, mask 4: 4=DEM_UDS_STATUS_PDTC, mask 8: 8=DEM_UDS_STATUS_CDTC, mask 16: 16=DEM_UDS_STATUS_TNCSLC, mask 32: 32=DEM_UDS_STATUS_TFSLC, mask 64: 64=DEM_UDS_STATUS_TNCTOC, mask 128: 128=DEM_UDS_STATUS_WIR}, range raw 0..255, implementation-data-type=uint8
package /DataTypes/BaseTypes
  5 x base type, all with category=FIXED_LENGTH:
    boolean_BaseType: base-type-size=1, base-type-encoding=BOOLEAN, native-declaration=boolean
    sint32_BaseType: base-type-size=32, base-type-encoding=2C, native-declaration=sint32
    uint16_BaseType: base-type-size=16, base-type-encoding=NONE, native-declaration=uint16
    uint32_BaseType: base-type-size=32, base-type-encoding=NONE, native-declaration=uint32
    uint8_BaseType: base-type-size=8, base-type-encoding=NONE, native-declaration=uint8
package /DataType
  range Motion_T_DataConstr: raw 0..7
  range MotionReq_T_DataConstr: raw 0..3
  range Automation_T_DataConstr: raw 0..7
  range AutomationReq_T_DataConstr: raw 0..7
  range SqC_T_DataConstr: raw 0..14
  range Velocity_T_DataConstr: raw 0..65535
  range CRC_T_DataConstr: raw 0..7
  range OnSteerWhl_T_DataConstr: raw 0..3
  range OnBrkPedal_T_DataConstr: raw 0..3
  range OnAccPedal_T_DataConstr: raw 0..3
  range DrvrPresUkwn_T_DataConstr: raw 0..3
  range OnParkBrake_T_DataConstr: raw 0..3
  range ThreshldPwr_T_DataConstr: raw 0..255
  range EnergyCap_T_DataConstr: raw 0..255
  range MtnCtrlType_T_DataConstr: raw 0..7
  range FullBrakes_ind_T_DataConstr: raw 0..255
  range PermittedHSAPressure_T_DataConstr: raw 0..255
  range RoadWheelAngleRequest_T_DataConstr: raw 0..65535
  range VehicleLgtlAccelerationReq_T_DataConstr: raw 0..65535
  range DirectionIndicatorLightsExtReq_T_DataConstr: raw 0..7
  range AutomationDoorLockUnlockReq_T_DataConstr: raw 0..7
  range VehAutoModeReasonForDisengmt_T_DataConstr: raw 0..7
  range IntvBySafetyDriverDetected_T_DataConstr: raw 0..7
  range VehicleLgtlDrvgDirectionCpby_T_DataConstr: raw 0..7
  impl type RearAxleSteeringFunctionStatus_T:
    category=VALUE
    base-type=BaseTypes/uint8_BaseType
    compu {0=RearAxleSteeringFunctionStatus_NotActive, 1=RearAxleSteeringFunctionStatus_Active, 2=RearAxleSteeringFunctionStatus_PassiveFailureMode, 3=RearAxleSteeringFunctionStatus_ActiveFailureMode, 4=RearAxleSteeringFunctionStatus_Spare1, 5=RearAxleSteeringFunctionStatus_Spare2, 6=RearAxleSteeringFunctionStatus_Error, 7=RearAxleSteeringFunctionStatus_NotAvailable}
    range raw 0..7
  impl type ActualTagWheelAngle_T: category=VALUE, base-type=BaseTypes/uint16_BaseType, compu {10001=ActualTagWheelAngle_SpareLow, 65023=ActualTagWheelAngle_SpareHigh, 65024=ActualTagWheelAngle_ErrorLow, 65279=ActualTagWheelAngle_Error, 65280=ActualTagWheelAngle_NotAvailableLow, 65535=ActualTagWheelAngle_NotAvailable}, range raw 0..65535
  range DriverSteeringTorqueEstimate_T_DataConstr: raw 0..1023
  range RoadWheelAngle_T_DataConstr: raw 0..65535
  range FASFunctionInControl_T_DataConstr: raw 0..3
  range FASSaturated_T_DataConstr: raw 0..3
  impl type XPRsystemstate_T: category=VALUE, base-type=BaseTypes/uint8_BaseType, compu {254=XPRsystemstate_Error, 255=XPRsystemstate_NotAvailable}, range raw 0..255
  range XBRSystemState_T_DataConstr: raw 0..3
  range CtaBs_HSABbRequest_T_DataConstr: raw 0..3
  range FASRoadWheelAngleRequest_T_DataConstr: raw 0..65535
  range XBRMessageCounter_T_DataConstr: raw 0..15
  range XBRMessageChecksum_T_DataConstr: raw 0..15
  range VelFwdMin_T_DataConstr: raw 0..255
  range VehicleMotionChInCmdSts_T_DataConstr: raw 0..3
  range OperatorEngmt_T_DataConstr: raw 0..3
  range VelFwdMax_T_DataConstr: raw 0..255
  range DrvgDir_T_DataConstr: raw 0..7
  range DrvgDirCpby_T_DataConstr: raw 0..7
  range FASControlMode_T_DataConstr: raw 0..15
  range XPRRequest_T_DataConstr: raw 0..255
  range VehicleMotionCtrlTypeModeReq_T_DataConstr: raw 0..7
  range VehicleLgtlDrivingDirectionReq_T_DataConstr: raw 0..7
  range VehicleMotionModeRequest_T_DataConstr: raw 0..3
  range VehicleAutonomousModeRequest_T_DataConstr: raw 0..255
  range RoadWheelAngleRateRequest_T_DataConstr: raw 0..65535
  range VehicleLgtlDrvgDirectionStatus_T_DataConstr: raw 0..7
  range VehicleMotionModeCapability_T_DataConstr: raw 0..7
  range VehicleOperatorMode_T_DataConstr: raw 0..7
  range VehicleAutonomousModeCpby_T_DataConstr: raw 0..7
  range VehicleAutonomousModeStatus_T_DataConstr: raw 0..3
  range SteeringWheelTorqueEstimate_T_DataConstr: raw 0..65535
  range RoadInclinationAngleStatus_T_DataConstr: raw 0..65535
  range VehicleLgtlAccelerationStatus_T_DataConstr: raw 0..65535
  range WheelSpeedStatus_T_DataConstr: raw 0..255
  range VehicleLgtlVelocityStatus_T_DataConstr: raw 0..65535
  range RoadWheelAngleStatus_T_DataConstr: raw 0..65535
  range Trailer1IdentifierStatus_T_DataConstr: raw 0..4294967295
  range VehicleIdentifierStatus_T_DataConstr: raw 0..134217727
  range RoadWheelAngleMinCapability_T_DataConstr: raw 0..255
  range RoadWheelAngleMaxCapability_T_DataConstr: raw 0..255
  range MassStatus_T_DataConstr: raw 0..65535
  range DirectionIndicatorLightsStatus_T_DataConstr: raw 0..7
  range VehicleLgtlVelocityFwdMinCpby_T_DataConstr: raw 0..255
  range SwNumberStatus_T_DataConstr: raw 0..255
  range DoorLockStatus_T_DataConstr: raw 0..3
  range VehicleLgtlVelocityFwdMaxCpby_T_DataConstr: raw 0..255
  range VehicleCmbRetardEnergyCpStatus_T_DataConstr: raw 0..255
  range RoadWheelAngleRateCapability_T_DataConstr: raw 0..255
  range VehCmbRetardThresholdPwrStatus_T_DataConstr: raw 0..255
  range RelativeLevel_T_DataConstr: raw 0..65535
  range BrakeAndPark_ind_T_DataConstr: raw 0..7
  range BrakeSwitch_T_DataConstr: raw 0..3
  range Count4bit_T_DataConstr: raw 0..15
  range DoorsAjar_stat_T_DataConstr: raw 0..7
  range DriverRetarderRequest_T_DataConstr: raw 0..7
  range DriverSeatBeltSwitch_T_DataConstr: raw 0..3
  range FoundationBrakeUse_T_DataConstr: raw 0..3
  range FullyOperational_T_DataConstr: raw 0..3
  range ReasonForDisengmt_T_DataConstr: raw 0..7
  range Operator_T_DataConstr: raw 0..7
  range MotionStatus_T_DataConstr: raw 0..15
  range AutomationStatus_T_DataConstr: raw 0..3
  range InactiveActive_T_DataConstr: raw 0..3
  range NotAllowedAllowed_T_DataConstr: raw 0..3
  range OffOn_T_DataConstr: raw 0..3
  range ParkingBrake_stat_T_DataConstr: raw 0..3
  range Percent8bitFactor04_T_DataConstr: raw 0..255
  range Priority_T_DataConstr: raw 0..3
  range Request_T_DataConstr: raw 0..3
  range RoadInclination_T_DataConstr: raw 0..255
  range TransmissionGear_T_DataConstr: raw 0..255
  range TSC1EngOverrideCtrlMode_T_DataConstr: raw 0..3
  11 x impl type, all with category=VALUE:
    Acceleration16bit_T: base-type=BaseTypes/uint16_BaseType, range raw 0..65535  # 65024 - 65279 Error ; 65280 - 65535 Not available
    AxleLoad_T: base-type=BaseTypes/uint16_BaseType, range raw 0..65535  # 65024 - 65279 Error ; 65280 - 65535 Not available
    DisengageEngage_T: base-type=BaseTypes/uint8_BaseType, compu {0=DisengageEngage_Disengage, 1=DisengageEngage_Engage, 2=DisengageEngage_Error, 3=DisengageEngage_NotAvailable}, range raw 0..3
    KFactor_T: base-type=BaseTypes/uint16_BaseType, range raw 0..65535  # 65024 - 65279 Error ; 65280 - 65535 Not available
    LiftAxlePositionStatus_T: base-type=BaseTypes/uint8_BaseType, compu {0=LiftAxlePositionStatus_Lowered, 1=LiftAxlePositionStatus_Lifted, 2=LiftAxlePositionStatus_Lowering, 3=LiftAxlePositionStatus_Lifting, 4=LiftAxlePositionStatus_Reserved, 5=LiftAxlePositionStatus_Reserved_01, 6=LiftAxlePositionStatus_Error, 7=LiftAxlePositionStatus_NotAvailable}, range raw 0..7
    PassiveActive2_T: base-type=BaseTypes/uint8_BaseType, compu {0=PassiveActive2_PassiveButInstalled, 1=PassiveActive2_Active, 2=PassiveActive2_Reserved, 3=PassiveActive2_DontCareTakeNoAction}, range raw 0..3
    Percent8bit125NegOffset_T: base-type=BaseTypes/uint8_BaseType, range raw 0..255  # 254 Error ; 255 Not available
    PressureFactor5_T: base-type=BaseTypes/uint8_BaseType, range raw 0..255  # 254 Error ; 255 Not available
    Speed16bit_T: base-type=BaseTypes/uint16_BaseType, compu {=SCALING; unit Km_per_h}, range raw 0..65535  # 65024 - 65279 Error ; 65280 - 65535 Not available
    SpeedRpm16bitMinus4000_T: base-type=BaseTypes/uint16_BaseType, range raw 0..65535  # 65024-65279: Error 65280-65535: Not Available
    SteeringWheelAngle_T: base-type=BaseTypes/uint16_BaseType, range raw 0..65535  # 65024 - 65279 Error ; 65280 - 65535 Not available
  range XBRControlMode_T_DataConstr: raw 0..3
  range XBREBIMode_T_DataConstr: raw 0..3
  impl type Acceleration_T: category=STRUCTURE, sw-calibration-access=READ-ONLY, type-emitter=RTE
    element Acceleration: implementation-data-type=DataType/float32
  impl type Speed_T: category=STRUCTURE, sw-calibration-access=READ-ONLY, type-emitter=RTE
    element Speed: implementation-data-type=DataType/float32
  impl type Angle_T: category=STRUCTURE, sw-calibration-access=READ-ONLY, type-emitter=RTE
    element Angle: implementation-data-type=DataType/float32
  impl type RoadInclinationPerc_T: category=VALUE, base-type=BaseTypes/uint32_BaseType, sw-calibration-access=READ-ONLY, type-emitter=RTE
  4 x impl type:
    VehicleMode_T: category=VALUE, base-type=BaseTypes/uint8_BaseType, compu {0=VehicleMode_Hibernate, 1=VehicleMode_Parked, 2=VehicleMode_Living, 3=VehicleMode_Accessory, 4=VehicleMode_PreRunning, 5=VehicleMode_Cranking, 6=VehicleMode_Running, 7..13=VehicleMode_Spare_1..VehicleMode_Spare_7, 14=VehicleMode_Error, 15=VehicleMode_NotAvailable}, range raw 0..15
    Torque16bit_T: category=VALUE, base-type=BaseTypes/uint16_BaseType, range raw 0..65535  # 65024 - 65279 Error ; 65280 - 65535 Not available
    TransmissionActualGearRatio_T: category=VALUE, base-type=BaseTypes/uint16_BaseType, sw-calibration-access=READ-ONLY, type-emitter=RTE
    YawRateChassis_T: category=STRUCTURE, sw-calibration-access=READ-ONLY, type-emitter=RTE
      element YawRate: implementation-data-type=DataType/float32
  range MotionState_T_DataConstr: raw 0..3
  24 x impl type, all with category=STRUCTURE, sw-calibration-access=READ-ONLY, type-emitter=RTE:
    YawAccChassis_T
      element YawAcc: implementation-data-type=DataType/float32
    Curvature_T
      element Curvature: implementation-data-type=DataType/float32
    CurvatureFac_T
      element CurvatureFac: implementation-data-type=uint8
    EquivalentRearAxlePos_T
      element EquivRrAxlePos: implementation-data-type=DataType/float32
    MotionEstStatus_T
      element MotionEstState: implementation-data-type=uint8
    Variance_T
      element Variance: implementation-data-type=DataType/float32
    Latency_T
      element Latency: implementation-data-type=DataType/float32
    LongMotionDirection_sg_T
      element LongMotionDirection: compu {0=LongMotionDirection_Stationary, 1=LongMotionDirection_Forward, 2=LongMotionDirection_Backward, 3=LongMotionDirection_Undetermined, 4=LongMotionDirection_Spare1, 5=LongMotionDirection_Spare2, 6=LongMotionDirection_Error, 7=LongMotionDirection_NotAvailable}, implementation-data-type=uint8
    LongMotionDirectionQuality_T
      element LongMotDirQuality: implementation-data-type=uint8
    LongMotionDirErrorSts_T
      element LongMotionDirErrorSts: implementation-data-type=uint8
    SteeringRatio_T
      element SteeringRatio: implementation-data-type=DataType/float32
    RoadWheelAngle_T2
      element RoadWheelAngle: implementation-data-type=uint16
    RollAngleEstQly_T
      element RollAngleEstQly: implementation-data-type=uint8
    SignalQuality_T
      element SignalQuality: compu {0=Error, 1=OK, 2=NotOK}, implementation-data-type=uint8
    V_spdAtWhl_Ax1L_T
      element V_spdAtWhl_Ax1: implementation-data-type=DataType/float32
    V_spdAtWhl_Ax2R_T
      element V_spdAtWhl_Ax2R: implementation-data-type=DataType/float32
    V_spdAtWhl_Ax3L_T
      element V_spdAtWhl_Ax3L: implementation-data-type=DataType/float32
    V_spdAtWhl_Ax3R_T
      element V_spdAtWhl_Ax3R: implementation-data-type=DataType/float32
    V_spdAtWhl_Ax4L_T
      element V_spdAtWhl_Ax4L: implementation-data-type=DataType/float32
    V_spdAtWhl_Ax4R_T
      element V_spdAtWhl_Ax4R: implementation-data-type=DataType/float32
    V_spdAtWhl_Ax5L_T
      element V_spdAtWhl_Ax5L: implementation-data-type=DataType/float32
    V_spdAtWhl_Ax5R_T
      element V_spdAtWhl_Ax5R: implementation-data-type=DataType/float32
    V_spdAtWhl_Ax1R_T
      element V_spdAtWhl_Ax1R: implementation-data-type=DataType/float32
    V_spdAtWhl_Ax2L_T
      element V_spdAtWhl_Ax2L: implementation-data-type=DataType/float32
  impl type RWhlAg_T: category=VALUE, base-type=BaseTypes/uint16_BaseType, compu {64001=RWhlAg_SpareLow, 65533=RWhlAg_SpareHigh, 65534=RWhlAg_Error, 65535=RWhlAg_NotAvailable}, range raw 0..65535
package /DataType/BaseTypes
  base type uint16_BaseType: category=FIXED_LENGTH, base-type-size=16, base-type-encoding=NONE, native-declaration=uint16
  base type uint32_BaseType: category=FIXED_LENGTH, base-type-size=32, base-type-encoding=NONE, native-declaration=uint32
  base type uint8_BaseType: category=FIXED_LENGTH, base-type-size=8, base-type-encoding=NONE, native-declaration=uint8
package /DataType/DataTypeSemantics
  compu method RoadWheelAngle_T: 65534=RoadWheelAngle_Error, 65535=RoadWheelAngle_NotAvailable
package /DataType/DataTypeUnits
  4 x unit, all with factor-si-to-unit=1, offset-si-to-unit=0:
    h: display-name=h
    min: display-name=min
    None
    Km_per_h: display-name=Km_per_h
package /Volvo_SEWS/DataTypes
  6 x impl type:
    Dem_EventStatusType: compu {0=DEM_EVENT_STATUS_PASSED, 1=DEM_EVENT_STATUS_FAILED, 2=DEM_EVENT_STATUS_PREPASSED, 3=DEM_EVENT_STATUS_PREFAILED, 4=DEM_EVENT_STATUS_FDC_THRESHOLD_REACHED, 5=DEM_EVENT_STATUS_PASSED_CONDITIONS_NOT_FULFILLED, 6=DEM_EVENT_STATUS_FAILED_CONDITIONS_NOT_FULFILLED, 7=DEM_EVENT_STATUS_PREPASSED_CONDITIONS_NOT_FULFILLED, 8=DEM_EVENT_STATUS_PREFAILED_CONDITIONS_NOT_FULFILLED}, implementation-data-type=uint8
    Dem_DTCFormatType: compu {0=DEM_DTC_FORMAT_OBD, 1=DEM_DTC_FORMAT_UDS, 2=DEM_DTC_FORMAT_J1939}, implementation-data-type=uint8
    Dem_MaxDataValueType: category=ARRAY, sw-calibration-access=READ-ONLY
      element Dem_MaxDataValueTypeElement: array-size=6, array-size-semantics=FIXED-SIZE, implementation-data-type=uint8
    Dem_UdsStatusByteType: compu {mask 1: 1=DEM_UDS_STATUS_TF, mask 2: 2=DEM_UDS_STATUS_TFTOC, mask 4: 4=DEM_UDS_STATUS_PDTC, mask 8: 8=DEM_UDS_STATUS_CDTC, mask 16: 16=DEM_UDS_STATUS_TNCSLC, mask 32: 32=DEM_UDS_STATUS_TFSLC, mask 64: 64=DEM_UDS_STATUS_TNCTOC, mask 128: 128=DEM_UDS_STATUS_WIR}, range raw 0..255, implementation-data-type=uint8
    Dem_DebounceResetStatusType: compu {0=DEM_DEBOUNCE_STATUS_FREEZE, 1=DEM_DEBOUNCE_STATUS_RESET}, implementation-data-type=uint8
    SEWS_D_precLongAccMeas_P10VW_T: implementation-data-type=uint8  # Datatype for P10VW
  app type SEWS_D_precLongAccMeas_P10VW_ADT: category=VALUE, sw-calibration-access=READ-ONLY, compu {phys=raw*0.04}  # Datatype for P10VW
  impl type SEWS_SelfSteeredTagAxleThreshSpeed_P1AK9_T: implementation-data-type=uint8  # Datatype for P1AK9
  app type SEWS_SelfSteeredTagAxleThreshSpeed_P1AK9_ADT: category=VALUE, sw-calibration-access=READ-ONLY, compu {phys=raw; unit km/h}  # Datatype for P1AK9
  impl type SEWS_NoOfPulsesPerRevolution_P1M6I_T: implementation-data-type=uint32  # Datatype for P1M6I
  app type SEWS_NoOfPulsesPerRevolution_P1M6I_ADT: category=VALUE, sw-calibration-access=READ-ONLY, compu {phys=raw*0.0001}  # Datatype for P1M6I
  impl type SEWS_D_lowSpdSnsrSelnLatAScaFac_X1C5B_T: implementation-data-type=uint8  # Datatype for X1C5B
  app type SEWS_D_lowSpdSnsrSelnLatAScaFac_X1C5B_ADT: category=VALUE, sw-calibration-access=READ-ONLY, compu {phys=raw*0.0392}  # Datatype for X1C5B
  impl type SEWS_D_FltHndlgIndirPrimSigFltScaFac_X1C6U_T: implementation-data-type=uint8  # Datatype for X1C6U
  app type SEWS_D_FltHndlgIndirPrimSigFltScaFac_X1C6U_ADT: category=VALUE, sw-calibration-access=READ-ONLY, compu {phys=raw*0.00394}  # Datatype for X1C6U
  impl type SEWS_ConfigAxle_4_axle_load_max_P1A8I_T: implementation-data-type=uint16  # Datatype for P1A8I
  app type SEWS_ConfigAxle_4_axle_load_max_P1A8I_ADT: category=VALUE, sw-calibration-access=READ-ONLY, compu {phys=raw*32; unit kg}  # Datatype for P1A8I
  impl type SEWS_D_precYawJerkInput_P10VT_T: implementation-data-type=uint8  # Datatype for P10VT
  app type SEWS_D_precYawJerkInput_P10VT_ADT: category=VALUE, sw-calibration-access=READ-ONLY, compu {phys=raw*0.01}  # Datatype for P10VT
  impl type SEWS_ConfigAxle_4_p_thres_P1A8A_T: implementation-data-type=sint16  # Datatype for P1A8A
  app type SEWS_ConfigAxle_4_p_thres_P1A8A_ADT: category=VALUE, sw-calibration-access=READ-ONLY, compu {phys=raw/1024; unit bar}  # Datatype for P1A8A
  impl type SEWS_ConfigAxle_4_axle_type_steered_P1A71_T: implementation-data-type=uint8  # Datatype for P1A71
  impl type SEWS_D_FltHndlgPrimSigFltScaFac_X1C68_T: implementation-data-type=uint8  # Datatype for X1C68
  app type SEWS_D_FltHndlgPrimSigFltScaFac_X1C68_ADT: category=VALUE, sw-calibration-access=READ-ONLY, compu {phys=raw*0.00394}  # Datatype for X1C68
  app type SEWS_ConfigAxle_4_axle_type_steered_P1A71_ADT: category=VALUE, sw-calibration-access=READ-ONLY, compu {phys=raw}  # Datatype for P1A71
  impl type SEWS_ConfigAxle_1_axle_type_liftable_P1A59_T: implementation-data-type=uint8  # Datatype for P1A59
  app type SEWS_ConfigAxle_1_axle_type_liftable_P1A59_ADT: category=VALUE, sw-calibration-access=READ-ONLY, compu {phys=raw}  # Datatype for P1A59
  impl type SEWS_T_interventionNoTrustTime_X1C60_T: implementation-data-type=uint8  # Datatype for X1C60
  impl type SEWS_ConfigAxle_2_wh_rollingcircu_P1A62_T: implementation-data-type=sint16  # Datatype for P1A62
  app type SEWS_T_interventionNoTrustTime_X1C60_ADT: category=VALUE, sw-calibration-access=READ-ONLY, compu {phys=raw*0.01; unit s}  # Datatype for X1C60
  app type SEWS_ConfigAxle_2_wh_rollingcircu_P1A62_ADT: category=VALUE, sw-calibration-access=READ-ONLY, compu {phys=raw/4000; unit m}  # Datatype for P1A62
  impl type SEWS_SteeringRatio_P1BGV_T: implementation-data-type=uint8  # Datatype for P1BGV
  impl type SEWS_VehicleType_P1L1L_T: implementation-data-type=uint8  # Datatype for P1L1L
  app type SEWS_SteeringRatio_P1BGV_ADT: category=VALUE, sw-calibration-access=READ-ONLY, compu {phys=raw*0.25}  # Datatype for P1BGV
  app type SEWS_VehicleType_P1L1L_ADT: category=VALUE, sw-calibration-access=READ-ONLY, compu {phys=raw}  # Datatype for P1L1L
  impl type SEWS_D_lowSpdSnsrSelnWhlSpdScaFac_X1C5E_T: implementation-data-type=uint8  # Datatype for X1C5E
  impl type SEWS_ConfigAxle_2_axle_type_liftable_P1A6U_T: implementation-data-type=uint8  # Datatype for P1A6U
  impl type SEWS_D_normSlipStfnAxle5_P10WG_T: implementation-data-type=uint8  # Datatype for P10WG
  app type SEWS_ConfigAxle_2_axle_type_liftable_P1A6U_ADT: category=VALUE, sw-calibration-access=READ-ONLY, compu {phys=raw}  # Datatype for P1A6U
  app type SEWS_D_lowSpdSnsrSelnWhlSpdScaFac_X1C5E_ADT: category=VALUE, sw-calibration-access=READ-ONLY, compu {phys=raw*0.0392}  # Datatype for X1C5E
  app type SEWS_D_normSlipStfnAxle5_P10WG_ADT: category=VALUE, sw-calibration-access=READ-ONLY, compu {phys=raw*0.4}  # Datatype for P10WG
  impl type SEWS_ConfigAxle_3_wh_rollingcircu_P1A7N_T: implementation-data-type=sint16  # Datatype for P1A7N
  impl type SEWS_M_Axle5SuspVertLoads_P10W2_T: implementation-data-type=uint8  # Datatype for P10W2
  impl type SEWS_T_absAsrTurnOffDly_X1DCK_T: implementation-data-type=uint8  # Datatype for X1DCK
  app type SEWS_ConfigAxle_3_wh_rollingcircu_P1A7N_ADT: category=VALUE, sw-calibration-access=READ-ONLY, compu {phys=raw/4000; unit m}  # Datatype for P1A7N
  impl type SEWS_M_Axle5SuspVertLoads_P10W2_a_T: category=ARRAY, sw-calibration-access=READ-ONLY
    element SEWS_M_Axle5SuspVertLoads_P10W2_a_TElement: array-size=2, array-size-semantics=FIXED-SIZE, implementation-data-type=SEWS_M_Axle5SuspVertLoads_P10W2_T
  impl type SEWS_Tq_minEngineWheelTorque_X1C8Y_T: implementation-data-type=uint8  # Datatype for X1C8Y
  app type SEWS_T_absAsrTurnOffDly_X1DCK_ADT: category=VALUE, sw-calibration-access=READ-ONLY, compu {phys=raw*0.01; unit s}  # Datatype for X1DCK
  app type SEWS_Tq_minEngineWheelTorque_X1C8Y_ADT: category=VALUE, sw-calibration-access=READ-ONLY, compu {phys=raw*100}  # Datatype for X1C8Y
  app type SEWS_M_Axle5SuspVertLoads_P10W2_ADT: category=VALUE, sw-calibration-access=READ-ONLY, compu {phys=raw*75; unit kg}  # Datatype for P10W2
  impl type SEWS_ConfigAxle_2_axle_load_max_P1A7C_T: implementation-data-type=uint16  # Datatype for P1A7C
  app type SEWS_M_Axle1SuspVertLoads_P10WU_ADT: category=VALUE, sw-calibration-access=READ-ONLY, compu {phys=raw*75; unit kg}  # Datatype for P10WU
  app type SEWS_ConfigAxle_2_axle_load_max_P1A7C_ADT: category=VALUE, sw-calibration-access=READ-ONLY, compu {phys=raw*32; unit kg}  # Datatype for P1A7C
  application array data type SEWS_M_Axle1SuspVertLoads_P10WU_a_ADT: category=ARRAY, sw-calibration-access=READ-ONLY
    element SEWS_M_Axle1SuspVertLoads_P10WU_a_ADTElement: category=VALUE, type=SEWS_M_Axle1SuspVertLoads_P10WU_ADT, array-size-semantics=FIXED-SIZE, max-number-of-elements=2
  impl type SEWS_M_Axle1SuspVertLoads_P10WU_T: implementation-data-type=uint8  # Datatype for P10WU
  application array data type SEWS_M_Axle5SuspVertLoads_P10W2_a_ADT: category=ARRAY, sw-calibration-access=READ-ONLY
    element SEWS_M_Axle5SuspVertLoads_P10W2_a_ADTElement: category=VALUE, type=SEWS_M_Axle5SuspVertLoads_P10W2_ADT, array-size-semantics=FIXED-SIZE, max-number-of-elements=2
  impl type SEWS_M_Axle1SuspVertLoads_P10WU_a_T: category=ARRAY, sw-calibration-access=READ-ONLY
    element SEWS_M_Axle1SuspVertLoads_P10WU_a_TElement: array-size=2, array-size-semantics=FIXED-SIZE, implementation-data-type=SEWS_M_Axle1SuspVertLoads_P10WU_T
  impl type SEWS_ConfigAxle_5_axle_type_liftable_P1A8L_T: implementation-data-type=uint8  # Datatype for P1A8L
  impl type SEWS_ConfigAxle_1_axle_load_max_P1A6R_T: implementation-data-type=uint16  # Datatype for P1A6R
  app type SEWS_ConfigAxle_5_axle_type_liftable_P1A8L_ADT: category=VALUE, sw-calibration-access=READ-ONLY, compu {phys=raw}  # Datatype for P1A8L
  impl type SEWS_ConfigAxle_5_axle_load_max_P1A83_T: implementation-data-type=uint16  # Datatype for P1A83
  app type SEWS_ConfigAxle_1_axle_load_max_P1A6R_ADT: category=VALUE, sw-calibration-access=READ-ONLY, compu {phys=raw*32; unit kg}  # Datatype for P1A6R
  impl type SEWS_Frq_lowSpdSnsrSelnTqFilFrq_X1C48_T: implementation-data-type=uint8  # Datatype for X1C48
  impl type SEWS_D_normSlipStfnAxle2_P10WD_T: implementation-data-type=uint8  # Datatype for P10WD
  app type SEWS_ConfigAxle_5_axle_load_max_P1A83_ADT: category=VALUE, sw-calibration-access=READ-ONLY, compu {phys=raw*32; unit kg}  # Datatype for P1A83
  app type SEWS_Frq_lowSpdSnsrSelnTqFilFrq_X1C48_ADT: category=VALUE, sw-calibration-access=READ-ONLY, compu {phys=raw*0.1; unit Hz}  # Datatype for X1C48
  impl type SEWS_T_absAsrRstDelayTime_X1DU3_T: implementation-data-type=uint8  # Datatype for X1DU3
  impl type SEWS_FAxleContactPatchOutside2OutsideDist_P1KJ7_T: implementation-data-type=uint16  # Datatype for P1KJ7
  app type SEWS_D_normSlipStfnAxle2_P10WD_ADT: category=VALUE, sw-calibration-access=READ-ONLY, compu {phys=raw*0.4}  # Datatype for P10WD
  impl type SEWS_ConfigAxle_1_p_thres_P1A6J_T: implementation-data-type=sint16  # Datatype for P1A6J
  app type SEWS_T_absAsrRstDelayTime_X1DU3_ADT: category=VALUE, sw-calibration-access=READ-ONLY, compu {phys=raw*0.01; unit s}  # Datatype for X1DU3
  app type SEWS_ConfigAxle_1_p_thres_P1A6J_ADT: category=VALUE, sw-calibration-access=READ-ONLY, compu {phys=raw/1024; unit bar}  # Datatype for P1A6J
  impl type SEWS_VehicleTargetGeneratorSpeedLimits1_P1B8U_T: implementation-data-type=uint8  # Datatype for P1B8U
  app type SEWS_FAxleContactPatchOutside2OutsideDist_P1KJ7_ADT: category=VALUE, sw-calibration-access=READ-ONLY, compu {phys=raw; unit mm}  # Datatype for P1KJ7
  impl type SEWS_Stfn_Axle5SuspVertStfns_P10W3_a_T: category=ARRAY, sw-calibration-access=READ-ONLY
    element SEWS_Stfn_Axle5SuspVertStfns_P10W3_a_TElement: array-size=2, array-size-semantics=FIXED-SIZE, implementation-data-type=SEWS_Stfn_Axle5SuspVertStfns_P10W3_T
  impl type SEWS_RearAxleArrangement_P1CSG_T: implementation-data-type=uint8  # Datatype for P1CSG
  app type SEWS_VehicleTargetGeneratorSpeedLimits1_P1B8U_ADT: category=VALUE, sw-calibration-access=READ-ONLY, compu {phys=raw; unit km/h}  # Datatype for P1B8U
  app type SEWS_Stfn_Axle5SuspVertStfns_P10W3_ADT: category=VALUE, sw-calibration-access=READ-ONLY, compu {phys=raw*500+1; unit N/m}  # Datatype for P10W3
  application array data type SEWS_Stfn_Axle5SuspVertStfns_P10W3_a_ADT: category=ARRAY, sw-calibration-access=READ-ONLY
    element SEWS_Stfn_Axle5SuspVertStfns_P10W3_a_ADTElement: category=VALUE, type=SEWS_Stfn_Axle5SuspVertStfns_P10W3_ADT, array-size-semantics=FIXED-SIZE, max-number-of-elements=2
  app type Boolean_ADT: category=VALUE, sw-calibration-access=READ-ONLY, compu {phys=raw for raw 0, phys=raw for raw 1, else 0}  # Boolean has the value space required to support the mathematical concept of binary-valued logic: {true, false}.
  app type SEWS_RearAxleArrangement_P1CSG_ADT: category=VALUE, sw-calibration-access=READ-ONLY, compu {phys=raw}  # Datatype for P1CSG
  app type SEWS_D_precLongVelRateInit_X1C3E_ADT: category=VALUE, sw-calibration-access=READ-ONLY, compu {phys=raw}  # Datatype for X1C3E
  5 x impl type:
    SEWS_Stfn_Axle2SuspVertStfns_P10WX_T: implementation-data-type=uint16  # Datatype for P10WX
    SEWS_Stfn_Axle5SuspVertStfns_P10W3_T: implementation-data-type=uint16  # Datatype for P10W3
    SEWS_ConfigAxle_3_brake_factor_P1A7Q_T: implementation-data-type=sint16  # Datatype for P1A7Q
    SEWS_Stfn_Axle2SuspVertStfns_P10WX_a_T: category=ARRAY, sw-calibration-access=READ-ONLY
      element SEWS_Stfn_Axle2SuspVertStfns_P10WX_a_TElement: array-size=2, array-size-semantics=FIXED-SIZE, implementation-data-type=SEWS_Stfn_Axle2SuspVertStfns_P10WX_T
    SEWS_BrandType_P1AFC_T: implementation-data-type=uint8  # Datatype for P1AFC
  4 x app type, all with category=VALUE, sw-calibration-access=READ-ONLY:
    SEWS_Stfn_Axle2SuspVertStfns_P10WX_ADT: compu {phys=raw*500+1; unit N/m}  # Datatype for P10WX
    SEWS_SteeringRatioRight2_P1BGZ_ADT: compu {phys=raw*0.25}  # Datatype for P1BGZ
    SEWS_BrandType_P1AFC_ADT: compu {phys=raw}  # Datatype for P1AFC
    SEWS_ConfigAxle_3_brake_factor_P1A7Q_ADT: compu {phys=raw*32}  # Datatype for P1A7Q
  application array data type SEWS_Stfn_Axle2SuspVertStfns_P10WX_a_ADT: category=ARRAY, sw-calibration-access=READ-ONLY
    element SEWS_Stfn_Axle2SuspVertStfns_P10WX_a_ADTElement: category=VALUE, type=SEWS_Stfn_Axle2SuspVertStfns_P10WX_ADT, array-size-semantics=FIXED-SIZE, max-number-of-elements=2
  impl type SEWS_D_precTrsmOutpShaftSpdMeas_X1C3K_T: implementation-data-type=uint8  # Datatype for X1C3K
  impl type SEWS_V_lowSpdSnsrSelnSpdThldUp_P10V2_T: implementation-data-type=uint8  # Datatype for P10V2
  impl type SEWS_Frq_lowSpdSnsrSelnSpdFilFrq_X1C49_T: implementation-data-type=uint8  # Datatype for X1C49
  4 x app type, all with category=VALUE, sw-calibration-access=READ-ONLY:
    SEWS_D_normSlipStfnAxle3_P10WE_ADT: compu {phys=raw*0.4}  # Datatype for P10WE
    SEWS_Frq_lowSpdSnsrSelnSpdFilFrq_X1C49_ADT: compu {phys=raw*0.5; unit Hz}  # Datatype for X1C49
    SEWS_V_lowSpdSnsrSelnSpdThldUp_P10V2_ADT: compu {phys=raw*0.02; unit m/s}  # Datatype for P10V2
    SEWS_D_precTrsmOutpShaftSpdMeas_X1C3K_ADT: compu {phys=raw*0.5}  # Datatype for X1C3K
  4 x impl type, all with category=TYPE_REFERENCE:
    SEWS_ConfigAxle_3_axle_type_liftable_P1A7F_T: implementation-data-type=uint8  # Datatype for P1A7F
    SEWS_DistRA1ToRA2_P1CNH_T: implementation-data-type=uint16  # Datatype for P1CNH
    SEWS_SteeringRatioRight2_P1BGZ_T: implementation-data-type=uint8  # Datatype for P1BGZ
    SEWS_D_normSlipStfnAxle3_P10WE_T: implementation-data-type=uint8  # Datatype for P10WE
  app type SEWS_ConfigAxle_3_axle_type_liftable_P1A7F_ADT: category=VALUE, sw-calibration-access=READ-ONLY, compu {phys=raw}  # Datatype for P1A7F
  app type SEWS_DistRA1ToRA2_P1CNH_ADT: category=VALUE, sw-calibration-access=READ-ONLY, compu {phys=raw; unit mm}  # Datatype for P1CNH
  app type SEWS_D_absTracCompLgtAScaFac_X1C63_ADT: category=VALUE, sw-calibration-access=READ-ONLY, compu {phys=raw*0.2}  # Datatype for X1C63
  impl type SEWS_ConfigAxle_5_axle_type_steered_P1A8M_T: implementation-data-type=uint8  # Datatype for P1A8M
  impl type SEWS_WheelBase_P1AZQ_T: implementation-data-type=uint16  # Datatype for P1AZQ
  impl type SEWS_D_precLatJerkDueToBankAngleInput_P10VU_T: implementation-data-type=uint8  # Datatype for P10VU
  application array data type SEWS_M_Axle4SuspVertLoads_P10W0_a_ADT: category=ARRAY, sw-calibration-access=READ-ONLY
    element SEWS_M_Axle4SuspVertLoads_P10W0_a_ADTElement: category=VALUE, type=SEWS_M_Axle4SuspVertLoads_P10W0_ADT, array-size-semantics=FIXED-SIZE, max-number-of-elements=2
  app type SEWS_ConfigAxle_5_axle_type_steered_P1A8M_ADT: category=VALUE, sw-calibration-access=READ-ONLY, compu {phys=raw}  # Datatype for P1A8M
  app type SEWS_WheelBase_P1AZQ_ADT: category=VALUE, sw-calibration-access=READ-ONLY, compu {phys=raw*0.0005; unit m}  # Datatype for P1AZQ
  app type SEWS_D_precLatJerkDueToBankAngleInput_P10VU_ADT: category=VALUE, sw-calibration-access=READ-ONLY, compu {phys=raw*0.05}  # Datatype for P10VU
  5 x impl type:
    SEWS_M_Axle4SuspVertLoads_P10W0_a_T: category=ARRAY, sw-calibration-access=READ-ONLY
      element SEWS_M_Axle4SuspVertLoads_P10W0_a_TElement: array-size=2, array-size-semantics=FIXED-SIZE, implementation-data-type=SEWS_M_Axle4SuspVertLoads_P10W0_T
    SEWS_L_trackWidthDrivenAxle_X1C3A_T: implementation-data-type=uint8  # Datatype for X1C3A
    SEWS_D_lowSpdSnsrSelnYawRateScaFac_X1C5C_T: implementation-data-type=uint8  # Datatype for X1C5C
    SEWS_D_FltHndlgIndirAltvSigFltScaFac_X1C6V_T: implementation-data-type=uint8  # Datatype for X1C6V
    SEWS_V_mtnDetnThdSpd_X1C9S_T: implementation-data-type=uint8  # Datatype for X1C9S
  5 x app type, all with category=VALUE, sw-calibration-access=READ-ONLY:
    SEWS_L_trackWidthDrivenAxle_X1C3A_ADT: compu {phys=raw/64; unit m}  # Datatype for X1C3A
    SEWS_M_Axle4SuspVertLoads_P10W0_ADT: compu {phys=raw*75; unit kg}  # Datatype for P10W0
    SEWS_D_lowSpdSnsrSelnYawRateScaFac_X1C5C_ADT: compu {phys=raw*0.0392}  # Datatype for X1C5C
    SEWS_D_FltHndlgIndirAltvSigFltScaFac_X1C6V_ADT: compu {phys=raw*0.00394}  # Datatype for X1C6V
    SEWS_V_mtnDetnThdSpd_X1C9S_ADT: compu {phys=raw*0.01; unit m/s}  # Datatype for X1C9S
  impl type SEWS_ConfigAxle_1_axle_type_steered_P1A6A_T: implementation-data-type=uint8  # Datatype for P1A6A
  impl type SEWS_D_absTracCompLgtAScaFac_X1C63_T: implementation-data-type=uint8  # Datatype for X1C63
  impl type SEWS_D_maxWheelSpeedTrustFac_vec_X1C69_T: implementation-data-type=uint8  # Datatype for X1C69
  app type SEWS_ConfigAxle_1_axle_type_steered_P1A6A_ADT: category=VALUE, sw-calibration-access=READ-ONLY, compu {phys=raw}  # Datatype for P1A6A
  app type SEWS_ConfigAxle_2_brake_factor_P1A65_ADT: category=VALUE, sw-calibration-access=READ-ONLY, compu {phys=raw*32}  # Datatype for P1A65
  impl type SEWS_ConfigAxle_2_axle_load_min_P1A7B_T: implementation-data-type=uint16  # Datatype for P1A7B
  impl type SEWS_A_mtnDetnThdLongAcc_X1DBJ_T: implementation-data-type=uint8  # Datatype for X1DBJ
  impl type SEWS_D_maxWheelSpeedTrustFac_vec_X1C69_a_T: category=ARRAY, sw-calibration-access=READ-ONLY
    element SEWS_D_maxWheelSpeedTrustFac_vec_X1C69_a_TElement: array-size=5, array-size-semantics=FIXED-SIZE, implementation-data-type=SEWS_D_maxWheelSpeedTrustFac_vec_X1C69_T
  app type SEWS_ConfigAxle_2_axle_load_min_P1A7B_ADT: category=VALUE, sw-calibration-access=READ-ONLY, compu {phys=raw*32; unit kg}  # Datatype for P1A7B
  app type SEWS_D_maxWheelSpeedTrustFac_vec_X1C69_ADT: category=VALUE, sw-calibration-access=READ-ONLY, compu {phys=raw*0.01}  # Datatype for X1C69
  impl type SEWS_ConfigAxle_3_axle_load_min_P1A7W_T: implementation-data-type=uint16  # Datatype for P1A7W
  impl type SEWS_ConfigAxle_2_brake_factor_P1A65_T: implementation-data-type=sint16  # Datatype for P1A65
  app type SEWS_A_mtnDetnThdLongAcc_X1DBJ_ADT: category=VALUE, sw-calibration-access=READ-ONLY, compu {phys=raw*0.04; unit TemporaryUNIT}  # Datatype for X1DBJ
  impl type SEWS_SteeringRatioLeft1_P1BGW_T: implementation-data-type=uint8  # Datatype for P1BGW
  application array data type SEWS_D_maxWheelSpeedTrustFac_vec_X1C69_a_ADT: category=ARRAY, sw-calibration-access=READ-ONLY
    element SEWS_D_maxWheelSpeedTrustFac_vec_X1C69_a_ADTElement: category=VALUE, type=SEWS_D_maxWheelSpeedTrustFac_vec_X1C69_ADT, array-size-semantics=FIXED-SIZE, max-number-of-elements=5
  impl type SEWS_M_Axle4SuspVertLoads_P10W0_T: implementation-data-type=uint8  # Datatype for P10W0
  app type SEWS_ConfigAxle_3_axle_load_min_P1A7W_ADT: category=VALUE, sw-calibration-access=READ-ONLY, compu {phys=raw*32; unit kg}  # Datatype for P1A7W
  app type SEWS_SteeringRatioLeft1_P1BGW_ADT: category=VALUE, sw-calibration-access=READ-ONLY, compu {phys=raw*0.25}  # Datatype for P1BGW
  7 x impl type, all with category=TYPE_REFERENCE:
    SEWS_D_precLongVelRateInit_X1C3E_T: implementation-data-type=uint8  # Datatype for X1C3E
    SEWS_ConfigAxle_2_axle_type_steered_P1A6V_T: implementation-data-type=uint8  # Datatype for P1A6V
    SEWS_Tq_lowSpdSnsrSelnTqThldUp_X1C46_T: implementation-data-type=uint8  # Datatype for X1C46
    SEWS_D_precWhlSpdMeas_X1C5P_T: implementation-data-type=uint8  # Datatype for X1C5P
    SEWS_DistRA2ToRA3_P1CNJ_T: implementation-data-type=uint16  # Datatype for P1CNJ
    SEWS_L_imuToFrontAxle_P10WH_T: implementation-data-type=uint8  # Datatype for P10WH
    SEWS_Stfn_Axle4SuspVertStfns_P10W1_T: implementation-data-type=uint16  # Datatype for P10W1
  5 x app type, all with category=VALUE, sw-calibration-access=READ-ONLY:
    SEWS_Tq_lowSpdSnsrSelnTqThldUp_X1C46_ADT: compu {phys=raw*100; unit Nm}  # Datatype for X1C46
    SEWS_ConfigAxle_2_axle_type_steered_P1A6V_ADT: compu {phys=raw}  # Datatype for P1A6V
    SEWS_D_precWhlSpdMeas_X1C5P_ADT: compu {phys=raw*0.1}  # Datatype for X1C5P
    SEWS_DistRA2ToRA3_P1CNJ_ADT: compu {phys=raw; unit mm}  # Datatype for P1CNJ
    SEWS_L_imuToFrontAxle_P10WH_ADT: compu {phys=raw*0.01961; unit m}  # Datatype for P10WH
  4 x impl type:
    SEWS_Stfn_Axle4SuspVertStfns_P10W1_a_T: category=ARRAY, sw-calibration-access=READ-ONLY
      element SEWS_Stfn_Axle4SuspVertStfns_P10W1_a_TElement: array-size=2, array-size-semantics=FIXED-SIZE, implementation-data-type=SEWS_Stfn_Axle4SuspVertStfns_P10W1_T
    SEWS_T_zeroSpdFltrTurnOffDly_X1C5W_T: implementation-data-type=uint8  # Datatype for X1C5W
    SEWS_E_EbsSwPackage_P1K5K_T: implementation-data-type=uint8  # Datatype for P1K5K
    SEWS_FrontAxleArrangement_P1CSH_T: implementation-data-type=uint8  # Datatype for P1CSH
  app type SEWS_Stfn_Axle4SuspVertStfns_P10W1_ADT: category=VALUE, sw-calibration-access=READ-ONLY, compu {phys=raw*500+1; unit N/m}  # Datatype for P10W1
  app type SEWS_T_zeroSpdFltrTurnOffDly_X1C5W_ADT: category=VALUE, sw-calibration-access=READ-ONLY, compu {phys=raw*0.01; unit s}  # Datatype for X1C5W
  impl type SEWS_D_precLatAccDueToBankAngleInit_X1DBH_T: implementation-data-type=uint8  # Datatype for X1DBH
  app type SEWS_FrontAxleArrangement_P1CSH_ADT: category=VALUE, sw-calibration-access=READ-ONLY, compu {phys=raw}  # Datatype for P1CSH
  impl type SEWS_D_FltHndlgAltvSigFltScaFac_X1C6T_T: implementation-data-type=uint8  # Datatype for X1C6T
  app type SEWS_E_EbsSwPackage_P1K5K_ADT: category=VALUE, sw-calibration-access=READ-ONLY, compu {phys=raw}  # Datatype for P1K5K
  application array data type SEWS_Stfn_Axle4SuspVertStfns_P10W1_a_ADT: category=ARRAY, sw-calibration-access=READ-ONLY
    element SEWS_Stfn_Axle4SuspVertStfns_P10W1_a_ADTElement: category=VALUE, type=SEWS_Stfn_Axle4SuspVertStfns_P10W1_ADT, array-size-semantics=FIXED-SIZE, max-number-of-elements=2
  impl type SEWS_E_BusAxleType_P11DU_T: implementation-data-type=sint8  # Datatype for P11DU
  impl type SEWS_ConfigAxle_5_axle_load_min_P1A82_T: implementation-data-type=uint16  # Datatype for P1A82
  app type SEWS_D_precLatAccDueToBankAngleInit_X1DBH_ADT: category=VALUE, sw-calibration-access=READ-ONLY, compu {phys=raw*25}  # Datatype for X1DBH
  impl type SEWS_D_wheelSpeedTrustFac_vec_X1C8Z_T: implementation-data-type=uint8  # Datatype for X1C8Z
  app type SEWS_D_FltHndlgAltvSigFltScaFac_X1C6T_ADT: category=VALUE, sw-calibration-access=READ-ONLY, compu {phys=raw*0.00394}  # Datatype for X1C6T
  app type SEWS_ConfigAxle_5_axle_load_min_P1A82_ADT: category=VALUE, sw-calibration-access=READ-ONLY, compu {phys=raw*32; unit kg}  # Datatype for P1A82
  impl type SEWS_Stfn_Axle1SuspVertStfns_P10WV_T: implementation-data-type=uint16  # Datatype for P10WV
  app type SEWS_E_BusAxleType_P11DU_ADT: category=VALUE, sw-calibration-access=READ-ONLY, compu {phys=raw}  # Datatype for P11DU
  5 x impl type:
    SEWS_ConfigAxle_4_wh_rollingcircu_P1A78_T: implementation-data-type=sint16  # Datatype for P1A78
    SEWS_D_precLatAccMeas_P10VX_T: implementation-data-type=uint8  # Datatype for P10VX
    SEWS_D_wheelSpeedTrustFac_vec_X1C8Z_a_T: category=ARRAY, sw-calibration-access=READ-ONLY
      element SEWS_D_wheelSpeedTrustFac_vec_X1C8Z_a_TElement: array-size=5, array-size-semantics=FIXED-SIZE, implementation-data-type=SEWS_D_wheelSpeedTrustFac_vec_X1C8Z_T
    SEWS_T_interventionRampUpTime_X1C61_T: implementation-data-type=uint8  # Datatype for X1C61
    SEWS_Stfn_Axle1SuspVertStfns_P10WV_a_T: category=ARRAY, sw-calibration-access=READ-ONLY
      element SEWS_Stfn_Axle1SuspVertStfns_P10WV_a_TElement: array-size=2, array-size-semantics=FIXED-SIZE, implementation-data-type=SEWS_Stfn_Axle1SuspVertStfns_P10WV_T
  app type SEWS_ConfigAxle_4_wh_rollingcircu_P1A78_ADT: category=VALUE, sw-calibration-access=READ-ONLY, compu {phys=raw/4000; unit m}  # Datatype for P1A78
  impl type SEWS_VehicleTargetGeneratorSpeedLimits2_P1B8V_T: implementation-data-type=uint8  # Datatype for P1B8V
  impl type SEWS_ConfigAxle_4_axle_load_min_P1A8H_T: implementation-data-type=uint16  # Datatype for P1A8H
  app type SEWS_T_interventionRampUpTime_X1C61_ADT: category=VALUE, sw-calibration-access=READ-ONLY, compu {phys=raw*0.02; unit s}  # Datatype for X1C61
  app type SEWS_Stfn_Axle1SuspVertStfns_P10WV_ADT: category=VALUE, sw-calibration-access=READ-ONLY, compu {phys=raw*500+1; unit N/m}  # Datatype for P10WV
  impl type SEWS_D_absTracCompLatAScaFac_X1DBO_T: implementation-data-type=uint8  # Datatype for X1DBO
  impl type SEWS_L_maxCogHeightFullyLaden_P10WS_T: implementation-data-type=uint8  # Datatype for P10WS
  app type SEWS_VehicleTargetGeneratorSpeedLimits2_P1B8V_ADT: category=VALUE, sw-calibration-access=READ-ONLY, compu {phys=raw; unit km/h}  # Datatype for P1B8V
  impl type SEWS_D_precLongJerkInput_P10VS_T: implementation-data-type=uint8  # Datatype for P10VS
  application array data type SEWS_Stfn_Axle1SuspVertStfns_P10WV_a_ADT: category=ARRAY, sw-calibration-access=READ-ONLY
    element SEWS_Stfn_Axle1SuspVertStfns_P10WV_a_ADTElement: category=VALUE, type=SEWS_Stfn_Axle1SuspVertStfns_P10WV_ADT, array-size-semantics=FIXED-SIZE, max-number-of-elements=2
  impl type SEWS_D_absTracCompLongJerkScaFac_X1DBQ_T: implementation-data-type=uint16  # Datatype for X1DBQ
  app type SEWS_L_maxCogHeightFullyLaden_P10WS_ADT: category=VALUE, sw-calibration-access=READ-ONLY, compu {phys=raw/128; unit m}  # Datatype for P10WS
  impl type SEWS_Tq_lowSpdSnsrSelnTqThldLo_X1C47_T: implementation-data-type=uint8  # Datatype for X1C47
  app type SEWS_D_absTracCompLongJerkScaFac_X1DBQ_ADT: category=VALUE, sw-calibration-access=READ-ONLY, compu {phys=raw}  # Datatype for X1DBQ
  impl type SEWS_D_lowSpdSnsrSelnLgtJerkScaFacSpd_X1C5T_T: implementation-data-type=uint8  # Datatype for X1C5T
  app type SEWS_Tq_lowSpdSnsrSelnTqThldLo_X1C47_ADT: category=VALUE, sw-calibration-access=READ-ONLY, compu {phys=raw*100; unit Nm}  # Datatype for X1C47
  impl type SEWS_D_lowSpdSnsrSelnLgtAScaFac_X1C5A_T: implementation-data-type=uint8  # Datatype for X1C5A
  app type SEWS_D_lowSpdSnsrSelnLgtJerkScaFacSpd_X1C5T_ADT: category=VALUE, sw-calibration-access=READ-ONLY, compu {phys=raw*0.1962}  # Datatype for X1C5T
  impl type SEWS_ConfigAxle_3_axle_load_max_P1A7X_T: implementation-data-type=uint16  # Datatype for P1A7X
  app type SEWS_D_lowSpdSnsrSelnLgtAScaFac_X1C5A_ADT: category=VALUE, sw-calibration-access=READ-ONLY, compu {phys=raw*0.0392}  # Datatype for X1C5A
  impl type SEWS_T_absAsrDetnDelayTime_X1DU0_T: implementation-data-type=uint8  # Datatype for X1DU0
  app type SEWS_ConfigAxle_4_axle_load_min_P1A8H_ADT: category=VALUE, sw-calibration-access=READ-ONLY, compu {phys=raw*32; unit kg}  # Datatype for P1A8H
  app type SEWS_D_precLatAccMeas_P10VX_ADT: category=VALUE, sw-calibration-access=READ-ONLY, compu {phys=raw*0.04}  # Datatype for P10VX
  impl type SEWS_ConfigAxle_4_axle_type_liftable_P1A70_T: implementation-data-type=uint8  # Datatype for P1A70
  impl type SEWS_DistFA1ToFA2_P1KME_T: implementation-data-type=uint16  # Datatype for P1KME
  app type SEWS_DistFA1ToFA2_P1KME_ADT: category=VALUE, sw-calibration-access=READ-ONLY, compu {phys=raw; unit mm}  # Datatype for P1KME
  app type SEWS_ConfigAxle_4_axle_type_liftable_P1A70_ADT: category=VALUE, sw-calibration-access=READ-ONLY, compu {phys=raw}  # Datatype for P1A70
  impl type SEWS_ConfigAxle_5_p_thres_P1A8V_T: implementation-data-type=sint16  # Datatype for P1A8V
  impl type SEWS_A_whlRateAbsAsrDetnThd_X1DCH_T: implementation-data-type=uint8  # Datatype for X1DCH
  app type SEWS_ConfigAxle_5_p_thres_P1A8V_ADT: category=VALUE, sw-calibration-access=READ-ONLY, compu {phys=raw/1024; unit bar}  # Datatype for P1A8V
  app type SEWS_D_absTracCompLatAScaFac_X1DBO_ADT: category=VALUE, sw-calibration-access=READ-ONLY, compu {phys=raw*0.0392}  # Datatype for X1DBO
  app type SEWS_A_whlRateAbsAsrDetnThd_X1DCH_ADT: category=VALUE, sw-calibration-access=READ-ONLY, compu {phys=raw*0.04; unit TemporaryUNIT}  # Datatype for X1DCH
  impl type SEWS_ConfigAxle_3_p_thres_P1A7P_T: implementation-data-type=sint16  # Datatype for P1A7P
  impl type SEWS_D_lowSpdSnsrSelnTrsmSpdScaFac_X1C5D_T: implementation-data-type=uint8  # Datatype for X1C5D
  app type SEWS_ConfigAxle_3_p_thres_P1A7P_ADT: category=VALUE, sw-calibration-access=READ-ONLY, compu {phys=raw/1024; unit bar}  # Datatype for P1A7P
  impl type SEWS_NetworkArchitecture_P1RPH_T: implementation-data-type=uint8  # Datatype for P1RPH
  app type SEWS_D_lowSpdSnsrSelnTrsmSpdScaFac_X1C5D_ADT: category=VALUE, sw-calibration-access=READ-ONLY, compu {phys=raw*0.0392}  # Datatype for X1C5D
  app type SEWS_NetworkArchitecture_P1RPH_ADT: category=VALUE, sw-calibration-access=READ-ONLY, compu {phys=raw}  # Datatype for P1RPH
  impl type SEWS_TagAxleFeatures_P1CSI_T: implementation-data-type=uint8  # Datatype for P1CSI
  impl type SEWS_D_precYawRateMeas_P10VY_T: implementation-data-type=uint8  # Datatype for P10VY
  app type SEWS_TagAxleFeatures_P1CSI_ADT: category=VALUE, sw-calibration-access=READ-ONLY, compu {phys=raw}  # Datatype for P1CSI
  app type SEWS_D_precYawRateMeas_P10VY_ADT: category=VALUE, sw-calibration-access=READ-ONLY, compu {phys=raw*20}  # Datatype for P10VY
  impl type SEWS_D_absTracCompYawRateScaFac_X1DBP_T: implementation-data-type=uint8  # Datatype for X1DBP
  impl type SEWS_Stfn_Axle3SuspVertStfns_P10WZ_T: implementation-data-type=uint16  # Datatype for P10WZ
  app type SEWS_D_absTracCompYawRateScaFac_X1DBP_ADT: category=VALUE, sw-calibration-access=READ-ONLY, compu {phys=raw*0.0392}  # Datatype for X1DBP
  impl type SEWS_Stfn_Axle3SuspVertStfns_P10WZ_a_T: category=ARRAY, sw-calibration-access=READ-ONLY
    element SEWS_Stfn_Axle3SuspVertStfns_P10WZ_a_TElement: array-size=2, array-size-semantics=FIXED-SIZE, implementation-data-type=SEWS_Stfn_Axle3SuspVertStfns_P10WZ_T
  impl type SEWS_V_maxWheelSpeedTrustBreakPoints_vec_X1C7C_T: implementation-data-type=sint8  # Datatype for X1C7C
  app type SEWS_Stfn_Axle3SuspVertStfns_P10WZ_ADT: category=VALUE, sw-calibration-access=READ-ONLY, compu {phys=raw*500+1; unit N/m}  # Datatype for P10WZ
  impl type SEWS_V_maxWheelSpeedTrustBreakPoints_vec_X1C7C_a_T: category=ARRAY, sw-calibration-access=READ-ONLY
    element SEWS_V_maxWheelSpeedTrustBreakPoints_vec_X1C7C_a_TElement: array-size=5, array-size-semantics=FIXED-SIZE, implementation-data-type=SEWS_V_maxWheelSpeedTrustBreakPoints_vec_X1C7C_T
  app type SEWS_ConfigAxle_3_axle_load_max_P1A7X_ADT: category=VALUE, sw-calibration-access=READ-ONLY, compu {phys=raw*32; unit kg}  # Datatype for P1A7X
  app type SEWS_V_maxWheelSpeedTrustBreakPoints_vec_X1C7C_ADT: category=VALUE, sw-calibration-access=READ-ONLY, compu {phys=raw*0.05; unit m/s}  # Datatype for X1C7C
  application array data type SEWS_Stfn_Axle3SuspVertStfns_P10WZ_a_ADT: category=ARRAY, sw-calibration-access=READ-ONLY
    element SEWS_Stfn_Axle3SuspVertStfns_P10WZ_a_ADTElement: category=VALUE, type=SEWS_Stfn_Axle3SuspVertStfns_P10WZ_ADT, array-size-semantics=FIXED-SIZE, max-number-of-elements=2
  impl type SEWS_D_normSlipStfnAxle4_P10WF_T: implementation-data-type=uint8  # Datatype for P10WF
  app type SEWS_T_absAsrDetnDelayTime_X1DU0_ADT: category=VALUE, sw-calibration-access=READ-ONLY, compu {phys=raw*0.01; unit s}  # Datatype for X1DU0
  application array data type SEWS_V_maxWheelSpeedTrustBreakPoints_vec_X1C7C_a_ADT: category=ARRAY, sw-calibration-access=READ-ONLY
    element SEWS_V_maxWheelSpeedTrustBreakPoints_vec_X1C7C_a_ADTElement: category=VALUE, type=SEWS_V_maxWheelSpeedTrustBreakPoints_vec_X1C7C_ADT, array-size-semantics=FIXED-SIZE, max-number-of-elements=5
  impl type SEWS_L_trackWidthNonDrivenAxle_X1C29_T: implementation-data-type=uint8  # Datatype for X1C29
  impl type SEWS_ConfigAxle_1_brake_factor_P1A6K_T: implementation-data-type=sint16  # Datatype for P1A6K
  app type SEWS_D_normSlipStfnAxle4_P10WF_ADT: category=VALUE, sw-calibration-access=READ-ONLY, compu {phys=raw*0.4}  # Datatype for P10WF
  impl type SEWS_Frq_lowSpdSnsrSelnSpdFilFrq_X1C5U_T: implementation-data-type=uint8  # Datatype for X1C5U
  app type SEWS_L_trackWidthNonDrivenAxle_X1C29_ADT: category=VALUE, sw-calibration-access=READ-ONLY, compu {phys=raw/64; unit m}  # Datatype for X1C29
  app type SEWS_ConfigAxle_1_brake_factor_P1A6K_ADT: category=VALUE, sw-calibration-access=READ-ONLY, compu {phys=raw*32}  # Datatype for P1A6K
  app type SEWS_Frq_lowSpdSnsrSelnSpdFilFrq_X1C5U_ADT: category=VALUE, sw-calibration-access=READ-ONLY, compu {phys=raw*0.1; unit Hz}  # Datatype for X1C5U
  5 x impl type, all with category=TYPE_REFERENCE:
    SEWS_ConfigAxle_3_axle_type_steered_P1A7G_T: implementation-data-type=uint8  # Datatype for P1A7G
    SEWS_Tq_minTotalBrakeTorque_X1C8X_T: implementation-data-type=uint8  # Datatype for X1C8X
    SEWS_D_precYawAccInit_X1C3G_T: implementation-data-type=uint8  # Datatype for X1C3G
    SEWS_T_mtnLowConfTolrTi_X1DCF_T: implementation-data-type=uint8  # Datatype for X1DCF
    SEWS_Radar2FrontAxleDist_P1E5Z_T: implementation-data-type=sint16  # Datatype for P1E5Z
  4 x app type, all with category=VALUE, sw-calibration-access=READ-ONLY:
    SEWS_Tq_minTotalBrakeTorque_X1C8X_ADT: compu {phys=raw*100; unit Nm}  # Datatype for X1C8X
    SEWS_ConfigAxle_3_axle_type_steered_P1A7G_ADT: compu {phys=raw}  # Datatype for P1A7G
    SEWS_D_precYawAccInit_X1C3G_ADT: compu {phys=raw*8}  # Datatype for X1C3G
    SEWS_T_mtnLowConfTolrTi_X1DCF_ADT: compu {phys=raw*0.01; unit s}  # Datatype for X1DCF
  impl type SEWS_D_precYawRateInit_X1C3F_T: implementation-data-type=uint8  # Datatype for X1C3F
  app type SEWS_Radar2FrontAxleDist_P1E5Z_ADT: category=VALUE, sw-calibration-access=READ-ONLY, compu {phys=raw; unit mm}  # Datatype for P1E5Z
  impl type SEWS_ConfigAxle_2_p_thres_P1A64_T: implementation-data-type=sint16  # Datatype for P1A64
  app type SEWS_D_precYawRateInit_X1C3F_ADT: category=VALUE, sw-calibration-access=READ-ONLY, compu {phys=raw*12}  # Datatype for X1C3F
  4 x impl type, all with category=TYPE_REFERENCE:
    SEWS_D_lowSpdSnsrSelnLgtJerkScaFacTrq_X1C5Q_T: implementation-data-type=uint8  # Datatype for X1C5Q
    SEWS_ConfigAxle_1_axle_load_min_P1A6Q_T: implementation-data-type=uint16  # Datatype for P1A6Q
    SEWS_ConfigAxle_5_brake_factor_P1A8W_T: implementation-data-type=sint16  # Datatype for P1A8W
    SEWS_ConfigAxle_1_wh_rollingcircu_P1A6H_T: implementation-data-type=sint16  # Datatype for P1A6H
  5 x app type, all with category=VALUE, sw-calibration-access=READ-ONLY:
    SEWS_D_lowSpdSnsrSelnLgtJerkScaFacTrq_X1C5Q_ADT: compu {phys=raw*0.1962}  # Datatype for X1C5Q
    SEWS_ConfigAxle_2_p_thres_P1A64_ADT: compu {phys=raw/1024; unit bar}  # Datatype for P1A64
    SEWS_D_precLongJerkInput_P10VS_ADT: compu {phys=raw*0.0005}  # Datatype for P10VS
    SEWS_ConfigAxle_5_brake_factor_P1A8W_ADT: compu {phys=raw*32}  # Datatype for P1A8W
    SEWS_ConfigAxle_1_axle_load_min_P1A6Q_ADT: compu {phys=raw*32; unit kg}  # Datatype for P1A6Q
  impl type SEWS_L_minCogHeightUnladen_P10WR_T: implementation-data-type=uint8  # Datatype for P10WR
  impl type SEWS_D_normSlipStfnAxle1_P10WC_T: implementation-data-type=uint8  # Datatype for P10WC
  app type SEWS_ConfigAxle_1_wh_rollingcircu_P1A6H_ADT: category=VALUE, sw-calibration-access=READ-ONLY, compu {phys=raw/4000; unit m}  # Datatype for P1A6H
  impl type SEWS_EquivalentWheelbaseTurning_P1IJ3_T: implementation-data-type=uint16  # Datatype for P1IJ3
  app type SEWS_L_minCogHeightUnladen_P10WR_ADT: category=VALUE, sw-calibration-access=READ-ONLY, compu {phys=raw/128; unit m}  # Datatype for P10WR
  app type SEWS_D_normSlipStfnAxle1_P10WC_ADT: category=VALUE, sw-calibration-access=READ-ONLY, compu {phys=raw*0.4}  # Datatype for P10WC
  impl type SEWS_D_precLongVelInit_X1C3D_T: implementation-data-type=uint8  # Datatype for X1C3D
  app type SEWS_EquivalentWheelbaseTurning_P1IJ3_ADT: category=VALUE, sw-calibration-access=READ-ONLY, compu {phys=raw; unit mm}  # Datatype for P1IJ3
  impl type SEWS_V_speedDifferenceBreakPoints_vec_X1C80_T: implementation-data-type=sint8  # Datatype for X1C80
  impl type SEWS_Frq_whlRateFilFrq_X1DCI_T: implementation-data-type=uint8  # Datatype for X1DCI
  app type SEWS_D_precLongVelInit_X1C3D_ADT: category=VALUE, sw-calibration-access=READ-ONLY, compu {phys=raw*4}  # Datatype for X1C3D
  impl type SEWS_ConfigAxle_5_wh_rollingcircu_P1A8T_T: implementation-data-type=sint16  # Datatype for P1A8T
  impl type SEWS_A_whlRateAbsAsrRstThd_X1DCM_T: implementation-data-type=uint8  # Datatype for X1DCM
  impl type SEWS_V_speedDifferenceBreakPoints_vec_X1C80_a_T: category=ARRAY, sw-calibration-access=READ-ONLY
    element SEWS_V_speedDifferenceBreakPoints_vec_X1C80_a_TElement: array-size=5, array-size-semantics=FIXED-SIZE, implementation-data-type=SEWS_V_speedDifferenceBreakPoints_vec_X1C80_T
  app type SEWS_Frq_whlRateFilFrq_X1DCI_ADT: category=VALUE, sw-calibration-access=READ-ONLY, compu {phys=raw*0.5; unit Hz}  # Datatype for X1DCI
  impl type SEWS_SelfSteeredTagAxleSpeedHysteresis_P1AT2_T: implementation-data-type=uint8  # Datatype for P1AT2
  4 x app type, all with category=VALUE, sw-calibration-access=READ-ONLY:
    SEWS_ConfigAxle_5_wh_rollingcircu_P1A8T_ADT: compu {phys=raw/4000; unit m}  # Datatype for P1A8T
    SEWS_A_whlRateAbsAsrRstThd_X1DCM_ADT: compu {phys=raw*0.4; unit TemporaryUNIT}  # Datatype for X1DCM
    SEWS_V_speedDifferenceBreakPoints_vec_X1C80_ADT: compu {phys=raw*0.03; unit m/s}  # Datatype for X1C80
    SEWS_SelfSteeredTagAxleSpeedHysteresis_P1AT2_ADT: compu {phys=raw; unit km/h}  # Datatype for P1AT2
  application array data type SEWS_V_speedDifferenceBreakPoints_vec_X1C80_a_ADT: category=ARRAY, sw-calibration-access=READ-ONLY
    element SEWS_V_speedDifferenceBreakPoints_vec_X1C80_a_ADTElement: category=VALUE, type=SEWS_V_speedDifferenceBreakPoints_vec_X1C80_ADT, array-size-semantics=FIXED-SIZE, max-number-of-elements=5
  impl type SEWS_AgV_maxPitchRate_P10WT_T: implementation-data-type=uint8  # Datatype for P10WT
  impl type SEWS_SteeringRatioRight1_P1BGY_T: implementation-data-type=uint8  # Datatype for P1BGY
  app type SEWS_AgV_maxPitchRate_P10WT_ADT: category=VALUE, sw-calibration-access=READ-ONLY, compu {phys=raw*0.05}  # Datatype for P10WT
  app type SEWS_SteeringRatioRight1_P1BGY_ADT: category=VALUE, sw-calibration-access=READ-ONLY, compu {phys=raw*0.25}  # Datatype for P1BGY
  impl type SEWS_VehicleWidth_mm_P1E50_T: implementation-data-type=uint16  # Datatype for P1E50
  impl type SEWS_V_lowSpdSnsrSelnSpdThldLo_P10V1_T: implementation-data-type=uint8  # Datatype for P10V1
  app type SEWS_VehicleWidth_mm_P1E50_ADT: category=VALUE, sw-calibration-access=READ-ONLY, compu {phys=raw; unit mm}  # Datatype for P1E50
  app type SEWS_V_lowSpdSnsrSelnSpdThldLo_P10V1_ADT: category=VALUE, sw-calibration-access=READ-ONLY, compu {phys=raw*0.02; unit m/s}  # Datatype for P10V1
  impl type SEWS_M_Axle2SuspVertLoads_P10WW_T: implementation-data-type=uint8  # Datatype for P10WW
  impl type SEWS_M_Axle2SuspVertLoads_P10WW_a_T: category=ARRAY, sw-calibration-access=READ-ONLY
    element SEWS_M_Axle2SuspVertLoads_P10WW_a_TElement: array-size=2, array-size-semantics=FIXED-SIZE, implementation-data-type=SEWS_M_Axle2SuspVertLoads_P10WW_T
  app type SEWS_M_Axle2SuspVertLoads_P10WW_ADT: category=VALUE, sw-calibration-access=READ-ONLY, compu {phys=raw*75; unit kg}  # Datatype for P10WW
  application array data type SEWS_M_Axle2SuspVertLoads_P10WW_a_ADT: category=ARRAY, sw-calibration-access=READ-ONLY
    element SEWS_M_Axle2SuspVertLoads_P10WW_a_ADTElement: category=VALUE, type=SEWS_M_Axle2SuspVertLoads_P10WW_ADT, array-size-semantics=FIXED-SIZE, max-number-of-elements=2
  impl type SEWS_SteeringRatioLeft2_P1BGX_T: implementation-data-type=uint8  # Datatype for P1BGX
  app type SEWS_SteeringRatioLeft2_P1BGX_ADT: category=VALUE, sw-calibration-access=READ-ONLY, compu {phys=raw*0.25}  # Datatype for P1BGX
  impl type SEWS_M_Axle3SuspVertLoads_P10WY_T: implementation-data-type=uint8  # Datatype for P10WY
  impl type SEWS_V_mtnDetnHysSpd_X1C9T_T: implementation-data-type=uint8  # Datatype for X1C9T
  app type SEWS_V_mtnDetnHysSpd_X1C9T_ADT: category=VALUE, sw-calibration-access=READ-ONLY, compu {phys=raw*0.01; unit km/h}  # Datatype for X1C9T
  app type SEWS_D_wheelSpeedTrustFac_vec_X1C8Z_ADT: category=VALUE, sw-calibration-access=READ-ONLY, compu {phys=raw*0.01}  # Datatype for X1C8Z
  impl type SEWS_M_Axle3SuspVertLoads_P10WY_a_T: category=ARRAY, sw-calibration-access=READ-ONLY
    element SEWS_M_Axle3SuspVertLoads_P10WY_a_TElement: array-size=2, array-size-semantics=FIXED-SIZE, implementation-data-type=SEWS_M_Axle3SuspVertLoads_P10WY_T
  application array data type SEWS_D_wheelSpeedTrustFac_vec_X1C8Z_a_ADT: category=ARRAY, sw-calibration-access=READ-ONLY
    element SEWS_D_wheelSpeedTrustFac_vec_X1C8Z_a_ADTElement: category=VALUE, type=SEWS_D_wheelSpeedTrustFac_vec_X1C8Z_ADT, array-size-semantics=FIXED-SIZE, max-number-of-elements=5
  app type SEWS_M_Axle3SuspVertLoads_P10WY_ADT: category=VALUE, sw-calibration-access=READ-ONLY, compu {phys=raw*75; unit kg}  # Datatype for P10WY
  application array data type SEWS_M_Axle3SuspVertLoads_P10WY_a_ADT: category=ARRAY, sw-calibration-access=READ-ONLY
    element SEWS_M_Axle3SuspVertLoads_P10WY_a_ADTElement: category=VALUE, type=SEWS_M_Axle3SuspVertLoads_P10WY_ADT, array-size-semantics=FIXED-SIZE, max-number-of-elements=2
  impl type SEWS_ConfigAxle_4_brake_factor_P1A8B_T: implementation-data-type=sint16  # Datatype for P1A8B
  app type SEWS_ConfigAxle_4_brake_factor_P1A8B_ADT: category=VALUE, sw-calibration-access=READ-ONLY, compu {phys=raw*32}  # Datatype for P1A8B
package /Volvo_SEWS/DataTypes/Units
  59 x unit:
    dummyUnit: display-name=TemporaryUNIT, factor-si-to-unit=1, offset-si-to-unit=0  # This is a dummy unit that is added until we know how to handle all SEWS Units. We currently don't know how to interpret the Unit of this parameter correctly.
    KiloGr: display-name=kg, factor-si-to-unit=1, offset-si-to-unit=0  # Kilo Gram | SI base unit of mass
    KiloMtr: display-name=km, factor-si-to-unit=0.001, offset-si-to-unit=0  # Kilo Meter | SI base unit of length with prefix
    KiloMtrPerHr: display-name=km/h, factor-si-to-unit=1, offset-si-to-unit=0  # Kilo Meter per Hour | not used
    MilliMtr: display-name=mm, factor-si-to-unit=1, offset-si-to-unit=0  # Milli Meter | length - not used
    Mins: display-name=min, factor-si-to-unit=1, offset-si-to-unit=0  # Minute | time - not used
    Mtr: display-name=m, factor-si-to-unit=1, offset-si-to-unit=0  # Meter | SI base unit of length
    MtrSqd: display-name=m^2, factor-si-to-unit=1, offset-si-to-unit=0  # Meter Squared | SI unit of area - not used
    NoUnit: display-name=-, factor-si-to-unit=1, offset-si-to-unit=0  # No Unit | Unit for dimensionless continuous value data types like numbers, factors and coefficients
    NwtMtr: display-name=Nm, factor-si-to-unit=1, offset-si-to-unit=0  # Newton Meter | SI derived unit of moment of force (torque = kg m^2/s^2)
    Perc: display-name=%, factor-si-to-unit=100, offset-si-to-unit=0  # Percent | a percentage is a way of expressing a number as a fraction of 100 (no SI unit).
    Rad: display-name=rad, factor-si-to-unit=1, offset-si-to-unit=0  # Radian | SI derived unit of plane angle (dimensionless)
    RadPerSec: display-name=rad/s, factor-si-to-unit=1, offset-si-to-unit=0  # Radian per Second | SI derived unit of angular velocity
    Sec: display-name=s, factor-si-to-unit=1, offset-si-to-unit=0  # Second | SI base unit of time
    AmprPerMtrSqd: display-name=A/m^2  # Ampere per Meter Squared | current density - not used
    Kelvin: display-name=K, factor-si-to-unit=1  # SI base unit of thermodynamic temperature
    Hr: display-name=h  # Hour | time - not used
    Bar: display-name=bar, factor-si-to-unit=1E-05  # pressure, no SI unit; 1 bar = 100,000 Pascal (Pa)
    Hz: display-name=Hz, factor-si-to-unit=1  # Hertz | SI derived unit of frequency
    Cd: display-name=cd  # Candela | SI base unit for luminous intensity - not used
    Coulomb: display-name=C  # SI unit of electric charge - not used
    Jerk: display-name=ft/sec^3  # TBD: definitely not in the metric system - not used
    DegCgrd: display-name=degC, factor-si-to-unit=1, offset-si-to-unit=-273.15  # Degree Centigrade | temperature, no SI unit, (degC = Kelvin - 273.15)
    Jou: display-name=J  # Joule | SI unit of energy - not used
    MtrPerSec: display-name=m/s, factor-si-to-unit=1  # Meter per Second | SI derived unit of velocity
    Frd: display-name=F  # Farad | SI unit of electric capacitance - not used
    MtrPerSecCubd: display-name=m/s^3, factor-si-to-unit=1  # Meter per Second Cubed | jerk (derived from SI units), also called jolt (esp. in British English), surge or lurch, is the rate of change of acceleration; more precisely, the derivative of acceleration with respect to time, the second derivative of velocity, or the third derivative of displacement.
    GigaHz: display-name=GHz  # Giga Hertz | frequency - not used
    MtrPerSecSqd: display-name=m/s^2, factor-si-to-unit=1  # Meter per Second Squared | SI derived unit of acceleration
    HectoPa: display-name=hPa, factor-si-to-unit=0.01  # Hecto Pascal | SI derived unit of pressure with prefix | It is equivalent to one Newton per square meter. In everyday life, the Pascal is perhaps best known from meteorological air-pressure reports, where it occurs in the form of hecto Pascal (1 hPa = 100 Pa).
    MtrRecpr: display-name=1/m, factor-si-to-unit=1  # Meter Reciprocal | SI derived unit of wave number for electromagnetic fields or curvature as reciprocal of curve radius
    Pa: display-name=Pa, factor-si-to-unit=1  # Pascal | SI derived unit of pressure | The Pascal (symbol: Pa) is the SI derived unit of pressure or stress (also: Young's modulus and tensile strength). It is equivalent to one Newton per square meter. In everyday life, the Pascal is perhaps best known from meteorological air-pressure reports.
    KiloGrPerMtrCubd: display-name=kg/m^3  # Kilo Gram per Meter Cubed | SI unit of density - not used
    KiloHz: display-name=kHz, factor-si-to-unit=0.001  # Kilo Hertz | SI derived unit of frequency with prefix
    PercPerSec: display-name=%/s, factor-si-to-unit=100  # Percent per Second | time-derivative of percent
    Ampr: display-name=A  # Ampere | SI base unit of electric current - not used
    AmpH: display-name=Ah  # Ampere hour | SI derived unit of electric charge - not used
    AmprPerMtr: display-name=A/m  # Ampere per Meter | (magnetic) field strength - not used
    dB: display-name=dB  # Decibel | The decibel (dB) is a logarithmic unit - not used
    Nwt: display-name=N, factor-si-to-unit=1  # Newton | SI derived unit of force
    NwtMtrPerSec: display-name=Nm/s, factor-si-to-unit=1  # Newton Meter per Second | SI derived unit of time-derivative of torque
    NwtPerMtr: display-name=N/m, factor-si-to-unit=1  # Newton per Meter | surface tension (derived from SI units)
    NwtSecPerMtr: display-name=Ns/m, factor-si-to-unit=1  # Newton Second per Meter | damping factor or coefficient (derived from SI units)
    Ohm: display-name=O  # SI unit of electric resistance - not used
    MegaHz: display-name=MHz  # Mega Hertz | frequency - not used
    MicroMtr: display-name=um  # Micro Meter | length - not used
    MicroSec: display-name=us  # Micro Second | time - not used
    RadPerSecSqd: display-name=rad/s^2, factor-si-to-unit=1  # Radian per Second Squared | SI derived unit of angular acceleration
    Rpm: display-name=rpm, factor-si-to-unit=0.0166666666666667  # revolutions per minute - no SI unit
    RpmPerSec: display-name=rpm/s, factor-si-to-unit=0.0166666666666667  # Revolutions per minute per Second | time-derivative of revolutions per minute - no SI unit
    MilliSec: display-name=ms  # Milli Second | time - not used
    SecRecpr: display-name=1/s  # Second Reciprocal | frequency, not used
    Srad: display-name=sr  # Steradian | unit for measuring solid angle - not used
    Volt: display-name=V, factor-si-to-unit=1  # SI derived unit of electric potential difference
    Watt: display-name=W  # SI unit of power - not used
    Wh: display-name=Wh  # watt-hour | Non-SI metric unit for energy - not used
    Mol: display-name=mol  # SI base unit of amount of substance - not used
    MtrCubd: display-name=m^3  # Meter Cubed | SI unit of volume - not used
    MtrCubdPerKiloGr: display-name=m^3/kg  # Meter Cubed per Kilo Gram | reciprocal density - not used
package /Volvo_SEWS/ComponentTypes/DataTypeMappingSets
  data type mapping set StateEstimation_TypeMappingSet
    data-type-maps:
      application-data-type=SEWS_D_precLongAccMeas_P10VW_ADT, implementation-data-type=SEWS_D_precLongAccMeas_P10VW_T
      application-data-type=SEWS_SelfSteeredTagAxleThreshSpeed_P1AK9_ADT, implementation-data-type=SEWS_SelfSteeredTagAxleThreshSpeed_P1AK9_T
      application-data-type=SEWS_NoOfPulsesPerRevolution_P1M6I_ADT, implementation-data-type=SEWS_NoOfPulsesPerRevolution_P1M6I_T
      application-data-type=SEWS_D_lowSpdSnsrSelnLatAScaFac_X1C5B_ADT, implementation-data-type=SEWS_D_lowSpdSnsrSelnLatAScaFac_X1C5B_T
      application-data-type=SEWS_D_FltHndlgIndirPrimSigFltScaFac_X1C6U_ADT, implementation-data-type=SEWS_D_FltHndlgIndirPrimSigFltScaFac_X1C6U_T
      application-data-type=SEWS_ConfigAxle_4_axle_load_max_P1A8I_ADT, implementation-data-type=SEWS_ConfigAxle_4_axle_load_max_P1A8I_T
      application-data-type=SEWS_D_precYawJerkInput_P10VT_ADT, implementation-data-type=SEWS_D_precYawJerkInput_P10VT_T
      application-data-type=SEWS_ConfigAxle_4_p_thres_P1A8A_ADT, implementation-data-type=SEWS_ConfigAxle_4_p_thres_P1A8A_T
      application-data-type=SEWS_D_FltHndlgPrimSigFltScaFac_X1C68_ADT, implementation-data-type=SEWS_D_FltHndlgPrimSigFltScaFac_X1C68_T
      application-data-type=SEWS_ConfigAxle_1_axle_type_liftable_P1A59_ADT, implementation-data-type=SEWS_ConfigAxle_1_axle_type_liftable_P1A59_T
      application-data-type=SEWS_ConfigAxle_2_wh_rollingcircu_P1A62_ADT, implementation-data-type=SEWS_ConfigAxle_2_wh_rollingcircu_P1A62_T
      application-data-type=SEWS_ConfigAxle_4_axle_type_steered_P1A71_ADT, implementation-data-type=SEWS_ConfigAxle_4_axle_type_steered_P1A71_T
      application-data-type=SEWS_T_interventionNoTrustTime_X1C60_ADT, implementation-data-type=SEWS_T_interventionNoTrustTime_X1C60_T
      application-data-type=SEWS_SteeringRatio_P1BGV_ADT, implementation-data-type=SEWS_SteeringRatio_P1BGV_T
      application-data-type=SEWS_VehicleType_P1L1L_ADT, implementation-data-type=SEWS_VehicleType_P1L1L_T
      application-data-type=SEWS_ConfigAxle_2_axle_type_liftable_P1A6U_ADT, implementation-data-type=SEWS_ConfigAxle_2_axle_type_liftable_P1A6U_T
      application-data-type=SEWS_ConfigAxle_3_wh_rollingcircu_P1A7N_ADT, implementation-data-type=SEWS_ConfigAxle_3_wh_rollingcircu_P1A7N_T
      application-data-type=SEWS_Tq_minEngineWheelTorque_X1C8Y_ADT, implementation-data-type=SEWS_Tq_minEngineWheelTorque_X1C8Y_T
      application-data-type=SEWS_D_lowSpdSnsrSelnWhlSpdScaFac_X1C5E_ADT, implementation-data-type=SEWS_D_lowSpdSnsrSelnWhlSpdScaFac_X1C5E_T
      application-data-type=SEWS_D_normSlipStfnAxle5_P10WG_ADT, implementation-data-type=SEWS_D_normSlipStfnAxle5_P10WG_T
      application-data-type=SEWS_T_absAsrTurnOffDly_X1DCK_ADT, implementation-data-type=SEWS_T_absAsrTurnOffDly_X1DCK_T
      application-data-type=SEWS_M_Axle5SuspVertLoads_P10W2_a_ADT, implementation-data-type=SEWS_M_Axle5SuspVertLoads_P10W2_a_T
      application-data-type=SEWS_M_Axle5SuspVertLoads_P10W2_ADT, implementation-data-type=SEWS_M_Axle5SuspVertLoads_P10W2_T
      application-data-type=SEWS_ConfigAxle_2_axle_load_max_P1A7C_ADT, implementation-data-type=SEWS_ConfigAxle_2_axle_load_max_P1A7C_T
      application-data-type=SEWS_M_Axle1SuspVertLoads_P10WU_a_ADT, implementation-data-type=SEWS_M_Axle1SuspVertLoads_P10WU_a_T
      application-data-type=SEWS_M_Axle1SuspVertLoads_P10WU_ADT, implementation-data-type=SEWS_M_Axle1SuspVertLoads_P10WU_T
      application-data-type=SEWS_ConfigAxle_5_axle_type_liftable_P1A8L_ADT, implementation-data-type=SEWS_ConfigAxle_5_axle_type_liftable_P1A8L_T
      application-data-type=SEWS_Frq_lowSpdSnsrSelnTqFilFrq_X1C48_ADT, implementation-data-type=SEWS_Frq_lowSpdSnsrSelnTqFilFrq_X1C48_T
      application-data-type=SEWS_ConfigAxle_1_p_thres_P1A6J_ADT, implementation-data-type=SEWS_ConfigAxle_1_p_thres_P1A6J_T
      application-data-type=SEWS_ConfigAxle_1_axle_load_max_P1A6R_ADT, implementation-data-type=SEWS_ConfigAxle_1_axle_load_max_P1A6R_T
      application-data-type=SEWS_D_normSlipStfnAxle2_P10WD_ADT, implementation-data-type=SEWS_D_normSlipStfnAxle2_P10WD_T
      application-data-type=SEWS_ConfigAxle_5_axle_load_max_P1A83_ADT, implementation-data-type=SEWS_ConfigAxle_5_axle_load_max_P1A83_T
      application-data-type=SEWS_FAxleContactPatchOutside2OutsideDist_P1KJ7_ADT, implementation-data-type=SEWS_FAxleContactPatchOutside2OutsideDist_P1KJ7_T
      application-data-type=SEWS_RearAxleArrangement_P1CSG_ADT, implementation-data-type=SEWS_RearAxleArrangement_P1CSG_T
      application-data-type=SEWS_ConfigAxle_3_brake_factor_P1A7Q_ADT, implementation-data-type=SEWS_ConfigAxle_3_brake_factor_P1A7Q_T
      application-data-type=SEWS_T_absAsrRstDelayTime_X1DU3_ADT, implementation-data-type=SEWS_T_absAsrRstDelayTime_X1DU3_T
      application-data-type=SEWS_VehicleTargetGeneratorSpeedLimits1_P1B8U_ADT, implementation-data-type=SEWS_VehicleTargetGeneratorSpeedLimits1_P1B8U_T
      application-data-type=Boolean_ADT, implementation-data-type=boolean
      application-data-type=SEWS_Stfn_Axle5SuspVertStfns_P10W3_a_ADT, implementation-data-type=SEWS_Stfn_Axle5SuspVertStfns_P10W3_a_T
      application-data-type=SEWS_Stfn_Axle5SuspVertStfns_P10W3_ADT, implementation-data-type=SEWS_Stfn_Axle5SuspVertStfns_P10W3_T
      application-data-type=SEWS_Stfn_Axle2SuspVertStfns_P10WX_a_ADT, implementation-data-type=SEWS_Stfn_Axle2SuspVertStfns_P10WX_a_T
      application-data-type=SEWS_Stfn_Axle2SuspVertStfns_P10WX_ADT, implementation-data-type=SEWS_Stfn_Axle2SuspVertStfns_P10WX_T
      application-data-type=SEWS_D_precTrsmOutpShaftSpdMeas_X1C3K_ADT, implementation-data-type=SEWS_D_precTrsmOutpShaftSpdMeas_X1C3K_T
      application-data-type=SEWS_ConfigAxle_3_axle_type_liftable_P1A7F_ADT, implementation-data-type=SEWS_ConfigAxle_3_axle_type_liftable_P1A7F_T
      application-data-type=SEWS_ConfigAxle_5_axle_type_steered_P1A8M_ADT, implementation-data-type=SEWS_ConfigAxle_5_axle_type_steered_P1A8M_T
      application-data-type=SEWS_V_mtnDetnThdSpd_X1C9S_ADT, implementation-data-type=SEWS_V_mtnDetnThdSpd_X1C9S_T
      application-data-type=SEWS_A_mtnDetnThdLongAcc_X1DBJ_ADT, implementation-data-type=SEWS_A_mtnDetnThdLongAcc_X1DBJ_T
      application-data-type=SEWS_D_precLongVelRateInit_X1C3E_ADT, implementation-data-type=SEWS_D_precLongVelRateInit_X1C3E_T
      application-data-type=SEWS_BrandType_P1AFC_ADT, implementation-data-type=SEWS_BrandType_P1AFC_T
      application-data-type=SEWS_Frq_lowSpdSnsrSelnSpdFilFrq_X1C49_ADT, implementation-data-type=SEWS_Frq_lowSpdSnsrSelnSpdFilFrq_X1C49_T
      application-data-type=SEWS_SteeringRatioRight2_P1BGZ_ADT, implementation-data-type=SEWS_SteeringRatioRight2_P1BGZ_T
      application-data-type=SEWS_V_lowSpdSnsrSelnSpdThldUp_P10V2_ADT, implementation-data-type=SEWS_V_lowSpdSnsrSelnSpdThldUp_P10V2_T
      application-data-type=SEWS_D_normSlipStfnAxle3_P10WE_ADT, implementation-data-type=SEWS_D_normSlipStfnAxle3_P10WE_T
      application-data-type=SEWS_DistRA1ToRA2_P1CNH_ADT, implementation-data-type=SEWS_DistRA1ToRA2_P1CNH_T
      application-data-type=SEWS_WheelBase_P1AZQ_ADT, implementation-data-type=SEWS_WheelBase_P1AZQ_T
      application-data-type=SEWS_D_lowSpdSnsrSelnYawRateScaFac_X1C5C_ADT, implementation-data-type=SEWS_D_lowSpdSnsrSelnYawRateScaFac_X1C5C_T
      application-data-type=SEWS_D_absTracCompLgtAScaFac_X1C63_ADT, implementation-data-type=SEWS_D_absTracCompLgtAScaFac_X1C63_T
      application-data-type=SEWS_D_precLatJerkDueToBankAngleInput_P10VU_ADT, implementation-data-type=SEWS_D_precLatJerkDueToBankAngleInput_P10VU_T
      application-data-type=SEWS_D_FltHndlgIndirAltvSigFltScaFac_X1C6V_ADT, implementation-data-type=SEWS_D_FltHndlgIndirAltvSigFltScaFac_X1C6V_T
      application-data-type=SEWS_ConfigAxle_2_axle_load_min_P1A7B_ADT, implementation-data-type=SEWS_ConfigAxle_2_axle_load_min_P1A7B_T
      application-data-type=SEWS_M_Axle4SuspVertLoads_P10W0_a_ADT, implementation-data-type=SEWS_M_Axle4SuspVertLoads_P10W0_a_T
      application-data-type=SEWS_M_Axle4SuspVertLoads_P10W0_ADT, implementation-data-type=SEWS_M_Axle4SuspVertLoads_P10W0_T
      application-data-type=SEWS_L_trackWidthDrivenAxle_X1C3A_ADT, implementation-data-type=SEWS_L_trackWidthDrivenAxle_X1C3A_T
      application-data-type=SEWS_ConfigAxle_1_axle_type_steered_P1A6A_ADT, implementation-data-type=SEWS_ConfigAxle_1_axle_type_steered_P1A6A_T
      application-data-type=SEWS_ConfigAxle_2_brake_factor_P1A65_ADT, implementation-data-type=SEWS_ConfigAxle_2_brake_factor_P1A65_T
      application-data-type=SEWS_D_maxWheelSpeedTrustFac_vec_X1C69_a_ADT, implementation-data-type=SEWS_D_maxWheelSpeedTrustFac_vec_X1C69_a_T
      application-data-type=SEWS_D_maxWheelSpeedTrustFac_vec_X1C69_ADT, implementation-data-type=SEWS_D_maxWheelSpeedTrustFac_vec_X1C69_T
      application-data-type=SEWS_Tq_lowSpdSnsrSelnTqThldUp_X1C46_ADT, implementation-data-type=SEWS_Tq_lowSpdSnsrSelnTqThldUp_X1C46_T
      application-data-type=SEWS_ConfigAxle_3_axle_load_min_P1A7W_ADT, implementation-data-type=SEWS_ConfigAxle_3_axle_load_min_P1A7W_T
      application-data-type=SEWS_SteeringRatioLeft1_P1BGW_ADT, implementation-data-type=SEWS_SteeringRatioLeft1_P1BGW_T
      application-data-type=SEWS_D_precWhlSpdMeas_X1C5P_ADT, implementation-data-type=SEWS_D_precWhlSpdMeas_X1C5P_T
      application-data-type=SEWS_ConfigAxle_2_axle_type_steered_P1A6V_ADT, implementation-data-type=SEWS_ConfigAxle_2_axle_type_steered_P1A6V_T
      application-data-type=SEWS_T_zeroSpdFltrTurnOffDly_X1C5W_ADT, implementation-data-type=SEWS_T_zeroSpdFltrTurnOffDly_X1C5W_T
      application-data-type=SEWS_D_wheelSpeedTrustFac_vec_X1C8Z_a_ADT, implementation-data-type=SEWS_D_wheelSpeedTrustFac_vec_X1C8Z_a_T
      application-data-type=SEWS_D_wheelSpeedTrustFac_vec_X1C8Z_ADT, implementation-data-type=SEWS_D_wheelSpeedTrustFac_vec_X1C8Z_T
      application-data-type=SEWS_DistRA2ToRA3_P1CNJ_ADT, implementation-data-type=SEWS_DistRA2ToRA3_P1CNJ_T
      application-data-type=SEWS_L_imuToFrontAxle_P10WH_ADT, implementation-data-type=SEWS_L_imuToFrontAxle_P10WH_T
      application-data-type=SEWS_Stfn_Axle4SuspVertStfns_P10W1_a_ADT, implementation-data-type=SEWS_Stfn_Axle4SuspVertStfns_P10W1_a_T
      application-data-type=SEWS_Stfn_Axle4SuspVertStfns_P10W1_ADT, implementation-data-type=SEWS_Stfn_Axle4SuspVertStfns_P10W1_T
      application-data-type=SEWS_ConfigAxle_4_wh_rollingcircu_P1A78_ADT, implementation-data-type=SEWS_ConfigAxle_4_wh_rollingcircu_P1A78_T
      application-data-type=SEWS_L_maxCogHeightFullyLaden_P10WS_ADT, implementation-data-type=SEWS_L_maxCogHeightFullyLaden_P10WS_T
      application-data-type=SEWS_E_EbsSwPackage_P1K5K_ADT, implementation-data-type=SEWS_E_EbsSwPackage_P1K5K_T
      application-data-type=SEWS_Stfn_Axle1SuspVertStfns_P10WV_a_ADT, implementation-data-type=SEWS_Stfn_Axle1SuspVertStfns_P10WV_a_T
      application-data-type=SEWS_Stfn_Axle1SuspVertStfns_P10WV_ADT, implementation-data-type=SEWS_Stfn_Axle1SuspVertStfns_P10WV_T
      application-data-type=SEWS_Tq_lowSpdSnsrSelnTqThldLo_X1C47_ADT, implementation-data-type=SEWS_Tq_lowSpdSnsrSelnTqThldLo_X1C47_T
      application-data-type=SEWS_ConfigAxle_3_axle_load_max_P1A7X_ADT, implementation-data-type=SEWS_ConfigAxle_3_axle_load_max_P1A7X_T
      application-data-type=SEWS_ConfigAxle_1_brake_factor_P1A6K_ADT, implementation-data-type=SEWS_ConfigAxle_1_brake_factor_P1A6K_T
      application-data-type=SEWS_T_mtnLowConfTolrTi_X1DCF_ADT, implementation-data-type=SEWS_T_mtnLowConfTolrTi_X1DCF_T
      application-data-type=SEWS_ConfigAxle_1_axle_load_min_P1A6Q_ADT, implementation-data-type=SEWS_ConfigAxle_1_axle_load_min_P1A6Q_T
      application-data-type=SEWS_FrontAxleArrangement_P1CSH_ADT, implementation-data-type=SEWS_FrontAxleArrangement_P1CSH_T
      application-data-type=SEWS_ConfigAxle_5_axle_load_min_P1A82_ADT, implementation-data-type=SEWS_ConfigAxle_5_axle_load_min_P1A82_T
      application-data-type=SEWS_D_precLatAccDueToBankAngleInit_X1DBH_ADT, implementation-data-type=SEWS_D_precLatAccDueToBankAngleInit_X1DBH_T
      application-data-type=SEWS_D_precLatAccMeas_P10VX_ADT, implementation-data-type=SEWS_D_precLatAccMeas_P10VX_T
      application-data-type=SEWS_D_FltHndlgAltvSigFltScaFac_X1C6T_ADT, implementation-data-type=SEWS_D_FltHndlgAltvSigFltScaFac_X1C6T_T
      application-data-type=SEWS_E_BusAxleType_P11DU_ADT, implementation-data-type=SEWS_E_BusAxleType_P11DU_T
      application-data-type=SEWS_VehicleTargetGeneratorSpeedLimits2_P1B8V_ADT, implementation-data-type=SEWS_VehicleTargetGeneratorSpeedLimits2_P1B8V_T
      application-data-type=SEWS_D_absTracCompLongJerkScaFac_X1DBQ_ADT, implementation-data-type=SEWS_D_absTracCompLongJerkScaFac_X1DBQ_T
      application-data-type=SEWS_D_lowSpdSnsrSelnLgtAScaFac_X1C5A_ADT, implementation-data-type=SEWS_D_lowSpdSnsrSelnLgtAScaFac_X1C5A_T
      application-data-type=SEWS_T_interventionRampUpTime_X1C61_ADT, implementation-data-type=SEWS_T_interventionRampUpTime_X1C61_T
      application-data-type=SEWS_D_precLongJerkInput_P10VS_ADT, implementation-data-type=SEWS_D_precLongJerkInput_P10VS_T
      application-data-type=SEWS_ConfigAxle_4_axle_load_min_P1A8H_ADT, implementation-data-type=SEWS_ConfigAxle_4_axle_load_min_P1A8H_T
      application-data-type=SEWS_DistFA1ToFA2_P1KME_ADT, implementation-data-type=SEWS_DistFA1ToFA2_P1KME_T
      application-data-type=SEWS_D_absTracCompLatAScaFac_X1DBO_ADT, implementation-data-type=SEWS_D_absTracCompLatAScaFac_X1DBO_T
      application-data-type=SEWS_D_lowSpdSnsrSelnLgtJerkScaFacSpd_X1C5T_ADT, implementation-data-type=SEWS_D_lowSpdSnsrSelnLgtJerkScaFacSpd_X1C5T_T
      application-data-type=SEWS_M_Axle3SuspVertLoads_P10WY_a_ADT, implementation-data-type=SEWS_M_Axle3SuspVertLoads_P10WY_a_T
      application-data-type=SEWS_M_Axle3SuspVertLoads_P10WY_ADT, implementation-data-type=SEWS_M_Axle3SuspVertLoads_P10WY_T
      application-data-type=SEWS_ConfigAxle_4_brake_factor_P1A8B_ADT, implementation-data-type=SEWS_ConfigAxle_4_brake_factor_P1A8B_T
      application-data-type=SEWS_T_absAsrDetnDelayTime_X1DU0_ADT, implementation-data-type=SEWS_T_absAsrDetnDelayTime_X1DU0_T
      application-data-type=SEWS_ConfigAxle_3_axle_type_steered_P1A7G_ADT, implementation-data-type=SEWS_ConfigAxle_3_axle_type_steered_P1A7G_T
      application-data-type=SEWS_D_precYawRateInit_X1C3F_ADT, implementation-data-type=SEWS_D_precYawRateInit_X1C3F_T
      application-data-type=SEWS_ConfigAxle_1_wh_rollingcircu_P1A6H_ADT, implementation-data-type=SEWS_ConfigAxle_1_wh_rollingcircu_P1A6H_T
      application-data-type=SEWS_ConfigAxle_4_axle_type_liftable_P1A70_ADT, implementation-data-type=SEWS_ConfigAxle_4_axle_type_liftable_P1A70_T
      application-data-type=SEWS_A_whlRateAbsAsrDetnThd_X1DCH_ADT, implementation-data-type=SEWS_A_whlRateAbsAsrDetnThd_X1DCH_T
      application-data-type=SEWS_ConfigAxle_5_p_thres_P1A8V_ADT, implementation-data-type=SEWS_ConfigAxle_5_p_thres_P1A8V_T
      application-data-type=SEWS_ConfigAxle_3_p_thres_P1A7P_ADT, implementation-data-type=SEWS_ConfigAxle_3_p_thres_P1A7P_T
      application-data-type=SEWS_NetworkArchitecture_P1RPH_ADT, implementation-data-type=SEWS_NetworkArchitecture_P1RPH_T
      application-data-type=SEWS_D_precYawRateMeas_P10VY_ADT, implementation-data-type=SEWS_D_precYawRateMeas_P10VY_T
      application-data-type=SEWS_D_lowSpdSnsrSelnTrsmSpdScaFac_X1C5D_ADT, implementation-data-type=SEWS_D_lowSpdSnsrSelnTrsmSpdScaFac_X1C5D_T
      application-data-type=SEWS_TagAxleFeatures_P1CSI_ADT, implementation-data-type=SEWS_TagAxleFeatures_P1CSI_T
      application-data-type=SEWS_D_normSlipStfnAxle4_P10WF_ADT, implementation-data-type=SEWS_D_normSlipStfnAxle4_P10WF_T
      application-data-type=SEWS_D_absTracCompYawRateScaFac_X1DBP_ADT, implementation-data-type=SEWS_D_absTracCompYawRateScaFac_X1DBP_T
      application-data-type=SEWS_V_maxWheelSpeedTrustBreakPoints_vec_X1C7C_a_ADT, implementation-data-type=SEWS_V_maxWheelSpeedTrustBreakPoints_vec_X1C7C_a_T
      application-data-type=SEWS_V_maxWheelSpeedTrustBreakPoints_vec_X1C7C_ADT, implementation-data-type=SEWS_V_maxWheelSpeedTrustBreakPoints_vec_X1C7C_T
      application-data-type=SEWS_Frq_lowSpdSnsrSelnSpdFilFrq_X1C5U_ADT, implementation-data-type=SEWS_Frq_lowSpdSnsrSelnSpdFilFrq_X1C5U_T
      application-data-type=SEWS_Stfn_Axle3SuspVertStfns_P10WZ_a_ADT, implementation-data-type=SEWS_Stfn_Axle3SuspVertStfns_P10WZ_a_T
      application-data-type=SEWS_Stfn_Axle3SuspVertStfns_P10WZ_ADT, implementation-data-type=SEWS_Stfn_Axle3SuspVertStfns_P10WZ_T
      application-data-type=SEWS_L_trackWidthNonDrivenAxle_X1C29_ADT, implementation-data-type=SEWS_L_trackWidthNonDrivenAxle_X1C29_T
      application-data-type=SEWS_Tq_minTotalBrakeTorque_X1C8X_ADT, implementation-data-type=SEWS_Tq_minTotalBrakeTorque_X1C8X_T
      application-data-type=SEWS_D_precYawAccInit_X1C3G_ADT, implementation-data-type=SEWS_D_precYawAccInit_X1C3G_T
      application-data-type=SEWS_ConfigAxle_2_p_thres_P1A64_ADT, implementation-data-type=SEWS_ConfigAxle_2_p_thres_P1A64_T
      application-data-type=SEWS_Radar2FrontAxleDist_P1E5Z_ADT, implementation-data-type=SEWS_Radar2FrontAxleDist_P1E5Z_T
      application-data-type=SEWS_ConfigAxle_5_brake_factor_P1A8W_ADT, implementation-data-type=SEWS_ConfigAxle_5_brake_factor_P1A8W_T
      application-data-type=SEWS_D_normSlipStfnAxle1_P10WC_ADT, implementation-data-type=SEWS_D_normSlipStfnAxle1_P10WC_T
      application-data-type=SEWS_Frq_whlRateFilFrq_X1DCI_ADT, implementation-data-type=SEWS_Frq_whlRateFilFrq_X1DCI_T
      application-data-type=SEWS_D_lowSpdSnsrSelnLgtJerkScaFacTrq_X1C5Q_ADT, implementation-data-type=SEWS_D_lowSpdSnsrSelnLgtJerkScaFacTrq_X1C5Q_T
      application-data-type=SEWS_L_minCogHeightUnladen_P10WR_ADT, implementation-data-type=SEWS_L_minCogHeightUnladen_P10WR_T
      application-data-type=SEWS_V_speedDifferenceBreakPoints_vec_X1C80_a_ADT, implementation-data-type=SEWS_V_speedDifferenceBreakPoints_vec_X1C80_a_T
      application-data-type=SEWS_V_speedDifferenceBreakPoints_vec_X1C80_ADT, implementation-data-type=SEWS_V_speedDifferenceBreakPoints_vec_X1C80_T
      application-data-type=SEWS_EquivalentWheelbaseTurning_P1IJ3_ADT, implementation-data-type=SEWS_EquivalentWheelbaseTurning_P1IJ3_T
      application-data-type=SEWS_A_whlRateAbsAsrRstThd_X1DCM_ADT, implementation-data-type=SEWS_A_whlRateAbsAsrRstThd_X1DCM_T
      application-data-type=SEWS_D_precLongVelInit_X1C3D_ADT, implementation-data-type=SEWS_D_precLongVelInit_X1C3D_T
      application-data-type=SEWS_SelfSteeredTagAxleSpeedHysteresis_P1AT2_ADT, implementation-data-type=SEWS_SelfSteeredTagAxleSpeedHysteresis_P1AT2_T
      application-data-type=SEWS_AgV_maxPitchRate_P10WT_ADT, implementation-data-type=SEWS_AgV_maxPitchRate_P10WT_T
      application-data-type=SEWS_VehicleWidth_mm_P1E50_ADT, implementation-data-type=SEWS_VehicleWidth_mm_P1E50_T
      application-data-type=SEWS_M_Axle2SuspVertLoads_P10WW_a_ADT, implementation-data-type=SEWS_M_Axle2SuspVertLoads_P10WW_a_T
      application-data-type=SEWS_M_Axle2SuspVertLoads_P10WW_ADT, implementation-data-type=SEWS_M_Axle2SuspVertLoads_P10WW_T
      application-data-type=SEWS_SteeringRatioLeft2_P1BGX_ADT, implementation-data-type=SEWS_SteeringRatioLeft2_P1BGX_T
      application-data-type=SEWS_V_mtnDetnHysSpd_X1C9T_ADT, implementation-data-type=SEWS_V_mtnDetnHysSpd_X1C9T_T
      application-data-type=SEWS_SteeringRatioRight1_P1BGY_ADT, implementation-data-type=SEWS_SteeringRatioRight1_P1BGY_T
      application-data-type=SEWS_V_lowSpdSnsrSelnSpdThldLo_P10V1_ADT, implementation-data-type=SEWS_V_lowSpdSnsrSelnSpdThldLo_P10V1_T
      application-data-type=SEWS_ConfigAxle_5_wh_rollingcircu_P1A8T_ADT, implementation-data-type=SEWS_ConfigAxle_5_wh_rollingcircu_P1A8T_T
