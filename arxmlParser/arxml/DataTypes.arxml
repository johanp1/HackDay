AUTOSAR XML (schema 00046)
standard types defined: dtRef_const_VOID, dtRef_VOID, boolean, float32, float64, sint16, sint16_least, sint32, sint32_least, sint64, sint8, sint8_least, uint16, uint16_least, uint32, uint32_least, uint64, uint8, uint8_least, boolean_CompuMethod, boolean_DataConstr, uint16_DataConstr, uint32_DataConstr, uint8_DataConstr
package /GCWCalculatorCtrl/DataType/CompuMethods
  compu method TransmissionActualGearRatio_T: phys=raw*0.001 for raw 0..65535; unit NotApplicable
package /GCWCalculatorCtrl/DataType/DataConstrs
  range TransmissionActualGearRatio_T_DataConstr: raw 0..65535
package /GCWCalculatorCtrl/DataType/Units
  unit NotApplicable: display-name=NotApplicable, factor-si-to-unit=1, offset-si-to-unit=0
package /AUTOSAR_Platform/ImplementationDataTypes
  impl type TrailerConnectedStatus_T: category=VALUE, base-type=BaseTypes/uint8_BaseType, compu {0=TrailerConnectedStatus_No, 1=TrailerConnectedStatus_Yes, 2=TrailerConnectedStatus_Error, 3=TrailerConnectedStatus_NotAvailable}, range raw 0..3
package /Predefined_DEV/ImplementationDataTypes
  impl type NvM_RequestResultType: compu {0=NVM_REQ_OK, 1=NVM_REQ_NOT_OK, 2=NVM_REQ_PENDING, 3=NVM_REQ_INTEGRITY_FAILED, 4=NVM_REQ_BLOCK_SKIPPED, 5=NVM_REQ_NV_INVALIDATED, 6=NVM_REQ_CANCELED, 7=NVM_REQ_REDUNDANCY_FAILED, 8=NVM_REQ_RESTORED_FROM_ROM}, implementation-data-type=uint8
  impl type NvM_ServiceIdType: compu {6=NVM_READ_BLOCK, 7=NVM_WRITE_BLOCK, 8=NVM_RESTORE_BLOCK_DEFAULTS, 9=NVM_ERASE_BLOCK, 11=NVM_INVALIDATE_NV_BLOCK, 12=NVM_READ_ALL}, implementation-data-type=uint8
  impl type Dem_UdsStatusByteType: compu {mask 1: 1=DEM_UDS_STATUS_TF, mask 2: 2=DEM_UDS_STATUS_TFTOC, mask 4: 4=DEM_UDS_STATUS_PDTC, mask 8: 8=DEM_UDS_STATUS_CDTC, mask 16: 16=DEM_UDS_STATUS_TNCSLC, mask 32: 32=DEM_UDS_STATUS_TFSLC, mask 64: 64=DEM_UDS_STATUS_TNCTOC, mask 128: 128=DEM_UDS_STATUS_WIR}, range raw 0..255, implementation-data-type=uint8
package /DataTypes/BaseTypes
  5 x base type, all with category=FIXED_LENGTH:
    boolean_BaseType: base-type-size=1, base-type-encoding=BOOLEAN, native-declaration=boolean
    sint32_BaseType: base-type-size=32, base-type-encoding=2C, native-declaration=sint32
    uint16_BaseType: base-type-size=16, base-type-encoding=NONE, native-declaration=uint16
    uint32_BaseType: base-type-size=32, base-type-encoding=NONE, native-declaration=uint32
    uint8_BaseType: base-type-size=8, base-type-encoding=NONE, native-declaration=uint8
package /DataType
  impl type SqC_T: category=VALUE, base-type=BaseTypes/uint8_BaseType, range raw 0..14
  impl type Velocity_T: category=VALUE, base-type=BaseTypes/uint16_BaseType, compu {16384=Velocity_ReservedLow, 65533=Velocity_ReservedHigh, 65534=Velocity_Error, 65535=Velocity_NotAvailable}, range raw 0..65535
  impl type VehicleLgtMotionSts2_T: category=STRUCTURE
    4 x element, all with category=TYPE_REFERENCE:
      Velocity_RE: implementation-data-type=Velocity_T
      DrvgDir_RE: implementation-data-type=DrvgDir_T
      SqC_RE: implementation-data-type=SqC_T
      CRC_RE: implementation-data-type=CRC_T
  4 x impl type:
    CRC_T: category=VALUE, base-type=BaseTypes/uint8_BaseType, range raw 0..7
    VehicleLgtMotionReq_T: category=STRUCTURE
      4 x element, all with category=TYPE_REFERENCE:
        Acceleration_RE: implementation-data-type=Acceleration16bit_T
        DrvgDir_RE: implementation-data-type=DrvgDir_T
        SqC_RE: implementation-data-type=SqC_T
        CRC_RE: implementation-data-type=CRC_T
    VehicleLgtMotionSts1_T: category=STRUCTURE
      5 x element, all with category=TYPE_REFERENCE:
        Accel_RE: implementation-data-type=Acceleration16bit_T
        AccelExtCmp_RE: implementation-data-type=Acceleration16bit_T
        AccelTarget_RE: implementation-data-type=Acceleration16bit_T
        SqC_RE: implementation-data-type=SqC_T
        CRC_RE: implementation-data-type=CRC_T
    VehicleStructureSts_T: category=STRUCTURE
      element Mass_RE: implementation-data-type=MassStatus_T
  impl type OnSteerWhl_T: category=VALUE, base-type=BaseTypes/uint8_BaseType, compu {0=OnSteerWhl_NoIntervention, 1=OnSteerWhl_InterventionOnSteeringWheel, 2=OnSteerWhl_Error, 3=OnSteerWhl_NotAvailable}, range raw 0..3
  impl type OnBrkPedal_T: category=VALUE, base-type=BaseTypes/uint8_BaseType, compu {0=OnBrkPedal_NoIntervention, 1=OnBrkPedal_InterventionOnBrakePedal, 2=OnBrkPedal_Error, 3=OnBrkPedal_NotAvailable}, range raw 0..3
  impl type OnAccPedal_T: category=VALUE, base-type=BaseTypes/uint8_BaseType, compu {0=OnAccPedal_NoIntervention, 1=OnAccPedal_InterventionOnAcceleratorPedal, 2=OnAccPedal_Error, 3=OnAccPedal_NotAvailable}, range raw 0..3
  impl type DrvrPresUkwn_T: category=VALUE, base-type=BaseTypes/uint8_BaseType, compu {0=DrvrPresUkwn_DriverDetected, 1=DrvrPresUkwn_DriverPresenceNotClear, 2=DrvrPresUkwn_Error, 3=DrvrPresUkwn_NotAvailable}, range raw 0..3
  impl type OnParkBrake_T: category=VALUE, base-type=BaseTypes/uint8_BaseType, compu {0=OnParkBrake_NoIntervention, 1=OnParkBrake_InterventionOnParkBrake, 2=OnParkBrake_Error, 3=OnParkBrake_NotAvailable}, range raw 0..3
  impl type IntvBySftyDrvrDetd_T: category=STRUCTURE
    5 x element, all with category=TYPE_REFERENCE:
      OnSteerWhl_RE: implementation-data-type=OnSteerWhl_T
      OnBrkPedal_RE: implementation-data-type=OnBrkPedal_T
      OnAccPedal_RE: implementation-data-type=OnAccPedal_T
      DrvrPresUkwn_RE: implementation-data-type=DrvrPresUkwn_T
      OnParkBrake_RE: implementation-data-type=OnParkBrake_T
  impl type ThreshldPwr_T: category=VALUE, base-type=BaseTypes/uint8_BaseType, compu {254=ThreshldPwr_Error, 255=ThreshldPwr_NotAvailable}, range raw 0..255
  impl type EnergyCap_T: category=VALUE, base-type=BaseTypes/uint8_BaseType, compu-method=EnergyCap_T, range raw 0..255
  10 x impl type:
    MtnCtrlType_T: category=VALUE, base-type=BaseTypes/uint8_BaseType, compu {0=MtnCtrlType_BothLatAndLongControl, 1=MtnCtrlType_OnlyLateralControl, 1=MtnCtrlType_OnlyLongitudinalControl, 3=MtnCtrlType_Spare1, 4=MtnCtrlType_Spare2, 5=MtnCtrlType_Spare3, 6=MtnCtrlType_Error, 7=MtnCtrlType_NotAvailable}, range raw 0..7
    VehicleModeReq_T: category=STRUCTURE
      5 x element, all with category=TYPE_REFERENCE:
        Automation_RE: implementation-data-type=AutomationReq_T
        Motion_RE: implementation-data-type=MotionReq_T
        MtnCtrlType_RE: implementation-data-type=MtnCtrlType_T
        SqC_RE: implementation-data-type=SqC_T
        CRC_RE: implementation-data-type=CRC_T
    VehicleMotionChInCmdSts_T: category=VALUE, base-type=BaseTypes/uint8_BaseType, compu {0=VehicleMotionChInCmdSts_PrimaryChannel, 1=VehicleMotionChInCmdSts_SecondaryChannel, 2=VehicleMotionChInCmdSts_Error, 3=VehicleMotionChInCmdSts_NotAvailable}, range raw 0..3
    VehCombRetardtnSts_T: category=STRUCTURE
      element ThreshldPwr_RE: compu {254=ThreshldPwr_Error, 255=ThreshldPwr_NotAvailable}, range raw 0..255, implementation-data-type=ThreshldPwr_T
      element EnergyCap_RE: compu-method=EnergyCap_T, range raw 0..255, implementation-data-type=EnergyCap_T
    Automation_T: category=VALUE, base-type=BaseTypes/uint8_BaseType, compu {0=Automation_ManualControl, 1=Automation_AutonomousControl, 2=Automation_ManualAndAutonomousControl, 3=Automation_Spare1, 4=Automation_Spare2, 5=Automation_Spare3, 6=Automation_Error, 7=Automation_NotAvailable}, range raw 0..7
    AutomationReq_T: category=VALUE, base-type=BaseTypes/uint8_BaseType, compu {0=AutomationReq_ManualControl, 1=AutomationReq_AutonomousControl, 2..5=AutomationReq_Spare1..AutomationReq_Spare4, 6=AutomationReq_Error, 7=AutomationReq_NotAvailable}, range raw 0..7
    Motion_T: category=VALUE, base-type=BaseTypes/uint8_BaseType, compu {0=Motion_SecurelyParked, 1=Motion_MotionControl, 2=Motion_MotionControlAndSecurelyParked, 3=Motion_Spare1, 4=Motion_Spare2, 5=Motion_Spare3, 6=Motion_Error, 7=Motion_NotAvailable}, range raw 0..7
    MotionReq_T: category=VALUE, base-type=BaseTypes/uint8_BaseType, compu {0=MotionReq_SecurelyParked, 1=MotionReq_MotionControl, 2=MotionReq_Error, 3=MotionReq_NotAvailable}, range raw 0..3
    VehicleModeCpby_T: category=STRUCTURE
      element Automation_RE: implementation-data-type=Automation_T
      element Motion_RE: implementation-data-type=Motion_T
    FullBrakes_ind_T: category=VALUE, base-type=BaseTypes/uint8_BaseType, compu {254=FullBrakes_ind_Error, 255=FullBrakes_ind_NotAvailable}, range raw 0..255
  impl type PermittedHSAPressure_T: category=VALUE, base-type=BaseTypes/uint8_BaseType, compu {254=PermittedHSAPressure_Error, 255=PermittedHSAPressure_NotAvailable}, range raw 0..255
  range RoadWheelAngleRequest_T_DataConstr: raw 0..65535
  range VehicleLgtlAccelerationReq_T_DataConstr: raw 0..65535
  impl type DirectionIndicatorLightsExtReq_T:
    category=VALUE
    base-type=BaseTypes/uint8_BaseType
    compu {0=DirectionIndicatorLightsExtReq_NotActive, 1=DirectionIndicatorLightsExtReq_LeftDirectionIndicatorActive, 2=DirectionIndicatorLightsExtReq_RightDirectionIndicatorActive, 3=DirectionIndicatorLightsExtReq_Spare1, 4=DirectionIndicatorLightsExtReq_Spare2, 5=DirectionIndicatorLightsExtReq_Spare3, 6=DirectionIndicatorLightsExtReq_Error, 7=DirectionIndicatorLightsExtReq_NotAvailable}
    range raw 0..7
  impl type AutomationDoorLockUnlockReq_T:
    category=VALUE
    base-type=BaseTypes/uint8_BaseType
    compu {0=AutomationDoorLockUnlockReq_NotRequest, 1=AutomationDoorLockUnlockReq_DoorLockRequest, 2=AutomationDoorLockUnlockReq_DoorUnlockRequest, 3=AutomationDoorLockUnlockReq_Spare1, 4=AutomationDoorLockUnlockReq_Spare2, 5=AutomationDoorLockUnlockReq_Spare3, 6=AutomationDoorLockUnlockReq_Error, 7=AutomationDoorLockUnlockReq_NotAvailable}
    range raw 0..7
  range VehAutoModeReasonForDisengmt_T_DataConstr: raw 0..7
  range IntvBySafetyDriverDetected_T_DataConstr: raw 0..7
  range VehicleLgtlDrvgDirectionCpby_T_DataConstr: raw 0..7
  impl type RearAxleSteeringFunctionStatus_T:
    category=VALUE
    base-type=BaseTypes/uint8_BaseType
    compu {0=RearAxleSteeringFunctionStatus_NotActive, 1=RearAxleSteeringFunctionStatus_Active, 2=RearAxleSteeringFunctionStatus_PassiveFailureMode, 3=RearAxleSteeringFunctionStatus_ActiveFailureMode, 4=RearAxleSteeringFunctionStatus_Spare1, 5=RearAxleSteeringFunctionStatus_Spare2, 6=RearAxleSteeringFunctionStatus_Error, 7=RearAxleSteeringFunctionStatus_NotAvailable}
    range raw 0..7
  impl type ActualTagWheelAngle_T: category=VALUE, base-type=BaseTypes/uint16_BaseType, compu {10001=ActualTagWheelAngle_SpareLow, 65023=ActualTagWheelAngle_SpareHigh, 65024=ActualTagWheelAngle_ErrorLow, 65279=ActualTagWheelAngle_Error, 65280=ActualTagWheelAngle_NotAvailableLow, 65535=ActualTagWheelAngle_NotAvailable}, range raw 0..65535
  impl type DriverSteeringTorqueEstimate_T: category=VALUE, base-type=BaseTypes/uint16_BaseType, compu {1001=DriverSteeringTorqueEstimate_SpareLow, 1021=DriverSteeringTorqueEstimate_SpareHigh, 1022=DriverSteeringTorqueEstimate_Error, 1023=DriverSteeringTorqueEstimate_NotAvailable}, range raw 0..1023
  impl type RoadWheelAngle_T: category=VALUE, base-type=BaseTypes/uint16_BaseType, compu {65534=RoadWheelAngle_Error, 65535=RoadWheelAngle_NotAvailable}, range raw 0..65535
  impl type VehicleLatMotionReq_T: category=STRUCTURE
    4 x element, all with category=TYPE_REFERENCE:
      RWhlAg_RE: implementation-data-type=RoadWheelAngle_T
      RWhlAgRate_RE: implementation-data-type=RoadWheelAngle_T
      SqC_RE: implementation-data-type=SqC_T
      CRC_RE: implementation-data-type=CRC_T
  impl type FASFunctionInControl_T: category=VALUE, base-type=BaseTypes/uint8_BaseType, compu {0=FASFunctionInControl_DriverInControl, 1=FASFunctionInControl_FunctionInControl, 2=FASFunctionInControl_Error, 3=FASFunctionInControl_NotAvailable}, range raw 0..3
  impl type FASSaturated_T: category=VALUE, base-type=BaseTypes/uint8_BaseType, compu {0=FASSaturated_FAS_IsNotSaturated, 1=FASSaturated_FAS_IsSaturated, 2=FASSaturated_Error, 3=FASSaturated_NotAvailable}, range raw 0..3
  impl type XPRsystemstate_T: category=VALUE, base-type=BaseTypes/uint8_BaseType, compu {254=XPRsystemstate_Error, 255=XPRsystemstate_NotAvailable}, range raw 0..255
  impl type XBRSystemState_T: category=VALUE, base-type=BaseTypes/uint8_BaseType, compu {0=XBRSystemState_BrakeDemandAccepted, 1=XBRSystemState_HighestPriorityAccepted, 2=XBRSystemState_NoExternalDemandAccepted, 3=XBRSystemState_NotAvailable}, range raw 0..3
  impl type CtaBs_HSABbRequest_T: category=VALUE, base-type=BaseTypes/uint8_BaseType, compu {0=CtaBs_HSABbRequest_HSANotRequested, 1=CtaBs_HSABbRequest_HSARequested, 2=CtaBs_HSABbRequest_Error, 3=CtaBs_HSABbRequest_NotAvailable}, range raw 0..3
  impl type FASRoadWheelAngleRequest_T: category=VALUE, base-type=BaseTypes/uint16_BaseType, range raw 0..65535
  impl type XBRMessageCounter_T: category=VALUE, base-type=BaseTypes/uint8_BaseType, range raw 0..15
  impl type XBRMessageChecksum_T: category=VALUE, base-type=BaseTypes/uint8_BaseType, range raw 0..15
  impl type FASControlMode_T: category=VALUE, base-type=BaseTypes/uint8_BaseType, compu {14=FASControlMode_Error, 15=FASControlMode_NotAvailable}, range raw 0..15
  impl type XPRRequest_T: category=VALUE, base-type=BaseTypes/uint8_BaseType, compu {254=XPRRequest_Error, 255=XPRRequest_NotAvailable}, range raw 0..255
  range VehicleMotionCtrlTypeModeReq_T_DataConstr: raw 0..7
  range VehicleLgtlDrivingDirectionReq_T_DataConstr: raw 0..7
  12 x impl type:
    AutomationStatus_T: category=VALUE, base-type=BaseTypes/uint8_BaseType, compu {0=AutomationStatus_ManualControl, 1=AutomationStatus_AutonomousControl, 2=AutomationStatus_Error, 3=AutomationStatus_NotAvailable}, range raw 0..3
    MotionStatus_T:
      category=VALUE
      base-type=BaseTypes/uint8_BaseType
      compu {0=MotionStatus_SecurelyParked, 1=MotionStatus_SecurelyParkedPreparationMotionControl, 2=MotionStatus_MotionControlFullyOperational, 3=MotionStatus_MotionControlMaintenanceRequired, 4=MotionStatus_MotionControlBackup, 5=MotionStatus_MotionControlUrgentBackup, 6=MotionStatus_MotionControlInmediateStopRequired, 7=MotionStatus_VehiclePlatformExecutingStop, 8..13=MotionStatus_Spare1..MotionStatus_Spare6, 14=MotionStatus_Error, 15=MotionStatus_NotAvailable}
      range raw 0..15
    VelFwdMin_T: category=VALUE, base-type=BaseTypes/uint8_BaseType, compu {254=VelFwdMin_Error, 255=VelFwdMin_NotAvailable}, range raw 0..255
    VelFwdMax_T: category=VALUE, base-type=BaseTypes/uint8_BaseType, compu {254=VelFwdMax_Error, 255=VelFwdMax_NotAvailable}, range raw 0..255
    DrvgDir_T: category=VALUE, base-type=BaseTypes/uint8_BaseType, compu {0=DrvgDir_Standstill, 1=DrvgDir_Forward, 2=DrvgDir_Backward, 3=DrvgDir_Spare1, 4=DrvgDir_Spare2, 5=DrvgDir_Spare3, 6=DrvgDir_Error, 7=DrvgDir_NotAvailable}, range raw 0..7
    DrvgDirCpby_T: category=VALUE, base-type=BaseTypes/uint8_BaseType, compu {0=DrvgDirCpby_Standstill, 1=DrvgDirCpby_Forward, 2=DrvgDirCpby_Backward, 3=DrvgDirCpby_ForwardStandstillBackward, 4=DrvgDirCpby_ForwardStandstill, 5=DrvgDirCpby_BackwardStandstill, 6=DrvgDirCpby_Error, 7=DrvgDirCpby_NotAvailable}, range raw 0..7
    OperatorEngmt_T: category=VALUE, base-type=BaseTypes/uint8_BaseType, compu {254=OperatorEngmt_Error, 255=OperatorEngmt_NotAvailable}, range raw 0..3
    ADSModeReq_T: category=STRUCTURE
      element OperatorEngmt_RE: implementation-data-type=OperatorEngmt_T
    VehicleLgtMotionCpby_T: category=STRUCTURE
      element VelFwdMin_RE: implementation-data-type=VelFwdMin_T
      element VelFwdMax_RE: implementation-data-type=VelFwdMax_T
      element DrvgDir_RE: implementation-data-type=DrvgDirCpby_T
    Operator_T: category=VALUE, base-type=BaseTypes/uint8_BaseType, compu {0=Operator_Undetermined, 1=Operator_VehicleOperatorPresent, 2=Operator_VehicleOperatorNotPresent, 3=Operator_Spare1, 4=Operator_Spare2, 5=Operator_Spare3, 2=Operator_Error, 3=Operator_NotAvailable}, range raw 0..7
    ReasonForDisengmt_T: category=VALUE, base-type=BaseTypes/uint8_BaseType, compu {0=ReasonForDisengmt_NoTransitionOccured, 1=ReasonForDisengmt_AdsRequest, 2=ReasonForDisengmt_SafetyDriverIntervention, 3=ReasonForDisengmt_VehicleDiagnosticInterupt, 4=ReasonForDisengmt_AdsRequestNotValid, 5=ReasonForDisengmt_ExternalInterupt, 6=ReasonForDisengmt_Error, 7=ReasonForDisengmt_NotAvailable}, range raw 0..7
    VehModeSts_T: category=STRUCTURE
      6 x element, all with category=TYPE_REFERENCE:
        Automation_RE: implementation-data-type=AutomationStatus_T
        Motion_RE: implementation-data-type=MotionStatus_T
        Operator_RE: implementation-data-type=Operator_T
        ReasonForDisengmt_RE: implementation-data-type=ReasonForDisengmt_T
        SqC_RE: implementation-data-type=SqC_T
        CRC_RE: implementation-data-type=CRC_T
  range VehicleMotionModeRequest_T_DataConstr: raw 0..3
  range VehicleAutonomousModeRequest_T_DataConstr: raw 0..255
  range RoadWheelAngleRateRequest_T_DataConstr: raw 0..65535
  range VehicleLgtlDrvgDirectionStatus_T_DataConstr: raw 0..7
  range VehicleMotionModeCapability_T_DataConstr: raw 0..7
  range VehicleOperatorMode_T_DataConstr: raw 0..7
  range VehicleAutonomousModeCpby_T_DataConstr: raw 0..7
  range VehicleAutonomousModeStatus_T_DataConstr: raw 0..3
  impl type SteeringWheelTorqueEstimate_T: category=VALUE, base-type=BaseTypes/uint16_BaseType, compu {1024=SteeringWheelTorqueEstimate_SpareLow, 65533=SteeringWheelTorqueEstimate_SpareHigh, 65534=SteeringWheelTorqueEstimate_Error, 65535=SteeringWheelTorqueEstimate_NotAvailable}, range raw 0..65535
  impl type RoadInclinationAngleStatus_T: category=VALUE, base-type=BaseTypes/uint16_BaseType, compu {65534=RoadInclinationAngleStatus_Error, 65535=RoadInclinationAngleStatus_NotAvailable}, range raw 0..65535
  range VehicleLgtlAccelerationStatus_T_DataConstr: raw 0..65535
  impl type WheelSpeedStatus_T: category=VALUE, base-type=BaseTypes/uint8_BaseType, compu {254=WheelSpeedStatus_Error, 255=WheelSpeedStatus_NotAvailable}, range raw 0..255
  range VehicleLgtlVelocityStatus_T_DataConstr: raw 0..65535
  impl type RoadWheelAngleStatus_T: category=VALUE, base-type=BaseTypes/uint16_BaseType, compu {65534=RoadWheelAngleStatus_Error, 65535=RoadWheelAngleStatus_NotAvailable}, range raw 0..65535
  impl type Trailer1IdentifierStatus_T: category=VALUE, base-type=BaseTypes/uint32_BaseType, compu {4294967294=Trailer1IdentifierStatus_Error, 4294967295=Trailer1IdentifierStatus_NotAvailable}, range raw 0..4294967295
  impl type VehicleIdentifierStatus_T: category=VALUE, base-type=BaseTypes/uint32_BaseType, compu {10000000=VehicleIdentifierStatus_SpareLow, 134217725=VehicleIdentifierStatus_SpareHigh, 134217726=VehicleIdentifierStatus_Error, 134217727=VehicleIdentifierStatus_NotAvailable}, range raw 0..134217727
  impl type RoadWheelAngleMaxCapability_T: category=VALUE, base-type=BaseTypes/uint8_BaseType, compu {254=RoadWheelAngleMaxCapability_Error, 255=RoadWheelAngleMaxCapability_NotAvailable}, range raw 0..255
  impl type RoadWheelAngleMinCapability_T: category=VALUE, base-type=BaseTypes/uint8_BaseType, compu {254=RoadWheelAngleMinCapability_Error, 255=RoadWheelAngleMinCapability_NotAvailable}, range raw 0..255
  impl type MassStatus_T: category=VALUE, base-type=BaseTypes/uint16_BaseType, compu {60001=MassStatus_SpareLow, 65533=MassStatus_SpareHigh, 65534=MassStatus_Error, 65535=MassStatus_NotAvailable}, range raw 0..65535
  impl type DirectionIndicatorLightsStatus_T:
    category=VALUE
    base-type=BaseTypes/uint8_BaseType
    compu {0=DirectionIndicatorLightsStatus_LightsNotActive, 1=DirectionIndicatorLightsStatus_LeftLightActive, 2=DirectionIndicatorLightsStatus_RightLightActive, 3=DirectionIndicatorLightsStatus_HazardLightsActive, 4=DirectionIndicatorLightsStatus_Spare1, 5=DirectionIndicatorLightsStatus_Spare2, 6=DirectionIndicatorLightsStatus_Error, 7=DirectionIndicatorLightsStatus_NotAvailable}
    range raw 0..7
  range VehicleLgtlVelocityFwdMinCpby_T_DataConstr: raw 0..255
  impl type SwNumberStatus_T: category=VALUE, base-type=BaseTypes/uint8_BaseType, compu {254=SwNumberStatus_Error, 255=SwNumberStatus_NotAvailable}, range raw 0..255
  impl type ADMSwNumber_T: category=STRUCTURE
    element Major_RE: implementation-data-type=SwNumberStatus_T
    element Minor_RE: implementation-data-type=SwNumberStatus_T
    element Patch_RE: implementation-data-type=SwNumberStatus_T
  impl type DoorLockStatus_T: category=VALUE, base-type=BaseTypes/uint8_BaseType, compu {0=DoorLockStatus_Unlocked, 1=DoorLockStatus_Locked, 2=DoorLockStatus_Error, 3=DoorLockStatus_NotAvailable}, range raw 0..3
  range VehicleLgtlVelocityFwdMaxCpby_T_DataConstr: raw 0..255
  range VehicleCmbRetardEnergyCpStatus_T_DataConstr: raw 0..255
  impl type RoadWheelAngleRateCapability_T: category=VALUE, base-type=BaseTypes/uint8_BaseType, compu {254=RoadWheelAngleRateCapability_Error, 255=RoadWheelAngleRateCapability_NotAvailable}, range raw 0..255
  range VehCmbRetardThresholdPwrStatus_T_DataConstr: raw 0..255
  range RoadInclination_T_DataConstr: raw 0..255
  30 x impl type:
    Acceleration16bit_T: category=VALUE, base-type=BaseTypes/uint16_BaseType, range raw 0..65535  # 65024 - 65279 Error ; 65280 - 65535 Not available
    AxleLoad_T: category=VALUE, base-type=BaseTypes/uint16_BaseType, range raw 0..65535  # 65024 - 65279 Error ; 65280 - 65535 Not available
    RelativeLevel_T: category=VALUE, base-type=BaseTypes/uint16_BaseType, compu {64256=RelativeLevel_SpareLow, 65023=RelativeLevel_SpareHigh, 65024=RelativeLevel_ErrorLow, 65279=RelativeLevel_Error, 65280=RelativeLevel_NotAvailableLow, 65535=RelativeLevel_NotAvailable}, range raw 0..65535  # 65024 - 65279 Error ; 65280 - 65535 Not available
    BrakeAndPark_ind_T: category=VALUE, base-type=BaseTypes/uint8_BaseType, compu {0=BrakeAndPark_ind_Inactive, 1=BrakeAndPark_ind_ActiveAndServiceBrakesRequested, 2=BrakeAndPark_ind_ActiveAndVehicleParked, 3=BrakeAndPark_ind_Spare1, 4=BrakeAndPark_ind_Spare2, 5=BrakeAndPark_ind_Spare3, 6=BrakeAndPark_ind_Error, 7=BrakeAndPark_ind_NotAvailable}, range raw 0..7
    BrakeSwitch_T: category=VALUE, base-type=BaseTypes/uint8_BaseType, compu {0=BrakeSwitch_BrakePedalReleased, 1=BrakeSwitch_BrakePedalDepressed, 2=BrakeSwitch_Error, 3=BrakeSwitch_NotAvailable}, range raw 0..3
    Count4bit_T: category=VALUE, base-type=BaseTypes/uint8_BaseType, range raw 0..15
    DisengageEngage_T: category=VALUE, base-type=BaseTypes/uint8_BaseType, compu {0=DisengageEngage_Disengage, 1=DisengageEngage_Engage, 2=DisengageEngage_Error, 3=DisengageEngage_NotAvailable}, range raw 0..3
    DoorsAjar_stat_T: category=VALUE, base-type=BaseTypes/uint8_BaseType, compu {0=DoorsAjar_stat_Idle, 1=DoorsAjar_stat_BothDoorsAreClosed, 2=DoorsAjar_stat_DriverDoorIsOpen, 3=DoorsAjar_stat_PassengerDoorIsOpen, 4=DoorsAjar_stat_BothDoorsAreOpen, 5=DoorsAjar_stat_Spare, 6=DoorsAjar_stat_Error, 7=DoorsAjar_stat_NotAvailable}, range raw 0..7
    DriverRetarderRequest_T: category=VALUE, base-type=BaseTypes/uint8_BaseType, compu {0=DriverRetarderRequest_NoRequest, 1..5=DriverRetarderRequest_Level1..DriverRetarderRequest_Level5, 6=DriverRetarderRequest_Error, 7=DriverRetarderRequest_NotAvailable}, range raw 0..7
    DriverSeatBeltSwitch_T: category=VALUE, base-type=BaseTypes/uint8_BaseType, compu {0=DriverSeatBeltSwitch_SeatBeltUnbuckledUnfastened, 1=DriverSeatBeltSwitch_SeatBeltBuckledFastened, 2=DriverSeatBeltSwitch_Error, 3=DriverSeatBeltSwitch_NotAvailable}, range raw 0..3
    FoundationBrakeUse_T: category=VALUE, base-type=BaseTypes/uint8_BaseType, compu {0=FoundationBrakeUse_FoundationBrakesNotInUse, 1=FoundationBrakeUse_FoundationBrakesInUse, 2=FoundationBrakeUse_Reserved, 3=FoundationBrakeUse_NotAvailable}, range raw 0..3
    FullyOperational_T: category=VALUE, base-type=BaseTypes/uint8_BaseType, compu {0=FullyOperational_NotFullyOperational, 1=FullyOperational_FullyOperational, 2=FullyOperational_Reserved, 3=FullyOperational_NotAvailable}, range raw 0..3
    InactiveActive_T: category=VALUE, base-type=BaseTypes/uint8_BaseType, compu {0=InactiveActive_Inactive, 1=InactiveActive_Active, 2=InactiveActive_Error, 3=InactiveActive_NotAvailable}, range raw 0..3
    KFactor_T: category=VALUE, base-type=BaseTypes/uint16_BaseType, range raw 0..65535  # 65024 - 65279 Error ; 65280 - 65535 Not available
    LiftAxlePositionStatus_T: category=VALUE, base-type=BaseTypes/uint8_BaseType, compu {0=LiftAxlePositionStatus_Lowered, 1=LiftAxlePositionStatus_Lifted, 2=LiftAxlePositionStatus_Lowering, 3=LiftAxlePositionStatus_Lifting, 4=LiftAxlePositionStatus_Reserved, 5=LiftAxlePositionStatus_Reserved_01, 6=LiftAxlePositionStatus_Error, 7=LiftAxlePositionStatus_NotAvailable}, range raw 0..7
    NotAllowedAllowed_T: category=VALUE, base-type=BaseTypes/uint8_BaseType, compu {0=NotAllowedAllowed_NotAllowed, 1=NotAllowedAllowed_Allowed, 2=NotAllowedAllowed_Error, 3=NotAllowedAllowed_NotAvailable}, range raw 0..3
    OffOn_T: category=VALUE, base-type=BaseTypes/uint8_BaseType, compu {0=OffOn_Off, 1=OffOn_On, 2=OffOn_Error, 3=OffOn_NotAvailable}, range raw 0..3
    ParkingBrake_stat_T: category=VALUE, base-type=BaseTypes/uint8_BaseType, compu {0=ParkingBrake_stat_ParkingBrakeReleased, 1=ParkingBrake_stat_ParkingBrakeActivated, 2=ParkingBrake_stat_Error, 3=ParkingBrake_stat_NotAvailable}, range raw 0..3
    PassiveActive2_T: category=VALUE, base-type=BaseTypes/uint8_BaseType, compu {0=PassiveActive2_PassiveButInstalled, 1=PassiveActive2_Active, 2=PassiveActive2_Reserved, 3=PassiveActive2_DontCareTakeNoAction}, range raw 0..3
    Percent8bit125NegOffset_T: category=VALUE, base-type=BaseTypes/uint8_BaseType, range raw 0..255  # 254 Error ; 255 Not available
    Percent8bitFactor04_T: category=VALUE, base-type=BaseTypes/uint8_BaseType, range raw 0..255  # 254 Error ; 255 Not available
    PressureFactor5_T: category=VALUE, base-type=BaseTypes/uint8_BaseType, range raw 0..255  # 254 Error ; 255 Not available
    Priority_T: category=VALUE, base-type=BaseTypes/uint8_BaseType, compu {0=Priority_HighestPriority, 1=Priority_HighPriority, 2=Priority_MediumPriority, 3=Priority_LowPriority}, range raw 0..3
    Request_T: category=VALUE, base-type=BaseTypes/uint8_BaseType, compu {0=Request_NotRequested, 1=Request_RequestActive, 2=Request_Error, 3=Request_NotAvailable}, range raw 0..3
    Speed16bit_T: category=VALUE, base-type=BaseTypes/uint16_BaseType, compu {=SCALING; unit Km_per_h}, range raw 0..65535  # 65024 - 65279 Error ; 65280 - 65535 Not available
    SpeedRpm16bitMinus4000_T: category=VALUE, base-type=BaseTypes/uint16_BaseType, range raw 0..65535  # 65024-65279: Error 65280-65535: Not Available
    SteeringWheelAngle_T: category=VALUE, base-type=BaseTypes/uint16_BaseType, range raw 0..65535  # 65024 - 65279 Error ; 65280 - 65535 Not available
    TransmissionGear_T: category=VALUE, base-type=BaseTypes/uint8_BaseType, range raw 0..255  # 254 Error ; 255 Not available
    TSC1EngOverrideCtrlMode_T: category=VALUE, base-type=BaseTypes/uint8_BaseType, compu {0=TSC1EngOverrideCtrlMode_OverrideDisabled, 1=TSC1EngOverrideCtrlMode_SpeedControl, 2=TSC1EngOverrideCtrlMode_TorqueControl, 3=TSC1EngOverrideCtrlMode_SpeedTorqueLimitControl}, range raw 0..3
    PreTSC1Torque_T: category=STRUCTURE
      element EnRTrqTrqLm_RE: implementation-data-type=Percent8bit125NegOffset_T
      element EnOvrdCtrlM_RE: implementation-data-type=TSC1EngOverrideCtrlMode_T
  13 x impl type:
    XBRControlMode_T: category=VALUE, base-type=BaseTypes/uint8_BaseType, compu {0=XBRControlMode_OverrideDisabled, 1=XBRControlMode_AccelerationControlWithAdditionMode, 2=XBRControlMode_AccelerationControlWithMaximumMode, 3=XBRControlMode_NotDefined}, range raw 0..3
    XBREBIMode_T: category=VALUE, base-type=BaseTypes/uint8_BaseType, compu {0=XBREBIMode_NoEnduranceBrakeIntegrationAllowed, 1=XBREBIMode_OnlyEnduranceBrakesAllowed, 2=XBREBIMode_EnduranceBrakeIntegrationAllowed, 3=XBREBIMode_NotDefined}, range raw 0..3
    XBRBBM_T: category=STRUCTURE
      7 x element, all with category=TYPE_REFERENCE:
        MsgChecksum_RE: implementation-data-type=Count4bit_T
        MsgCounter_RE: implementation-data-type=Count4bit_T
        EBIMode_RE: implementation-data-type=XBREBIMode_T
        Priority_RE: implementation-data-type=Priority_T
        ControlMode_RE: implementation-data-type=XBRControlMode_T
        Urgency_RE: implementation-data-type=Percent8bitFactor04_T
        ExtAccelDemand_RE: implementation-data-type=Acceleration16bit_T
    AxleCurvature_T: category=STRUCTURE, sw-calibration-access=READ-ONLY, type-emitter=RTE
      element Curvature: implementation-data-type=float32
      element QualityFlag: implementation-data-type=QualityFlag_T
    AccelerationQ_T: category=STRUCTURE, sw-calibration-access=READ-ONLY, type-emitter=RTE
      element Acceleration: implementation-data-type=float32
      element QualityFlag: implementation-data-type=QualityFlag_T
    SpeedQ_T: category=STRUCTURE, sw-calibration-access=READ-ONLY, type-emitter=RTE
      element Speed: implementation-data-type=float32
      element QualityFlag: implementation-data-type=QualityFlag_T
    AngleQ_T: category=STRUCTURE, sw-calibration-access=READ-ONLY, type-emitter=RTE
      element Angle: implementation-data-type=float32
      element QualityFlag: implementation-data-type=QualityFlag_T
    LoadQ_T: category=STRUCTURE, sw-calibration-access=READ-ONLY, type-emitter=RTE
      element Load: implementation-data-type=float32
      element QualityFlag: implementation-data-type=QualityFlag_T
    LiftedQ_T: category=STRUCTURE, sw-calibration-access=READ-ONLY, type-emitter=RTE
      element Lifted: implementation-data-type=boolean
      element QualityFlag: implementation-data-type=QualityFlag_T
    MotionStateQ_T: category=STRUCTURE, sw-calibration-access=READ-ONLY, type-emitter=RTE
      element State: implementation-data-type=MotionState_T
      element QualityFlag: implementation-data-type=QualityFlag_T
    TrailerConnectedQ_T: category=STRUCTURE, sw-calibration-access=READ-ONLY, type-emitter=RTE
      element Connected: implementation-data-type=boolean
      element QualityFlag: implementation-data-type=QualityFlag_T
    StandstillQ_T: category=STRUCTURE, sw-calibration-access=READ-ONLY, type-emitter=RTE
      element StandStill: implementation-data-type=boolean
      element QualityFlag: implementation-data-type=QualityFlag_T
    FASFullyOperational_T: category=VALUE, base-type=BaseTypes/uint8_BaseType, compu {0=FASFullyOperational_FASNotFullyOperational, 1=FASFullyOperational_FASFullyOperational, 2=FASFullyOperational_Error, 3=FASFullyOperational_NotAvailable}, range raw 0..3
  impl type RoadInclinationPerc_T: category=VALUE, base-type=BaseTypes/uint32_BaseType, sw-calibration-access=READ-ONLY, type-emitter=RTE
  9 x impl type:
    VehicleMode_T: category=VALUE, base-type=BaseTypes/uint8_BaseType, compu {0=VehicleMode_Hibernate, 1=VehicleMode_Parked, 2=VehicleMode_Living, 3=VehicleMode_Accessory, 4=VehicleMode_PreRunning, 5=VehicleMode_Cranking, 6=VehicleMode_Running, 7..13=VehicleMode_Spare_1..VehicleMode_Spare_7, 14=VehicleMode_Error, 15=VehicleMode_NotAvailable}, range raw 0..15
    ACC_SGO_Status_T:
      category=VALUE
      base-type=BaseTypes/uint8_BaseType
      compu {0=ACC_SGO_Status_ACC_SGO_OFF, 1=ACC_SGO_Status_ACC_SGO_Inactive, 2=ACC_SGO_Status_ACC_SGO_Active_Driving, 3=ACC_SGO_Status_ACC_SGO_Stopping, 4=ACC_SGO_Status_ACC_SGO_Active_Stationary, 5=ACC_SGO_Status_ACC_SGO_Active_Hold, 6=ACC_SGO_Status_ACC_SGO_Active_TakeOffRequest, 7..13=ACC_SGO_Status_Spare1..ACC_SGO_Status_Spare7, 14=ACC_SGO_Status_Error, 15=ACC_SGO_Status_NotAvailable}
      range raw 0..15
    Torque16bit_T: category=VALUE, base-type=BaseTypes/uint16_BaseType, range raw 0..65535  # 65024 - 65279 Error ; 65280 - 65535 Not available
    SpeedRpm16bit_T: category=VALUE, base-type=BaseTypes/uint16_BaseType, range raw 0..65535  # 65024 - 65279 Error ; 65280 - 65535 Not available
    TransmissionShiftInProcess_T: category=VALUE, base-type=BaseTypes/uint8_BaseType, compu {0=TransmissionShiftInProcess_ShiftNotInProcess, 1=TransmissionShiftInProcess_ShiftInProcess, 2=TransmissionShiftInProcess_Error, 3=TransmissionShiftInProcess_NotAvailable}, range raw 0..3
    TransmissionActualGearRatio_T: category=VALUE, base-type=BaseTypes/uint32_BaseType, sw-calibration-access=READ-ONLY, type-emitter=RTE
    QualityFlag_T: category=VALUE, base-type=boolean_BaseType, sw-calibration-access=READ-ONLY, type-emitter=RTE
    InertiaQ_T: category=STRUCTURE, sw-calibration-access=READ-ONLY, type-emitter=RTE
      element Inertia: implementation-data-type=float32
      element QualityFlag: implementation-data-type=QualityFlag_T
    MotionState_T: category=VALUE, base-type=BaseTypes/uint8_BaseType, compu {0=MotionState_Standstill, 1=MotionState_Forward, 2=MotionState_Reverse, 3=MotionState_UndefinedMoving}, range raw 0..3
package /DataType/BaseTypes
  base type uint16_BaseType: category=FIXED_LENGTH, base-type-size=16, base-type-encoding=NONE, native-declaration=uint16
  base type uint32_BaseType: category=FIXED_LENGTH, base-type-size=32, base-type-encoding=NONE, native-declaration=uint32
  base type uint8_BaseType: category=FIXED_LENGTH, base-type-size=8, base-type-encoding=NONE, native-declaration=uint8
package /DataType/DataTypeSemantics
  compu method VehicleMotionCtrlTypeModeReq_T: 0=VehicleMotionCtrlTypeModeReq_BothLatAndLongControl, 1=VehicleMotionCtrlTypeModeReq_OnlyLateralControl, 2=VehicleMotionCtrlTypeModeReq_OnlyLongitudinalControl, 3=VehicleMotionCtrlTypeModeReq_Spare1, 4=VehicleMotionCtrlTypeModeReq_Spare2, 5=VehicleMotionCtrlTypeModeReq_Spare3, 6=VehicleMotionCtrlTypeModeReq_Error, 7=VehicleMotionCtrlTypeModeReq_NotAvailable
  compu method VehicleLgtlDrivingDirectionReq_T: 0=VehicleLgtlDrivingDirectionReq_Standstill, 1=VehicleLgtlDrivingDirectionReq_Forward, 2=VehicleLgtlDrivingDirectionReq_Backward, 3=VehicleLgtlDrivingDirectionReq_Spare1, 4=VehicleLgtlDrivingDirectionReq_Spare2, 5=VehicleLgtlDrivingDirectionReq_Spare3, 6=VehicleLgtlDrivingDirectionReq_Error, 7=VehicleLgtlDrivingDirectionReq_NotAvailable
  compu method VehicleMotionModeRequest_T: 0=VehicleMotionModeRequest_SecurelyParked, 1=VehicleMotionModeRequest_MotionControl, 2=VehicleMotionModeRequest_Error, 3=VehicleMotionModeRequest_NotAvailable
  compu method RoadWheelAngleRequest_T: 65534=RoadWheelAngleRequest_Error, 65535=RoadWheelAngleRequest_NotAvailable
  compu method VehAutoModeReasonForDisengmt_T: 0=VehAutoModeReasonForDisengmt_NoTransitionOccured, 1=VehAutoModeReasonForDisengmt_AdsRequest, 2=VehAutoModeReasonForDisengmt_SafetyDriverIntervention, 3=VehAutoModeReasonForDisengmt_VehicleDiagnosticInterupt, 4=VehAutoModeReasonForDisengmt_AdsRequestNotValid, 5=VehAutoModeReasonForDisengmt_ExternalInterupt, 6=VehAutoModeReasonForDisengmt_Error, 7=VehAutoModeReasonForDisengmt_NotAvailable
  compu method VehicleLgtlAccelerationReq_T: 65534=VehicleLgtlAccelerationReq_Error, 65535=VehicleLgtlAccelerationReq_NotAvailable
  compu method VehicleLgtlDrvgDirectionCpby_T: 0=VehicleLgtlDrvgDirectionCpby_Standstill, 1=VehicleLgtlDrvgDirectionCpby_Forward, 2=VehicleLgtlDrvgDirectionCpby_Backward, 3=VehicleLgtlDrvgDirectionCpby_ForwardStandstillBackward, 4=VehicleLgtlDrvgDirectionCpby_ForwardStandstill, 5=VehicleLgtlDrvgDirectionCpby_BackwardStandstill, 6=VehicleLgtlDrvgDirectionCpby_Error, 7=VehicleLgtlDrvgDirectionCpby_NotAvailable
  compu method VehicleLgtlVelocityFwdMaxCpby_T: 254=VehicleLgtlVelocityFwdMaxCpby_Error, 255=VehicleLgtlVelocityFwdMaxCpby_NotAvailable
  compu method VehicleMotionModeCapability_T: 0=VehicleMotionModeCapability_SecurelyParked, 1=VehicleMotionModeCapability_MotionControl, 2=VehicleMotionModeCapability_MotionControlAndSecurelyParked, 3=VehicleMotionModeCapability_Spare1, 4=VehicleMotionModeCapability_Spare2, 5=VehicleMotionModeCapability_Spare3, 6=VehicleMotionModeCapability_Error, 7=VehicleMotionModeCapability_NotAvailable
  compu method VehicleLgtlDrvgDirectionStatus_T: 0=VehicleLgtlDrvgDirectionStatus_Standstill, 1=VehicleLgtlDrvgDirectionStatus_Forward, 2=VehicleLgtlDrvgDirectionStatus_Backward, 3=VehicleLgtlDrvgDirectionStatus_Spare1, 4=VehicleLgtlDrvgDirectionStatus_Spare2, 5=VehicleLgtlDrvgDirectionStatus_Spare3, 6=VehicleLgtlDrvgDirectionStatus_Error, 7=VehicleLgtlDrvgDirectionStatus_NotAvailable
  compu method VehicleLgtlVelocityFwdMinCpby_T: 254=VehicleLgtlVelocityFwdMinCpby_Error, 255=VehicleLgtlVelocityFwdMinCpby_NotAvailable
  compu method VehicleAutonomousModeRequest_T: 0=VehicleAutonomousModeRequest_ManualControl, 1=VehicleAutonomousModeRequest_AutonomousControl, 2..5=VehicleAutonomousModeRequest_Spare1..VehicleAutonomousModeRequest_Spare4, 6=VehicleAutonomousModeRequest_Error, 7=VehicleAutonomousModeRequest_NotAvailable
  compu method RoadWheelAngleRateRequest_T: 65534=RoadWheelAngleRateRequest_Error, 65535=RoadWheelAngleRateRequest_NotAvailable
  compu method VehicleLgtlVelocityStatus_T: 65534=VehicleLgtlVelocityStatus_Error, 65535=VehicleLgtlVelocityStatus_NotAvailable
  compu method VehicleAutonomousModeCpby_T: 0=VehicleAutonomousModeCpby_ManualControl, 1=VehicleAutonomousModeCpby_AutonomousControl, 2=VehicleAutonomousModeCpby_ManualAndAutonomousControl, 3=VehicleAutonomousModeCpby_Spare1, 4=VehicleAutonomousModeCpby_Spare2, 5=VehicleAutonomousModeCpby_Spare3, 6=VehicleAutonomousModeCpby_Error, 7=VehicleAutonomousModeCpby_NotAvailable
  compu method VehicleOperatorMode_T: 0=VehicleOperatorMode_Undetermined, 1=VehicleOperatorMode_VehicleOperatorPresent, 2=VehicleOperatorMode_VehicleOperatorNotPresent, 3=VehicleOperatorMode_Spare1, 4=VehicleOperatorMode_Spare2, 5=VehicleOperatorMode_Spare3, 6=VehicleOperatorMode_Error, 7=VehicleOperatorMode_NotAvailable
  compu method VehicleAutonomousModeStatus_T: 0=VehicleAutonomousModeStatus_ManualControl, 1=VehicleAutonomousModeStatus_AutonomousControl, 2=VehicleAutonomousModeStatus_Error, 3=VehicleAutonomousModeStatus_NotAvailable
  compu method VehCmbRetardThresholdPwrStatus_T: 254=VehCmbRetardThresholdPwrStatus_Error, 255=VehCmbRetardThresholdPwrStatus_NotAvailable
  compu method VehicleCmbRetardEnergyCpStatus_T: 254=VehicleCmbRetardEnergyCpStatus_Error, 255=VehicleCmbRetardEnergyCpStatus_NotAvailable
  compu method VehicleLgtlAccelerationStatus_T: 65534=VehicleLgtlAccelerationStatus_Error, 65535=VehicleLgtlAccelerationStatus_NotAvailable
  compu method EnergyCap_T: 240=EnergyCap_SpareLow, 253=EnergyCap_SpareHigh, 254=EnergyCap_Error, 255=EnergyCap_NotAvailable
package /DataType/DataTypeUnits
  4 x unit, all with factor-si-to-unit=1, offset-si-to-unit=0:
    h: display-name=h
    min: display-name=min
    None
    Km_per_h: display-name=Km_per_h
package /Volvo_SEWS/DataTypes/Units
  14 x unit, all with offset-si-to-unit=0:
    dummyUnit: display-name=TemporaryUNIT, factor-si-to-unit=1  # This is a dummy unit that is added until we know how to handle all SEWS Units. We currently don't know how to interpret the Unit of this parameter correctly.
    KiloGr: display-name=kg, factor-si-to-unit=1  # SI base unit of mass
    KiloMtr: display-name=km, factor-si-to-unit=0.001  # SI base unit of length with prefix
    KiloMtrPerHr: display-name=km/h, factor-si-to-unit=1  # not used
    MilliMtr: display-name=mm, factor-si-to-unit=1  # length - not used
    Mins: display-name=min, factor-si-to-unit=1  # time - not used
    Mtr: display-name=m, factor-si-to-unit=1  # SI base unit of length
    MtrSqd: display-name=m^2, factor-si-to-unit=1  # SI unit of area - not used
    NoUnit: display-name=-, factor-si-to-unit=1  # Unit for dimensionless continuous value data types like numbers, factors and coefficients
    NwtMtr: display-name=Nm, factor-si-to-unit=1  # SI derived unit of moment of force (torque = kg m^2/s^2)
    Perc: display-name=%, factor-si-to-unit=100  # a percentage is a way of expressing a number as a fraction of 100 (no SI unit).
    Rad: display-name=rad, factor-si-to-unit=1  # SI derived unit of plane angle (dimensionless)
    RadPerSec: display-name=rad/s, factor-si-to-unit=1  # SI derived unit of angular velocity
    Sec: display-name=s, factor-si-to-unit=1  # SI base unit of time
