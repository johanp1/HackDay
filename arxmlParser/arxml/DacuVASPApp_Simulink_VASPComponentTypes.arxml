[part 2 of 2: package /Simulink_VASP/ComponentTypes]
AUTOSAR XML (schema 4-2-2)
package /Simulink_VASP/ComponentTypes  (continued)
  ... ESI_SLModel_DTMS, ESO_SLModel_DTMS, TrafficSituationActionGate_SLModel_DTMS, VSI_SLModel_DTMS, TSAM_SLModel_DTMS, ESI_SLModel_DTMS, ESO_SLModel_DTMS, TrafficSituationActionGate_SLModel_DTMS, VSI_SLModel_DTMS, TSAM_SLModel_DTMS, ESI_SLModel_DTMS, ESO_SLModel_DTMS, TrafficSituationActionGate_SLModel_DTMS, VSI_SLModel_DTMS, TSAM_SLModel_DTMS, ESI_SLModel_DTMS, ESO_SLModel_DTMS, TrafficSituationActionGate_SLModel_DTMS, VSI_SLModel_DTMS, TSAM_SLModel_DTMS, ESI_SLModel_DTMS, ESO_SLModel_DTMS, TrafficSituationActionGate_SLModel_DTMS, VSI_SLModel_DTMS, TSAM_SLModel_DTMS, ESI_SLModel_DTMS, ESO_SLModel_DTMS, TrafficSituationActionGate_SLModel_DTMS, VSI_SLModel_DTMS, TSAM_SLModel_DTMS, ESI_SLModel_DTMS, ESO_SLModel_DTMS, TrafficSituationActionGate_SLModel_DTMS, VSI_SLModel_DTMS, TSAM_SLModel_DTMS, ESI_SLModel_DTMS, ESO_SLModel_DTMS, TrafficSituationActionGate_SLModel_DTMS, VSI_SLModel_DTMS, TSAM_SLModel_DTMS, ESI_SLModel_DTMS, ESO_SLModel_DTMS, TrafficSituationActionGate_SLModel_DTMS, VSI_SLModel_DTMS, TSAM_SLModel_DTMS, ESI_SLModel_DTMS, ESO_SLModel_DTMS, TrafficSituationActionGate_SLModel_DTMS, VSI_SLModel_DTMS, TSAM_SLModel_DTMS, ESI_SLModel_DTMS, ESO_SLModel_DTMS, TrafficSituationActionGate_SLModel_DTMS, VSI_SLModel_DTMS, TSAM_SLModel_DTMS, ESI_SLModel_DTMS, ESO_SLModel_DTMS, TrafficSituationActionGate_SLModel_DTMS, VSI_SLModel_DTMS, TSAM_SLModel_DTMS, ESI_SLModel_DTMS, ESO_SLModel_DTMS, TrafficSituationActionGate_SLModel_DTMS, VSI_SLModel_DTMS, TSAM_SLModel_DTMS, ESI_SLModel_DTMS, ESO_SLModel_DTMS, TrafficSituationActionGate_SLModel_DTMS, VSI_SLModel_DTMS, TSAM_SLModel_DTMS, ESI_SLModel_DTMS, ESO_SLModel_DTMS, TrafficSituationActionGate_SLModel_DTMS, VSI_SLModel_DTMS, TSAM_SLModel_DTMS, ESI_SLModel_DTMS, ESO_SLModel_DTMS, TrafficSituationActionGate_SLModel_DTMS, VSI_SLModel_DTMS, TSAM_SLModel_DTMS, ESI_SLModel_DTMS, ESO_SLModel_DTMS, TrafficSituationActionGate_SLModel_DTMS, VSI_SLModel_DTMS, TSAM_SLModel_DTMS, ESI_SLModel_DTMS, ESO_SLModel_DTMS, TrafficSituationActionGate_SLModel_DTMS, VSI_SLModel_DTMS, TSAM_SLModel_DTMS, ESI_SLModel_DTMS, ESO_SLModel_DTMS, TrafficSituationActionGate_SLModel_DTMS, VSI_SLModel_DTMS, TSAM_SLModel_DTMS, ESI_SLModel_DTMS, ESO_SLModel_DTMS, TrafficSituationActionGate_SLModel_DTMS, VSI_SLModel_DTMS, TSAM_SLModel_DTMS, ESI_SLModel_DTMS, ESO_SLModel_DTMS, TrafficSituationActionGate_SLModel_DTMS, VSI_SLModel_DTMS, TSAM_SLModel_DTMS, ESI_SLModel_DTMS, ESO_SLModel_DTMS, TrafficSituationActionGate_SLModel_DTMS, VSI_SLModel_DTMS, TSAM_SLModel_DTMS, ESI_SLModel_DTMS, ESO_SLModel_DTMS, TrafficSituationActionGate_SLModel_DTMS, VSI_SLModel_DTMS, TSAM_SLModel_DTMS, ESI_SLModel_DTMS, ESO_SLModel_DTMS, TrafficSituationActionGate_SLModel_DTMS, VSI_SLModel_DTMS, TSAM_SLModel_DTMS, ESI_SLModel_DTMS, ESO_SLModel_DTMS, TrafficSituationActionGate_SLModel_DTMS, VSI_SLModel_DTMS, TSAM_SLModel_DTMS, ESI_SLModel_DTMS, ESO_SLModel_DTMS, TrafficSituationActionGate_SLModel_DTMS, VSI_SLModel_DTMS, TSAM_SLModel_DTMS, ESI_SLModel_DTMS, ESO_SLModel_DTMS, TrafficSituationActionGate_SLModel_DTMS, VSI_SLModel_DTMS, TSAM_SLModel_DTMS, ESI_SLModel_DTMS, ESO_SLModel_DTMS, TrafficSituationActionGate_SLModel_DTMS, VSI_SLModel_DTMS, TSAM_SLModel_DTMS, ESI_SLModel_DTMS, ESO_SLModel_DTMS, TrafficSituationActionGate_SLModel_DTMS, VSI_SLModel_DTMS, TSAM_SLModel_DTMS, ESI_SLModel_DTMS, ESO_SLModel_DTMS, TrafficSituationActionGate_SLModel_DTMS, VSI_SLModel_DTMS, TSAM_SLModel_DTMS, ESI_SLModel_DTMS, ESO_SLModel_DTMS, TrafficSituationActionGate_SLModel_DTMS, VSI_SLModel_DTMS, TSAM_SLModel_DTMS, ESI_SLModel_DTMS, ESO_SLModel_DTMS, TrafficSituationActionGate_SLModel_DTMS, VSI_SLModel_DTMS, TSAM_SLModel_DTMS, ESI_SLModel_DTMS, ESO_SLModel_DTMS, TrafficSituationActionGate_SLModel_DTMS, VSI_SLModel_DTMS, TSAM_SLModel_DTMS, ESI_SLModel_DTMS, ESO_SLModel_DTMS, TrafficSituationActionGate_SLModel_DTMS, VSI_SLModel_DTMS, TSAM_SLModel_DTMS, ESI_SLModel_DTMS, ESO_SLModel_DTMS, TrafficSituationActionGate_SLModel_DTMS, VSI_SLModel_DTMS, TSAM_SLModel_DTMS, ESI_SLModel_DTMS, ESO_SLModel_DTMS, TrafficSituationActionGate_SLModel_DTMS, VSI_SLModel_DTMS, TSAM_SLModel_DTMS, ESI_SLModel_DTMS, ESO_SLModel_DTMS, TrafficSituationActionGate_SLModel_DTMS, VSI_SLModel_DTMS, TSAM_SLModel_DTMS, ESI_SLModel_DTMS, ESO_SLModel_DTMS, TrafficSituationActionGate_SLModel_DTMS, VSI_SLModel_DTMS, TSAM_SLModel_DTMS, ESI_SLModel_DTMS, ESO_SLModel_DTMS, TrafficSituationActionGate_SLModel_DTMS, VSI_SLModel_DTMS, TSAM_SLModel_DTMS, ESI_SLModel_DTMS, ESO_SLModel_DTMS, TrafficSituationActionGate_SLModel_DTMS, VSI_SLModel_DTMS, TSAM_SLModel_DTMS, ESI_SLModel_DTMS, ESO_SLModel_DTMS, TrafficSituationActionGate_SLModel_DTMS, VSI_SLModel_DTMS, TSAM_SLModel_DTMS, ESI_SLModel_DTMS, ESO_SLModel_DTMS, TrafficSituationActionGate_SLModel_DTMS, VSI_SLModel_DTMS, TSAM_SLModel_DTMS, ESI_SLModel_DTMS, ESO_SLModel_DTMS, TrafficSituationActionGate_SLModel_DTMS, VSI_SLModel_DTMS, TSAM_SLModel_DTMS, ESI_SLModel_DTMS, ESO_SLModel_DTMS, TrafficSituationActionGate_SLModel_DTMS, VSI_SLModel_DTMS, TSAM_SLModel_DTMS, ESI_SLModel_DTMS, ESO_SLModel_DTMS, TrafficSituationActionGate_SLModel_DTMS, VSI_SLModel_DTMS, TSAM_SLModel_DTMS, ESI_SLModel_DTMS, ESO_SLModel_DTMS, TrafficSituationActionGate_SLModel_DTMS, VSI_SLModel_DTMS, TSAM_SLModel_DTMS, ESI_SLModel_DTMS, ESO_SLModel_DTMS, TrafficSituationActionGate_SLModel_DTMS, VSI_SLModel_DTMS, TSAM_SLModel_DTMS, ESI_SLModel_DTMS, ESO_SLModel_DTMS, TrafficSituationActionGate_SLModel_DTMS, VSI_SLModel_DTMS, TSAM_SLModel_DTMS, ESI_SLModel_DTMS, ESO_SLModel_DTMS, TrafficSituationActionGate_SLModel_DTMS, VSI_SLModel_DTMS, TSAM_SLModel_DTMS, ESI_SLModel_DTMS, ESO_SLModel_DTMS, TrafficSituationActionGate_SLModel_DTMS, VSI_SLModel_DTMS, TSAM_SLModel_DTMS, ESI_SLModel_DTMS, ESO_SLModel_DTMS, TrafficSituationActionGate_SLModel_DTMS, VSI_SLModel_DTMS, TSAM_SLModel_DTMS, ESI_SLModel_DTMS, ESO_SLModel_DTMS, TrafficSituationActionGate_SLModel_DTMS, VSI_SLModel_DTMS, TSAM_SLModel_DTMS, ESI_SLModel_DTMS, ESO_SLModel_DTMS, TrafficSituationActionGate_SLModel_DTMS, VSI_SLModel_DTMS, TSAM_SLModel_DTMS, ESI_SLModel_DTMS, ESO_SLModel_DTMS, TrafficSituationActionGate_SLModel_DTMS, VSI_SLModel_DTMS, TSAM_SLModel_DTMS, ESI_SLModel_DTMS, ESO_SLModel_DTMS, TrafficSituationActionGate_SLModel_DTMS, VSI_SLModel_DTMS, TSAM_SLModel_DTMS, ESI_SLModel_DTMS, ESO_SLModel_DTMS, TrafficSituationActionGate_SLModel_DTMS, VSI_SLModel_DTMS, TSAM_SLModel_DTMS, ESI_SLModel_DTMS, ESO_SLModel_DTMS, TrafficSituationActionGate_SLModel_DTMS, VSI_SLModel_DTMS, TSAM_SLModel_DTMS, ESI_SLModel_DTMS, ESO_SLModel_DTMS, TrafficSituationActionGate_SLModel_DTMS, VSI_SLModel_DTMS, TSAM_SLModel_DTMS, ESI_SLModel_DTMS, ESO_SLModel_DTMS, TrafficSituationActionGate_SLModel_DTMS, VSI_SLModel_DTMS, TSAM_SLModel_DTMS, ESI_SLModel_DTMS, ESO_SLModel_DTMS, TrafficSituationActionGate_SLModel_DTMS, VSI_SLModel_DTMS, TSAM_SLModel_DTMS, ESI_SLModel_DTMS, ESO_SLModel_DTMS, TrafficSituationActionGate_SLModel_DTMS, VSI_SLModel_DTMS, TSAM_SLModel_DTMS, ESI_SLModel_DTMS, ESO_SLModel_DTMS, TrafficSituationActionGate_SLModel_DTMS, VSI_SLModel_DTMS, TSAM_SLModel_DTMS, ESI_SLModel_DTMS, ESO_SLModel_DTMS, TrafficSituationActionGate_SLModel_DTMS, VSI_SLModel_DTMS, TSAM_SLModel_DTMS, ESI_SLModel_DTMS, ESO_SLModel_DTMS, TrafficSituationActionGate_SLModel_DTMS, VSI_SLModel_DTMS, TSAM_SLModel_DTMS, ESI_SLModel_DTMS, ESO_SLModel_DTMS, TrafficSituationActionGate_SLModel_DTMS, VSI_SLModel_DTMS, TSAM_SLModel_DTMS, ESI_SLModel_DTMS, ESO_SLModel_DTMS, TrafficSituationActionGate_SLModel_DTMS, VSI_SLModel_DTMS, TSAM_SLModel_DTMS, ESI_SLModel_DTMS, ESO_SLModel_DTMS, TrafficSituationActionGate_SLModel_DTMS, VSI_SLModel_DTMS, TSAM_SLModel_DTMS, ESI_SLModel_DTMS, ESO_SLModel_DTMS, TrafficSituationActionGate_SLModel_DTMS, VSI_SLModel_DTMS, TSAM_SLModel_DTMS, ESI_SLModel_DTMS, ESO_SLModel_DTMS, TrafficSituationActionGate_SLModel_DTMS, VSI_SLModel_DTMS, TSAM_SLModel_DTMS, ESI_SLModel_DTMS, ESO_SLModel_DTMS, TrafficSituationActionGate_SLModel_DTMS, VSI_SLModel_DTMS, TSAM_SLModel_DTMS, ESI_SLModel_DTMS, ESO_SLModel_DTMS, TrafficSituationActionGate_SLModel_DTMS, VSI_SLModel_DTMS, TSAM_SLModel_DTMS, ESI_SLModel_DTMS, ESO_SLModel_DTMS, TrafficSituationActionGate_SLModel_DTMS, VSI_SLModel_DTMS, TSAM_SLModel_DTMS, ESI_SLModel_DTMS, ESO_SLModel_DTMS, TrafficSituationActionGate_SLModel_DTMS, VSI_SLModel_DTMS, TSAM_SLModel_DTMS, ESI_SLModel_DTMS, ESO_SLModel_DTMS, TrafficSituationActionGate_SLModel_DTMS, VSI_SLModel_DTMS, TSAM_SLModel_DTMS, ESI_SLModel_DTMS, ESO_SLModel_DTMS, TrafficSituationActionGate_SLModel_DTMS, VSI_SLModel_DTMS, TSAM_SLModel_DTMS, ESI_SLModel_DTMS, ESO_SLModel_DTMS, TrafficSituationActionGate_SLModel_DTMS, VSI_SLModel_DTMS, TSAM_SLModel_DTMS, ESI_SLModel_DTMS, ESO_SLModel_DTMS, TrafficSituationActionGate_SLModel_DTMS, VSI_SLModel_DTMS, TSAM_SLModel_DTMS, ESI_SLModel_DTMS, ESO_SLModel_DTMS, TrafficSituationActionGate_SLModel_DTMS, VSI_SLModel_DTMS, TSAM_SLModel_DTMS, ESI_SLModel_DTMS, ESO_SLModel_DTMS, TrafficSituationActionGate_SLModel_DTMS, VSI_SLModel_DTMS, TSAM_SLModel_DTMS, ESI_SLModel_DTMS, ESO_SLModel_DTMS, TrafficSituationActionGate_SLModel_DTMS, VSI_SLModel_DTMS, TSAM_SLModel_DTMS, ESI_SLModel_DTMS, ESO_SLModel_DTMS, TrafficSituationActionGate_SLModel_DTMS, VSI_SLModel_DTMS, TSAM_SLModel_DTMS, ESI_SLModel_DTMS, ESO_SLModel_DTMS, TrafficSituationActionGate_SLModel_DTMS, VSI_SLModel_DTMS, TSAM_SLModel_DTMS, ESI_SLModel_DTMS, ESO_SLModel_DTMS, TrafficSituationActionGate_SLModel_DTMS, VSI_SLModel_DTMS, TSAM_SLModel_DTMS, ESI_SLModel_DTMS, ESO_SLModel_DTMS, TrafficSituationActionGate_SLModel_DTMS, VSI_SLModel_DTMS, TSAM_SLModel_DTMS, ESI_SLModel_DTMS, ESO_SLModel_DTMS, TrafficSituationActionGate_SLModel_DTMS, VSI_SLModel_DTMS, TSAM_SLModel_DTMS, ESI_SLModel_DTMS, ESO_SLModel_DTMS, TrafficSituationActionGate_SLModel_DTMS, VSI_SLModel_DTMS, TSAM_SLModel_DTMS, ESI_SLModel_DTMS, ESO_SLModel_DTMS, TrafficSituationActionGate_SLModel_DTMS, VSI_SLModel_DTMS, TSAM_SLModel_DTMS, ESI_SLModel_DTMS, ESO_SLModel_DTMS, TrafficSituationActionGate_SLModel_DTMS, VSI_SLModel_DTMS, TSAM_SLModel_DTMS, ESI_SLModel_DTMS, ESO_SLModel_DTMS, TrafficSituationActionGate_SLModel_DTMS, VSI_SLModel_DTMS, TSAM_SLModel_DTMS, ESI_SLModel_DTMS, ESO_SLModel_DTMS, TrafficSituationActionGate_SLModel_DTMS, VSI_SLModel_DTMS, TSAM_SLModel_DTMS, ESI_SLModel_DTMS, ESO_SLModel_DTMS, TrafficSituationActionGate_SLModel_DTMS, VSI_SLModel_DTMS, TSAM_SLModel_DTMS, ESI_SLModel_DTMS, ESO_SLModel_DTMS, TrafficSituationActionGate_SLModel_DTMS, VSI_SLModel_DTMS, TSAM_SLModel_DTMS, ESI_SLModel_DTMS, ESO_SLModel_DTMS, TrafficSituationActionGate_SLModel_DTMS, VSI_SLModel_DTMS, TSAM_SLModel_DTMS, ESI_SLModel_DTMS, ESO_SLModel_DTMS, TrafficSituationActionGate_SLModel_DTMS, VSI_SLModel_DTMS, TSAM_SLModel_DTMS, ESI_SLModel_DTMS, ESO_SLModel_DTMS, TrafficSituationActionGate_SLModel_DTMS, VSI_SLModel_DTMS, TSAM_SLModel_DTMS, ESI_SLModel_DTMS, ESO_SLModel_DTMS, TrafficSituationActionGate_SLModel_DTMS, VSI_SLModel_DTMS, TSAM_SLModel_DTMS, ESI_SLModel_DTMS, ESO_SLModel_DTMS, TrafficSituationActionGate_SLModel_DTMS, VSI_SLModel_DTMS, TSAM_SLModel_DTMS, ESI_SLModel_DTMS, ESO_SLModel_DTMS, TrafficSituationActionGate_SLModel_DTMS, VSI_SLModel_DTMS, TSAM_SLModel_DTMS, ESI_SLModel_DTMS, ESO_SLModel_DTMS, TrafficSituationActionGate_SLModel_DTMS, VSI_SLModel_DTMS, TSAM_SLModel_DTMS, ESI_SLModel_DTMS, ESO_SLModel_DTMS, TrafficSituationActionGate_SLModel_DTMS, VSI_SLModel_DTMS, TSAM_SLModel_DTMS, ESI_SLModel_DTMS, ESO_SLModel_DTMS, TrafficSituationActionGate_SLModel_DTMS, VSI_SLModel_DTMS, TSAM_SLModel_DTMS, ESI_SLModel_DTMS, ESO_SLModel_DTMS, TrafficSituationActionGate_SLModel_DTMS, VSI_SLModel_DTMS, TSAM_SLModel_DTMS, ESI_SLModel_DTMS, ESO_SLModel_DTMS, TrafficSituationActionGate_SLModel_DTMS, VSI_SLModel_DTMS, TSAM_SLModel_DTMS, ESI_SLModel_DTMS, ESO_SLModel_DTMS, TrafficSituationActionGate_SLModel_DTMS, VSI_SLModel_DTMS, TSAM_SLModel_DTMS, ESI_SLModel_DTMS, ESO_SLModel_DTMS, TrafficSituationActionGate_SLModel_DTMS, VSI_SLModel_DTMS, TSAM_SLModel_DTMS, ESI_SLModel_DTMS, ESI_SLModel_DTMS, ESO_SLModel_DTMS, TrafficSituationActionGate_SLModel_DTMS, VSI_SLModel_DTMS, TSAM_SLModel_DTMS, ESI_SLModel_DTMS, ESO_SLModel_DTMS, TrafficSituationActionGate_SLModel_DTMS, VSI_SLModel_DTMS, TSAM_SLModel_DTMS, ESI_SLModel_DTMS, ESO_SLModel_DTMS, TrafficSituationActionGate_SLModel_DTMS, VSI_SLModel_DTMS, TSAM_SLModel_DTMS, ESI_SLModel_DTMS, ESO_SLModel_DTMS, TrafficSituationActionGate_SLModel_DTMS, VSI_SLModel_DTMS, TSAM_SLModel_DTMS, ESI_SLModel_DTMS, ESO_SLModel_DTMS, TrafficSituationActionGate_SLModel_DTMS, VSI_SLModel_DTMS, TSAM_SLModel_DTMS, ESI_SLModel_DTMS, ESO_SLModel_DTMS, TrafficSituationActionGate_SLModel_DTMS, VSI_SLModel_DTMS, TSAM_SLModel_DTMS, ESI_SLModel_DTMS, ESO_SLModel_DTMS, TrafficSituationActionGate_SLModel_DTMS, VSI_SLModel_DTMS, TSAM_SLModel_DTMS, ESI_SLModel_DTMS, ESO_SLModel_DTMS, TrafficSituationActionGate_SLModel_DTMS, VSI_SLModel_DTMS, TSAM_SLModel_DTMS, ESI_SLModel_DTMS, ESO_SLModel_DTMS, TrafficSituationActionGate_SLModel_DTMS, VSI_SLModel_DTMS, TSAM_SLModel_DTMS, ESI_SLModel_DTMS, ESO_SLModel_DTMS, TrafficSituationActionGate_SLModel_DTMS, VSI_SLModel_DTMS, TSAM_SLModel_DTMS, ESI_SLModel_DTMS, ESO_SLModel_DTMS, TrafficSituationActionGate_SLModel_DTMS, VSI_SLModel_DTMS, TSAM_SLModel_DTMS, ESI_SLModel_DTMS, ESO_SLModel_DTMS, TrafficSituationActionGate_SLModel_DTMS, VSI_SLModel_DTMS, TSAM_SLModel_DTMS, ESI_SLModel_DTMS, ESO_SLModel_DTMS, TrafficSituationActionGate_SLModel_DTMS, VSI_SLModel_DTMS, TSAM_SLModel_DTMS, ESI_SLModel_DTMS, ESO_SLModel_DTMS, TrafficSituationActionGate_SLModel_DTMS, VSI_SLModel_DTMS, TSAM_SLModel_DTMS, ESI_SLModel_DTMS, ESO_SLModel_DTMS, TrafficSituationActionGate_SLModel_DTMS, VSI_SLModel_DTMS, TSAM_SLModel_DTMS, ESI_SLModel_DTMS, ESO_SLModel_DTMS, TrafficSituationActionGate_SLModel_DTMS, VSI_SLModel_DTMS, TSAM_SLModel_DTMS, ESI_SLModel_DTMS, ESO_SLModel_DTMS, TrafficSituationActionGate_SLModel_DTMS, VSI_SLModel_DTMS, TSAM_SLModel_DTMS, ESI_SLModel_DTMS, ESO_SLModel_DTMS, TrafficSituationActionGate_SLModel_DTMS, VSI_SLModel_DTMS, TSAM_SLModel_DTMS, ESI_SLModel_DTMS, ESO_SLModel_DTMS, TrafficSituationActionGate_SLModel_DTMS, VSI_SLModel_DTMS, TSAM_SLModel_DTMS, ESI_SLModel_DTMS, ESO_SLModel_DTMS, TrafficSituationActionGate_SLModel_DTMS, VSI_SLModel_DTMS, TSAM_SLModel_DTMS, ESI_SLModel_DTMS, ESO_SLModel_DTMS, TrafficSituationActionGate_SLModel_DTMS, VSI_SLModel_DTMS, TSAM_SLModel_DTMS, ESI_SLModel_DTMS, ESO_SLModel_DTMS, TrafficSituationActionGate_SLModel_DTMS, VSI_SLModel_DTMS, TSAM_SLModel_DTMS, ESI_SLModel_DTMS, ESO_SLModel_DTMS, TrafficSituationActionGate_SLModel_DTMS, VSI_SLModel_DTMS, TSAM_SLModel_DTMS, ESI_SLModel_DTMS, ESO_SLModel_DTMS, TrafficSituationActionGate_SLModel_DTMS, VSI_SLModel_DTMS, TSAM_SLModel_DTMS, ESI_SLModel_DTMS, ESI_SLModel_DTMS, ESI_SLModel_DTMS, TSAM_SLModel_DTMS, TSAM_SLModel_DTMS, ESI_SLModel_DTMS, ESI_SLModel_DTMS, ESI_SLModel_DTMS, ESI_SLModel_DTMS, ESI_SLModel_DTMS, ESI_SLModel_DTMS, ESO_SLModel_DTMS, TrafficSituationActionGate_SLModel_DTMS, VSI_SLModel_DTMS, TSAM_SLModel_DTMS, ESI_SLModel_DTMS, ESO_SLModel_DTMS, TrafficSituationActionGate_SLModel_DTMS, VSI_SLModel_DTMS, TSAM_SLModel_DTMS, ESI_SLModel_DTMS, ESO_SLModel_DTMS, TrafficSituationActionGate_SLModel_DTMS, VSI_SLModel_DTMS, TSAM_SLModel_DTMS, ESI_SLModel_DTMS, ESO_SLModel_DTMS, TrafficSituationActionGate_SLModel_DTMS, VSI_SLModel_DTMS, TSAM_SLModel_DTMS, ESI_SLModel_DTMS, ESO_SLModel_DTMS, TrafficSituationActionGate_SLModel_DTMS, VSI_SLModel_DTMS, TSAM_SLModel_DTMS, ESI_SLModel_DTMS, ESO_SLModel_DTMS, TrafficSituationActionGate_SLModel_DTMS, VSI_SLModel_DTMS, TSAM_SLModel_DTMS, ESI_SLModel_DTMS, ESO_SLModel_DTMS, TrafficSituationActionGate_SLModel_DTMS, VSI_SLModel_DTMS, TSAM_SLModel_DTMS, ESI_SLModel_DTMS, ESO_SLModel_DTMS, TrafficSituationActionGate_SLModel_DTMS, VSI_SLModel_DTMS, TSAM_SLModel_DTMS, ESI_SLModel_DTMS, VSI_SLModel_DTMS, VSI_SLModel_DTMS, VSI_SLModel_DTMS, VSI_SLModel_DTMS, VSI_SLModel_DTMS, ESO_SLModel_DTMS, TrafficSituationActionGate_SLModel_DTMS, VSI_SLModel_DTMS, TSAM_SLModel_DTMS, ESI_SLModel_DTMS, ESO_SLModel_DTMS, TrafficSituationActionGate_SLModel_DTMS, VSI_SLModel_DTMS, TSAM_SLModel_DTMS, ESI_SLModel_DTMS, ESO_SLModel_DTMS, TrafficSituationActionGate_SLModel_DTMS, VSI_SLModel_DTMS, TSAM_SLModel_DTMS, ESI_SLModel_DTMS, ESO_SLModel_DTMS, TrafficSituationActionGate_SLModel_DTMS, VSI_SLModel_DTMS, TSAM_SLModel_DTMS, ESI_SLModel_DTMS, ESO_SLModel_DTMS, TrafficSituationActionGate_SLModel_DTMS, VSI_SLModel_DTMS, TSAM_SLModel_DTMS, ESI_SLModel_DTMS, ESO_SLModel_DTMS, TrafficSituationActionGate_SLModel_DTMS, VSI_SLModel_DTMS, TSAM_SLModel_DTMS, ESI_SLModel_DTMS, ESO_SLModel_DTMS, TrafficSituationActionGate_SLModel_DTMS, VSI_SLModel_DTMS, TSAM_SLModel_DTMS, ESI_SLModel_DTMS, ESO_SLModel_DTMS, TrafficSituationActionGate_SLModel_DTMS, VSI_SLModel_DTMS, TSAM_SLModel_DTMS, ESI_SLModel_DTMS, ESI_SLModel_DTMS, ESO_SLModel_DTMS, TrafficSituationActionGate_SLModel_DTMS, VSI_SLModel_DTMS, TSAM_SLModel_DTMS, ESI_SLModel_DTMS, ESO_SLModel_DTMS, TrafficSituationActionGate_SLModel_DTMS, VSI_SLModel_DTMS, TSAM_SLModel_DTMS, ESI_SLModel_DTMS, ESO_SLModel_DTMS, TrafficSituationActionGate_SLModel_DTMS, VSI_SLModel_DTMS, TSAM_SLModel_DTMS, ESI_SLModel_DTMS, ESO_SLModel_DTMS, TrafficSituationActionGate_SLModel_DTMS, VSI_SLModel_DTMS, TSAM_SLModel_DTMS, ESI_SLModel_DTMS, ESO_SLModel_DTMS, TrafficSituationActionGate_SLModel_DTMS, VSI_SLModel_DTMS, TSAM_SLModel_DTMS, ESI_SLModel_DTMS, VSI_SLModel_DTMS, VSI_SLModel_DTMS, VSI_SLModel_DTMS, VSI_SLModel_DTMS, VSI_SLModel_DTMS, VSI_SLModel_DTMS, ESO_SLModel_DTMS, TrafficSituationActionGate_SLModel_DTMS, VSI_SLModel_DTMS, TSAM_SLModel_DTMS, ESI_SLModel_DTMS, ESO_SLModel_DTMS, TrafficSituationActionGate_SLModel_DTMS, VSI_SLModel_DTMS, TSAM_SLModel_DTMS, ESI_SLModel_DTMS, ESO_SLModel_DTMS, TrafficSituationActionGate_SLModel_DTMS, VSI_SLModel_DTMS, TSAM_SLModel_DTMS, ESI_SLModel_DTMS, ESO_SLModel_DTMS, TrafficSituationActionGate_SLModel_DTMS, VSI_SLModel_DTMS, TSAM_SLModel_DTMS, ESI_SLModel_DTMS, ESO_SLModel_DTMS, TrafficSituationActionGate_SLModel_DTMS, VSI_SLModel_DTMS, TSAM_SLModel_DTMS, ESI_SLModel_DTMS, ESO_SLModel_DTMS, TrafficSituationActionGate_SLModel_DTMS, VSI_SLModel_DTMS, TSAM_SLModel_DTMS, ESI_SLModel_DTMS, ESO_SLModel_DTMS, TrafficSituationActionGate_SLModel_DTMS, VSI_SLModel_DTMS, TSAM_SLModel_DTMS, ESI_SLModel_DTMS, ESO_SLModel_DTMS, TrafficSituationActionGate_SLModel_DTMS, VSI_SLModel_DTMS, TSAM_SLModel_DTMS, ESI_SLModel_DTMS, ESO_SLModel_DTMS, TrafficSituationActionGate_SLModel_DTMS, VSI_SLModel_DTMS, TSAM_SLModel_DTMS, ESI_SLModel_DTMS, ESO_SLModel_DTMS, TrafficSituationActionGate_SLModel_DTMS, VSI_SLModel_DTMS, TSAM_SLModel_DTMS, ESI_SLModel_DTMS, ESO_SLModel_DTMS, TrafficSituationActionGate_SLModel_DTMS, VSI_SLModel_DTMS, TSAM_SLModel_DTMS, ESI_SLModel_DTMS, ESO_SLModel_DTMS, TrafficSituationActionGate_SLModel_DTMS, VSI_SLModel_DTMS, TSAM_SLModel_DTMS, ESI_SLModel_DTMS, ESO_SLModel_DTMS, TrafficSituationActionGate_SLModel_DTMS, VSI_SLModel_DTMS, TSAM_SLModel_DTMS, ESI_SLModel_DTMS, ESO_SLModel_DTMS, TrafficSituationActionGate_SLModel_DTMS, VSI_SLModel_DTMS, TSAM_SLModel_DTMS, ESI_SLModel_DTMS, ESO_SLModel_DTMS, TrafficSituationActionGate_SLModel_DTMS, VSI_SLModel_DTMS, TSAM_SLModel_DTMS, ESI_SLModel_DTMS, ESO_SLModel_DTMS, TrafficSituationActionGate_SLModel_DTMS, VSI_SLModel_DTMS, TSAM_SLModel_DTMS, ESI_SLModel_DTMS, ESO_SLModel_DTMS, TrafficSituationActionGate_SLModel_DTMS, VSI_SLModel_DTMS, TSAM_SLModel_DTMS, ESI_SLModel_DTMS, ESO_SLModel_DTMS, TrafficSituationActionGate_SLModel_DTMS, VSI_SLModel_DTMS, TSAM_SLModel_DTMS, ESI_SLModel_DTMS, ESO_SLModel_DTMS, TrafficSituationActionGate_SLModel_DTMS, VSI_SLModel_DTMS, TSAM_SLModel_DTMS, ESI_SLModel_DTMS, ESO_SLModel_DTMS, TrafficSituationActionGate_SLModel_DTMS, VSI_SLModel_DTMS, TSAM_SLModel_DTMS, ESI_SLModel_DTMS, ESO_SLModel_DTMS, TrafficSituationActionGate_SLModel_DTMS, VSI_SLModel_DTMS, TSAM_SLModel_DTMS, ESI_SLModel_DTMS, ESO_SLModel_DTMS, TrafficSituationActionGate_SLModel_DTMS, VSI_SLModel_DTMS, TSAM_SLModel_DTMS, ESI_SLModel_DTMS, ESO_SLModel_DTMS, TrafficSituationActionGate_SLModel_DTMS, VSI_SLModel_DTMS, TSAM_SLModel_DTMS, ESI_SLModel_DTMS, ESO_SLModel_DTMS, TrafficSituationActionGate_SLModel_DTMS, VSI_SLModel_DTMS, TSAM_SLModel_DTMS, ESI_SLModel_DTMS, ESO_SLModel_DTMS, TrafficSituationActionGate_SLModel_DTMS, VSI_SLModel_DTMS, TSAM_SLModel_DTMS, ESI_SLModel_DTMS, ESO_SLModel_DTMS, TrafficSituationActionGate_SLModel_DTMS, VSI_SLModel_DTMS, TSAM_SLModel_DTMS, ESI_SLModel_DTMS, ESO_SLModel_DTMS, TrafficSituationActionGate_SLModel_DTMS, VSI_SLModel_DTMS, TSAM_SLModel_DTMS, ESI_SLModel_DTMS, ESO_SLModel_DTMS, TrafficSituationActionGate_SLModel_DTMS, VSI_SLModel_DTMS, TSAM_SLModel_DTMS, ESI_SLModel_DTMS, ESO_SLModel_DTMS, TrafficSituationActionGate_SLModel_DTMS, VSI_SLModel_DTMS, TSAM_SLModel_DTMS, ESI_SLModel_DTMS, ESO_SLModel_DTMS, TrafficSituationActionGate_SLModel_DTMS, VSI_SLModel_DTMS, TSAM_SLModel_DTMS, ESI_SLModel_DTMS, ESO_SLModel_DTMS, TrafficSituationActionGate_SLModel_DTMS, VSI_SLModel_DTMS, TSAM_SLModel_DTMS, ESI_SLModel_DTMS, ESO_SLModel_DTMS, TrafficSituationActionGate_SLModel_DTMS, VSI_SLModel_DTMS, TSAM_SLModel_DTMS, ESI_SLModel_DTMS, ESO_SLModel_DTMS, TrafficSituationActionGate_SLModel_DTMS, VSI_SLModel_DTMS, TSAM_SLModel_DTMS, ESI_SLModel_DTMS, ESO_SLModel_DTMS, TrafficSituationActionGate_SLModel_DTMS, VSI_SLModel_DTMS, TSAM_SLModel_DTMS, ESI_SLModel_DTMS, ESO_SLModel_DTMS, TrafficSituationActionGate_SLModel_DTMS, VSI_SLModel_DTMS, TSAM_SLModel_DTMS, ESI_SLModel_DTMS, ESO_SLModel_DTMS, TrafficSituationActionGate_SLModel_DTMS, VSI_SLModel_DTMS, TSAM_SLModel_DTMS, ESI_SLModel_DTMS, ESO_SLModel_DTMS, TrafficSituationActionGate_SLModel_DTMS, VSI_SLModel_DTMS, TSAM_SLModel_DTMS, ESI_SLModel_DTMS, ESO_SLModel_DTMS, TrafficSituationActionGate_SLModel_DTMS, VSI_SLModel_DTMS, TSAM_SLModel_DTMS, ESI_SLModel_DTMS, ESO_SLModel_DTMS, TrafficSituationActionGate_SLModel_DTMS, VSI_SLModel_DTMS, TSAM_SLModel_DTMS, ESI_SLModel_DTMS, ESO_SLModel_DTMS, TrafficSituationActionGate_SLModel_DTMS, VSI_SLModel_DTMS, TSAM_SLModel_DTMS, ESI_SLModel_DTMS, ESO_SLModel_DTMS, TrafficSituationActionGate_SLModel_DTMS, VSI_SLModel_DTMS, TSAM_SLModel_DTMS, ESI_SLModel_DTMS, ESO_SLModel_DTMS, TrafficSituationActionGate_SLModel_DTMS, VSI_SLModel_DTMS, TSAM_SLModel_DTMS, ESI_SLModel_DTMS, ESO_SLModel_DTMS, TrafficSituationActionGate_SLModel_DTMS, VSI_SLModel_DTMS, TSAM_SLModel_DTMS, ESI_SLModel_DTMS, ESO_SLModel_DTMS, TrafficSituationActionGate_SLModel_DTMS, VSI_SLModel_DTMS, TSAM_SLModel_DTMS, ESI_SLModel_DTMS, ESO_SLModel_DTMS, TrafficSituationActionGate_SLModel_DTMS, VSI_SLModel_DTMS, TSAM_SLModel_DTMS, ESI_SLModel_DTMS, ESO_SLModel_DTMS, TrafficSituationActionGate_SLModel_DTMS, VSI_SLModel_DTMS, TSAM_SLModel_DTMS, ESI_SLModel_DTMS, ESO_SLModel_DTMS, TrafficSituationActionGate_SLModel_DTMS, VSI_SLModel_DTMS, TSAM_SLModel_DTMS, ESI_SLModel_DTMS, ESO_SLModel_DTMS, TrafficSituationActionGate_SLModel_DTMS, VSI_SLModel_DTMS, TSAM_SLModel_DTMS, ESI_SLModel_DTMS, ESO_SLModel_DTMS, TrafficSituationActionGate_SLModel_DTMS, VSI_SLModel_DTMS, TSAM_SLModel_DTMS, ESI_SLModel_DTMS, ESO_SLModel_DTMS, TrafficSituationActionGate_SLModel_DTMS, VSI_SLModel_DTMS, TSAM_SLModel_DTMS, ESI_SLModel_DTMS, ESO_SLModel_DTMS, TrafficSituationActionGate_SLModel_DTMS, VSI_SLModel_DTMS, TSAM_SLModel_DTMS, ESI_SLModel_DTMS, ESO_SLModel_DTMS, TrafficSituationActionGate_SLModel_DTMS, VSI_SLModel_DTMS, TSAM_SLModel_DTMS, ESI_SLModel_DTMS, ESO_SLModel_DTMS, TrafficSituationActionGate_SLModel_DTMS, VSI_SLModel_DTMS, TSAM_SLModel_DTMS, ESI_SLModel_DTMS, ESO_SLModel_DTMS, TrafficSituationActionGate_SLModel_DTMS, VSI_SLModel_DTMS, TSAM_SLModel_DTMS, ESI_SLModel_DTMS, ESO_SLModel_DTMS, TrafficSituationActionGate_SLModel_DTMS, VSI_SLModel_DTMS, TSAM_SLModel_DTMS, ESI_SLModel_DTMS, ESO_SLModel_DTMS, TrafficSituationActionGate_SLModel_DTMS, VSI_SLModel_DTMS, TSAM_SLModel_DTMS, ESI_SLModel_DTMS, ESO_SLModel_DTMS, TrafficSituationActionGate_SLModel_DTMS, VSI_SLModel_DTMS, TSAM_SLModel_DTMS, ESI_SLModel_DTMS, ESO_SLModel_DTMS, TrafficSituationActionGate_SLModel_DTMS, VSI_SLModel_DTMS, TSAM_SLModel_DTMS, ESI_SLModel_DTMS, ESO_SLModel_DTMS, TrafficSituationActionGate_SLModel_DTMS, VSI_SLModel_DTMS, TSAM_SLModel_DTMS, ESI_SLModel_DTMS, ESO_SLModel_DTMS, TrafficSituationActionGate_SLModel_DTMS, VSI_SLModel_DTMS, TSAM_SLModel_DTMS, ESI_SLModel_DTMS, ESO_SLModel_DTMS, TrafficSituationActionGate_SLModel_DTMS, VSI_SLModel_DTMS, TSAM_SLModel_DTMS, ESI_SLModel_DTMS, ESO_SLModel_DTMS, TrafficSituationActionGate_SLModel_DTMS, VSI_SLModel_DTMS, TSAM_SLModel_DTMS, ESI_SLModel_DTMS, ESO_SLModel_DTMS, TrafficSituationActionGate_SLModel_DTMS, VSI_SLModel_DTMS, TSAM_SLModel_DTMS, ESI_SLModel_DTMS, ESO_SLModel_DTMS, TrafficSituationActionGate_SLModel_DTMS, VSI_SLModel_DTMS, TSAM_SLModel_DTMS, ESI_SLModel_DTMS, ESO_SLModel_DTMS, TrafficSituationActionGate_SLModel_DTMS, VSI_SLModel_DTMS, TSAM_SLModel_DTMS, ESI_SLModel_DTMS, ESO_SLModel_DTMS, TrafficSituationActionGate_SLModel_DTMS, VSI_SLModel_DTMS, TSAM_SLModel_DTMS, ESI_SLModel_DTMS, ESO_SLModel_DTMS, TrafficSituationActionGate_SLModel_DTMS, VSI_SLModel_DTMS, TSAM_SLModel_DTMS, ESI_SLModel_DTMS, ESO_SLModel_DTMS, TrafficSituationActionGate_SLModel_DTMS, VSI_SLModel_DTMS, TSAM_SLModel_DTMS, ESI_SLModel_DTMS, ESO_SLModel_DTMS, TrafficSituationActionGate_SLModel_DTMS, VSI_SLModel_DTMS, TSAM_SLModel_DTMS, ESI_SLModel_DTMS, ESO_SLModel_DTMS, TrafficSituationActionGate_SLModel_DTMS, VSI_SLModel_DTMS, TSAM_SLModel_DTMS, ESI_SLModel_DTMS, ESO_SLModel_DTMS, TrafficSituationActionGate_SLModel_DTMS, VSI_SLModel_DTMS, TSAM_SLModel_DTMS, ESI_SLModel_DTMS, ESO_SLModel_DTMS, TrafficSituationActionGate_SLModel_DTMS, VSI_SLModel_DTMS, TSAM_SLModel_DTMS, ESI_SLModel_DTMS, ESO_SLModel_DTMS, TrafficSituationActionGate_SLModel_DTMS, VSI_SLModel_DTMS, TSAM_SLModel_DTMS, ESI_SLModel_DTMS, ESO_SLModel_DTMS, TrafficSituationActionGate_SLModel_DTMS, VSI_SLModel_DTMS, TSAM_SLModel_DTMS, ESI_SLModel_DTMS, ESO_SLModel_DTMS, TrafficSituationActionGate_SLModel_DTMS, VSI_SLModel_DTMS, TSAM_SLModel_DTMS, ESI_SLModel_DTMS, ESO_SLModel_DTMS, TrafficSituationActionGate_SLModel_DTMS, VSI_SLModel_DTMS, TSAM_SLModel_DTMS, ESI_SLModel_DTMS, ESO_SLModel_DTMS, TrafficSituationActionGate_SLModel_DTMS, VSI_SLModel_DTMS, TSAM_SLModel_DTMS, ESI_SLModel_DTMS, ESO_SLModel_DTMS, TrafficSituationActionGate_SLModel_DTMS, VSI_SLModel_DTMS, TSAM_SLModel_DTMS, ESI_SLModel_DTMS, ESO_SLModel_DTMS, TrafficSituationActionGate_SLModel_DTMS, VSI_SLModel_DTMS, TSAM_SLModel_DTMS, ESI_SLModel_DTMS, ESO_SLModel_DTMS, TrafficSituationActionGate_SLModel_DTMS, VSI_SLModel_DTMS, TSAM_SLModel_DTMS, ESI_SLModel_DTMS, ESO_SLModel_DTMS, TrafficSituationActionGate_SLModel_DTMS, VSI_SLModel_DTMS, TSAM_SLModel_DTMS, ESI_SLModel_DTMS, ESO_SLModel_DTMS, TrafficSituationActionGate_SLModel_DTMS, VSI_SLModel_DTMS, TSAM_SLModel_DTMS, ESI_SLModel_DTMS, ESO_SLModel_DTMS, TrafficSituationActionGate_SLModel_DTMS, VSI_SLModel_DTMS, TSAM_SLModel_DTMS, ESI_SLModel_DTMS, ESO_SLModel_DTMS, TrafficSituationActionGate_SLModel_DTMS, VSI_SLModel_DTMS, TSAM_SLModel_DTMS, ESI_SLModel_DTMS, ESO_SLModel_DTMS, TrafficSituationActionGate_SLModel_DTMS, VSI_SLModel_DTMS, TSAM_SLModel_DTMS, ESI_SLModel_DTMS, ESO_SLModel_DTMS, TrafficSituationActionGate_SLModel_DTMS, VSI_SLModel_DTMS, TSAM_SLModel_DTMS, ESI_SLModel_DTMS, ESO_SLModel_DTMS, TrafficSituationActionGate_SLModel_DTMS, VSI_SLModel_DTMS, TSAM_SLModel_DTMS, ESI_SLModel_DTMS, ESO_SLModel_DTMS, TrafficSituationActionGate_SLModel_DTMS, VSI_SLModel_DTMS, TSAM_SLModel_DTMS, ESI_SLModel_DTMS, ESO_SLModel_DTMS, ESO_SLModel_DTMS, TrafficSituationActionGate_SLModel_DTMS, VSI_SLModel_DTMS, TSAM_SLModel_DTMS, ESI_SLModel_DTMS, ESO_SLModel_DTMS, TrafficSituationActionGate_SLModel_DTMS, VSI_SLModel_DTMS, TSAM_SLModel_DTMS, ESI_SLModel_DTMS, ESO_SLModel_DTMS, TrafficSituationActionGate_SLModel_DTMS, VSI_SLModel_DTMS, TSAM_SLModel_DTMS, ESI_SLModel_DTMS, ESO_SLModel_DTMS, TrafficSituationActionGate_SLModel_DTMS, VSI_SLModel_DTMS, TSAM_SLModel_DTMS, ESI_SLModel_DTMS, ESO_SLModel_DTMS, TrafficSituationActionGate_SLModel_DTMS, VSI_SLModel_DTMS, TSAM_SLModel_DTMS, ESI_SLModel_DTMS, ESO_SLModel_DTMS, TrafficSituationActionGate_SLModel_DTMS, VSI_SLModel_DTMS, TSAM_SLModel_DTMS, ESI_SLModel_DTMS, ESO_SLModel_DTMS, TrafficSituationActionGate_SLModel_DTMS, VSI_SLModel_DTMS, TSAM_SLModel_DTMS, ESI_SLModel_DTMS, ESO_SLModel_DTMS, TrafficSituationActionGate_SLModel_DTMS, VSI_SLModel_DTMS, TSAM_SLModel_DTMS, ESI_SLModel_DTMS, ESO_SLModel_DTMS, TrafficSituationActionGate_SLModel_DTMS, VSI_SLModel_DTMS, TSAM_SLModel_DTMS, ESI_SLModel_DTMS, ESO_SLModel_DTMS, TrafficSituationActionGate_SLModel_DTMS, VSI_SLModel_DTMS, TSAM_SLModel_DTMS, ESI_SLModel_DTMS, ESO_SLModel_DTMS, TrafficSituationActionGate_SLModel_DTMS, VSI_SLModel_DTMS, TSAM_SLModel_DTMS, ESI_SLModel_DTMS, ESO_SLModel_DTMS, TrafficSituationActionGate_SLModel_DTMS, VSI_SLModel_DTMS, TSAM_SLModel_DTMS, ESI_SLModel_DTMS, ESO_SLModel_DTMS, TrafficSituationActionGate_SLModel_DTMS, VSI_SLModel_DTMS, TSAM_SLModel_DTMS, ESI_SLModel_DTMS, ESO_SLModel_DTMS, TrafficSituationActionGate_SLModel_DTMS, VSI_SLModel_DTMS, TSAM_SLModel_DTMS, ESI_SLModel_DTMS, ESO_SLModel_DTMS, TrafficSituationActionGate_SLModel_DTMS, VSI_SLModel_DTMS, TSAM_SLModel_DTMS, ESI_SLModel_DTMS, ESO_SLModel_DTMS, TrafficSituationActionGate_SLModel_DTMS, VSI_SLModel_DTMS, TSAM_SLModel_DTMS, ESI_SLModel_DTMS, ESO_SLModel_DTMS, TrafficSituationActionGate_SLModel_DTMS, VSI_SLModel_DTMS, TSAM_SLModel_DTMS, ESI_SLModel_DTMS, TrafficSituationActionGate_SLModel_DTMS, ESI_SLModel_DTMS, VSI_SLModel_DTMS, ESO_SLModel_DTMS, TrafficSituationActionGate_SLModel_DTMS, VSI_SLModel_DTMS, TSAM_SLModel_DTMS, ESI_SLModel_DTMS, ESO_SLModel_DTMS, TrafficSituationActionGate_SLModel_DTMS, VSI_SLModel_DTMS, TSAM_SLModel_DTMS, ESI_SLModel_DTMS, ESO_SLModel_DTMS, TrafficSituationActionGate_SLModel_DTMS, VSI_SLModel_DTMS, TSAM_SLModel_DTMS, ESI_SLModel_DTMS, ESO_SLModel_DTMS, TrafficSituationActionGate_SLModel_DTMS, VSI_SLModel_DTMS, TSAM_SLModel_DTMS, ESI_SLModel_DTMS, ESO_SLModel_DTMS, TrafficSituationActionGate_SLModel_DTMS, VSI_SLModel_DTMS, TSAM_SLModel_DTMS, ESI_SLModel_DTMS, ESO_SLModel_DTMS, TrafficSituationActionGate_SLModel_DTMS, VSI_SLModel_DTMS, TSAM_SLModel_DTMS, ESI_SLModel_DTMS, ESO_SLModel_DTMS, TrafficSituationActionGate_SLModel_DTMS, VSI_SLModel_DTMS, TSAM_SLModel_DTMS, ESI_SLModel_DTMS, ESO_SLModel_DTMS, TrafficSituationActionGate_SLModel_DTMS, VSI_SLModel_DTMS, TSAM_SLModel_DTMS, ESI_SLModel_DTMS, ESO_SLModel_DTMS, TrafficSituationActionGate_SLModel_DTMS, VSI_SLModel_DTMS, TSAM_SLModel_DTMS, ESI_SLModel_DTMS, ESO_SLModel_DTMS, TrafficSituationActionGate_SLModel_DTMS, VSI_SLModel_DTMS, TSAM_SLModel_DTMS, ESI_SLModel_DTMS, ESO_SLModel_DTMS, TrafficSituationActionGate_SLModel_DTMS, VSI_SLModel_DTMS, TSAM_SLModel_DTMS, ESI_SLModel_DTMS, ESO_SLModel_DTMS, TrafficSituationActionGate_SLModel_DTMS, VSI_SLModel_DTMS, TSAM_SLModel_DTMS, ESI_SLModel_DTMS, ESO_SLModel_DTMS, TrafficSituationActionGate_SLModel_DTMS, VSI_SLModel_DTMS, TSAM_SLModel_DTMS, ESI_SLModel_DTMS, ESO_SLModel_DTMS, TrafficSituationActionGate_SLModel_DTMS, VSI_SLModel_DTMS, TSAM_SLModel_DTMS, ESI_SLModel_DTMS, ESO_SLModel_DTMS, TrafficSituationActionGate_SLModel_DTMS, VSI_SLModel_DTMS, TSAM_SLModel_DTMS, ESI_SLModel_DTMS, ESO_SLModel_DTMS, TrafficSituationActionGate_SLModel_DTMS, VSI_SLModel_DTMS, TSAM_SLModel_DTMS, ESI_SLModel_DTMS, ESO_SLModel_DTMS, TrafficSituationActionGate_SLModel_DTMS, VSI_SLModel_DTMS, TSAM_SLModel_DTMS, ESI_SLModel_DTMS, ESO_SLModel_DTMS, TrafficSituationActionGate_SLModel_DTMS, VSI_SLModel_DTMS, TSAM_SLModel_DTMS, ESI_SLModel_DTMS, ESO_SLModel_DTMS, TrafficSituationActionGate_SLModel_DTMS, VSI_SLModel_DTMS, TSAM_SLModel_DTMS, ESI_SLModel_DTMS, ESO_SLModel_DTMS, TrafficSituationActionGate_SLModel_DTMS, VSI_SLModel_DTMS, TSAM_SLModel_DTMS, ESI_SLModel_DTMS, VSI_SLModel_DTMS, VSI_SLModel_DTMS, VSI_SLModel_DTMS, ESO_SLModel_DTMS, TrafficSituationActionGate_SLModel_DTMS, VSI_SLModel_DTMS, TSAM_SLModel_DTMS, ESI_SLModel_DTMS, ESO_SLModel_DTMS, TrafficSituationActionGate_SLModel_DTMS, VSI_SLModel_DTMS, TSAM_SLModel_DTMS, ESI_SLModel_DTMS, ESO_SLModel_DTMS, TrafficSituationActionGate_SLModel_DTMS, VSI_SLModel_DTMS, TSAM_SLModel_DTMS, ESI_SLModel_DTMS, ESO_SLModel_DTMS, TrafficSituationActionGate_SLModel_DTMS, VSI_SLModel_DTMS, TSAM_SLModel_DTMS, ESI_SLModel_DTMS, ESO_SLModel_DTMS, TrafficSituationActionGate_SLModel_DTMS, VSI_SLModel_DTMS, TSAM_SLModel_DTMS, ESI_SLModel_DTMS, ESO_SLModel_DTMS, TrafficSituationActionGate_SLModel_DTMS, VSI_SLModel_DTMS, TSAM_SLModel_DTMS, ESI_SLModel_DTMS, ESO_SLModel_DTMS, TrafficSituationActionGate_SLModel_DTMS, VSI_SLModel_DTMS, TSAM_SLModel_DTMS, ESI_SLModel_DTMS, ESO_SLModel_DTMS, TrafficSituationActionGate_SLModel_DTMS, VSI_SLModel_DTMS, TSAM_SLModel_DTMS, ESI_SLModel_DTMS, ESO_SLModel_DTMS, TrafficSituationActionGate_SLModel_DTMS, VSI_SLModel_DTMS, TSAM_SLModel_DTMS, ESI_SLModel_DTMS, ESO_SLModel_DTMS, TrafficSituationActionGate_SLModel_DTMS, VSI_SLModel_DTMS, TSAM_SLModel_DTMS, ESI_SLModel_DTMS, ESO_SLModel_DTMS, TrafficSituationActionGate_SLModel_DTMS, VSI_SLModel_DTMS, TSAM_SLModel_DTMS, ESI_SLModel_DTMS, ESO_SLModel_DTMS, TrafficSituationActionGate_SLModel_DTMS, VSI_SLModel_DTMS, TSAM_SLModel_DTMS, ESI_SLModel_DTMS, ESO_SLModel_DTMS, TrafficSituationActionGate_SLModel_DTMS, VSI_SLModel_DTMS, TSAM_SLModel_DTMS, ESI_SLModel_DTMS, ESO_SLModel_DTMS, TrafficSituationActionGate_SLModel_DTMS, VSI_SLModel_DTMS, TSAM_SLModel_DTMS, ESI_SLModel_DTMS, ESO_SLModel_DTMS, TrafficSituationActionGate_SLModel_DTMS, VSI_SLModel_DTMS, TSAM_SLModel_DTMS, ESI_SLModel_DTMS, ESO_SLModel_DTMS, TrafficSituationActionGate_SLModel_DTMS, VSI_SLModel_DTMS, TSAM_SLModel_DTMS, ESI_SLModel_DTMS, ESO_SLModel_DTMS, TrafficSituationActionGate_SLModel_DTMS, VSI_SLModel_DTMS, TSAM_SLModel_DTMS, ESI_SLModel_DTMS, ESO_SLModel_DTMS, TrafficSituationActionGate_SLModel_DTMS, VSI_SLModel_DTMS, TSAM_SLModel_DTMS, ESI_SLModel_DTMS, ESO_SLModel_DTMS, TrafficSituationActionGate_SLModel_DTMS, VSI_SLModel_DTMS, TSAM_SLModel_DTMS, ESI_SLModel_DTMS, ESO_SLModel_DTMS, TrafficSituationActionGate_SLModel_DTMS, VSI_SLModel_DTMS, TSAM_SLModel_DTMS, ESI_SLModel_DTMS, ESO_SLModel_DTMS, TrafficSituationActionGate_SLModel_DTMS, VSI_SLModel_DTMS, TSAM_SLModel_DTMS, ESI_SLModel_DTMS, ESO_SLModel_DTMS, TrafficSituationActionGate_SLModel_DTMS, VSI_SLModel_DTMS, TSAM_SLModel_DTMS, ESI_SLModel_DTMS, ESO_SLModel_DTMS, TrafficSituationActionGate_SLModel_DTMS, VSI_SLModel_DTMS, TSAM_SLModel_DTMS, ESI_SLModel_DTMS, ESO_SLModel_DTMS, TrafficSituationActionGate_SLModel_DTMS, VSI_SLModel_DTMS, TSAM_SLModel_DTMS, ESI_SLModel_DTMS, ESO_SLModel_DTMS, TrafficSituationActionGate_SLModel_DTMS, VSI_SLModel_DTMS, TSAM_SLModel_DTMS, ESI_SLModel_DTMS, ESO_SLModel_DTMS, TrafficSituationActionGate_SLModel_DTMS, VSI_SLModel_DTMS, TSAM_SLModel_DTMS, ESI_SLModel_DTMS, ESO_SLModel_DTMS, TrafficSituationActionGate_SLModel_DTMS, VSI_SLModel_DTMS, TSAM_SLModel_DTMS, ESI_SLModel_DTMS, ESO_SLModel_DTMS, TrafficSituationActionGate_SLModel_DTMS, VSI_SLModel_DTMS, TSAM_SLModel_DTMS, ESI_SLModel_DTMS, ESO_SLModel_DTMS, TrafficSituationActionGate_SLModel_DTMS, VSI_SLModel_DTMS, TSAM_SLModel_DTMS, ESI_SLModel_DTMS, ESO_SLModel_DTMS, TrafficSituationActionGate_SLModel_DTMS, VSI_SLModel_DTMS, TSAM_SLModel_DTMS, ESI_SLModel_DTMS, ESO_SLModel_DTMS, TrafficSituationActionGate_SLModel_DTMS, VSI_SLModel_DTMS, TSAM_SLModel_DTMS, ESI_SLModel_DTMS, ESO_SLModel_DTMS, TrafficSituationActionGate_SLModel_DTMS, VSI_SLModel_DTMS, TSAM_SLModel_DTMS, ESI_SLModel_DTMS, ESO_SLModel_DTMS, TrafficSituationActionGate_SLModel_DTMS, VSI_SLModel_DTMS, TSAM_SLModel_DTMS, ESI_SLModel_DTMS, ESO_SLModel_DTMS, TrafficSituationActionGate_SLModel_DTMS, VSI_SLModel_DTMS, TSAM_SLModel_DTMS, ESI_SLModel_DTMS, ESO_SLModel_DTMS, TrafficSituationActionGate_SLModel_DTMS, VSI_SLModel_DTMS, TSAM_SLModel_DTMS, ESI_SLModel_DTMS, ESO_SLModel_DTMS, TrafficSituationActionGate_SLModel_DTMS, VSI_SLModel_DTMS, TSAM_SLModel_DTMS, ESI_SLModel_DTMS, ESO_SLModel_DTMS, TrafficSituationActionGate_SLModel_DTMS, VSI_SLModel_DTMS, TSAM_SLModel_DTMS, ESI_SLModel_DTMS, ESO_SLModel_DTMS, TrafficSituationActionGate_SLModel_DTMS, VSI_SLModel_DTMS, TSAM_SLModel_DTMS, ESI_SLModel_DTMS, ESO_SLModel_DTMS, TrafficSituationActionGate_SLModel_DTMS, VSI_SLModel_DTMS, TSAM_SLModel_DTMS, ESI_SLModel_DTMS, ESO_SLModel_DTMS, TrafficSituationActionGate_SLModel_DTMS, VSI_SLModel_DTMS, TSAM_SLModel_DTMS, ESI_SLModel_DTMS, ESO_SLModel_DTMS, TrafficSituationActionGate_SLModel_DTMS, VSI_SLModel_DTMS, TSAM_SLModel_DTMS, ESI_SLModel_DTMS, ESO_SLModel_DTMS, TrafficSituationActionGate_SLModel_DTMS, VSI_SLModel_DTMS, TSAM_SLModel_DTMS, ESI_SLModel_DTMS, ESO_SLModel_DTMS, TrafficSituationActionGate_SLModel_DTMS, VSI_SLModel_DTMS, TSAM_SLModel_DTMS, ESI_SLModel_DTMS, ESO_SLModel_DTMS, TrafficSituationActionGate_SLModel_DTMS, VSI_SLModel_DTMS, TSAM_SLModel_DTMS, ESI_SLModel_DTMS, ESO_SLModel_DTMS, TrafficSituationActionGate_SLModel_DTMS, VSI_SLModel_DTMS, TSAM_SLModel_DTMS, ESI_SLModel_DTMS, ESO_SLModel_DTMS, TrafficSituationActionGate_SLModel_DTMS, VSI_SLModel_DTMS, TSAM_SLModel_DTMS, ESI_SLModel_DTMS, ESO_SLModel_DTMS, TrafficSituationActionGate_SLModel_DTMS, VSI_SLModel_DTMS, TSAM_SLModel_DTMS, ESI_SLModel_DTMS, ESO_SLModel_DTMS, TrafficSituationActionGate_SLModel_DTMS, VSI_SLModel_DTMS, TSAM_SLModel_DTMS, ESI_SLModel_DTMS, ESO_SLModel_DTMS, TrafficSituationActionGate_SLModel_DTMS, VSI_SLModel_DTMS, TSAM_SLModel_DTMS, ESI_SLModel_DTMS, ESO_SLModel_DTMS, TrafficSituationActionGate_SLModel_DTMS, VSI_SLModel_DTMS, TSAM_SLModel_DTMS, ESI_SLModel_DTMS, ESO_SLModel_DTMS, TrafficSituationActionGate_SLModel_DTMS, VSI_SLModel_DTMS, TSAM_SLModel_DTMS, ESI_SLModel_DTMS, ESO_SLModel_DTMS, TrafficSituationActionGate_SLModel_DTMS, VSI_SLModel_DTMS, TSAM_SLModel_DTMS, ESI_SLModel_DTMS, ESO_SLModel_DTMS, TrafficSituationActionGate_SLModel_DTMS, VSI_SLModel_DTMS, TSAM_SLModel_DTMS, ESI_SLModel_DTMS, ESO_SLModel_DTMS, TrafficSituationActionGate_SLModel_DTMS, VSI_SLModel_DTMS, TSAM_SLModel_DTMS, ESI_SLModel_DTMS, ESO_SLModel_DTMS, TrafficSituationActionGate_SLModel_DTMS, VSI_SLModel_DTMS, TSAM_SLModel_DTMS, ESI_SLModel_DTMS, ESO_SLModel_DTMS, TrafficSituationActionGate_SLModel_DTMS, VSI_SLModel_DTMS, TSAM_SLModel_DTMS, ESI_SLModel_DTMS, ESO_SLModel_DTMS, TrafficSituationActionGate_SLModel_DTMS, VSI_SLModel_DTMS, TSAM_SLModel_DTMS, ESI_SLModel_DTMS, ESO_SLModel_DTMS, TrafficSituationActionGate_SLModel_DTMS, VSI_SLModel_DTMS, TSAM_SLModel_DTMS, ESI_SLModel_DTMS, ESO_SLModel_DTMS, TrafficSituationActionGate_SLModel_DTMS, VSI_SLModel_DTMS, TSAM_SLModel_DTMS, ESI_SLModel_DTMS, ESO_SLModel_DTMS, TrafficSituationActionGate_SLModel_DTMS, VSI_SLModel_DTMS, TSAM_SLModel_DTMS, ESI_SLModel_DTMS, ESO_SLModel_DTMS, TrafficSituationActionGate_SLModel_DTMS, VSI_SLModel_DTMS, TSAM_SLModel_DTMS, ESI_SLModel_DTMS, ESO_SLModel_DTMS, TrafficSituationActionGate_SLModel_DTMS, VSI_SLModel_DTMS, TSAM_SLModel_DTMS, ESI_SLModel_DTMS, ESO_SLModel_DTMS, TrafficSituationActionGate_SLModel_DTMS, VSI_SLModel_DTMS, TSAM_SLModel_DTMS, ESI_SLModel_DTMS, ESO_SLModel_DTMS, TrafficSituationActionGate_SLModel_DTMS, VSI_SLModel_DTMS, TSAM_SLModel_DTMS, ESI_SLModel_DTMS, ESO_SLModel_DTMS, TrafficSituationActionGate_SLModel_DTMS, VSI_SLModel_DTMS, TSAM_SLModel_DTMS, ESI_SLModel_DTMS, ESO_SLModel_DTMS, TrafficSituationActionGate_SLModel_DTMS, VSI_SLModel_DTMS, TSAM_SLModel_DTMS, ESI_SLModel_DTMS, ESO_SLModel_DTMS, TrafficSituationActionGate_SLModel_DTMS, VSI_SLModel_DTMS, TSAM_SLModel_DTMS, ESI_SLModel_DTMS, ESO_SLModel_DTMS, TrafficSituationActionGate_SLModel_DTMS, VSI_SLModel_DTMS, TSAM_SLModel_DTMS, ESI_SLModel_DTMS, ESO_SLModel_DTMS, TrafficSituationActionGate_SLModel_DTMS, VSI_SLModel_DTMS, TSAM_SLModel_DTMS, ESI_SLModel_DTMS, ESO_SLModel_DTMS, TrafficSituationActionGate_SLModel_DTMS, VSI_SLModel_DTMS, TSAM_SLModel_DTMS, ESI_SLModel_DTMS, ESO_SLModel_DTMS, TrafficSituationActionGate_SLModel_DTMS, VSI_SLModel_DTMS, TSAM_SLModel_DTMS, ESI_SLModel_DTMS, ESO_SLModel_DTMS, TrafficSituationActionGate_SLModel_DTMS, VSI_SLModel_DTMS, TSAM_SLModel_DTMS, ESI_SLModel_DTMS, ESO_SLModel_DTMS, TrafficSituationActionGate_SLModel_DTMS, VSI_SLModel_DTMS, TSAM_SLModel_DTMS, ESI_SLModel_DTMS, ESO_SLModel_DTMS, TrafficSituationActionGate_SLModel_DTMS, VSI_SLModel_DTMS, TSAM_SLModel_DTMS, ESI_SLModel_DTMS, ESO_SLModel_DTMS, TrafficSituationActionGate_SLModel_DTMS, VSI_SLModel_DTMS, TSAM_SLModel_DTMS, ESI_SLModel_DTMS, ESO_SLModel_DTMS, TrafficSituationActionGate_SLModel_DTMS, VSI_SLModel_DTMS, TSAM_SLModel_DTMS, ESI_SLModel_DTMS, ESO_SLModel_DTMS, TrafficSituationActionGate_SLModel_DTMS, VSI_SLModel_DTMS, TSAM_SLModel_DTMS, ESI_SLModel_DTMS, ESO_SLModel_DTMS, TrafficSituationActionGate_SLModel_DTMS, VSI_SLModel_DTMS, TSAM_SLModel_DTMS, ESI_SLModel_DTMS, ESO_SLModel_DTMS, TrafficSituationActionGate_SLModel_DTMS, VSI_SLModel_DTMS, TSAM_SLModel_DTMS, ESI_SLModel_DTMS, ESO_SLModel_DTMS, TrafficSituationActionGate_SLModel_DTMS, VSI_SLModel_DTMS, TSAM_SLModel_DTMS, ESI_SLModel_DTMS, ESO_SLModel_DTMS, TrafficSituationActionGate_SLModel_DTMS, VSI_SLModel_DTMS, TSAM_SLModel_DTMS, ESI_SLModel_DTMS, ESO_SLModel_DTMS, TrafficSituationActionGate_SLModel_DTMS, VSI_SLModel_DTMS, TSAM_SLModel_DTMS, ESI_SLModel_DTMS, ESO_SLModel_DTMS, TrafficSituationActionGate_SLModel_DTMS, VSI_SLModel_DTMS, TSAM_SLModel_DTMS, ESI_SLModel_DTMS, ESO_SLModel_DTMS, TrafficSituationActionGate_SLModel_DTMS, VSI_SLModel_DTMS, TSAM_SLModel_DTMS, ESI_SLModel_DTMS, ESO_SLModel_DTMS, TrafficSituationActionGate_SLModel_DTMS, VSI_SLModel_DTMS, TSAM_SLModel_DTMS, ESI_SLModel_DTMS, ESO_SLModel_DTMS, TrafficSituationActionGate_SLModel_DTMS, VSI_SLModel_DTMS, TSAM_SLModel_DTMS, ESI_SLModel_DTMS, ESO_SLModel_DTMS, TrafficSituationActionGate_SLModel_DTMS, VSI_SLModel_DTMS, TSAM_SLModel_DTMS, ESI_SLModel_DTMS, ESO_SLModel_DTMS, TrafficSituationActionGate_SLModel_DTMS, VSI_SLModel_DTMS, TSAM_SLModel_DTMS, ESI_SLModel_DTMS, ESO_SLModel_DTMS, TrafficSituationActionGate_SLModel_DTMS, VSI_SLModel_DTMS, TSAM_SLModel_DTMS, ESI_SLModel_DTMS, ESO_SLModel_DTMS, TrafficSituationActionGate_SLModel_DTMS, VSI_SLModel_DTMS, TSAM_SLModel_DTMS, ESI_SLModel_DTMS, ESO_SLModel_DTMS, TrafficSituationActionGate_SLModel_DTMS, VSI_SLModel_DTMS, TSAM_SLModel_DTMS, ESI_SLModel_DTMS, ESO_SLModel_DTMS, TrafficSituationActionGate_SLModel_DTMS, VSI_SLModel_DTMS, TSAM_SLModel_DTMS, ESI_SLModel_DTMS, ESO_SLModel_DTMS, TrafficSituationActionGate_SLModel_DTMS, VSI_SLModel_DTMS, TSAM_SLModel_DTMS, ESI_SLModel_DTMS, ESO_SLModel_DTMS, TrafficSituationActionGate_SLModel_DTMS, VSI_SLModel_DTMS, TSAM_SLModel_DTMS, ESI_SLModel_DTMS, ESO_SLModel_DTMS, TrafficSituationActionGate_SLModel_DTMS, VSI_SLModel_DTMS, TSAM_SLModel_DTMS, ESI_SLModel_DTMS, ESO_SLModel_DTMS, TrafficSituationActionGate_SLModel_DTMS, VSI_SLModel_DTMS, TSAM_SLModel_DTMS, ESI_SLModel_DTMS, ESO_SLModel_DTMS, TrafficSituationActionGate_SLModel_DTMS, VSI_SLModel_DTMS, TSAM_SLModel_DTMS, ESI_SLModel_DTMS, ESO_SLModel_DTMS, TrafficSituationActionGate_SLModel_DTMS, VSI_SLModel_DTMS, TSAM_SLModel_DTMS, ESI_SLModel_DTMS, ESO_SLModel_DTMS, TrafficSituationActionGate_SLModel_DTMS, VSI_SLModel_DTMS, TSAM_SLModel_DTMS, ESI_SLModel_DTMS, ESO_SLModel_DTMS, TrafficSituationActionGate_SLModel_DTMS, VSI_SLModel_DTMS, TSAM_SLModel_DTMS, ESI_SLModel_DTMS, ESO_SLModel_DTMS, TrafficSituationActionGate_SLModel_DTMS, VSI_SLModel_DTMS, TSAM_SLModel_DTMS, ESI_SLModel_DTMS, ESO_SLModel_DTMS, TrafficSituationActionGate_SLModel_DTMS, VSI_SLModel_DTMS, TSAM_SLModel_DTMS, ESI_SLModel_DTMS, ESO_SLModel_DTMS, TrafficSituationActionGate_SLModel_DTMS, VSI_SLModel_DTMS, TSAM_SLModel_DTMS, ESI_SLModel_DTMS, ESO_SLModel_DTMS, TrafficSituationActionGate_SLModel_DTMS, VSI_SLModel_DTMS, TSAM_SLModel_DTMS, ESI_SLModel_DTMS, ESO_SLModel_DTMS, TrafficSituationActionGate_SLModel_DTMS, VSI_SLModel_DTMS, TSAM_SLModel_DTMS, ESI_SLModel_DTMS, ESO_SLModel_DTMS, TrafficSituationActionGate_SLModel_DTMS, VSI_SLModel_DTMS, TSAM_SLModel_DTMS, ESI_SLModel_DTMS, ESO_SLModel_DTMS, TrafficSituationActionGate_SLModel_DTMS, VSI_SLModel_DTMS, TSAM_SLModel_DTMS, ESI_SLModel_DTMS, ESO_SLModel_DTMS, TrafficSituationActionGate_SLModel_DTMS, VSI_SLModel_DTMS, TSAM_SLModel_DTMS, ESI_SLModel_DTMS, ESO_SLModel_DTMS, TrafficSituationActionGate_SLModel_DTMS, VSI_SLModel_DTMS, TSAM_SLModel_DTMS, ESI_SLModel_DTMS, ESO_SLModel_DTMS, TrafficSituationActionGate_SLModel_DTMS, VSI_SLModel_DTMS, TSAM_SLModel_DTMS, ESI_SLModel_DTMS, ESO_SLModel_DTMS, TrafficSituationActionGate_SLModel_DTMS, VSI_SLModel_DTMS, TSAM_SLModel_DTMS, ESI_SLModel_DTMS, ESO_SLModel_DTMS, TrafficSituationActionGate_SLModel_DTMS, VSI_SLModel_DTMS, TSAM_SLModel_DTMS, ESI_SLModel_DTMS, ESO_SLModel_DTMS, TrafficSituationActionGate_SLModel_DTMS, VSI_SLModel_DTMS, TSAM_SLModel_DTMS, ESI_SLModel_DTMS, ESO_SLModel_DTMS, TrafficSituationActionGate_SLModel_DTMS, VSI_SLModel_DTMS, TSAM_SLModel_DTMS, ESI_SLModel_DTMS, ESO_SLModel_DTMS, TrafficSituationActionGate_SLModel_DTMS, VSI_SLModel_DTMS, TSAM_SLModel_DTMS, ESI_SLModel_DTMS, ESO_SLModel_DTMS, TrafficSituationActionGate_SLModel_DTMS, VSI_SLModel_DTMS, TSAM_SLModel_DTMS, ESI_SLModel_DTMS, ESO_SLModel_DTMS, TrafficSituationActionGate_SLModel_DTMS, VSI_SLModel_DTMS, TSAM_SLModel_DTMS, ESI_SLModel_DTMS, ESO_SLModel_DTMS, TrafficSituationActionGate_SLModel_DTMS, VSI_SLModel_DTMS, TSAM_SLModel_DTMS, ESI_SLModel_DTMS, ESO_SLModel_DTMS, TrafficSituationActionGate_SLModel_DTMS, VSI_SLModel_DTMS, TSAM_SLModel_DTMS, ESI_SLModel_DTMS, ESO_SLModel_DTMS, TrafficSituationActionGate_SLModel_DTMS, VSI_SLModel_DTMS, TSAM_SLModel_DTMS, ESI_SLModel_DTMS, ESO_SLModel_DTMS, TrafficSituationActionGate_SLModel_DTMS, VSI_SLModel_DTMS, TSAM_SLModel_DTMS, ESI_SLModel_DTMS, ESO_SLModel_DTMS, TrafficSituationActionGate_SLModel_DTMS, VSI_SLModel_DTMS, TSAM_SLModel_DTMS, ESI_SLModel_DTMS, ESO_SLModel_DTMS, TrafficSituationActionGate_SLModel_DTMS, VSI_SLModel_DTMS, TSAM_SLModel_DTMS, ESI_SLModel_DTMS, ESO_SLModel_DTMS, TrafficSituationActionGate_SLModel_DTMS, VSI_SLModel_DTMS, TSAM_SLModel_DTMS, ESI_SLModel_DTMS, ESO_SLModel_DTMS, TrafficSituationActionGate_SLModel_DTMS, VSI_SLModel_DTMS, TSAM_SLModel_DTMS, ESI_SLModel_DTMS, ESO_SLModel_DTMS, TrafficSituationActionGate_SLModel_DTMS, VSI_SLModel_DTMS, TSAM_SLModel_DTMS, ESI_SLModel_DTMS, ESO_SLModel_DTMS, TrafficSituationActionGate_SLModel_DTMS, VSI_SLModel_DTMS, TSAM_SLModel_DTMS, ESI_SLModel_DTMS, ESO_SLModel_DTMS, TrafficSituationActionGate_SLModel_DTMS, VSI_SLModel_DTMS, TSAM_SLModel_DTMS, ESI_SLModel_DTMS, ESO_SLModel_DTMS, TrafficSituationActionGate_SLModel_DTMS, VSI_SLModel_DTMS, TSAM_SLModel_DTMS, ESI_SLModel_DTMS, ESO_SLModel_DTMS, TrafficSituationActionGate_SLModel_DTMS, VSI_SLModel_DTMS, TSAM_SLModel_DTMS, ESI_SLModel_DTMS, ESO_SLModel_DTMS, TrafficSituationActionGate_SLModel_DTMS, VSI_SLModel_DTMS, TSAM_SLModel_DTMS, ESI_SLModel_DTMS, ESO_SLModel_DTMS, TrafficSituationActionGate_SLModel_DTMS, VSI_SLModel_DTMS, TSAM_SLModel_DTMS, ESI_SLModel_DTMS, ESO_SLModel_DTMS, TrafficSituationActionGate_SLModel_DTMS, VSI_SLModel_DTMS, TSAM_SLModel_DTMS, ESI_SLModel_DTMS, ESO_SLModel_DTMS, TrafficSituationActionGate_SLModel_DTMS, VSI_SLModel_DTMS, TSAM_SLModel_DTMS, ESI_SLModel_DTMS, ESO_SLModel_DTMS, TrafficSituationActionGate_SLModel_DTMS, VSI_SLModel_DTMS, TSAM_SLModel_DTMS, ESI_SLModel_DTMS, ESO_SLModel_DTMS, TrafficSituationActionGate_SLModel_DTMS, VSI_SLModel_DTMS, TSAM_SLModel_DTMS, ESI_SLModel_DTMS, ESO_SLModel_DTMS, TrafficSituationActionGate_SLModel_DTMS, VSI_SLModel_DTMS, TSAM_SLModel_DTMS, ESI_SLModel_DTMS, ESO_SLModel_DTMS, TrafficSituationActionGate_SLModel_DTMS, VSI_SLModel_DTMS, TSAM_SLModel_DTMS, ESI_SLModel_DTMS, ESO_SLModel_DTMS, TrafficSituationActionGate_SLModel_DTMS, VSI_SLModel_DTMS, TSAM_SLModel_DTMS, ESI_SLModel_DTMS, ESO_SLModel_DTMS, TrafficSituationActionGate_SLModel_DTMS, VSI_SLModel_DTMS, TSAM_SLModel_DTMS, ESI_SLModel_DTMS, ESO_SLModel_DTMS, TrafficSituationActionGate_SLModel_DTMS, VSI_SLModel_DTMS, TSAM_SLModel_DTMS, ESI_SLModel_DTMS, ESO_SLModel_DTMS, TrafficSituationActionGate_SLModel_DTMS, VSI_SLModel_DTMS, TSAM_SLModel_DTMS, ESI_SLModel_DTMS, ESO_SLModel_DTMS, TrafficSituationActionGate_SLModel_DTMS, VSI_SLModel_DTMS, TSAM_SLModel_DTMS, ESI_SLModel_DTMS, ESO_SLModel_DTMS, TrafficSituationActionGate_SLModel_DTMS, VSI_SLModel_DTMS, TSAM_SLModel_DTMS, ESI_SLModel_DTMS, ESO_SLModel_DTMS, TrafficSituationActionGate_SLModel_DTMS, VSI_SLModel_DTMS, TSAM_SLModel_DTMS, ESI_SLModel_DTMS, ESO_SLModel_DTMS, TrafficSituationActionGate_SLModel_DTMS, VSI_SLModel_DTMS, TSAM_SLModel_DTMS, ESI_SLModel_DTMS, ESO_SLModel_DTMS, TrafficSituationActionGate_SLModel_DTMS, VSI_SLModel_DTMS, TSAM_SLModel_DTMS, ESI_SLModel_DTMS, ESO_SLModel_DTMS, TrafficSituationActionGate_SLModel_DTMS, VSI_SLModel_DTMS, TSAM_SLModel_DTMS, ESI_SLModel_DTMS, ESO_SLModel_DTMS, TrafficSituationActionGate_SLModel_DTMS, VSI_SLModel_DTMS, TSAM_SLModel_DTMS, ESI_SLModel_DTMS, ESO_SLModel_DTMS, TrafficSituationActionGate_SLModel_DTMS, VSI_SLModel_DTMS, TSAM_SLModel_DTMS, ESI_SLModel_DTMS, ESO_SLModel_DTMS, TrafficSituationActionGate_SLModel_DTMS, VSI_SLModel_DTMS, TSAM_SLModel_DTMS, ESI_SLModel_DTMS, ESO_SLModel_DTMS, TrafficSituationActionGate_SLModel_DTMS, VSI_SLModel_DTMS, TSAM_SLModel_DTMS, ESI_SLModel_DTMS, ESO_SLModel_DTMS, TrafficSituationActionGate_SLModel_DTMS, VSI_SLModel_DTMS, TSAM_SLModel_DTMS, ESI_SLModel_DTMS, ESO_SLModel_DTMS, TrafficSituationActionGate_SLModel_DTMS, VSI_SLModel_DTMS, TSAM_SLModel_DTMS, ESI_SLModel_DTMS, ESO_SLModel_DTMS, TrafficSituationActionGate_SLModel_DTMS, VSI_SLModel_DTMS, TSAM_SLModel_DTMS, ESI_SLModel_DTMS, ESO_SLModel_DTMS, TrafficSituationActionGate_SLModel_DTMS, VSI_SLModel_DTMS, TSAM_SLModel_DTMS, ESI_SLModel_DTMS, ESO_SLModel_DTMS, TrafficSituationActionGate_SLModel_DTMS, VSI_SLModel_DTMS, TSAM_SLModel_DTMS, ESI_SLModel_DTMS, ESO_SLModel_DTMS, TrafficSituationActionGate_SLModel_DTMS, VSI_SLModel_DTMS, TSAM_SLModel_DTMS, ESI_SLModel_DTMS, ESO_SLModel_DTMS, TrafficSituationActionGate_SLModel_DTMS, VSI_SLModel_DTMS, TSAM_SLModel_DTMS, ESI_SLModel_DTMS, ESO_SLModel_DTMS, TrafficSituationActionGate_SLModel_DTMS, VSI_SLModel_DTMS, TSAM_SLModel_DTMS, ESI_SLModel_DTMS, ESO_SLModel_DTMS, TrafficSituationActionGate_SLModel_DTMS, VSI_SLModel_DTMS, TSAM_SLModel_DTMS, ESI_SLModel_DTMS, ESO_SLModel_DTMS, TrafficSituationActionGate_SLModel_DTMS, VSI_SLModel_DTMS, TSAM_SLModel_DTMS, ESI_SLModel_DTMS, ESO_SLModel_DTMS, TrafficSituationActionGate_SLModel_DTMS, VSI_SLModel_DTMS, TSAM_SLModel_DTMS, ESI_SLModel_DTMS, ESO_SLModel_DTMS, TrafficSituationActionGate_SLModel_DTMS, VSI_SLModel_DTMS, TSAM_SLModel_DTMS, ESI_SLModel_DTMS, ESO_SLModel_DTMS, TrafficSituationActionGate_SLModel_DTMS, VSI_SLModel_DTMS, TSAM_SLModel_DTMS, ESI_SLModel_DTMS, ESO_SLModel_DTMS, TrafficSituationActionGate_SLModel_DTMS, VSI_SLModel_DTMS, TSAM_SLModel_DTMS, ESI_SLModel_DTMS, ESO_SLModel_DTMS, TrafficSituationActionGate_SLModel_DTMS, VSI_SLModel_DTMS, TSAM_SLModel_DTMS, ESI_SLModel_DTMS, ESO_SLModel_DTMS, TrafficSituationActionGate_SLModel_DTMS, VSI_SLModel_DTMS, TSAM_SLModel_DTMS, ESI_SLModel_DTMS, ESO_SLModel_DTMS, TrafficSituationActionGate_SLModel_DTMS, VSI_SLModel_DTMS, TSAM_SLModel_DTMS, ESI_SLModel_DTMS, ESO_SLModel_DTMS, TrafficSituationActionGate_SLModel_DTMS, VSI_SLModel_DTMS, TSAM_SLModel_DTMS, ESI_SLModel_DTMS, ESO_SLModel_DTMS, TrafficSituationActionGate_SLModel_DTMS, VSI_SLModel_DTMS, TSAM_SLModel_DTMS, ESI_SLModel_DTMS, ESO_SLModel_DTMS, TrafficSituationActionGate_SLModel_DTMS, VSI_SLModel_DTMS, TSAM_SLModel_DTMS, ESI_SLModel_DTMS, ESO_SLModel_DTMS, TrafficSituationActionGate_SLModel_DTMS, VSI_SLModel_DTMS, TSAM_SLModel_DTMS, ESI_SLModel_DTMS, ESO_SLModel_DTMS, TrafficSituationActionGate_SLModel_DTMS, VSI_SLModel_DTMS, TSAM_SLModel_DTMS, ESI_SLModel_DTMS, ESO_SLModel_DTMS, TrafficSituationActionGate_SLModel_DTMS, VSI_SLModel_DTMS, TSAM_SLModel_DTMS, ESI_SLModel_DTMS, ESO_SLModel_DTMS, TrafficSituationActionGate_SLModel_DTMS, VSI_SLModel_DTMS, TSAM_SLModel_DTMS, ESI_SLModel_DTMS, ESO_SLModel_DTMS, TrafficSituationActionGate_SLModel_DTMS, VSI_SLModel_DTMS, TSAM_SLModel_DTMS, ESI_SLModel_DTMS, ESO_SLModel_DTMS, TrafficSituationActionGate_SLModel_DTMS, VSI_SLModel_DTMS, TSAM_SLModel_DTMS, ESI_SLModel_DTMS, ESO_SLModel_DTMS, TrafficSituationActionGate_SLModel_DTMS, VSI_SLModel_DTMS, TSAM_SLModel_DTMS, ESI_SLModel_DTMS, ESO_SLModel_DTMS, TrafficSituationActionGate_SLModel_DTMS, VSI_SLModel_DTMS, TSAM_SLModel_DTMS, ESI_SLModel_DTMS, ESO_SLModel_DTMS, TrafficSituationActionGate_SLModel_DTMS, VSI_SLModel_DTMS, TSAM_SLModel_DTMS, ESI_SLModel_DTMS, ESO_SLModel_DTMS, TrafficSituationActionGate_SLModel_DTMS, VSI_SLModel_DTMS, TSAM_SLModel_DTMS, ESI_SLModel_DTMS, ESO_SLModel_DTMS, TrafficSituationActionGate_SLModel_DTMS, VSI_SLModel_DTMS, TSAM_SLModel_DTMS, ESI_SLModel_DTMS, ESO_SLModel_DTMS, TrafficSituationActionGate_SLModel_DTMS, VSI_SLModel_DTMS, TSAM_SLModel_DTMS, ESI_SLModel_DTMS, ESO_SLModel_DTMS, TrafficSituationActionGate_SLModel_DTMS, VSI_SLModel_DTMS, TSAM_SLModel_DTMS, ESI_SLModel_DTMS, ESO_SLModel_DTMS, TrafficSituationActionGate_SLModel_DTMS, VSI_SLModel_DTMS, TSAM_SLModel_DTMS, ESI_SLModel_DTMS, ESO_SLModel_DTMS, TrafficSituationActionGate_SLModel_DTMS, VSI_SLModel_DTMS, TSAM_SLModel_DTMS, ESI_SLModel_DTMS, ESO_SLModel_DTMS, TrafficSituationActionGate_SLModel_DTMS, VSI_SLModel_DTMS, TSAM_SLModel_DTMS, ESI_SLModel_DTMS, ESO_SLModel_DTMS, TrafficSituationActionGate_SLModel_DTMS, VSI_SLModel_DTMS, TSAM_SLModel_DTMS, ESI_SLModel_DTMS, ESO_SLModel_DTMS, TrafficSituationActionGate_SLModel_DTMS, VSI_SLModel_DTMS, TSAM_SLModel_DTMS, ESI_SLModel_DTMS, ESO_SLModel_DTMS, TrafficSituationActionGate_SLModel_DTMS, VSI_SLModel_DTMS, TSAM_SLModel_DTMS, ESI_SLModel_DTMS, ESO_SLModel_DTMS, TrafficSituationActionGate_SLModel_DTMS, VSI_SLModel_DTMS, TSAM_SLModel_DTMS, ESI_SLModel_DTMS, ESO_SLModel_DTMS, TrafficSituationActionGate_SLModel_DTMS, VSI_SLModel_DTMS, TSAM_SLModel_DTMS, ESI_SLModel_DTMS, ESO_SLModel_DTMS, TrafficSituationActionGate_SLModel_DTMS, VSI_SLModel_DTMS, TSAM_SLModel_DTMS, ESI_SLModel_DTMS, ESO_SLModel_DTMS, TrafficSituationActionGate_SLModel_DTMS, VSI_SLModel_DTMS, TSAM_SLModel_DTMS, ESI_SLModel_DTMS, ESO_SLModel_DTMS, TrafficSituationActionGate_SLModel_DTMS, VSI_SLModel_DTMS, TSAM_SLModel_DTMS, ESI_SLModel_DTMS, ESO_SLModel_DTMS, TrafficSituationActionGate_SLModel_DTMS, VSI_SLModel_DTMS, TSAM_SLModel_DTMS, ESI_SLModel_DTMS, ESO_SLModel_DTMS, TrafficSituationActionGate_SLModel_DTMS, VSI_SLModel_DTMS, TSAM_SLModel_DTMS, ESI_SLModel_DTMS, ESO_SLModel_DTMS, TrafficSituationActionGate_SLModel_DTMS, VSI_SLModel_DTMS, TSAM_SLModel_DTMS, ESI_SLModel_DTMS, ESO_SLModel_DTMS, TrafficSituationActionGate_SLModel_DTMS, VSI_SLModel_DTMS, TSAM_SLModel_DTMS, ESI_SLModel_DTMS, ESO_SLModel_DTMS, TrafficSituationActionGate_SLModel_DTMS, VSI_SLModel_DTMS, TSAM_SLModel_DTMS, ESI_SLModel_DTMS, ESO_SLModel_DTMS, TrafficSituationActionGate_SLModel_DTMS, VSI_SLModel_DTMS, TSAM_SLModel_DTMS, ESI_SLModel_DTMS, ESO_SLModel_DTMS, TrafficSituationActionGate_SLModel_DTMS, VSI_SLModel_DTMS, TSAM_SLModel_DTMS, ESI_SLModel_DTMS, ESO_SLModel_DTMS, TrafficSituationActionGate_SLModel_DTMS, VSI_SLModel_DTMS, TSAM_SLModel_DTMS, ESI_SLModel_DTMS, ESO_SLModel_DTMS, TrafficSituationActionGate_SLModel_DTMS, VSI_SLModel_DTMS, TSAM_SLModel_DTMS, ESI_SLModel_DTMS, ESO_SLModel_DTMS, TrafficSituationActionGate_SLModel_DTMS, VSI_SLModel_DTMS, TSAM_SLModel_DTMS, ESI_SLModel_DTMS, ESO_SLModel_DTMS, TrafficSituationActionGate_SLModel_DTMS, VSI_SLModel_DTMS, TSAM_SLModel_DTMS, ESI_SLModel_DTMS, ESO_SLModel_DTMS, TrafficSituationActionGate_SLModel_DTMS, VSI_SLModel_DTMS, TSAM_SLModel_DTMS, ESI_SLModel_DTMS, ESO_SLModel_DTMS, TrafficSituationActionGate_SLModel_DTMS, VSI_SLModel_DTMS, TSAM_SLModel_DTMS, ESI_SLModel_DTMS, ESO_SLModel_DTMS, TrafficSituationActionGate_SLModel_DTMS, VSI_SLModel_DTMS, TSAM_SLModel_DTMS, ESI_SLModel_DTMS, ESO_SLModel_DTMS, TrafficSituationActionGate_SLModel_DTMS, VSI_SLModel_DTMS, TSAM_SLModel_DTMS, ESI_SLModel_DTMS, ESO_SLModel_DTMS, TrafficSituationActionGate_SLModel_DTMS, VSI_SLModel_DTMS, TSAM_SLModel_DTMS, ESI_SLModel_DTMS, ESO_SLModel_DTMS, TrafficSituationActionGate_SLModel_DTMS, VSI_SLModel_DTMS, TSAM_SLModel_DTMS, ESI_SLModel_DTMS, ESO_SLModel_DTMS, TrafficSituationActionGate_SLModel_DTMS, VSI_SLModel_DTMS, TSAM_SLModel_DTMS, ESI_SLModel_DTMS, ESO_SLModel_DTMS, TrafficSituationActionGate_SLModel_DTMS, VSI_SLModel_DTMS, TSAM_SLModel_DTMS, ESI_SLModel_DTMS, ESO_SLModel_DTMS, TrafficSituationActionGate_SLModel_DTMS, VSI_SLModel_DTMS, TSAM_SLModel_DTMS, ESI_SLModel_DTMS, ESO_SLModel_DTMS, TrafficSituationActionGate_SLModel_DTMS, VSI_SLModel_DTMS, TSAM_SLModel_DTMS, ESI_SLModel_DTMS, ESO_SLModel_DTMS, TrafficSituationActionGate_SLModel_DTMS, VSI_SLModel_DTMS, TSAM_SLModel_DTMS, ESI_SLModel_DTMS, ESO_SLModel_DTMS, TrafficSituationActionGate_SLModel_DTMS, VSI_SLModel_DTMS, TSAM_SLModel_DTMS, ESI_SLModel_DTMS, ESO_SLModel_DTMS, TrafficSituationActionGate_SLModel_DTMS, VSI_SLModel_DTMS, TSAM_SLModel_DTMS, ESI_SLModel_DTMS, ESO_SLModel_DTMS, TrafficSituationActionGate_SLModel_DTMS, VSI_SLModel_DTMS, TSAM_SLModel_DTMS, ESI_SLModel_DTMS, ESO_SLModel_DTMS, TrafficSituationActionGate_SLModel_DTMS, VSI_SLModel_DTMS, TSAM_SLModel_DTMS, ESI_SLModel_DTMS, ESO_SLModel_DTMS, TrafficSituationActionGate_SLModel_DTMS, VSI_SLModel_DTMS, TSAM_SLModel_DTMS, ESI_SLModel_DTMS, ESO_SLModel_DTMS, TrafficSituationActionGate_SLModel_DTMS, VSI_SLModel_DTMS, TSAM_SLModel_DTMS, ESI_SLModel_DTMS, ESO_SLModel_DTMS, TrafficSituationActionGate_SLModel_DTMS, VSI_SLModel_DTMS, TSAM_SLModel_DTMS, ESI_SLModel_DTMS, ESO_SLModel_DTMS, TrafficSituationActionGate_SLModel_DTMS, VSI_SLModel_DTMS, TSAM_SLModel_DTMS, ESI_SLModel_DTMS, ESO_SLModel_DTMS, TrafficSituationActionGate_SLModel_DTMS, VSI_SLModel_DTMS, TSAM_SLModel_DTMS, ESI_SLModel_DTMS, ESO_SLModel_DTMS, TrafficSituationActionGate_SLModel_DTMS, VSI_SLModel_DTMS, TSAM_SLModel_DTMS, ESI_SLModel_DTMS, ESO_SLModel_DTMS, TrafficSituationActionGate_SLModel_DTMS, VSI_SLModel_DTMS, TSAM_SLModel_DTMS, ESI_SLModel_DTMS, ESO_SLModel_DTMS, TrafficSituationActionGate_SLModel_DTMS, VSI_SLModel_DTMS, TSAM_SLModel_DTMS, ESI_SLModel_DTMS, ESO_SLModel_DTMS, TrafficSituationActionGate_SLModel_DTMS, VSI_SLModel_DTMS, TSAM_SLModel_DTMS, ESI_SLModel_DTMS, ESO_SLModel_DTMS, TrafficSituationActionGate_SLModel_DTMS, VSI_SLModel_DTMS, TSAM_SLModel_DTMS, ESI_SLModel_DTMS, ESO_SLModel_DTMS, TrafficSituationActionGate_SLModel_DTMS, VSI_SLModel_DTMS, TSAM_SLModel_DTMS, ESI_SLModel_DTMS, ESO_SLModel_DTMS, TrafficSituationActionGate_SLModel_DTMS, VSI_SLModel_DTMS, TSAM_SLModel_DTMS, ESI_SLModel_DTMS, ESO_SLModel_DTMS, TrafficSituationActionGate_SLModel_DTMS, VSI_SLModel_DTMS, TSAM_SLModel_DTMS, ESI_SLModel_DTMS, ESO_SLModel_DTMS, TrafficSituationActionGate_SLModel_DTMS, VSI_SLModel_DTMS, TSAM_SLModel_DTMS, ESI_SLModel_DTMS, ESO_SLModel_DTMS, TrafficSituationActionGate_SLModel_DTMS, VSI_SLModel_DTMS, TSAM_SLModel_DTMS, ESI_SLModel_DTMS, ESO_SLModel_DTMS, TrafficSituationActionGate_SLModel_DTMS, VSI_SLModel_DTMS, TSAM_SLModel_DTMS, ESI_SLModel_DTMS, ESO_SLModel_DTMS, TrafficSituationActionGate_SLModel_DTMS, VSI_SLModel_DTMS, TSAM_SLModel_DTMS, ESI_SLModel_DTMS, ESO_SLModel_DTMS, TrafficSituationActionGate_SLModel_DTMS, VSI_SLModel_DTMS, TSAM_SLModel_DTMS, ESI_SLModel_DTMS, ESO_SLModel_DTMS, TrafficSituationActionGate_SLModel_DTMS, VSI_SLModel_DTMS, TSAM_SLModel_DTMS, ESI_SLModel_DTMS, ESO_SLModel_DTMS, TrafficSituationActionGate_SLModel_DTMS, VSI_SLModel_DTMS, TSAM_SLModel_DTMS, ESI_SLModel_DTMS, ESO_SLModel_DTMS, TrafficSituationActionGate_SLModel_DTMS, VSI_SLModel_DTMS, TSAM_SLModel_DTMS, ESI_SLModel_DTMS, ESO_SLModel_DTMS, TrafficSituationActionGate_SLModel_DTMS, VSI_SLModel_DTMS, TSAM_SLModel_DTMS, ESI_SLModel_DTMS, ESO_SLModel_DTMS, TrafficSituationActionGate_SLModel_DTMS, VSI_SLModel_DTMS, TSAM_SLModel_DTMS, ESI_SLModel_DTMS, ESO_SLModel_DTMS, TrafficSituationActionGate_SLModel_DTMS, VSI_SLModel_DTMS, TSAM_SLModel_DTMS, ESI_SLModel_DTMS, ESO_SLModel_DTMS, TrafficSituationActionGate_SLModel_DTMS, VSI_SLModel_DTMS, TSAM_SLModel_DTMS, ESI_SLModel_DTMS, ESO_SLModel_DTMS, TrafficSituationActionGate_SLModel_DTMS, VSI_SLModel_DTMS, TSAM_SLModel_DTMS, ESI_SLModel_DTMS, ESO_SLModel_DTMS, TrafficSituationActionGate_SLModel_DTMS, VSI_SLModel_DTMS, TSAM_SLModel_DTMS, ESI_SLModel_DTMS, ESO_SLModel_DTMS, TrafficSituationActionGate_SLModel_DTMS, VSI_SLModel_DTMS, TSAM_SLModel_DTMS, ESI_SLModel_DTMS, ESO_SLModel_DTMS, TrafficSituationActionGate_SLModel_DTMS, VSI_SLModel_DTMS, TSAM_SLModel_DTMS, ESI_SLModel_DTMS, ESO_SLModel_DTMS, TrafficSituationActionGate_SLModel_DTMS, VSI_SLModel_DTMS, TSAM_SLModel_DTMS, ESI_SLModel_DTMS, ESO_SLModel_DTMS, TrafficSituationActionGate_SLModel_DTMS, VSI_SLModel_DTMS, TSAM_SLModel_DTMS, ESI_SLModel_DTMS, ESO_SLModel_DTMS, TrafficSituationActionGate_SLModel_DTMS, VSI_SLModel_DTMS, TSAM_SLModel_DTMS, ESI_SLModel_DTMS, ESO_SLModel_DTMS, TrafficSituationActionGate_SLModel_DTMS, VSI_SLModel_DTMS, TSAM_SLModel_DTMS, ESI_SLModel_DTMS, ESO_SLModel_DTMS, TrafficSituationActionGate_SLModel_DTMS, VSI_SLModel_DTMS, TSAM_SLModel_DTMS, ESI_SLModel_DTMS, ESO_SLModel_DTMS, TrafficSituationActionGate_SLModel_DTMS, VSI_SLModel_DTMS, TSAM_SLModel_DTMS, ESI_SLModel_DTMS, ESO_SLModel_DTMS, TrafficSituationActionGate_SLModel_DTMS, VSI_SLModel_DTMS, TSAM_SLModel_DTMS, ESI_SLModel_DTMS, ESO_SLModel_DTMS, TrafficSituationActionGate_SLModel_DTMS, VSI_SLModel_DTMS, TSAM_SLModel_DTMS, ESI_SLModel_DTMS, ESO_SLModel_DTMS, TrafficSituationActionGate_SLModel_DTMS, VSI_SLModel_DTMS, TSAM_SLModel_DTMS, ESI_SLModel_DTMS, ESO_SLModel_DTMS, TrafficSituationActionGate_SLModel_DTMS, VSI_SLModel_DTMS, TSAM_SLModel_DTMS, ESI_SLModel_DTMS, ESO_SLModel_DTMS, TrafficSituationActionGate_SLModel_DTMS, VSI_SLModel_DTMS, TSAM_SLModel_DTMS, ESI_SLModel_DTMS, ESO_SLModel_DTMS, TrafficSituationActionGate_SLModel_DTMS, VSI_SLModel_DTMS, TSAM_SLModel_DTMS, ESI_SLModel_DTMS, ESO_SLModel_DTMS, TrafficSituationActionGate_SLModel_DTMS, VSI_SLModel_DTMS, TSAM_SLModel_DTMS, ESI_SLModel_DTMS, ESO_SLModel_DTMS, TrafficSituationActionGate_SLModel_DTMS, VSI_SLModel_DTMS, TSAM_SLModel_DTMS, ESI_SLModel_DTMS, ESO_SLModel_DTMS, TrafficSituationActionGate_SLModel_DTMS, VSI_SLModel_DTMS, TSAM_SLModel_DTMS, ESI_SLModel_DTMS, ESO_SLModel_DTMS, TrafficSituationActionGate_SLModel_DTMS, VSI_SLModel_DTMS, TSAM_SLModel_DTMS, ESI_SLModel_DTMS, ESO_SLModel_DTMS, TrafficSituationActionGate_SLModel_DTMS, VSI_SLModel_DTMS, TSAM_SLModel_DTMS, ESI_SLModel_DTMS, ESO_SLModel_DTMS, TrafficSituationActionGate_SLModel_DTMS, VSI_SLModel_DTMS, TSAM_SLModel_DTMS, ESI_SLModel_DTMS, ESO_SLModel_DTMS, TrafficSituationActionGate_SLModel_DTMS, VSI_SLModel_DTMS, TSAM_SLModel_DTMS, ESI_SLModel_DTMS, ESO_SLModel_DTMS, TrafficSituationActionGate_SLModel_DTMS, VSI_SLModel_DTMS, TSAM_SLModel_DTMS, ESI_SLModel_DTMS, ESO_SLModel_DTMS, TrafficSituationActionGate_SLModel_DTMS, VSI_SLModel_DTMS, TSAM_SLModel_DTMS, ESI_SLModel_DTMS, ESO_SLModel_DTMS, TrafficSituationActionGate_SLModel_DTMS, VSI_SLModel_DTMS, TSAM_SLModel_DTMS, ESI_SLModel_DTMS, ESO_SLModel_DTMS, TrafficSituationActionGate_SLModel_DTMS, VSI_SLModel_DTMS, TSAM_SLModel_DTMS, ESI_SLModel_DTMS, ESO_SLModel_DTMS, TrafficSituationActionGate_SLModel_DTMS, VSI_SLModel_DTMS, TSAM_SLModel_DTMS, ESI_SLModel_DTMS, ESO_SLModel_DTMS, TrafficSituationActionGate_SLModel_DTMS, VSI_SLModel_DTMS, TSAM_SLModel_DTMS, ESI_SLModel_DTMS, ESO_SLModel_DTMS, TrafficSituationActionGate_SLModel_DTMS, VSI_SLModel_DTMS, TSAM_SLModel_DTMS, ESI_SLModel_DTMS, ESO_SLModel_DTMS, TrafficSituationActionGate_SLModel_DTMS, VSI_SLModel_DTMS, TSAM_SLModel_DTMS, ESI_SLModel_DTMS, ESO_SLModel_DTMS, TrafficSituationActionGate_SLModel_DTMS, VSI_SLModel_DTMS, TSAM_SLModel_DTMS, ESI_SLModel_DTMS, ESO_SLModel_DTMS, TrafficSituationActionGate_SLModel_DTMS, VSI_SLModel_DTMS, TSAM_SLModel_DTMS, ESI_SLModel_DTMS, ESO_SLModel_DTMS, TrafficSituationActionGate_SLModel_DTMS, VSI_SLModel_DTMS, TSAM_SLModel_DTMS, ESI_SLModel_DTMS, ESO_SLModel_DTMS, TrafficSituationActionGate_SLModel_DTMS, VSI_SLModel_DTMS, TSAM_SLModel_DTMS, ESI_SLModel_DTMS, ESO_SLModel_DTMS, TrafficSituationActionGate_SLModel_DTMS, VSI_SLModel_DTMS, TSAM_SLModel_DTMS, ESI_SLModel_DTMS, ESO_SLModel_DTMS, TrafficSituationActionGate_SLModel_DTMS, VSI_SLModel_DTMS, TSAM_SLModel_DTMS, ESI_SLModel_DTMS, ESO_SLModel_DTMS, TrafficSituationActionGate_SLModel_DTMS, VSI_SLModel_DTMS, TSAM_SLModel_DTMS, ESI_SLModel_DTMS, ESO_SLModel_DTMS, TrafficSituationActionGate_SLModel_DTMS, VSI_SLModel_DTMS, TSAM_SLModel_DTMS, ESI_SLModel_DTMS, ESO_SLModel_DTMS, TrafficSituationActionGate_SLModel_DTMS, VSI_SLModel_DTMS, TSAM_SLModel_DTMS, ESI_SLModel_DTMS, ESO_SLModel_DTMS, TrafficSituationActionGate_SLModel_DTMS, VSI_SLModel_DTMS, TSAM_SLModel_DTMS, ESI_SLModel_DTMS, ESO_SLModel_DTMS, TrafficSituationActionGate_SLModel_DTMS, VSI_SLModel_DTMS, TSAM_SLModel_DTMS, ESI_SLModel_DTMS, ESO_SLModel_DTMS, TrafficSituationActionGate_SLModel_DTMS, VSI_SLModel_DTMS, TSAM_SLModel_DTMS, ESI_SLModel_DTMS, ESO_SLModel_DTMS, TrafficSituationActionGate_SLModel_DTMS, VSI_SLModel_DTMS, TSAM_SLModel_DTMS, ESI_SLModel_DTMS, ESO_SLModel_DTMS, TrafficSituationActionGate_SLModel_DTMS, VSI_SLModel_DTMS, TSAM_SLModel_DTMS, ESI_SLModel_DTMS, ESO_SLModel_DTMS, TrafficSituationActionGate_SLModel_DTMS, VSI_SLModel_DTMS, TSAM_SLModel_DTMS, ESI_SLModel_DTMS, ESO_SLModel_DTMS, TrafficSituationActionGate_SLModel_DTMS, VSI_SLModel_DTMS, TSAM_SLModel_DTMS, ESI_SLModel_DTMS, ESO_SLModel_DTMS, TrafficSituationActionGate_SLModel_DTMS, VSI_SLModel_DTMS, TSAM_SLModel_DTMS, ESI_SLModel_DTMS, ESO_SLModel_DTMS, TrafficSituationActionGate_SLModel_DTMS, VSI_SLModel_DTMS, TSAM_SLModel_DTMS, ESI_SLModel_DTMS, ESO_SLModel_DTMS, TrafficSituationActionGate_SLModel_DTMS, VSI_SLModel_DTMS, TSAM_SLModel_DTMS, ESI_SLModel_DTMS, ESO_SLModel_DTMS, TrafficSituationActionGate_SLModel_DTMS, VSI_SLModel_DTMS, TSAM_SLModel_DTMS, ESI_SLModel_DTMS, ESO_SLModel_DTMS, TrafficSituationActionGate_SLModel_DTMS, VSI_SLModel_DTMS, TSAM_SLModel_DTMS, ESI_SLModel_DTMS, ESO_SLModel_DTMS, TrafficSituationActionGate_SLModel_DTMS, VSI_SLModel_DTMS, TSAM_SLModel_DTMS, ESI_SLModel_DTMS, ESO_SLModel_DTMS, TrafficSituationActionGate_SLModel_DTMS, VSI_SLModel_DTMS, TSAM_SLModel_DTMS, ESI_SLModel_DTMS, ESO_SLModel_DTMS, TrafficSituationActionGate_SLModel_DTMS, VSI_SLModel_DTMS, TSAM_SLModel_DTMS, ESI_SLModel_DTMS, ESO_SLModel_DTMS, TrafficSituationActionGate_SLModel_DTMS, VSI_SLModel_DTMS, TSAM_SLModel_DTMS, ESI_SLModel_DTMS, ESO_SLModel_DTMS, TrafficSituationActionGate_SLModel_DTMS, VSI_SLModel_DTMS, TSAM_SLModel_DTMS, ESI_SLModel_DTMS, ESO_SLModel_DTMS, TrafficSituationActionGate_SLModel_DTMS, VSI_SLModel_DTMS, TSAM_SLModel_DTMS, ESI_SLModel_DTMS, ESO_SLModel_DTMS, TrafficSituationActionGate_SLModel_DTMS, VSI_SLModel_DTMS, TSAM_SLModel_DTMS, ESI_SLModel_DTMS, ESO_SLModel_DTMS, TrafficSituationActionGate_SLModel_DTMS, VSI_SLModel_DTMS, TSAM_SLModel_DTMS, ESI_SLModel_DTMS, ESO_SLModel_DTMS, TrafficSituationActionGate_SLModel_DTMS, VSI_SLModel_DTMS, TSAM_SLModel_DTMS, ESI_SLModel_DTMS, ESO_SLModel_DTMS, TrafficSituationActionGate_SLModel_DTMS, VSI_SLModel_DTMS, TSAM_SLModel_DTMS, ESI_SLModel_DTMS, ESO_SLModel_DTMS, TrafficSituationActionGate_SLModel_DTMS, VSI_SLModel_DTMS, TSAM_SLModel_DTMS, ESI_SLModel_DTMS, ESO_SLModel_DTMS, TrafficSituationActionGate_SLModel_DTMS, VSI_SLModel_DTMS, TSAM_SLModel_DTMS, ESI_SLModel_DTMS, ESO_SLModel_DTMS, TrafficSituationActionGate_SLModel_DTMS, VSI_SLModel_DTMS, TSAM_SLModel_DTMS, ESI_SLModel_DTMS, ESO_SLModel_DTMS, TrafficSituationActionGate_SLModel_DTMS, VSI_SLModel_DTMS, TSAM_SLModel_DTMS, ESI_SLModel_DTMS, ESO_SLModel_DTMS, TrafficSituationActionGate_SLModel_DTMS, VSI_SLModel_DTMS, TSAM_SLModel_DTMS, ESI_SLModel_DTMS, ESO_SLModel_DTMS, TrafficSituationActionGate_SLModel_DTMS, VSI_SLModel_DTMS, TSAM_SLModel_DTMS, ESI_SLModel_DTMS, ESO_SLModel_DTMS, TrafficSituationActionGate_SLModel_DTMS, VSI_SLModel_DTMS, TSAM_SLModel_DTMS, ESI_SLModel_DTMS, ESO_SLModel_DTMS, TrafficSituationActionGate_SLModel_DTMS, VSI_SLModel_DTMS, TSAM_SLModel_DTMS, ESI_SLModel_DTMS, ESO_SLModel_DTMS, TrafficSituationActionGate_SLModel_DTMS, VSI_SLModel_DTMS, TSAM_SLModel_DTMS, ESI_SLModel_DTMS, ESO_SLModel_DTMS, TrafficSituationActionGate_SLModel_DTMS, VSI_SLModel_DTMS, TSAM_SLModel_DTMS, ESI_SLModel_DTMS, ESO_SLModel_DTMS, TrafficSituationActionGate_SLModel_DTMS, VSI_SLModel_DTMS, TSAM_SLModel_DTMS, ESI_SLModel_DTMS, ESO_SLModel_DTMS, TrafficSituationActionGate_SLModel_DTMS, VSI_SLModel_DTMS, TSAM_SLModel_DTMS, ESI_SLModel_DTMS, ESO_SLModel_DTMS, TrafficSituationActionGate_SLModel_DTMS, VSI_SLModel_DTMS, TSAM_SLModel_DTMS, ESI_SLModel_DTMS, ESO_SLModel_DTMS, TrafficSituationActionGate_SLModel_DTMS, VSI_SLModel_DTMS, TSAM_SLModel_DTMS, ESI_SLModel_DTMS, ESO_SLModel_DTMS, TrafficSituationActionGate_SLModel_DTMS, VSI_SLModel_DTMS, TSAM_SLModel_DTMS, ESI_SLModel_DTMS, ESO_SLModel_DTMS, TrafficSituationActionGate_SLModel_DTMS, VSI_SLModel_DTMS, TSAM_SLModel_DTMS, ESI_SLModel_DTMS, ESO_SLModel_DTMS, TrafficSituationActionGate_SLModel_DTMS, VSI_SLModel_DTMS, TSAM_SLModel_DTMS, ESI_SLModel_DTMS, ESO_SLModel_DTMS, TrafficSituationActionGate_SLModel_DTMS, VSI_SLModel_DTMS, TSAM_SLModel_DTMS, ESI_SLModel_DTMS, ESO_SLModel_DTMS, TrafficSituationActionGate_SLModel_DTMS, VSI_SLModel_DTMS, TSAM_SLModel_DTMS, ESI_SLModel_DTMS, ESO_SLModel_DTMS, TrafficSituationActionGate_SLModel_DTMS, VSI_SLModel_DTMS, TSAM_SLModel_DTMS, ESI_SLModel_DTMS, ESO_SLModel_DTMS, TrafficSituationActionGate_SLModel_DTMS, VSI_SLModel_DTMS, TSAM_SLModel_DTMS, ESI_SLModel_DTMS, ESO_SLModel_DTMS, TrafficSituationActionGate_SLModel_DTMS, VSI_SLModel_DTMS, TSAM_SLModel_DTMS, ESI_SLModel_DTMS, ESO_SLModel_DTMS, TrafficSituationActionGate_SLModel_DTMS, VSI_SLModel_DTMS, TSAM_SLModel_DTMS, ESI_SLModel_DTMS, ESO_SLModel_DTMS, TrafficSituationActionGate_SLModel_DTMS, VSI_SLModel_DTMS, TSAM_SLModel_DTMS, ESI_SLModel_DTMS, ESO_SLModel_DTMS, TrafficSituationActionGate_SLModel_DTMS, VSI_SLModel_DTMS, TSAM_SLModel_DTMS, ESI_SLModel_DTMS, ESO_SLModel_DTMS, TrafficSituationActionGate_SLModel_DTMS, VSI_SLModel_DTMS, TSAM_SLModel_DTMS, ESI_SLModel_DTMS, ESO_SLModel_DTMS, TrafficSituationActionGate_SLModel_DTMS, VSI_SLModel_DTMS, TSAM_SLModel_DTMS, ESI_SLModel_DTMS, ESO_SLModel_DTMS, TrafficSituationActionGate_SLModel_DTMS, VSI_SLModel_DTMS, TSAM_SLModel_DTMS, ESI_SLModel_DTMS, ESO_SLModel_DTMS, TrafficSituationActionGate_SLModel_DTMS, VSI_SLModel_DTMS, TSAM_SLModel_DTMS, ESI_SLModel_DTMS, ESO_SLModel_DTMS, TrafficSituationActionGate_SLModel_DTMS, VSI_SLModel_DTMS, TSAM_SLModel_DTMS, ESI_SLModel_DTMS, ESO_SLModel_DTMS, TrafficSituationActionGate_SLModel_DTMS, VSI_SLModel_DTMS, TSAM_SLModel_DTMS, ESI_SLModel_DTMS, ESO_SLModel_DTMS, TrafficSituationActionGate_SLModel_DTMS, VSI_SLModel_DTMS, TSAM_SLModel_DTMS, ESI_SLModel_DTMS, ESO_SLModel_DTMS, TrafficSituationActionGate_SLModel_DTMS, VSI_SLModel_DTMS, TSAM_SLModel_DTMS, ESI_SLModel_DTMS, ESO_SLModel_DTMS, TrafficSituationActionGate_SLModel_DTMS, VSI_SLModel_DTMS, TSAM_SLModel_DTMS, ESI_SLModel_DTMS, ESO_SLModel_DTMS, TrafficSituationActionGate_SLModel_DTMS, VSI_SLModel_DTMS, TSAM_SLModel_DTMS, ESI_SLModel_DTMS, ESO_SLModel_DTMS, TrafficSituationActionGate_SLModel_DTMS, VSI_SLModel_DTMS, TSAM_SLModel_DTMS, ESI_SLModel_DTMS, ESO_SLModel_DTMS, TrafficSituationActionGate_SLModel_DTMS, VSI_SLModel_DTMS, TSAM_SLModel_DTMS, ESI_SLModel_DTMS, ESO_SLModel_DTMS, TrafficSituationActionGate_SLModel_DTMS, VSI_SLModel_DTMS, TSAM_SLModel_DTMS, ESI_SLModel_DTMS, ESO_SLModel_DTMS, TrafficSituationActionGate_SLModel_DTMS, VSI_SLModel_DTMS, TSAM_SLModel_DTMS, ESI_SLModel_DTMS, ESO_SLModel_DTMS, TrafficSituationActionGate_SLModel_DTMS, VSI_SLModel_DTMS, TSAM_SLModel_DTMS, ESI_SLModel_DTMS, ESO_SLModel_DTMS, TrafficSituationActionGate_SLModel_DTMS, VSI_SLModel_DTMS, TSAM_SLModel_DTMS, ESI_SLModel_DTMS, ESO_SLModel_DTMS, TrafficSituationActionGate_SLModel_DTMS, VSI_SLModel_DTMS, TSAM_SLModel_DTMS, ESI_SLModel_DTMS, ESO_SLModel_DTMS, TrafficSituationActionGate_SLModel_DTMS, VSI_SLModel_DTMS, TSAM_SLModel_DTMS, ESI_SLModel_DTMS, ESO_SLModel_DTMS, TrafficSituationActionGate_SLModel_DTMS, VSI_SLModel_DTMS, TSAM_SLModel_DTMS, ESI_SLModel_DTMS, ESO_SLModel_DTMS, TrafficSituationActionGate_SLModel_DTMS, VSI_SLModel_DTMS, TSAM_SLModel_DTMS, ESI_SLModel_DTMS, ESO_SLModel_DTMS, TrafficSituationActionGate_SLModel_DTMS, VSI_SLModel_DTMS, TSAM_SLModel_DTMS, ESI_SLModel_DTMS, ESO_SLModel_DTMS, TrafficSituationActionGate_SLModel_DTMS, VSI_SLModel_DTMS, TSAM_SLModel_DTMS, ESI_SLModel_DTMS, ESO_SLModel_DTMS, TrafficSituationActionGate_SLModel_DTMS, VSI_SLModel_DTMS, TSAM_SLModel_DTMS, ESI_SLModel_DTMS, ESO_SLModel_DTMS, TrafficSituationActionGate_SLModel_DTMS, VSI_SLModel_DTMS, TSAM_SLModel_DTMS, ESI_SLModel_DTMS, ESO_SLModel_DTMS, TrafficSituationActionGate_SLModel_DTMS, VSI_SLModel_DTMS, TSAM_SLModel_DTMS, ESI_SLModel_DTMS, ESO_SLModel_DTMS, TrafficSituationActionGate_SLModel_DTMS, VSI_SLModel_DTMS, TSAM_SLModel_DTMS, ESI_SLModel_DTMS, ESO_SLModel_DTMS, TrafficSituationActionGate_SLModel_DTMS, VSI_SLModel_DTMS, TSAM_SLModel_DTMS, ESI_SLModel_DTMS, ESO_SLModel_DTMS, TrafficSituationActionGate_SLModel_DTMS, VSI_SLModel_DTMS, TSAM_SLModel_DTMS, ESI_SLModel_DTMS, VSI_SLModel_DTMS]
    72 x provide port:
      ACC_SGO_Status: nonqueued-sender-com-spec=data-element=ACC_SGO_Status, provided-interface=ACC_SGO_Status_I
      ACC_SGOFaultCondStat: nonqueued-sender-com-spec=data-element=ACC_SGOFaultCondStat, provided-interface=ACC_SGOFaultCondStat_I
      ACC_Status: nonqueued-sender-com-spec=data-element=ACC_Status, provided-interface=ACC_Status_I
      ACC_Status_BB1_X_D: nonqueued-sender-com-spec=data-element=ACC_Status_BB1_X_D, provided-interface=ACC_Status_BB1_X_D_I
      ACCBrakeCapacityWarning: nonqueued-sender-com-spec=data-element=ACCBrakeCapacityWarning, provided-interface=ACCBrakeCapacityWarning_I
      ACCBrakeCapacityWarning_MD: nonqueued-sender-com-spec=data-element=ACCBrakeCapacityWarning, provided-interface=ACCBrakeCapacityWarning_I
      ACCBrakeRequestStatus: nonqueued-sender-com-spec=data-element=ACCBrakeRequestStatus, provided-interface=ACCBrakeRequestStatus_I
      ACCForwardVehicleDistance: nonqueued-sender-com-spec=data-element=ACCForwardVehicleDistance, provided-interface=ACCForwardVehicleDistance_I
      ACCForwardVehicleDistance_MD: nonqueued-sender-com-spec=data-element=ACCForwardVehicleDistance, provided-interface=ACCForwardVehicleDistance_I
      ACCForwardVehicleSpeed: nonqueued-sender-com-spec=data-element=ACCForwardVehicleSpeed, provided-interface=ACCForwardVehicleSpeed_I
      ACCForwardVehicleSpeed_MD: nonqueued-sender-com-spec=data-element=ACCForwardVehicleSpeed, provided-interface=ACCForwardVehicleSpeed_I
      ACCHMIStatus: nonqueued-sender-com-spec=data-element=ACCHMIStatus, provided-interface=ACCHMIStatus_I
      ACCHSARequest: nonqueued-sender-com-spec=data-element=ACCHSARequest, provided-interface=ACCHSARequest_I
      ACCiRollInhibit: nonqueued-sender-com-spec=data-element=ACCiRollInhibit, provided-interface=ACCiRollInhibit_I
      ACCiSeeDistanceGap: nonqueued-sender-com-spec=data-element=ACCiSeeDistanceGap, provided-interface=ACCiSeeDistanceGap_I
      ACCTargetDetected: nonqueued-sender-com-spec=data-element=ACCTargetDetected, provided-interface=ACCTargetDetected_I
      ACCTargetDetected_MD: nonqueued-sender-com-spec=data-element=ACCTargetDetected, provided-interface=ACCTargetDetected_I
      ACCTargetRelLongSpeed: nonqueued-sender-com-spec=data-element=ACCTargetRelLongSpeed, provided-interface=ACCTargetRelLongSpeed_I
      AdaptiveCruiseControlMode: nonqueued-sender-com-spec=data-element=AdaptiveCruiseControlMode, provided-interface=AdaptiveCruiseControlMode_I
      AdaptiveCruiseControlSetDistan: nonqueued-sender-com-spec=data-element=AdaptiveCruiseControlSetDistan, provided-interface=AdaptiveCruiseControlSetDistan_I
      BB_XBR_RqstActive: nonqueued-sender-com-spec=data-element=BB_XBR_RqstActive, provided-interface=BB_XBR_RqstActive_I
      BBSteeringStatus: nonqueued-sender-com-spec=data-element=BBSteeringStatus, provided-interface=BBSteeringStatus_I
      CM_DisengageDrivelineRequest: nonqueued-sender-com-spec=data-element=CM_DisengageDrivelineRequest, provided-interface=CM_DisengageDrivelineRequest_I
      CM_Status: nonqueued-sender-com-spec=data-element=CM_Status, provided-interface=CM_Status_I
      CMReducedAbilityStatus: nonqueued-sender-com-spec=data-element=CMReducedAbilityStatus, provided-interface=CMReducedAbilityStatus_I
      CMTargetID: nonqueued-sender-com-spec=data-element=TargetID, provided-interface=TargetID_I
      CollisionSituationAliveAck: nonqueued-sender-com-spec=data-element=CollisionSituationAliveAck, provided-interface=CollisionSituationAliveAck_I
      CollSituationHazardLightReq: nonqueued-sender-com-spec=data-element=HazardLightRequest, provided-interface=HazardLightRequest_I
      CWEB_Out: nonqueued-sender-com-spec=data-element=CWEB_Out, provided-interface=CWEB_Out_I
      DASApplicationStatus: nonqueued-sender-com-spec=data-element=DASApplicationStatus, provided-interface=DASApplicationStatus_I
      DASWarning_BB1_X_D: nonqueued-sender-com-spec=data-element=DASWarning_BB1_X_D, provided-interface=DASWarning_BB1_X_D_I
      DisengageDrivelineRequest: nonqueued-sender-com-spec=data-element=DisengageDrivelineRequest, provided-interface=DisengageDrivelineRequest_I
      DriverImpairedDriverAlert: nonqueued-sender-com-spec=data-element=DriverImpairedDriverAlert, provided-interface=DriverImpairedDriverAlert_I
      DriverVigilanceLevel: nonqueued-sender-com-spec=data-element=DriverVigilanceLevel, provided-interface=DriverVigilanceLevel_I
      DriverVigilanceLevel_BB1_X_D: nonqueued-sender-com-spec=data-element=DriverVigilanceLevel_BB1_X_D, provided-interface=DriverVigilanceLevel_BB1_X_D_I
      EgoVehicleTrajectoryPlanner_Out: nonqueued-sender-com-spec=data-element=EgoVehicleTrajectoryPlanner_Out, provided-interface=EgoVehicleTrajectoryPlanner_Out_I
      FASControlMode: nonqueued-sender-com-spec=data-element=FASControlMode, provided-interface=FASControlMode_I
      FASCurvatureRequest: nonqueued-sender-com-spec=data-element=FASCurvatureRequest, provided-interface=FASCurvatureRequest_I
      FASExtCtrlMsgChecksum: nonqueued-sender-com-spec=data-element=XBRMessageChecksum, provided-interface=XBRMessageChecksum_I
      FASExtCtrlMsgCounter: nonqueued-sender-com-spec=data-element=XBRMessageCounter, provided-interface=XBRMessageCounter_I
      FASHapticFeedbackRequest: nonqueued-sender-com-spec=data-element=FASHapticFeedbackRequest, provided-interface=FASHapticFeedbackRequest_I
      FASRoadWheelAngleRequest: nonqueued-sender-com-spec=data-element=FASRoadWheelAngleRequest, provided-interface=FASRoadWheelAngleRequest_I
      FCW_Status: nonqueued-sender-com-spec=data-element=FCW_Status, provided-interface=FCW_Status_I
      FrontalCollisionDriverAlert: nonqueued-sender-com-spec=data-element=FrontalCollisionDriverAlert, provided-interface=FrontalCollisionDriverAlert_I
      FrontCollisionDriverAlrt_BB1_X_D: nonqueued-sender-com-spec=data-element=FrontCollisionDriverAlrt_BB1_X_D, provided-interface=FrontCollisionDriverAlrt_BB1_X_D_I
      GlareFreeArea{01..03}: nonqueued-sender-com-spec=data-element=GlareFreeArea, provided-interface=GlareFreeArea_I
      LCSSoundSettingStatus: nonqueued-sender-com-spec=data-element=LCSSoundSettingStatus, provided-interface=LCSSoundSettingStatus_I
      LCSSystemStatus: nonqueued-sender-com-spec=data-element=LCSSystemStatus, provided-interface=LCSSystemStatus_I
      LKSApplicationStatus: nonqueued-sender-com-spec=data-element=LKSApplicationStatus, provided-interface=LKSApplicationStatus_I
      LKSApplicationStatus_BB1_X_D: nonqueued-sender-com-spec=data-element=LKSApplicationStatus_BB1_X_D, provided-interface=LKSApplicationStatus_BB1_X_D_I
      LKSCorrectiveSteeringStatus: nonqueued-sender-com-spec=data-element=LKSCorrectiveSteeringStatus, provided-interface=LKSCorrectiveSteeringStatus_I
      LPOSBlocked: nonqueued-sender-com-spec=data-element=LPOSBlocked, provided-interface=LPOSBlocked_I
      ObserveRoadRestriction_OpCap: nonqueued-sender-com-spec=data-element=ObserveRoadRestriction_OpCap, provided-interface=ObserveRoadRestriction_OpCap_I
      ObserveRoadRestrictionStatus: nonqueued-sender-com-spec=data-element=ObserveRoadRestrictionStatus, provided-interface=ObserveRoadRestrictionStatus_I
      PathDeviationDriverAlert: nonqueued-sender-com-spec=data-element=PathDeviationDriverAlert, provided-interface=PathDeviationDriverAlert_I
      PathDeviationDriverAlert_BB1_X_D: nonqueued-sender-com-spec=PathDeviationDriverAlert_BB1_X_D, provided-interface=PathDeviationDriverAlert_BB1_X_D_I
      ReferencePathCurvature: nonqueued-sender-com-spec=data-element=ReferencePathCurvature, provided-interface=ReferencePathCurvature_I
      RoadOvertakingRestriction: nonqueued-sender-com-spec=data-element=RoadOvertakingRestriction, provided-interface=RoadOvertakingRestriction_I
      RoadSpeedRestriction: nonqueued-sender-com-spec=data-element=RoadSpeedRestriction, provided-interface=RoadSpeedRestriction_I
      RoadTypeSpeedRestriction: nonqueued-sender-com-spec=data-element=RoadTypeSpeedRestriction, provided-interface=RoadTypeSpeedRestriction_I
      TrafficSituationCriticality: nonqueued-sender-com-spec=data-element=TrafficSituationCriticality, provided-interface=TrafficSituationCriticality_I
      TSC1_E_D_sg: nonqueued-sender-com-spec=data-element=TSC1_E_D_sg, provided-interface=TSC1_E_D_sg_I
      TSC1EMSDACU: nonqueued-sender-com-spec=data-element=TSC1EMSDACU, provided-interface=TSC1EMSDACU_I
      VisionLight_stat: nonqueued-sender-com-spec=data-element=VisionLight_stat, provided-interface=VisionLight_stat_I
      VSI_Dynamic_Out: nonqueued-sender-com-spec=data-element=VSI_Dynamic_Out, provided-interface=VSI_Dynamic_Out_I
      VSI_Out: nonqueued-sender-com-spec=data-element=VSI_Out, provided-interface=VSI_Out_I
      XARDACU: nonqueued-sender-com-spec=data-element=XARDACU, provided-interface=XARDACU_I
      XBR_A_D_sg: nonqueued-sender-com-spec=data-element=XBR_A_D_sg, provided-interface=XBR_A_D_sg_I
      XBRDACU: nonqueued-sender-com-spec=data-element=XBRDACU, provided-interface=XBRDACU_I
      XPRRequest_CM: nonqueued-sender-com-spec=data-element=XPRRequest, provided-interface=XPRRequest_I
    143 x require port:
      ABSFullyOperational: nonqueued-receiver-com-spec{data-element=ABSFullyOperational, filter=data-filter-type=ALWAYS}, required-interface=ABSFullyOperational_I
      ACC_SGO_TransmissionStatus: nonqueued-receiver-com-spec{data-element=ACC_SGO_TransmissionStatus, filter=data-filter-type=ALWAYS}, required-interface=ACC_SGO_TransmissionStatus_I
      AcceleratorPedalPosition1: nonqueued-receiver-com-spec{data-element=AcceleratorPedalPosition1, filter=data-filter-type=ALWAYS}, required-interface=AcceleratorPedalPosition1_I
      ACCEnableRqst: nonqueued-receiver-com-spec{data-element=ACCEnableRqst, filter=data-filter-type=ALWAYS}, required-interface=ACCEnableRqst_I
      ACCstatus: nonqueued-receiver-com-spec{data-element=ACCstatus, filter=data-filter-type=ALWAYS}, required-interface=ACCstatus_I
      ACCTimeGapRqst: nonqueued-receiver-com-spec{data-element=ACCTimeGapRqst, filter=data-filter-type=ALWAYS}, required-interface=ACCTimeGapRqst_I  # ACC time gap index/mode (not seconds) for heavy duty trucks.
      ACCTimeGapRqst_MD: nonqueued-receiver-com-spec{data-element=ACCTimeGapRqst, filter=data-filter-type=ALWAYS}, required-interface=ACCTimeGapRqst_I  # ACC time gap index/mode (not seconds) for medium duty trucks.
      AcctrPedalKickDownSw_stat: nonqueued-receiver-com-spec{data-element=AcctrPedalKickDownSw_stat, filter=data-filter-type=ALWAYS}, required-interface=AcctrPedalKickDownSw_stat_I
      ActiveSafetySystemsDisableByRoutine: nonqueued-receiver-com-spec{data-element=ActiveSafetySystemsDisableByRoutine, filter=data-filter-type=ALWAYS}, required-interface=ActiveSafetySystemsDisableByRoutine_I
      ActualEnginePercentTorque: nonqueued-receiver-com-spec{data-element=ActualEnginePercentTorque, filter=data-filter-type=ALWAYS}, required-interface=ActualEnginePercentTorque_I
      AntiLockBrakingActive: nonqueued-receiver-com-spec{data-element=AntiLockBrakingActive, filter=data-filter-type=ALWAYS}, required-interface=AntiLockBrakingActive_I
      AutomaticCMenableStatus: nonqueued-receiver-com-spec{data-element=AutomaticCMenableStatus, filter=data-filter-type=ALWAYS}, required-interface=AutomaticCMenableStatus_I
      BlackOutandConvoyMode_rqst: nonqueued-receiver-com-spec{data-element=BlackOutandConvoyMode_rqst, filter=data-filter-type=ALWAYS}, required-interface=BlackOutandConvoyMode_rqst_I
      BrakePedalPosition: nonqueued-receiver-com-spec{data-element=BrakePedalPosition, filter=data-filter-type=ALWAYS}, required-interface=BrakePedalPosition_I
      BrakeSwitch: nonqueued-receiver-com-spec{data-element=BrakeSwitch, filter=data-filter-type=ALWAYS}, required-interface=BrakeSwitch_I
      BrakeTempWarningLevel: nonqueued-receiver-com-spec{data-element=BrakeTempWarningLevel, filter=data-filter-type=ALWAYS}, required-interface=BrakeTempWarningLevel_I
      CCActive: nonqueued-receiver-com-spec{data-element=CCActive, filter=data-filter-type=ALWAYS}, required-interface=CCActive_I
      CCBSetSpeed: nonqueued-receiver-com-spec{data-element=CCBSetSpeed, filter=data-filter-type=ALWAYS}, required-interface=CCBSetSpeed_I
      CCBSetSpeedApplied: nonqueued-receiver-com-spec{data-element=CCBSetSpeedApplied, filter=data-filter-type=ALWAYS}, required-interface=CCBSetSpeedApplied_I
      CCDeactivationWarning: nonqueued-receiver-com-spec{data-element=CCDeactivationWarning, filter=data-filter-type=ALWAYS}, required-interface=CCDeactivationWarning_I
      CCSetSpeed: nonqueued-receiver-com-spec{data-element=CCSetSpeed, filter=data-filter-type=ALWAYS}, required-interface=CCSetSpeed_I
      CCSetSpeedApplied: nonqueued-receiver-com-spec{data-element=CCSetSpeedApplied, filter=data-filter-type=ALWAYS}, required-interface=CCSetSpeedApplied_I
      CMTelltale_stat: nonqueued-receiver-com-spec{data-element=CMTelltale_stat, filter=data-filter-type=ALWAYS}, required-interface=CMTelltale_stat_I
      CMTellTaleStatus: nonqueued-receiver-com-spec{data-element=CMTellTaleStatus, filter=data-filter-type=ALWAYS}, required-interface=CMTellTaleStatus_I
      CollisionSituationAliveRequest: nonqueued-receiver-com-spec{data-element=CollisionSituationAliveRequest, filter=data-filter-type=ALWAYS}, required-interface=CollisionSituationAliveRequest_I
      CollisionSituationAliveStatus: nonqueued-receiver-com-spec{data-element=CollisionSituationAliveStatus, filter=data-filter-type=ALWAYS}, required-interface=CollisionSituationAliveStatus_I
      CruiseCtrlActive: nonqueued-receiver-com-spec{data-element=CruiseCtrlActive, filter=data-filter-type=ALWAYS}, required-interface=CruiseCtrlActive_I
      CruiseCtrlSetSpeed: nonqueued-receiver-com-spec{data-element=CruiseCtrlSetSpeed, filter=data-filter-type=ALWAYS}, required-interface=CruiseCtrlSetSpeed_I
      DASActivation_rqst: nonqueued-receiver-com-spec{data-element=DASActivation_rqst, filter=data-filter-type=ALWAYS}, required-interface=DASActivation_rqst_I
      DiffLockInteraxelStatus: nonqueued-receiver-com-spec{data-element=DiffLockInteraxelStatus, filter=data-filter-type=ALWAYS}, required-interface=DiffLockInteraxelStatus_I
      DiffLockWheelsInput1: nonqueued-receiver-com-spec{data-element=DiffLockWheelsInput1, filter=data-filter-type=ALWAYS}, required-interface=DiffLockWheelsInput1_I
      DiffLockWheelsInput2: nonqueued-receiver-com-spec{data-element=DiffLockWheelsInput2, filter=data-filter-type=ALWAYS}, required-interface=DiffLockWheelsInput2_I
      DoorsAjar_stat: nonqueued-receiver-com-spec{data-element=DoorsAjar_stat, filter=data-filter-type=ALWAYS}, required-interface=DoorsAjar_stat_I
      DriveAxleLoad: nonqueued-receiver-com-spec{data-element=AxleLoad, filter=data-filter-type=ALWAYS}, required-interface=AxleLoad_I
      DrivelineRetarderLocation: queued-receiver-com-spec{data-element=DrivelineRetarderLocation, queue-length=1}, required-interface=DrivelineRetarderLocation_I
      DrivelineRetarderRefTorque: queued-receiver-com-spec{data-element=DrivelineRetarderRefTorque, queue-length=1}, required-interface=DrivelineRetarderRefTorque_I
      DriverCardDriver1: nonqueued-receiver-com-spec{data-element=DriverCardDriver1, filter=data-filter-type=ALWAYS}, required-interface=DriverCardDriver1_I
      DriverSeatBeltSwitch: nonqueued-receiver-com-spec{data-element=DriverSeatBeltSwitch, filter=data-filter-type=ALWAYS}, required-interface=DriverSeatBeltSwitch_I
      DriverSteeringTorqueEstimate: nonqueued-receiver-com-spec{data-element=DriverSteeringTorqueEstimate, filter=data-filter-type=ALWAYS}, required-interface=DriverSteeringTorqueEstimate_I
      DriverSteeringTqEstimateConf: nonqueued-receiver-com-spec{data-element=DriverSteeringTqEstimateConf, filter=data-filter-type=ALWAYS}, required-interface=DriverSteeringTqEstimateConf_I
      EBSXBRStatusInformation: nonqueued-receiver-com-spec{data-element=EBSXBRStatusInformation, filter=data-filter-type=ALWAYS}, required-interface=EBSXBRStatusInformation_I
      EmergencyBrakingInhibition: nonqueued-receiver-com-spec{data-element=EmergencyBrakingInhibition, filter=data-filter-type=ALWAYS}, required-interface=EmergencyBrakingInhibition_I
      EngineReferenceTorque: queued-receiver-com-spec{data-element=EngineReferenceTorque, queue-length=1}, required-interface=EngineReferenceTorque_I
      EngineSpeed: nonqueued-receiver-com-spec{data-element=EngineSpeed, filter=data-filter-type=ALWAYS}, required-interface=EngineSpeed_I
      EngineTorqueMode: nonqueued-receiver-com-spec{data-element=EngineTorqueMode, filter=data-filter-type=ALWAYS}, required-interface=EngineTorqueMode_I
      ERC1ERActualEngineRetPercentTrq: nonqueued-receiver-com-spec{data-element=ERC1ERActualEngineRetPercentTrq, filter=data-filter-type=ALWAYS}, required-interface=ERC1ERActualEngineRetPercentTrq_I
      ERC1RActualRetarderPercentTorque: nonqueued-receiver-com-spec{data-element=ERC1RActualRetarderPercentTorque, filter=data-filter-type=ALWAYS}, required-interface=ERC1RActualRetarderPercentTorque_I
      ETC2_TransActualGearRatio: nonqueued-receiver-com-spec{data-element=ETC2_TransActualGearRatio, filter=data-filter-type=ALWAYS}, required-interface=ETC2_TransActualGearRatio_I
      ETC2_TransCurrentGear: nonqueued-receiver-com-spec{data-element=ETC2_TransCurrentGear, filter=data-filter-type=ALWAYS}, required-interface=ETC2_TransCurrentGear_I
      FASFullyOperational: nonqueued-receiver-com-spec{data-element=FASFullyOperational, filter=data-filter-type=ALWAYS}, required-interface=FASFullyOperational_I
      FASFunctionInControl: nonqueued-receiver-com-spec{data-element=FASFunctionInControl, filter=data-filter-type=ALWAYS}, required-interface=FASFunctionInControl_I
      FASSaturated: nonqueued-receiver-com-spec{data-element=FASSaturated, filter=data-filter-type=ALWAYS}, required-interface=FASSaturated_I
      FCW_OpticalWarningStatus: nonqueued-receiver-com-spec{data-element=FCW_OpticalWarningStatus, filter=data-filter-type=ALWAYS}, required-interface=FCW_OpticalWarningStatus_I
      FoundationBrakeUse: nonqueued-receiver-com-spec{data-element=FoundationBrakeUse, filter=data-filter-type=ALWAYS}, required-interface=FoundationBrakeUse_I
      FrontAxle1Load: nonqueued-receiver-com-spec{data-element=AxleLoad, filter=data-filter-type=ALWAYS}, required-interface=AxleLoad_I
      FrontAxle2Load: nonqueued-receiver-com-spec{data-element=AxleLoad, filter=data-filter-type=ALWAYS}, required-interface=AxleLoad_I
      FrontAxleLeftWheelSpeed: nonqueued-receiver-com-spec{data-element=FrontAxleLeftWheelSpeed, filter=data-filter-type=ALWAYS}, required-interface=FrontAxleLeftWheelSpeed_I
      FrontAxleRightWheelSpeed: nonqueued-receiver-com-spec{data-element=FrontAxleRightWheelSpeed, filter=data-filter-type=ALWAYS}, required-interface=FrontAxleRightWheelSpeed_I
      FrontAxleSpeed: nonqueued-receiver-com-spec{data-element=FrontAxleSpeed, filter=data-filter-type=ALWAYS}, required-interface=FrontAxleSpeed_I
      FrontRoadWheelAngleEstimate: nonqueued-receiver-com-spec{data-element=FrontRoadWheelAngleEstimate, filter=data-filter-type=ALWAYS}, required-interface=FrontRoadWheelAngleEstimate_I
      GrossCombinationVehicleWeight: nonqueued-receiver-com-spec{data-element=GrossCombinationVehicleWeight, filter=data-filter-type=ALWAYS}, required-interface=GrossCombinationVehicleWeight_I
      HillHolderMode: nonqueued-receiver-com-spec{data-element=HillHolderMode, filter=data-filter-type=ALWAYS}, required-interface=HillHolderMode_I
      HSAState: nonqueued-receiver-com-spec{data-element=HSAState, filter=data-filter-type=ALWAYS}, required-interface=HSAState_I
      KFactor: nonqueued-receiver-com-spec{data-element=KFactor, filter=data-filter-type=ALWAYS}, required-interface=KFactor_I
      LaneChangeStatus: nonqueued-receiver-com-spec{data-element=LaneChangeStatus, filter=data-filter-type=ALWAYS}, required-interface=LaneChangeStatus_I
      LaneChangeStatus_RTEStat: nonqueued-receiver-com-spec{data-element=RteStatus, filter=data-filter-type=ALWAYS}, required-interface=RteStatus_I
      LateralAcceleration: nonqueued-receiver-com-spec{data-element=LateralAcceleration, filter=data-filter-type=ALWAYS}, required-interface=LateralAcceleration_I
      LateralAccOffset_BB1_X_A: nonqueued-receiver-com-spec{data-element=LateralAccOffset_BB1_X_A, filter=data-filter-type=ALWAYS}, required-interface=LateralAccOffset_BB1_X_A_I
      LCS_EnableSwitch_rqst: nonqueued-receiver-com-spec{data-element=LCS_EnableSwitch_rqst, filter=data-filter-type=ALWAYS}, required-interface=LCS_EnableSwitch_rqst_I
      LCSSoundSettingRequest: nonqueued-receiver-com-spec{data-element=LCSSoundSettingRequest, filter=data-filter-type=ALWAYS}, required-interface=LCSSoundSettingRequest_I
      LiftAxle1PositionStatus: nonqueued-receiver-com-spec{data-element=LiftAxle1PositionStatus, filter=data-filter-type=ALWAYS}, required-interface=LiftAxle1PositionStatus_I
      LKS_Enable: nonqueued-receiver-com-spec{data-element=LKS_Enable, filter=data-filter-type=ALWAYS}, required-interface=LKS_Enable_I
      LKSCSEnableSwitch_rqst: nonqueued-receiver-com-spec{data-element=LKSEnableSwitch_rqst, filter=data-filter-type=ALWAYS}, required-interface=LKSEnableSwitch_rqst_I
      LKSEnableSwitch_rqst: nonqueued-receiver-com-spec{data-element=LKSEnableSwitch_rqst, filter=data-filter-type=ALWAYS}, required-interface=LKSEnableSwitch_rqst_I
      LoadTruck: nonqueued-receiver-com-spec{data-element=LoadTruck, filter=data-filter-type=ALWAYS}, required-interface=LoadTruck_I
      NominalFrictionPercentTorque: nonqueued-receiver-com-spec{data-element=NominalFrictionPercentTorque, filter=data-filter-type=ALWAYS}, required-interface=NominalFrictionPercentTorque_I
      ParkBrakeActuationStatus: nonqueued-receiver-com-spec{data-element=ParkBrakeActuationStatus, filter=data-filter-type=ALWAYS}, required-interface=ParkBrakeActuationStatus_I
      ParkingBrkSwitch: nonqueued-receiver-com-spec{data-element=ParkingBrkSwitch, filter=data-filter-type=ALWAYS}, required-interface=ParkingBrkSwitch_I
      PercentageOfBrakeTemperatureWa: nonqueued-receiver-com-spec{data-element=PercentageOfBrakeTemperatureWa, filter=data-filter-type=ALWAYS}, required-interface=PercentageOfBrakeTemperatureWa_I
      PloughLampModeStatus: nonqueued-receiver-com-spec{data-element=PloughLampModeStatus, filter=data-filter-type=ALWAYS}, required-interface=PloughLampModeStatus_I
      PoweredVehicleWeight: nonqueued-receiver-com-spec{data-element=PoweredVehicleWeight, filter=data-filter-type=ALWAYS}, required-interface=PoweredVehicleWeight_I
      PusherAxleLoad: nonqueued-receiver-com-spec{data-element=AxleLoad, filter=data-filter-type=ALWAYS}, required-interface=AxleLoad_I
      RASstatus: nonqueued-receiver-com-spec{data-element=RASstatus, filter=data-filter-type=ALWAYS}, required-interface=RASstatus_I
      RCERReferenceRetarderTorque: nonqueued-receiver-com-spec{data-element=RCERReferenceRetarderTorque, filter=data-filter-type=ALWAYS}, required-interface=RCERReferenceRetarderTorque_I
      RCRReferenceRetarderTorque: nonqueued-receiver-com-spec{data-element=RCRReferenceRetarderTorque, filter=data-filter-type=ALWAYS}, required-interface=RCRReferenceRetarderTorque_I
      RCRRetarderLocation: nonqueued-receiver-com-spec{data-element=RCRRetarderLocation, filter=data-filter-type=ALWAYS}, required-interface=RCRRetarderLocation_I
      RearAxleLeftWheelSpeed: nonqueued-receiver-com-spec{data-element=RearAxleLeftWheelSpeed, filter=data-filter-type=ALWAYS}, required-interface=RearAxleLeftWheelSpeed_I
      RearAxleRightWheelSpeed: nonqueued-receiver-com-spec{data-element=RearAxleRightWheelSpeed, filter=data-filter-type=ALWAYS}, required-interface=RearAxleRightWheelSpeed_I
      RearAxleSteeringFunctionStatus: nonqueued-receiver-com-spec{data-element=RearAxleSteeringFunctionStatus, filter=data-filter-type=ALWAYS}, required-interface=RearAxleSteeringFunctionStatus_I
      RearPropulsionStat: nonqueued-receiver-com-spec{data-element=PropulsionStat, filter=data-filter-type=ALWAYS}, required-interface=PropulsionStat_I
      ReferenceEngineRetarderTorque: queued-receiver-com-spec{data-element=ReferenceEngineRetarderTorque, queue-length=1}, required-interface=ReferenceEngineRetarderTorque_I
      RelativeSpdFrntAxleLeftWheel: nonqueued-receiver-com-spec{data-element=RelativeSpdFrntAxleLeftWheel, filter=data-filter-type=ALWAYS}, required-interface=RelativeSpdFrntAxleLeftWheel_I
      RelativeSpdRearAxle1LeftWheel: nonqueued-receiver-com-spec{data-element=RelativeSpdRearAxle1LeftWheel, filter=data-filter-type=ALWAYS}, required-interface=RelativeSpdRearAxle1LeftWheel_I
      RequestedACCDistanceMode: nonqueued-receiver-com-spec{data-element=RequestedACCDistanceMode, filter=data-filter-type=ALWAYS}, required-interface=RequestedACCDistanceMode_I  # ACC time gap index/mode (not seconds) for buses (not for medium duty trucks or heavy duty trucks).
      ResumeRequestForACC: nonqueued-receiver-com-spec{data-element=ResumeRequestForACC, filter=data-filter-type=ALWAYS}, required-interface=ResumeRequestForACC_I
      RetarderStalkArmPosition: nonqueued-receiver-com-spec{data-element=RetarderStalkArmPosition, filter=data-filter-type=ALWAYS}, required-interface=RetarderStalkArmPosition_I
      ReverseGearEngaged: nonqueued-receiver-com-spec{data-element=ReverseGearEngaged, filter=data-filter-type=ALWAYS}, required-interface=ReverseGearEngaged_I
      ReverseGearStatus: nonqueued-receiver-com-spec{data-element=ReverseGearStatus, filter=data-filter-type=ALWAYS}, required-interface=ReverseGearStatus_I
      RlativeSpdFrntAxleRightWheel: nonqueued-receiver-com-spec{data-element=RlativeSpdFrntAxleRightWheel, filter=data-filter-type=ALWAYS}, required-interface=RlativeSpdFrntAxleRightWheel_I
      RlativeSpdRearAxle1RightWheel: nonqueued-receiver-com-spec{data-element=RlativeSpdRearAxle1RightWheel, filter=data-filter-type=ALWAYS}, required-interface=RlativeSpdRearAxle1RightWheel_I
      RoadInclination: nonqueued-receiver-com-spec{data-element=RoadInclination, filter=data-filter-type=ALWAYS}, required-interface=RoadInclination_I
      RoadInclinationVP15: nonqueued-receiver-com-spec{data-element=RoadInclinationVP15, filter=data-filter-type=ALWAYS}, required-interface=RoadInclinationVP15_I
      RollerBenchModeStatus: nonqueued-receiver-com-spec{data-element=RollerBenchModeStatus, filter=data-filter-type=ALWAYS}, required-interface=RollerBenchModeStatus_I
      ROPBrakeControlActive: nonqueued-receiver-com-spec{data-element=ROPBrakeControlActive, filter=data-filter-type=ALWAYS}, required-interface=ROPBrakeControlActive_I
      ROPBrakeCtrlActive: nonqueued-receiver-com-spec{data-element=ROPBrakeCtrlActive, filter=data-filter-type=ALWAYS}, required-interface=ROPBrakeCtrlActive_I
      RSBBM: nonqueued-receiver-com-spec{data-element=RSBBM, filter=data-filter-type=ALWAYS}, required-interface=RSBBM_I
      SecondaryDriveAxleLoad: nonqueued-receiver-com-spec{data-element=AxleLoad, filter=data-filter-type=ALWAYS}, required-interface=AxleLoad_I
      SecondThrottle: nonqueued-receiver-com-spec{data-element=SecondThrottle, filter=data-filter-type=ALWAYS}, required-interface=SecondThrottle_I
      SelectedEcoCruiseLevel: nonqueued-receiver-com-spec{data-element=SelectedEcoCruiseLevel, filter=data-filter-type=ALWAYS}, required-interface=SelectedEcoCruiseLevel_I
      SetCMOperation_BP: nonqueued-receiver-com-spec{data-element=SetCMOperation, filter=data-filter-type=ALWAYS}, required-interface=SetCMOperation_I
      SetFCWOperation: nonqueued-receiver-com-spec{data-element=SetFCWOperation, filter=data-filter-type=ALWAYS}, required-interface=SetFCWOperation_I
      SetFCWOperation_BP: nonqueued-receiver-com-spec{data-element=SetFCWOperation, filter=data-filter-type=ALWAYS}, required-interface=SetFCWOperation_I
      SideObjectDetectedT2P: nonqueued-receiver-com-spec{data-element=SideObjectDetected, filter=data-filter-type=ALWAYS}, required-interface=SideObjectDetected_I
      SteeringWheelAngle: nonqueued-receiver-com-spec{data-element=SteeringWheelAngle, filter=data-filter-type=ALWAYS}, required-interface=SteeringWheelAngle_I
      SteeringWheelAngle1: nonqueued-receiver-com-spec{data-element=SteeringWheelAngle1, filter=data-filter-type=ALWAYS}, required-interface=SteeringWheelAngle1_I
      SteeringWheelAngleOffset: nonqueued-receiver-com-spec{data-element=SteeringWheelAngleOffset, filter=data-filter-type=ALWAYS}, required-interface=SteeringWheelAngleOffset_I
      TagAxleLoad: nonqueued-receiver-com-spec{data-element=AxleLoad, filter=data-filter-type=ALWAYS}, required-interface=AxleLoad_I
      TrailerABSStatus: nonqueued-receiver-com-spec{data-element=TrailerABSStatus, filter=data-filter-type=ALWAYS}, required-interface=TrailerABSStatus_I
      TrailerConnected: nonqueued-receiver-com-spec{data-element=TrailerConnected, filter=data-filter-type=ALWAYS}, required-interface=TrailerConnected_I
      TrailerWithoutABS: nonqueued-receiver-com-spec{data-element=TrailerWithoutABS, filter=data-filter-type=ALWAYS}, required-interface=TrailerWithoutABS_I
      TrailerWoABS: nonqueued-receiver-com-spec{data-element=TrailerWoABS, filter=data-filter-type=ALWAYS}, required-interface=TrailerWoABS_I
      TransmissionActualGearRatio: nonqueued-receiver-com-spec{data-element=TransmissionActualGearRatio, filter=data-filter-type=ALWAYS}, required-interface=TransmissionActualGearRatio_I
      TransmissionDrivelineEngaged: nonqueued-receiver-com-spec{data-element=TransmissionDrivelineEngaged, filter=data-filter-type=ALWAYS}, required-interface=TransmissionDrivelineEngaged_I
      TransmissionShiftInProcess: nonqueued-receiver-com-spec{data-element=TransmissionShiftInProcess, filter=data-filter-type=ALWAYS}, required-interface=TransmissionShiftInProcess_I
      TransmOutputShaftSpeedSigned: nonqueued-receiver-com-spec{data-element=TransmOutputShaftSpeedSigned, filter=data-filter-type=ALWAYS}, required-interface=TransmOutputShaftSpeedSigned_I
      VDCFullyOperational: nonqueued-receiver-com-spec{data-element=VDCFullyOperational, filter=data-filter-type=ALWAYS}, required-interface=VDCFullyOperational_I
      VehicleCalibratedLoad: nonqueued-receiver-com-spec{data-element=VehicleCalibratedLoad, filter=data-filter-type=ALWAYS}, required-interface=VehicleCalibratedLoad_I
      VehicleMode: nonqueued-receiver-com-spec{data-element=VehicleMode, filter=data-filter-type=ALWAYS}, required-interface=VehicleMode_I
      WheelBasedVehicleSpeed: nonqueued-receiver-com-spec{data-element=WheelBasedVehicleSpeed, filter=data-filter-type=ALWAYS}, required-interface=WheelBasedVehicleSpeed_I
      VP40TrailerABSStatus: nonqueued-receiver-com-spec{data-element=VP40TrailerABSStatus, filter=data-filter-type=ALWAYS}, required-interface=VP40TrailerABSStatus_I
      XARActiveControlMode: nonqueued-receiver-com-spec{data-element=XARActiveControlMode, filter=data-filter-type=ALWAYS}, required-interface=XARActiveControlMode_I
      XARSystemState: nonqueued-receiver-com-spec{data-element=XARSystemState, filter=data-filter-type=ALWAYS}, required-interface=XARSystemState_I
      XBR_A_V_ControlMode: nonqueued-receiver-com-spec{data-element=XBR_A_V_ControlMode, filter=data-filter-type=ALWAYS}, required-interface=XBR_A_V_ControlMode_I
      XBRActiveControlMode: nonqueued-receiver-com-spec{data-element=XBRActiveControlMode, filter=data-filter-type=ALWAYS}, required-interface=XBRActiveControlMode_I
      XBRBrakingCapacityTemperature: nonqueued-receiver-com-spec{data-element=XBRBrakingCapacityTemperature, filter=data-filter-type=ALWAYS}, required-interface=XBRBrakingCapacityTemperature_I
      XBRBrakingCapacityTime: nonqueued-receiver-com-spec{data-element=XBRBrakingCapacityTime, filter=data-filter-type=ALWAYS}, required-interface=XBRBrakingCapacityTime_I
      XBRSystemInformation: nonqueued-receiver-com-spec{data-element=XBRSystemInformation, filter=data-filter-type=ALWAYS}, required-interface=XBRSystemInformation_I
      XBRSystemState: nonqueued-receiver-com-spec{data-element=XBRSystemState, filter=data-filter-type=ALWAYS}, required-interface=XBRSystemState_I
      XPRsystemstate: nonqueued-receiver-com-spec{data-element=XPRsystemstate, filter=data-filter-type=ALWAYS}, required-interface=XPRsystemstate_I
      YawRate: nonqueued-receiver-com-spec{data-element=YawRate, filter=data-filter-type=ALWAYS}, required-interface=YawRate_I
      YawRateOffset: nonqueued-receiver-com-spec{data-element=YawRateOffset, filter=data-filter-type=ALWAYS}, required-interface=YawRateOffset_I
      YCBrakeControlActive: nonqueued-receiver-com-spec{data-element=YCBrakeControlActive, filter=data-filter-type=ALWAYS}, required-interface=YCBrakeControlActive_I
      GPSData: queued-receiver-com-spec{data-element=GPSData, queue-length=1}, required-interface=GPSData_I
    5 x provide port:
      RoadSpeedUnitType: nonqueued-sender-com-spec=RoadSpeedUnitType, provided-interface=RoadSpeedUnitType_I
      LKS_DriverOverride: nonqueued-sender-com-spec=LKS_DriverOverride, provided-interface=LKS_DriverOverride_I
      PathDeviationSteeringStatus: nonqueued-sender-com-spec=PathDeviationSteeringStatus, provided-interface=PathDeviationSteeringStatus_I
      TSAMIntervntionCapabilityLeft: nonqueued-sender-com-spec=TSAMIntervntionCapabilityLeft, provided-interface=TSAMIntervntionCapabilityLeft_I
      TSAMIntervntionCapabilityRight: nonqueued-sender-com-spec=TSAMIntervntionCapabilityRight, provided-interface=TSAMIntervntionCapabilityRight_I
    7 x require port:
      Trailer{1..5}GeometricData: nonqueued-receiver-com-spec{data-element=TrailerGeometricData, filter=data-filter-type=ALWAYS}, required-interface=TrailerGeometricData_I
      TrailersConnected: nonqueued-receiver-com-spec{data-element=TrailersConnected, filter=data-filter-type=ALWAYS}, required-interface=TrailersConnected_I
      TransmissionCurrentGear: nonqueued-receiver-com-spec{data-element=TransmissionCurrentGear, filter=data-filter-type=ALWAYS}, required-interface=TransmissionCurrentGear_I
    provide port LSMS_LED_IndicationCmd: nonqueued-sender-com-spec=LSMS_LED_IndicationCmd, provided-interface=LSMS_LED_IndicationCmd_I
    require port AdasisMapData: nonqueued-receiver-com-spec{data-element=AdasisMapData, filter=data-filter-type=ALWAYS}, required-interface=AdasisMapData_I
    14 x provide port:
      ACC_SGOBrakeAlert: nonqueued-sender-com-spec=ACC_SGOBrakeAlert, provided-interface=ACC_SGOBrakeAlert_I
      CACCStatus: nonqueued-sender-com-spec=CACCStatus, provided-interface=CACCStatus_I
      FrontRoadWheelAngleEstimate1: nonqueued-sender-com-spec=FrontRoadWheelAngleEstimate, provided-interface=FrontRoadWheelAngleEstimate_I
      LSMS_AngleMatch1: nonqueued-sender-com-spec=LSMS_AngleMatch, provided-interface=LSMS_AngleMatch_I
      LSMS_JackKnifeWarning1: nonqueued-sender-com-spec=LSMS_JackKnifeWarning, provided-interface=LSMS_JackKnifeWarning_I
      LSMS_KnbSteerUAPreCon1: nonqueued-sender-com-spec=LSMS_KnbSteerUAPreCon, provided-interface=LSMS_KnbSteerUAPreCon_I
      LSMS_KnbSteerUASens1: nonqueued-sender-com-spec=LSMS_KnbSteerUASens, provided-interface=LSMS_KnbSteerUASens_I
      LSMS_KnobAngle1: nonqueued-sender-com-spec=LSMS_KnobAngle, provided-interface=LSMS_KnobAngle_I
      LSMS_RecordedPathLeft1: nonqueued-sender-com-spec=LSMS_RecordedPathLeft, provided-interface=LSMS_RecordedPathLeft_I
      LSMS_RevDirSupportUAPreCon1: nonqueued-sender-com-spec=LSMS_RevDirSupportUAPreCon, provided-interface=LSMS_RevDirSupportUAPreCon_I
      LSMS_RevDirSupportUASens1: nonqueued-sender-com-spec=LSMS_RevDirSupportUASens, provided-interface=LSMS_RevDirSupportUASens_I
      LSMS_SpeedLimit: nonqueued-sender-com-spec=LSMS_SpeedLimit, provided-interface=LSMS_SpeedLimit_I
      LSMS_UndoUAPreCon1: nonqueued-sender-com-spec=LSMS_UndoUAPreCon, provided-interface=LSMS_UndoUAPreCon_I
      LSMS_UndoUASens1: nonqueued-sender-com-spec=LSMS_UndoUASens, provided-interface=LSMS_UndoUASens_I
    8 x require port:
      CACCSuitability: nonqueued-receiver-com-spec{data-element=CACCSuitability, filter=data-filter-type=ALWAYS}, required-interface=CACCSuitability_I
      CACCTimeGapRqst: nonqueued-receiver-com-spec{data-element=CACCTimeGapRqst, filter=data-filter-type=ALWAYS}, required-interface=CACCTimeGapRqst_I
      SpeedAdaptationLevelRqst: nonqueued-receiver-com-spec{data-element=SpeedAdaptationLevelRqst, filter=data-filter-type=ALWAYS}, required-interface=SpeedAdaptationLevelRqst_I
      SpeedAdaptEnableRqst: nonqueued-receiver-com-spec{data-element=SpeedAdaptEnableRqst, filter=data-filter-type=ALWAYS}, required-interface=SpeedAdaptEnableRqst_I
      ISeeStatus: nonqueued-receiver-com-spec{data-element=ISeeStatus, filter=data-filter-type=ALWAYS}, required-interface=ISeeStatus_I
      LKSCSActiveBoxStatus_GUIrqst: nonqueued-receiver-com-spec{data-element=LKSCSActiveBoxStatus_GUIrqst, filter=data-filter-type=ALWAYS}, required-interface=LKSCSActiveBoxStatus_GUIrqst_I
      TransmissionDrivingMode: nonqueued-receiver-com-spec{data-element=TransmissionDrivingMode, filter=data-filter-type=ALWAYS}, required-interface=TransmissionDrivingMode_I
      DebugFrame_1: nonqueued-receiver-com-spec{data-element=FrameData, filter=data-filter-type=ALWAYS}, required-interface=DebugFrame_I
    6 x provide port:
      TrafficSitPathEvent1: nonqueued-sender-com-spec=TrafficSitPathEvent, provided-interface=TrafficSitPathEvent_I
      TrafficSitPathEvent2: nonqueued-sender-com-spec=TrafficSitPathEvent, provided-interface=TrafficSitPathEvent_I
      PSC_DriverBrakingAllowed: nonqueued-sender-com-spec=PSC_DriverBrakingAllowed, provided-interface=PSC_DriverBrakingAllowed_I
      PSC_RequestedPresetSpeed: nonqueued-sender-com-spec=PSC_RequestedPresetSpeed, provided-interface=PSC_RequestedPresetSpeed_I
      PSC_SetSpeedChangeRqst: nonqueued-sender-com-spec=PSC_SetSpeedChangeRqst, provided-interface=PSC_SetSpeedChangeRqst_I
      TrafficSitSpdProfile: nonqueued-sender-com-spec=TrafficSitSpdProfile, provided-interface=TrafficSitSpdProfile_I
    4 x require port:
      EngineActiveStatus: nonqueued-receiver-com-spec{data-element=EngineActiveStatus, filter=data-filter-type=ALWAYS}, required-interface=EngineActiveStatus_I
      RelativeLevelFrontAxleLeftRaw: nonqueued-receiver-com-spec{data-element=RelativeLevelFrontAxleLeftRaw, filter=data-filter-type=ALWAYS}, required-interface=RelativeLevelFrontAxleLeftRaw_I
      RelativeLevelFrontAxleRightRaw: nonqueued-receiver-com-spec{data-element=RelativeLevelFrontAxleRightRaw, filter=data-filter-type=ALWAYS}, required-interface=RelativeLevelFrontAxleRightRaw_I
      TrafficSitPathExecSta: nonqueued-receiver-com-spec{data-element=TrafficSitPathEvent, filter=data-filter-type=ALWAYS}, required-interface=TrafficSitPathEvent_I
    provide port DriveAssistStatus: nonqueued-sender-com-spec=DriveAssistStatus, provided-interface=DriveAssistStatus_I
    provide port DriverTakeControlRqst: nonqueued-sender-com-spec=DriverTakeControlRqst, provided-interface=DriverTakeControlRqst_I
    provide port TSMEngineOnRecommended: nonqueued-sender-com-spec=TSMEngineOnRecommended, provided-interface=TSMEngineOnRecommended_I
    27 x require port:
      ActualDrvlnRetdrPercentTorque: nonqueued-receiver-com-spec{data-element=ActualDrvlnRetdrPercentTorque, filter=data-filter-type=ALWAYS}, required-interface=ActualDrvlnRetdrPercentTorque_I
      ActualEngineRetarderPercentTrq: nonqueued-receiver-com-spec{data-element=ActualEngineRetarderPercentTrq, filter=data-filter-type=ALWAYS}, required-interface=ActualEngineRetarderPercentTrq_I
      ActualMaxAvailDrvlnRetPrctTrq: nonqueued-receiver-com-spec{data-element=ActualMaxAvailDrvlnRetPrctTrq, filter=data-filter-type=ALWAYS}, required-interface=ActualMaxAvailDrvlnRetPrctTrq_I
      AmbientAirTemperature: nonqueued-receiver-com-spec{data-element=AmbientAirTemperature, filter=data-filter-type=ALWAYS}, required-interface=AmbientAirTemperature_I
      ASRBrakeControlActive: nonqueued-receiver-com-spec{data-element=ASRBrakeControlActive, filter=data-filter-type=ALWAYS}, required-interface=ASRBrakeControlActive_I
      DriveAssistEnableRqst: nonqueued-receiver-com-spec{data-element=DriveAssistEnableRqst, filter=data-filter-type=ALWAYS}, required-interface=DriveAssistEnableRqst_I
      DriverRetarderRequest: nonqueued-receiver-com-spec{data-element=DriverRetarderRequest, filter=data-filter-type=ALWAYS}, required-interface=DriverRetarderRequest_I
      FogLight_Front_cmd: nonqueued-receiver-com-spec{data-element=FogLight_Front_cmd, filter=data-filter-type=ALWAYS}, required-interface=FogLight_Front_cmd_I
      FrAxleLtWhlBrakeApplPrsHiRng: nonqueued-receiver-com-spec{data-element=FrAxleLtWhlBrakeApplPrsHiRng, filter=data-filter-type=ALWAYS}, required-interface=FrAxleLtWhlBrakeApplPrsHiRng_I
      FrAxleRtWhlBrakeApplPrsHiRng: nonqueued-receiver-com-spec{data-element=FrAxleRtWhlBrakeApplPrsHiRng, filter=data-filter-type=ALWAYS}, required-interface=FrAxleRtWhlBrakeApplPrsHiRng_I
      MainBeam_cmd: nonqueued-receiver-com-spec{data-element=MainBeam_cmd, filter=data-filter-type=ALWAYS}, required-interface=MainBeam_cmd_I
      RelativeLevelFrontAxleLeft: nonqueued-receiver-com-spec{data-element=RelativeLevelFrontAxleLeft, filter=data-filter-type=ALWAYS}, required-interface=RelativeLevelFrontAxleLeft_I
      RelativeLevelFrontAxleRight: nonqueued-receiver-com-spec{data-element=RelativeLevelFrontAxleRight, filter=data-filter-type=ALWAYS}, required-interface=RelativeLevelFrontAxleRight_I
      RelativeLevelRearAxleLeft: nonqueued-receiver-com-spec{data-element=RelativeLevelRearAxleLeft, filter=data-filter-type=ALWAYS}, required-interface=RelativeLevelRearAxleLeft_I
      RelativeLevelRearAxleRight: nonqueued-receiver-com-spec{data-element=RelativeLevelRearAxleRight, filter=data-filter-type=ALWAYS}, required-interface=RelativeLevelRearAxleRight_I
      RrAxle1LtWhlBrakeApplPrsHiRng: nonqueued-receiver-com-spec{data-element=RrAxle1LtWhlBrakeApplPrsHiRng, filter=data-filter-type=ALWAYS}, required-interface=RrAxle1LtWhlBrakeApplPrsHiRng_I
      RrAxle1RtWhlBrakeApplPrsHiRng: nonqueued-receiver-com-spec{data-element=RrAxle1RtWhlBrakeApplPrsHiRng, filter=data-filter-type=ALWAYS}, required-interface=RrAxle1RtWhlBrakeApplPrsHiRng_I
      RrAxle2LtWhlBrakeApplPrsHiRng: nonqueued-receiver-com-spec{data-element=RrAxle2LtWhlBrakeApplPrsHiRng, filter=data-filter-type=ALWAYS}, required-interface=RrAxle2LtWhlBrakeApplPrsHiRng_I
      RrAxle2RtWhlBrakeApplPrsHiRng: nonqueued-receiver-com-spec{data-element=RrAxle2RtWhlBrakeApplPrsHiRng, filter=data-filter-type=ALWAYS}, required-interface=RrAxle2RtWhlBrakeApplPrsHiRng_I
      RrAxle3LtWhlBrakeApplPrsHiRng: nonqueued-receiver-com-spec{data-element=RrAxle3LtWhlBrakeApplPrsHiRng, filter=data-filter-type=ALWAYS}, required-interface=RrAxle3LtWhlBrakeApplPrsHiRng_I
      RrAxle3RtWhlBrakeApplPrsHiRng: nonqueued-receiver-com-spec{data-element=RrAxle3RtWhlBrakeApplPrsHiRng, filter=data-filter-type=ALWAYS}, required-interface=RrAxle3RtWhlBrakeApplPrsHiRng_I
      ScndRrDriveAxleLeftWheelSpeed: nonqueued-receiver-com-spec{data-element=ScndRrDriveAxleLeftWheelSpeed, filter=data-filter-type=ALWAYS}, required-interface=ScndRrDriveAxleLeftWheelSpeed_I
      ScndRrDriveAxleRightWheelSpeed: nonqueued-receiver-com-spec{data-element=ScndRrDriveAxleRightWheelSpeed, filter=data-filter-type=ALWAYS}, required-interface=ScndRrDriveAxleRightWheelSpeed_I
      TachographLocalHourOffset: nonqueued-receiver-com-spec{data-element=TachographLocalHourOffset, filter=data-filter-type=ALWAYS}, required-interface=TachographLocalHourOffset_I
      TachographLocalMinuteOffset: nonqueued-receiver-com-spec{data-element=TachographLocalMinuteOffset, filter=data-filter-type=ALWAYS}, required-interface=TachographLocalMinuteOffset_I
      TachographVehicleSpeed: nonqueued-receiver-com-spec{data-element=TachographVehicleSpeed, filter=data-filter-type=ALWAYS}, required-interface=TachographVehicleSpeed_I
      TotalVehicleDistanceHighRes: nonqueued-receiver-com-spec{data-element=TotalVehicleDistanceHighRes, filter=data-filter-type=ALWAYS}, required-interface=TotalVehicleDistanceHighRes_I
    12 x provide port:
      Debug_{2..11}_DACU: nonqueued-sender-com-spec=FrameData, provided-interface=DebugFrame_I
      ACC_Debug: nonqueued-sender-com-spec=ACC_Debug, provided-interface=ACC_Debug_I
      CWEB_Debug: nonqueued-sender-com-spec=CWEB_Debug, provided-interface=CWEB_Debug_I
    18 x require port:
      ABSAxle{1..5}Active: nonqueued-receiver-com-spec{data-element=ABSAxle{1..5}Active, filter=data-filter-type=ALWAYS}, required-interface=ABSAxle{1..5}Active_I
      ActualPusherWheelAngle: nonqueued-receiver-com-spec{data-element=ActualTagWheelAngle, filter=data-filter-type=ALWAYS}, required-interface=ActualTagWheelAngle_I
      ActualTagWheelAngle: nonqueued-receiver-com-spec{data-element=ActualTagWheelAngle, filter=data-filter-type=ALWAYS}, required-interface=ActualTagWheelAngle_I
      ASREngineControlActive: nonqueued-receiver-com-spec{data-element=ASREngineControlActive, filter=data-filter-type=ALWAYS}, required-interface=ASREngineControlActive_I
      CabLightIntensity_stat: nonqueued-receiver-com-spec{data-element=CabLightIntensity_stat, filter=data-filter-type=ALWAYS}, required-interface=CabLightIntensity_stat_I
      CountryCode: nonqueued-receiver-com-spec{data-element=CountryCode, filter=data-filter-type=ALWAYS}, required-interface=CountryCode_I
      LiftAxle2PositionStatus: nonqueued-receiver-com-spec{data-element=LiftAxle2PositionStatus, filter=data-filter-type=ALWAYS}, required-interface=LiftAxle2PositionStatus_I
      LongitudinalAcceleration: nonqueued-receiver-com-spec{data-element=LongitudinalAcceleration, filter=data-filter-type=ALWAYS}, required-interface=LongitudinalAcceleration_I
      PusherAxleLeftWheelSpeed: nonqueued-receiver-com-spec{data-element=PusherAxleLeftWheelSpeed, filter=data-filter-type=ALWAYS}, required-interface=PusherAxleLeftWheelSpeed_I
      PusherAxleRightWheelSpeed: nonqueued-receiver-com-spec{data-element=PusherAxleRightWheelSpeed, filter=data-filter-type=ALWAYS}, required-interface=PusherAxleRightWheelSpeed_I
      ScndFrAxleLeftWheelSpeed: nonqueued-receiver-com-spec{data-element=ScndFrAxleLeftWheelSpeed, filter=data-filter-type=ALWAYS}, required-interface=ScndFrAxleLeftWheelSpeed_I
      ScndFrAxleRightWheelSpeed: nonqueued-receiver-com-spec{data-element=ScndFrAxleRightWheelSpeed, filter=data-filter-type=ALWAYS}, required-interface=ScndFrAxleRightWheelSpeed_I
      TagAxleLeftWheelSpeed: nonqueued-receiver-com-spec{data-element=TagAxleLeftWheelSpeed, filter=data-filter-type=ALWAYS}, required-interface=TagAxleLeftWheelSpeed_I
      TagAxleRightWheelSpeed: nonqueued-receiver-com-spec{data-element=TagAxleRightWheelSpeed, filter=data-filter-type=ALWAYS}, required-interface=TagAxleRightWheelSpeed_I
    4 x provide port:
      EgoPathPrediction: nonqueued-sender-com-spec=EgoPathPrediction, provided-interface=EgoPathPrediction_I
      LCS_WarningStatusLeft: nonqueued-sender-com-spec=LCS_WarningStatusLeft, provided-interface=LCS_WarningStatusLeft_I
      LCS_WarningStatusRight: nonqueued-sender-com-spec=LCS_WarningStatusRight, provided-interface=LCS_WarningStatusRight_I
      ShadowArea: nonqueued-sender-com-spec=ShadowArea, provided-interface=ShadowArea_I
    24 x require port:
      Clothoid{00..07}: nonqueued-receiver-com-spec{data-element=Clothoid, filter=data-filter-type=ALWAYS}, required-interface=Clothoid_I
      FLCSwVersion: nonqueued-receiver-com-spec{data-element=SwVersion, filter=data-filter-type=ALWAYS}, required-interface=SwVersion_I
      FLREgoAssumpt: nonqueued-receiver-com-spec{data-element=EgoAssumpt, filter=data-filter-type=ALWAYS}, required-interface=EgoAssumpt_I
      FLRSwVersion: nonqueued-receiver-com-spec{data-element=SwVersion, filter=data-filter-type=ALWAYS}, required-interface=SwVersion_I
      FwdRadarStatus: nonqueued-receiver-com-spec{data-element=RadarSensorStatus, filter=data-filter-type=ALWAYS}, required-interface=RadarSensorStatus_I
      LFSREgoAssumpt: nonqueued-receiver-com-spec{data-element=EgoAssumpt, filter=data-filter-type=ALWAYS}, required-interface=EgoAssumpt_I
      LFSRSensingRadarStat: nonqueued-receiver-com-spec{data-element=SideSensingRadarStat, filter=data-filter-type=ALWAYS}, required-interface=SideSensingRadarStat_I
      LFSRSideSensorStatus: nonqueued-receiver-com-spec{data-element=RadarSensorStatus, filter=data-filter-type=ALWAYS}, required-interface=RadarSensorStatus_I
      LFSRSwVersion: nonqueued-receiver-com-spec{data-element=SwVersion, filter=data-filter-type=ALWAYS}, required-interface=SwVersion_I
      LRSREgoAssumpt: nonqueued-receiver-com-spec{data-element=EgoAssumpt, filter=data-filter-type=ALWAYS}, required-interface=EgoAssumpt_I
      LRSRSwVersion: nonqueued-receiver-com-spec{data-element=SwVersion, filter=data-filter-type=ALWAYS}, required-interface=SwVersion_I
      RFSREgoAssumpt: nonqueued-receiver-com-spec{data-element=EgoAssumpt, filter=data-filter-type=ALWAYS}, required-interface=EgoAssumpt_I
      RFSRSideSensorStatus: nonqueued-receiver-com-spec{data-element=RadarSensorStatus, filter=data-filter-type=ALWAYS}, required-interface=RadarSensorStatus_I
      RFSRSwVersion: nonqueued-receiver-com-spec{data-element=SwVersion, filter=data-filter-type=ALWAYS}, required-interface=SwVersion_I
      RRSREgoAssumpt: nonqueued-receiver-com-spec{data-element=EgoAssumpt, filter=data-filter-type=ALWAYS}, required-interface=EgoAssumpt_I
      RRSRSideSensorStatus: nonqueued-receiver-com-spec{data-element=RadarSensorStatus, filter=data-filter-type=ALWAYS}, required-interface=RadarSensorStatus_I
      RRSRSwVersion: nonqueued-receiver-com-spec{data-element=SwVersion, filter=data-filter-type=ALWAYS}, required-interface=SwVersion_I
    11 x provide port:
      EgoMotionRaw: nonqueued-sender-com-spec=EgoMotionRaw, provided-interface=EgoMotionRaw_I
      FrontCameraDynPitch: nonqueued-sender-com-spec=DynamicAngle, provided-interface=DynamicAngle_I
      FrontCameraDynRoll: nonqueued-sender-com-spec=DynamicAngle, provided-interface=DynamicAngle_I
      RegionCode: nonqueued-sender-com-spec=RegionCode, provided-interface=RegionCode_I
      TimeSynchStat_DACU: nonqueued-sender-com-spec=TimeSynchStat, provided-interface=TimeSynchStat_I
      Trailer{1..5}Data: nonqueued-sender-com-spec=TrailerData, provided-interface=TrailerData_I
      VIN_DACU: nonqueued-sender-com-spec=VIN, provided-interface=VIN_I
    114 x require port:
      Brightspot{00..08}: nonqueued-receiver-com-spec{data-element=Brightspot, filter=data-filter-type=ALWAYS}, required-interface=Brightspot_I
      FLCEgoAssumption: nonqueued-receiver-com-spec{data-element=FLCEgoAssumption, filter=data-filter-type=ALWAYS}, required-interface=FLCEgoAssumption_I
      FLCObject{00..23}: nonqueued-receiver-com-spec{data-element=FLCObject, filter=data-filter-type=ALWAYS}, required-interface=FLCObject_I
      FLRObj{00..23}: nonqueued-receiver-com-spec{data-element=FLRObject, filter=data-filter-type=ALWAYS}, required-interface=FLRObject_I
      LeftRoadBoundary: nonqueued-receiver-com-spec{data-element=RaisedEdge, filter=data-filter-type=ALWAYS}, required-interface=RaisedEdge_I
      LFSideSensorObj{00..11}: nonqueued-receiver-com-spec{data-element=SideSensorObject, filter=data-filter-type=ALWAYS}, required-interface=SideSensorObject_I
      LFSRRaisedEdge: nonqueued-receiver-com-spec{data-element=RaisedEdge, filter=data-filter-type=ALWAYS}, required-interface=RaisedEdge_I
      LRSideSensorObj{00..11}: nonqueued-receiver-com-spec{data-element=SideSensorObject, filter=data-filter-type=ALWAYS}, required-interface=SideSensorObject_I
      LRSRRaisedEdge: nonqueued-receiver-com-spec{data-element=RaisedEdge, filter=data-filter-type=ALWAYS}, required-interface=RaisedEdge_I
      RFSideSensorObj{00..11}: nonqueued-receiver-com-spec{data-element=SideSensorObject, filter=data-filter-type=ALWAYS}, required-interface=SideSensorObject_I
      RFSRRaisedEdge: nonqueued-receiver-com-spec{data-element=RaisedEdge, filter=data-filter-type=ALWAYS}, required-interface=RaisedEdge_I
      RightRoadBoundary: nonqueued-receiver-com-spec{data-element=RaisedEdge, filter=data-filter-type=ALWAYS}, required-interface=RaisedEdge_I
      RRSideSensorObj{00..11}: nonqueued-receiver-com-spec{data-element=SideSensorObject, filter=data-filter-type=ALWAYS}, required-interface=SideSensorObject_I
      RRSRRaisedEdge: nonqueued-receiver-com-spec{data-element=RaisedEdge, filter=data-filter-type=ALWAYS}, required-interface=RaisedEdge_I
      WiperModeStatus: nonqueued-receiver-com-spec{data-element=WiperModeStatus, filter=data-filter-type=ALWAYS}, required-interface=WiperModeStatus_I
      ForwardLookingCameraStatus2: nonqueued-receiver-com-spec{data-element=ForwardLookingCameraStatus2, filter=data-filter-type=ALWAYS}, required-interface=ForwardLookingCameraStatus2_I
    4 x provide port:
      CameraLoggingTrigger: nonqueued-sender-com-spec=SensorLoggingTrigger, provided-interface=SensorLoggingTrigger_I
      CountryCodeLocal: nonqueued-sender-com-spec=CountryCodeLocal, provided-interface=CountryCodeLocal_I
      FRadarLoggingTrigger: nonqueued-sender-com-spec=SensorLoggingTrigger, provided-interface=SensorLoggingTrigger_I
      SRadarLoggingTrigger: nonqueued-sender-com-spec=SensorLoggingTrigger, provided-interface=SensorLoggingTrigger_I
    25 x require port:
      ActualEHPusherWheelAngle: nonqueued-receiver-com-spec{data-element=ActualEHPusherWheelAngle, filter=data-filter-type=ALWAYS}, required-interface=ActualEHPusherWheelAngle_I
      ActualEHTagWheelAngle: nonqueued-receiver-com-spec{data-element=ActualEHTagWheelAngle, filter=data-filter-type=ALWAYS}, required-interface=ActualEHTagWheelAngle_I
      CentralRearDiffLock_stat: nonqueued-receiver-com-spec{data-element=CentralRearDiffLock_stat, filter=data-filter-type=ALWAYS}, required-interface=CentralRearDiffLock_stat_I
      DifferentialLockStateCentral: nonqueued-receiver-com-spec{data-element=DifferentialLockStateCentral, filter=data-filter-type=ALWAYS}, required-interface=DifferentialLockStateCentral_I
      DifferentialLockStateCentral2: nonqueued-receiver-com-spec{data-element=DifferentialLockStateCentral2, filter=data-filter-type=ALWAYS}, required-interface=DifferentialLockStateCentral2_I
      DifferentialLockStateFrAxle1: nonqueued-receiver-com-spec{data-element=DifferentialLockStateFrAxle1, filter=data-filter-type=ALWAYS}, required-interface=DifferentialLockStateFrAxle1_I
      DifferentialLockStateFrAxle2: nonqueued-receiver-com-spec{data-element=DifferentialLockStateFrAxle2, filter=data-filter-type=ALWAYS}, required-interface=DifferentialLockStateFrAxle2_I
      EASActualPusherWheelAngle: nonqueued-receiver-com-spec{data-element=ActualTagWheelAngle, filter=data-filter-type=ALWAYS}, required-interface=ActualTagWheelAngle_I
      EASActualTagWheelAngle: nonqueued-receiver-com-spec{data-element=ActualTagWheelAngle, filter=data-filter-type=ALWAYS}, required-interface=ActualTagWheelAngle_I
      EHERearAxleSteeringFuncStatus: nonqueued-receiver-com-spec{data-element=EHERearAxleSteeringFuncStatus, filter=data-filter-type=ALWAYS}, required-interface=EHERearAxleSteeringFuncStatus_I
      EHRearAxleSteeringFuncStatus: nonqueued-receiver-com-spec{data-element=EHRearAxleSteeringFuncStatus, filter=data-filter-type=ALWAYS}, required-interface=EHRearAxleSteeringFuncStatus_I
      ExtraAxleSteeringFunctionStat: nonqueued-receiver-com-spec{data-element=RearAxleSteeringFunctionStatus, filter=data-filter-type=ALWAYS}, required-interface=RearAxleSteeringFunctionStatus_I
      FLCVideoOutStatus: nonqueued-receiver-com-spec{data-element=FLCVideoOutStatus, filter=data-filter-type=ALWAYS}, required-interface=FLCVideoOutStatus_I
      FwdCam: nonqueued-receiver-com-spec{data-element=CalibStat, filter=data-filter-type=ALWAYS}, required-interface=CalibStat_I
      FwdRdr: nonqueued-receiver-com-spec{data-element=CalibStat, filter=data-filter-type=ALWAYS}, required-interface=CalibStat_I
      PitchAngle: nonqueued-receiver-com-spec{data-element=AngleType, filter=data-filter-type=ALWAYS}, required-interface=AngleType_I
      PitchAngleRef: nonqueued-receiver-com-spec{data-element=AngleType, filter=data-filter-type=ALWAYS}, required-interface=AngleType_I
      RearAxle{1..3}DiffLock_stat: nonqueued-receiver-com-spec{data-element=RearAxle{1..3}DiffLock_stat, filter=data-filter-type=ALWAYS}, required-interface=RearAxle{1..3}DiffLock_stat_I
      SideRadarLF: nonqueued-receiver-com-spec{data-element=CalibStat, filter=data-filter-type=ALWAYS}, required-interface=CalibStat_I
      SideRadarLR: nonqueued-receiver-com-spec{data-element=CalibStat, filter=data-filter-type=ALWAYS}, required-interface=CalibStat_I
      SideRadarRF: nonqueued-receiver-com-spec{data-element=CalibStat, filter=data-filter-type=ALWAYS}, required-interface=CalibStat_I
      SideRadarRR: nonqueued-receiver-com-spec{data-element=CalibStat, filter=data-filter-type=ALWAYS}, required-interface=CalibStat_I
      WheelCircumference: nonqueued-receiver-com-spec{data-element=WheelCircumference, filter=data-filter-type=ALWAYS}, required-interface=WheelCircumference_I
    provide port EgoMotionXYplane: nonqueued-sender-com-spec=EgoMotionXYplane, provided-interface=EgoMotionXYplane_I
    23 x require port:
      FwdSensingCamStat: nonqueued-receiver-com-spec{data-element=FwdSensingCamStat, filter=data-filter-type=ALWAYS}, required-interface=FwdSensingCamStat_I
      FwdSensingRadarStat: nonqueued-receiver-com-spec{data-element=FwdSensingRadarStat, filter=data-filter-type=ALWAYS}, required-interface=FwdSensingRadarStat_I
      LFSideSensorTrlrObj: nonqueued-receiver-com-spec{data-element=SideSensorTrlrObj, filter=data-filter-type=ALWAYS}, required-interface=SideSensorTrlrObj_I
      LRSideSensorTrlrObj: nonqueued-receiver-com-spec{data-element=SideSensorTrlrObj, filter=data-filter-type=ALWAYS}, required-interface=SideSensorTrlrObj_I
      LRSRSensingRadarStat: nonqueued-receiver-com-spec{data-element=SideSensingRadarStat, filter=data-filter-type=ALWAYS}, required-interface=SideSensingRadarStat_I
      LRSRSideSensorStatus: nonqueued-receiver-com-spec{data-element=RadarSensorStatus, filter=data-filter-type=ALWAYS}, required-interface=RadarSensorStatus_I
      RFSideSensorTrlrObj: nonqueued-receiver-com-spec{data-element=SideSensorTrlrObj, filter=data-filter-type=ALWAYS}, required-interface=SideSensorTrlrObj_I
      RFSRSensingRadarStat: nonqueued-receiver-com-spec{data-element=SideSensingRadarStat, filter=data-filter-type=ALWAYS}, required-interface=SideSensingRadarStat_I
      RRSideSensorTrlrObj: nonqueued-receiver-com-spec{data-element=SideSensorTrlrObj, filter=data-filter-type=ALWAYS}, required-interface=SideSensorTrlrObj_I
      RRSRSensingRadarStat: nonqueued-receiver-com-spec{data-element=SideSensingRadarStat, filter=data-filter-type=ALWAYS}, required-interface=SideSensingRadarStat_I
      TrafficSign{00..11}: nonqueued-receiver-com-spec{data-element=TrafficSign, filter=data-filter-type=ALWAYS}, required-interface=TrafficSign_I
      VisionProperties: nonqueued-receiver-com-spec{data-element=VisionProperties, filter=data-filter-type=ALWAYS}, required-interface=VisionProperties_I
    7 x provide port:
      VideoOutConfFLC: nonqueued-sender-com-spec=VideoOutConfFLC, provided-interface=VideoOutConfFLC_I
      RightRadarsCalibProgress: nonqueued-sender-com-spec=RadarCalibrationProgress, provided-interface=RadarCalibrationProgress_I
      RightRadarsCalibStatus: nonqueued-sender-com-spec=RadarCalibrationStatus, provided-interface=RadarCalibrationStatus_I
      RightSideRadarsStatus: nonqueued-sender-com-spec=SideRadarsStatus, provided-interface=SideRadarsStatus_I
      LeftSideRadarsStatus: nonqueued-sender-com-spec=SideRadarsStatus, provided-interface=SideRadarsStatus_I
      LeftRadarsCalibStatus: nonqueued-sender-com-spec=RadarCalibrationStatus, provided-interface=RadarCalibrationStatus_I
      LeftRadarsCalibProgress: nonqueued-sender-com-spec=RadarCalibrationProgress, provided-interface=RadarCalibrationProgress_I
    16 x require port:
      LiftAxle2Pos: nonqueued-receiver-com-spec{data-element=LiftAxle2Pos, filter=data-filter-type=ALWAYS}, required-interface=LiftAxle2Pos_I
      ASRBrakeControlActive_BB1_X_EBS: nonqueued-receiver-com-spec{data-element=ASRBrakeControlActive_BB1_X_EBS, filter=data-filter-type=ALWAYS}, required-interface=ASRBrakeControlActive_BB1_X_EBS_I
      LiftAxle1Pos: nonqueued-receiver-com-spec{data-element=LiftAxle1Pos, filter=data-filter-type=ALWAYS}, required-interface=LiftAxle1Pos_I
      RelativeSpeedRearAxle2LeftWheel: nonqueued-receiver-com-spec{data-element=RelativeSpeedRearAxle2LeftWheel, filter=data-filter-type=ALWAYS}, required-interface=RelativeSpeedRearAxle2LeftWheel_I
      BrkApplPressHiRaRearAxle1L: nonqueued-receiver-com-spec{data-element=BrkApplPressHiRaRearAxle1L, filter=data-filter-type=ALWAYS}, required-interface=BrkApplPressHiRaRearAxle1L_I
      BrkApplPressHiRaRearAxle1R: nonqueued-receiver-com-spec{data-element=BrkApplPressHiRaRearAxle1R, filter=data-filter-type=ALWAYS}, required-interface=BrkApplPressHiRaRearAxle1R_I
      AxleLocation: nonqueued-receiver-com-spec{data-element=AxleLocation, filter=data-filter-type=ALWAYS}, required-interface=AxleLocation_I
      BrkApplPressHiRaRearAxle2R: nonqueued-receiver-com-spec{data-element=BrkApplPressHiRaRearAxle2R, filter=data-filter-type=ALWAYS}, required-interface=BrkApplPressHiRaRearAxle2R_I
      BrkApplPressHiRaRearAxle2L: nonqueued-receiver-com-spec{data-element=BrkApplPressHiRaRearAxle2L, filter=data-filter-type=ALWAYS}, required-interface=BrkApplPressHiRaRearAxle2L_I
      TERoadinclination_BB1_X_V: nonqueued-receiver-com-spec{data-element=TERoadinclination_BB1_X_V, filter=data-filter-type=ALWAYS}, required-interface=TERoadinclination_BB1_X_V_I
      BrkApplPressHiRaRearAxle3L: nonqueued-receiver-com-spec{data-element=BrkApplPressHiRaRearAxle3L, filter=data-filter-type=ALWAYS}, required-interface=BrkApplPressHiRaRearAxle3L_I
      BrkApplPressHiRaRearAxle3R: nonqueued-receiver-com-spec{data-element=BrkApplPressHiRaRearAxle3R, filter=data-filter-type=ALWAYS}, required-interface=BrkApplPressHiRaRearAxle3R_I
      BrkApplPressHiRaFrAxleR: nonqueued-receiver-com-spec{data-element=BrkApplPressHiRaFrAxleR, filter=data-filter-type=ALWAYS}, required-interface=BrkApplPressHiRaFrAxleR_I
      BrkApplPressHiRaFrAxleL: nonqueued-receiver-com-spec{data-element=BrkApplPressHiRaFrAxleL, filter=data-filter-type=ALWAYS}, required-interface=BrkApplPressHiRaFrAxleL_I
      AxleWeight: nonqueued-receiver-com-spec{data-element=AxleWeight, filter=data-filter-type=ALWAYS}, required-interface=AxleWeight_I
      RlativeSpeedRearAxle2RightWheel: nonqueued-receiver-com-spec{data-element=RlativeSpeedRearAxle2RightWheel, filter=data-filter-type=ALWAYS}, required-interface=RlativeSpeedRearAxle2RightWheel_I
    5 x provide port:
      TrafficSitOverspeedWarn: nonqueued-sender-com-spec=TrafficSitOverspeedWarn, provided-interface=TrafficSitOverspeedWarn_I
      TrafficSitPathInfo1: nonqueued-sender-com-spec=TrafficSitPathInfo, provided-interface=TrafficSitPathInfo_I
      TrafficSitPathInfo2: nonqueued-sender-com-spec=TrafficSitPathInfo, provided-interface=TrafficSitPathInfo_I
      TrafficSitSpeedNotify: nonqueued-sender-com-spec=TrafficSitSpeedNotify, provided-interface=TrafficSitSpeedNotify_I
      UpcomingRoadSpeedRestriction: nonqueued-sender-com-spec=UpcomingRoadSpeedRestriction, provided-interface=UpcomingRoadSpeedRestriction_I
    4 x require port:
      PEMTimeGapRequest: nonqueued-receiver-com-spec{data-element=PEMTimeGapRequest, filter=data-filter-type=ALWAYS}, required-interface=PEMTimeGapRequest_I
      FCW_OpticalWarningStatusHUA: nonqueued-receiver-com-spec{data-element=FCW_OpticalWarningStatus, filter=data-filter-type=ALWAYS}, required-interface=FCW_OpticalWarningStatus_I
      TransOutputShaftSpdSignd_BB1_X_T: nonqueued-receiver-com-spec{data-element=TransOutputShaftSpdSignd_BB1_X_T, filter=data-filter-type=ALWAYS}, required-interface=TransOutputShaftSpdSignd_BB1_X_T_I
      SCS_OpticalWarningStatus: nonqueued-receiver-com-spec{data-element=SCS_OpticalWarningStatus, filter=data-filter-type=ALWAYS}, required-interface=SCS_OpticalWarningStatus_I
    7 x provide port:
      BendingAngle: nonqueued-sender-com-spec=BendingAngle, provided-interface=BendingAngle_I
      ForwardDistanceAlert: nonqueued-sender-com-spec=ForwardDistanceAlert, provided-interface=ForwardDistanceAlert_I
      FrontCameraCalibProgress: nonqueued-sender-com-spec=RadarCalibrationProgress, provided-interface=RadarCalibrationProgress_I
      FrontCameraCalibStatus: nonqueued-sender-com-spec=RadarCalibrationStatus, provided-interface=RadarCalibrationStatus_I
      FrontRadarCalibProgress: nonqueued-sender-com-spec=RadarCalibrationProgress, provided-interface=RadarCalibrationProgress_I
      FrontRadarCalibStatus: nonqueued-sender-com-spec=RadarCalibrationStatus, provided-interface=RadarCalibrationStatus_I
      MOISDriverAlert: nonqueued-sender-com-spec=MOISDriverAlert, provided-interface=MOISDriverAlert_I
    require port RelativeLevelRearAxleLeftRaw: nonqueued-receiver-com-spec{data-element=RelativeLevelRearAxleLeftRaw, filter=data-filter-type=ALWAYS}, required-interface=RelativeLevelRearAxleLeftRaw_I
    require port RelativeLevelRearAxleRightRaw: nonqueued-receiver-com-spec{data-element=RelativeLevelRearAxleRightRaw, filter=data-filter-type=ALWAYS}, required-interface=RelativeLevelRearAxleRightRaw_I
    require port SideCollSituationEnableRqst: nonqueued-receiver-com-spec{data-element=SideCollSituationEnableRqst, filter=data-filter-type=ALWAYS}, required-interface=SideCollSituationEnableRqst_I
    provide port LightIntensity: nonqueued-sender-com-spec=LightIntensity, provided-interface=LightIntensity_I
    21 x require port:
      AccPedal: nonqueued-receiver-com-spec{data-element=AccPedal, filter=data-filter-type=ALWAYS}, required-interface=AccPedal_I
      AmbientLight_stat: nonqueued-receiver-com-spec{data-element=AmbientLight_stat, filter=data-filter-type=ALWAYS}, required-interface=AmbientLight_stat_I
      CMSLCSWarningLeftStatus_stat: nonqueued-receiver-com-spec{data-element=CMSLCSWarningStatus_stat, filter=data-filter-type=ALWAYS}, required-interface=CMSLCSWarningStatus_stat_I
      CMSLCSWarningRightStatus_stat: nonqueued-receiver-com-spec{data-element=CMSLCSWarningStatus_stat, filter=data-filter-type=ALWAYS}, required-interface=CMSLCSWarningStatus_stat_I
      DayOfWeek_stat: nonqueued-receiver-com-spec{data-element=DayOfWeek_stat, filter=data-filter-type=ALWAYS}, required-interface=DayOfWeek_stat_I
      HoursLocal: nonqueued-receiver-com-spec{data-element=HoursLocal, filter=data-filter-type=ALWAYS}, required-interface=HoursLocal_I
      LFSideSensorMALAzimuth: nonqueued-receiver-com-spec{data-element=SideSensorMALAzimuth, filter=data-filter-type=ALWAYS}, required-interface=SideSensorMALAzimuth_I
      LFSideSensorMALElevation: nonqueued-receiver-com-spec{data-element=SideSensorMALElevation, filter=data-filter-type=ALWAYS}, required-interface=SideSensorMALElevation_I
      LRSideSensorMALAzimuth: nonqueued-receiver-com-spec{data-element=SideSensorMALAzimuth, filter=data-filter-type=ALWAYS}, required-interface=SideSensorMALAzimuth_I
      LRSideSensorMALElevation: nonqueued-receiver-com-spec{data-element=SideSensorMALElevation, filter=data-filter-type=ALWAYS}, required-interface=SideSensorMALElevation_I
      MinutesLocal: nonqueued-receiver-com-spec{data-element=MinutesLocal, filter=data-filter-type=ALWAYS}, required-interface=MinutesLocal_I
      PositionLightRequest_status: nonqueued-receiver-com-spec{data-element=PositionLightRequest_status, filter=data-filter-type=ALWAYS}, required-interface=PositionLightRequest_status_I
      PSCTimeGapRequest: nonqueued-receiver-com-spec{data-element=PSCTimeGapRequest, filter=data-filter-type=ALWAYS}, required-interface=PSCTimeGapRequest_I
      RFSideSensorMALAzimuth: nonqueued-receiver-com-spec{data-element=SideSensorMALAzimuth, filter=data-filter-type=ALWAYS}, required-interface=SideSensorMALAzimuth_I
      RFSideSensorMALElevation: nonqueued-receiver-com-spec{data-element=SideSensorMALElevation, filter=data-filter-type=ALWAYS}, required-interface=SideSensorMALElevation_I
      RRSideSensorMALAzimuth: nonqueued-receiver-com-spec{data-element=SideSensorMALAzimuth, filter=data-filter-type=ALWAYS}, required-interface=SideSensorMALAzimuth_I
      RRSideSensorMALElevation: nonqueued-receiver-com-spec{data-element=SideSensorMALElevation, filter=data-filter-type=ALWAYS}, required-interface=SideSensorMALElevation_I
      TertiaryDriveAxleLoad: nonqueued-receiver-com-spec{data-element=AxleLoad, filter=data-filter-type=ALWAYS}, required-interface=AxleLoad_I
      WiperParkStatusGlobal_BB1_X_LCM: nonqueued-receiver-com-spec{data-element=WiperParkStatusGlobal_BB1_X_LCM, filter=data-filter-type=ALWAYS}, required-interface=WiperParkStatusGlobal_BB1_X_LCM_I
      RightFlash_Truck_BB1_X_LCM: nonqueued-receiver-com-spec{data-element=RightFlash_Truck_BB1_X_LCM, filter=data-filter-type=ALWAYS}, required-interface=RightFlash_Truck_BB1_X_LCM_I
      FrontVRU_EnableSwitch_rqst: nonqueued-receiver-com-spec{data-element=FrontVRU_EnableSwitch_rqst, filter=data-filter-type=ALWAYS}, required-interface=FrontVRU_EnableSwitch_rqst_I
    provide port ForwardLookingRadarStat_BB1_X_D: nonqueued-sender-com-spec=ForwardLookingRadarStat_BB1_X_D, provided-interface=ForwardLookingRadarStat_BB1_X_D_I
    require port LeftFlash_Truck_BB1_X_LCM: nonqueued-receiver-com-spec{data-element=LeftFlash_Truck_BB1_X_LCM, filter=data-filter-type=ALWAYS}, required-interface=LeftFlash_Truck_BB1_X_LCM_I
    require port TrailerConnected_BB1_X_LCM: nonqueued-receiver-com-spec{data-element=TrailerConnected_BB1_X_LCM, filter=data-filter-type=ALWAYS}, required-interface=TrailerConnected_BB1_X_LCM_I
    provide port ForwardLookingCameraStat_BB1_X_D: nonqueued-sender-com-spec=ForwardLookingCameraStat_BB1_X_D, provided-interface=ForwardLookingCameraStat_BB1_X_D_I
    provide port MOIS_Status: nonqueued-sender-com-spec=MOIS_Status, provided-interface=MOIS_Status_I
    14 x require port:
      FwdLookingCamStat3: nonqueued-receiver-com-spec{data-element=FwdLookingCamStat3, filter=data-filter-type=ALWAYS}, required-interface=FwdLookingCamStat3_I
      FwdRadarStatus2: nonqueued-receiver-com-spec{data-element=FwdRadarStatus2, filter=data-filter-type=ALWAYS}, required-interface=FwdRadarStatus2_I
      LFSideSensorSafeState: nonqueued-receiver-com-spec{data-element=SideSensorSafeState, filter=data-filter-type=ALWAYS}, required-interface=SideSensorSafeState_I
      LRSideSensorSafeState: nonqueued-receiver-com-spec{data-element=SideSensorSafeState, filter=data-filter-type=ALWAYS}, required-interface=SideSensorSafeState_I
      RFSideSensorSafeState: nonqueued-receiver-com-spec{data-element=SideSensorSafeState, filter=data-filter-type=ALWAYS}, required-interface=SideSensorSafeState_I
      RRSideSensorSafeState: nonqueued-receiver-com-spec{data-element=SideSensorSafeState, filter=data-filter-type=ALWAYS}, required-interface=SideSensorSafeState_I
      SetFwdDistanceAlert_Rqst: nonqueued-receiver-com-spec{data-element=SetFwdDistanceAlert_Rqst, filter=data-filter-type=ALWAYS}, required-interface=SetFwdDistanceAlert_Rqst_I
      SetMOISOperation: nonqueued-receiver-com-spec{data-element=SetMOISOperation, filter=data-filter-type=ALWAYS}, required-interface=SetMOISOperation_I
      IlluminationBrightnessPercent_SLCM08: nonqueued-receiver-com-spec{data-element=IlluminationBrightnessPercent_SLCM08, filter=data-filter-type=ALWAYS}, required-interface=IlluminationBrightnessPercent_SL_I
      NightOrDay_BB1_X_LCM: nonqueued-receiver-com-spec{data-element=NightOrDay_BB1_X_LCM, filter=data-filter-type=ALWAYS}, required-interface=NightOrDay_BB1_X_LCM_I
      LongitudinalAcceleration_8b: nonqueued-receiver-com-spec{data-element=LongitudinalAcceleration_8b, filter=data-filter-type=ALWAYS}, required-interface=LongitudinalAcceleration_8b_I
      ACCEnableRqst_BB1_X_D: nonqueued-receiver-com-spec{data-element=ACCEnableRqst_BB1_X_D, filter=data-filter-type=ALWAYS}, required-interface=ACCEnableRqst_BB1_X_D_I
      SetCMOperation: nonqueued-receiver-com-spec{data-element=SetCMOperation, filter=data-filter-type=ALWAYS}, required-interface=SetCMOperation_I
      FuncIndIlluminationLevel: nonqueued-receiver-com-spec{data-element=FuncIndIlluminationLevel, filter=data-filter-type=ALWAYS}, required-interface=FuncIndIlluminationLevel_I
    provide port SDF_Debug_Local: nonqueued-sender-com-spec{data-element=SDF_Debug_Local, init-value=fields=[ObjectTracks:96 x fields=[{short-label=Estimate, fields=[objID:0, objClass:0, latPos:0, latVel:0, longPos:0, longVel:0, latAcc:0, longAcc:0, heading:0, motionHeading:0, latExtLeft:0, latExtRight:0, longExtFront:0, longExtBack:0]}, {short-label=Information, fields=[sourceId:[0, 0], timeStamp:0, source:[0, 0], isOnComing:0]}], {short-label=EgoVehicle, fields=[yawRate:0, speed:0, acceleration:0, centerOfYawMotion:0, velocityCorrectionFactor:0]}]}, provided-interface=SDF_Debug_Local
    19 x component:
      ACC: type=ACC
      CWEB: type=CWEB
      DVE: type=DVE
      EgoVehicleTrajectoryPlanner: type=EgoVehicleTrajectoryPlanner
      ESI: type=ESI
      ESO: type=ESO
      HOA: type=HOA
      LPS: type=LPS
      MUM: type=MUM
      NonDrivableRegionSituation: type=NonDrivableRegionSituation
      SCS: type=SCS
      SDF: type=SDF
      TrafficSituationActionGate: type=TrafficSituationActionGate
      TSAM: type=TSAM
      TSM: type=TSM
      TSR: type=TSR
      VSI: type=VSI
      MapDataReconstructor: type=MapDataReconstructor
      LongitudinalPathPlanner: type=LongitudinalPathPlanner
    connect ACC.ACC_Out -> CWEB.ACC_Out
    connect ACC.ACC_Out -> TSAM.ACC_Out
    connect ACC.ACC_Out -> TSM.ACC_Out
    connect CWEB.CWEB_Out -> MUM.CWEB_Out
    connect CWEB.CWEB_Out -> TSAM.CWEB_Out
    connect CWEB.CWEB_Out -> TSM.CWEB_Out
    connect DVE.DVE_Out -> TSAM.DVE_Out
    connect EgoVehicleTrajectoryPlanner.EgoVehicleTrajectoryPlanner_Out -> TrafficSituationActionGate.EgoVehicleTrajectoryPlanner_Out
    connect EgoVehicleTrajectoryPlanner.EgoVehicleTrajectoryPlanner_Out -> TSAM.EgoVehicleTrajectoryPlanner_Out
    connect ESI.sideObject -> SDF.sideObject
    connect HOA.HOA_Out -> TSAM.HOA_Out
    connect LPS.LPS_Out -> TSAM.LPS_Out
    connect MUM.MUM_Out -> ESO.MUM_Out
    connect MUM.MUM_Out -> HOA.MUM_Out
    connect MUM.MUM_Out -> SDF.MUM_Out
    connect MUM.MUM_Out -> TSM.MUM_Out
    connect NonDrivableRegionSituation.NonDrivableRegionSituation_Out -> EgoVehicleTrajectoryPlanner.NonDrivableRegionSituation_Out
    connect SCS.SCS_Out -> TSAM.SCS_Out
    connect TrafficSituationActionGate.FASControlMode -> EgoVehicleTrajectoryPlanner.FASControlMode
    connect TrafficSituationActionGate.XBRDACU -> TSM.XBRDACU
    connect TSAM.TrafficSit_XAR -> TrafficSituationActionGate.TrafficSit_XAR
    connect TSAM.TrafficSit_XBR -> TrafficSituationActionGate.TrafficSit_XBR
    connect TSAM.TrafficSit_XSR -> TrafficSituationActionGate.TrafficSit_XSR
    connect TSAM.BB_XBR_RqstActive -> TSM.BB_XBR_RqstActive
    connect TSM.TSM_Out -> ACC.TSM_Out
    connect TSM.TSM_Out -> CWEB.TSM_Out
    connect TSM.TSM_Out -> TrafficSituationActionGate.TSM_Out
    connect TSM.TSM_Out -> TSAM.TSM_Out
    connect TSR.TSR_Out -> TSAM.TSR_Out
    connect VSI.VSI_Out -> ACC.VSI_Out
    connect VSI.VSI_Out -> CWEB.VSI_Out
    connect VSI.VSI_Dynamic_Out -> DVE.VSI_Dynamic_Out
    connect VSI.VSI_Out -> DVE.VSI_Out
    connect VSI.VSI_Out -> EgoVehicleTrajectoryPlanner.VSI_Out
    connect VSI.VSI_Out -> ESO.VSI_Out
    connect VSI.VSI_Dynamic_Out -> LPS.VSI_Dynamic_Out
    connect VSI.VSI_Out -> LPS.VSI_Out
    connect VSI.VSI_Dynamic_Out -> MUM.VSI_Dynamic_Out
    connect VSI.VSI_Out -> MUM.VSI_Out
    connect VSI.VSI_Out -> SCS.VSI_Out
    connect VSI.VSI_Out -> SDF.VSI_Out
    connect VSI.VSI_Out -> TrafficSituationActionGate.VSI_Out
    connect VSI.VSI_Out -> TSAM.VSI_Out
    connect VSI.VSI_Dynamic_Out -> TSM.VSI_Dynamic_Out
    connect VSI.VSI_Out -> TSM.VSI_Out
    delegate VSI.ABSFullyOperational <-> outer port ABSFullyOperational
    delegate TSAM.ACC_SGO_Status <-> outer port ACC_SGO_Status
    delegate VSI.ACC_SGO_TransmissionStatus <-> outer port ACC_SGO_TransmissionStatus
    delegate TSAM.ACC_SGOFaultCondStat <-> outer port ACC_SGOFaultCondStat
    delegate TSAM.ACC_Status <-> outer port ACC_Status
    delegate TSAM.ACC_Status_BB1_X_D <-> outer port ACC_Status_BB1_X_D
    delegate TSAM.ACCBrakeCapacityWarning <-> outer port ACCBrakeCapacityWarning
    delegate TSAM.ACCBrakeCapacityWarning_MD <-> outer port ACCBrakeCapacityWarning_MD
    delegate TSAM.ACCBrakeRequestStatus <-> outer port ACCBrakeRequestStatus
    delegate VSI.AcceleratorPedalPosition1 <-> outer port AcceleratorPedalPosition1
    delegate VSI.ACCEnableRqst <-> outer port ACCEnableRqst
    delegate TSAM.ACCForwardVehicleDistance <-> outer port ACCForwardVehicleDistance
    delegate TSAM.ACCForwardVehicleDistance_MD <-> outer port ACCForwardVehicleDistance_MD
    delegate TSAM.ACCForwardVehicleSpeed <-> outer port ACCForwardVehicleSpeed
    delegate TSAM.ACCForwardVehicleSpeed_MD <-> outer port ACCForwardVehicleSpeed_MD
    delegate TSAM.ACCHMIStatus <-> outer port ACCHMIStatus
    delegate TSAM.ACCHSARequest <-> outer port ACCHSARequest
    delegate TSAM.ACCiRollInhibit <-> outer port ACCiRollInhibit
    delegate TSAM.ACCiSeeDistanceGap <-> outer port ACCiSeeDistanceGap
    delegate VSI.ACCstatus <-> outer port ACCstatus
    delegate TSAM.ACCTargetDetected <-> outer port ACCTargetDetected
    delegate TSAM.ACCTargetDetected_MD <-> outer port ACCTargetDetected_MD
    delegate TSAM.ACCTargetRelLongSpeed <-> outer port ACCTargetRelLongSpeed
    delegate VSI.ACCTimeGapRqst <-> outer port ACCTimeGapRqst
    delegate VSI.ACCTimeGapRqst_MD <-> outer port ACCTimeGapRqst_MD
    delegate VSI.AcctrPedalKickDownSw_stat <-> outer port AcctrPedalKickDownSw_stat
    delegate VSI.ActiveSafetySystemsDisableByRoutine <-> outer port ActiveSafetySystemsDisableByRoutine
    delegate VSI.ActualEnginePercentTorque <-> outer port ActualEnginePercentTorque
    delegate TSAM.AdaptiveCruiseControlMode <-> outer port AdaptiveCruiseControlMode
    delegate TSAM.AdaptiveCruiseControlSetDistan <-> outer port AdaptiveCruiseControlSetDistan
    delegate VSI.AntiLockBrakingActive <-> outer port AntiLockBrakingActive
    delegate VSI.AutomaticCMenableStatus <-> outer port AutomaticCMenableStatus
    delegate TSAM.BB_XBR_RqstActive <-> outer port BB_XBR_RqstActive
    delegate TSAM.BBSteeringStatus <-> outer port BBSteeringStatus
    delegate VSI.BlackOutandConvoyMode_rqst <-> outer port BlackOutandConvoyMode_rqst
    delegate VSI.BrakePedalPosition <-> outer port BrakePedalPosition
    delegate VSI.BrakeSwitch <-> outer port BrakeSwitch
    delegate VSI.BrakeTempWarningLevel <-> outer port BrakeTempWarningLevel
    delegate VSI.CCActive <-> outer port CCActive
    delegate VSI.CCBSetSpeed <-> outer port CCBSetSpeed
    delegate VSI.CCBSetSpeedApplied <-> outer port CCBSetSpeedApplied
    delegate VSI.CCDeactivationWarning <-> outer port CCDeactivationWarning
    delegate VSI.CCSetSpeed <-> outer port CCSetSpeed
    delegate VSI.CCSetSpeedApplied <-> outer port CCSetSpeedApplied
    delegate TSAM.CM_DisengageDrivelineRequest <-> outer port CM_DisengageDrivelineRequest
    delegate TSAM.CM_Status <-> outer port CM_Status
    delegate TSAM.CMReducedAbilityStatus <-> outer port CMReducedAbilityStatus
    delegate TSAM.CMTargetID <-> outer port CMTargetID
    delegate VSI.CMTelltale_stat <-> outer port CMTelltale_stat
    delegate VSI.CMTellTaleStatus <-> outer port CMTellTaleStatus
    delegate TSAM.CollisionSituationAliveAck <-> outer port CollisionSituationAliveAck
    delegate VSI.CollisionSituationAliveRequest <-> outer port CollisionSituationAliveRequest
    delegate VSI.CollisionSituationAliveStatus <-> outer port CollisionSituationAliveStatus
    delegate TSAM.CollSituationHazardLightReq <-> outer port CollSituationHazardLightReq
    delegate VSI.CruiseCtrlActive <-> outer port CruiseCtrlActive
    delegate VSI.CruiseCtrlSetSpeed <-> outer port CruiseCtrlSetSpeed
    delegate CWEB.CWEB_Out <-> outer port CWEB_Out
    delegate VSI.DASActivation_rqst <-> outer port DASActivation_rqst
    delegate TSAM.DASApplicationStatus <-> outer port DASApplicationStatus
    delegate TSAM.DASWarning_BB1_X_D <-> outer port DASWarning_BB1_X_D
    delegate VSI.DiffLockInteraxelStatus <-> outer port DiffLockInteraxelStatus
    delegate VSI.DiffLockWheelsInput1 <-> outer port DiffLockWheelsInput1
    delegate VSI.DiffLockWheelsInput2 <-> outer port DiffLockWheelsInput2
    delegate TSAM.DisengageDrivelineRequest <-> outer port DisengageDrivelineRequest
    delegate VSI.DoorsAjar_stat <-> outer port DoorsAjar_stat
    delegate VSI.DriveAxleLoad <-> outer port DriveAxleLoad
    delegate VSI.DrivelineRetarderLocation <-> outer port DrivelineRetarderLocation
    delegate VSI.DrivelineRetarderRefTorque <-> outer port DrivelineRetarderRefTorque
    delegate VSI.DriverCardDriver1 <-> outer port DriverCardDriver1
    delegate TSAM.DriverImpairedDriverAlert <-> outer port DriverImpairedDriverAlert
    delegate VSI.DriverSeatBeltSwitch <-> outer port DriverSeatBeltSwitch
    delegate VSI.DriverSteeringTorqueEstimate <-> outer port DriverSteeringTorqueEstimate
    delegate VSI.DriverSteeringTqEstimateConf <-> outer port DriverSteeringTqEstimateConf
    delegate TSAM.DriverVigilanceLevel <-> outer port DriverVigilanceLevel
    delegate TSAM.DriverVigilanceLevel_BB1_X_D <-> outer port DriverVigilanceLevel_BB1_X_D
    delegate VSI.EBSXBRStatusInformation <-> outer port EBSXBRStatusInformation
    delegate EgoVehicleTrajectoryPlanner.EgoVehicleTrajectoryPlanner_Out <-> outer port EgoVehicleTrajectoryPlanner_Out
    delegate VSI.EmergencyBrakingInhibition <-> outer port EmergencyBrakingInhibition
    delegate VSI.EngineReferenceTorque <-> outer port EngineReferenceTorque
    delegate VSI.EngineSpeed <-> outer port EngineSpeed
    delegate VSI.EngineTorqueMode <-> outer port EngineTorqueMode
    delegate VSI.ERC1ERActualEngineRetPercentTrq <-> outer port ERC1ERActualEngineRetPercentTrq
    delegate VSI.ERC1RActualRetarderPercentTorque <-> outer port ERC1RActualRetarderPercentTorque
    delegate VSI.ETC2_TransActualGearRatio <-> outer port ETC2_TransActualGearRatio
    delegate VSI.ETC2_TransCurrentGear <-> outer port ETC2_TransCurrentGear
    delegate TrafficSituationActionGate.FASControlMode <-> outer port FASControlMode
    delegate TrafficSituationActionGate.FASCurvatureRequest <-> outer port FASCurvatureRequest
    delegate TrafficSituationActionGate.FASExtCtrlMsgChecksum <-> outer port FASExtCtrlMsgChecksum
    delegate TrafficSituationActionGate.FASExtCtrlMsgCounter <-> outer port FASExtCtrlMsgCounter
    delegate VSI.FASFullyOperational <-> outer port FASFullyOperational
    delegate VSI.FASFunctionInControl <-> outer port FASFunctionInControl
    delegate TSAM.FASHapticFeedbackRequest <-> outer port FASHapticFeedbackRequest
    delegate TrafficSituationActionGate.FASRoadWheelAngleRequest <-> outer port FASRoadWheelAngleRequest
    delegate VSI.FASSaturated <-> outer port FASSaturated
    delegate VSI.FCW_OpticalWarningStatus <-> outer port FCW_OpticalWarningStatus
    delegate TSAM.FCW_Status <-> outer port FCW_Status
    delegate VSI.FoundationBrakeUse <-> outer port FoundationBrakeUse
    delegate TSAM.FrontalCollisionDriverAlert <-> outer port FrontalCollisionDriverAlert
    delegate VSI.FrontAxle1Load <-> outer port FrontAxle1Load
    delegate VSI.FrontAxle2Load <-> outer port FrontAxle2Load
    delegate VSI.FrontAxleLeftWheelSpeed <-> outer port FrontAxleLeftWheelSpeed
    delegate VSI.FrontAxleRightWheelSpeed <-> outer port FrontAxleRightWheelSpeed
    delegate VSI.FrontAxleSpeed <-> outer port FrontAxleSpeed
    delegate TSAM.FrontCollisionDriverAlrt_BB1_X_D <-> outer port FrontCollisionDriverAlrt_BB1_X_D
    delegate VSI.FrontRoadWheelAngleEstimate <-> outer port FrontRoadWheelAngleEstimate
    delegate TSAM.GlareFreeArea{01..03} <-> outer port GlareFreeArea{01..03}
    delegate VSI.GrossCombinationVehicleWeight <-> outer port GrossCombinationVehicleWeight
    delegate VSI.HillHolderMode <-> outer port HillHolderMode
    delegate VSI.HSAState <-> outer port HSAState
    delegate VSI.KFactor <-> outer port KFactor
    delegate VSI.LaneChangeStatus <-> outer port LaneChangeStatus
    delegate VSI.LaneChangeStatus_RTEStat <-> outer port LaneChangeStatus_RTEStat
    delegate VSI.LateralAcceleration <-> outer port LateralAcceleration
    delegate VSI.LateralAccOffset_BB1_X_A <-> outer port LateralAccOffset_BB1_X_A
    delegate VSI.LCS_EnableSwitch_rqst <-> outer port LCS_EnableSwitch_rqst
    delegate VSI.LCSSoundSettingRequest <-> outer port LCSSoundSettingRequest
    delegate TSAM.LCSSoundSettingStatus <-> outer port LCSSoundSettingStatus
    delegate TSAM.LCSSystemStatus <-> outer port LCSSystemStatus
    delegate VSI.LiftAxle1PositionStatus <-> outer port LiftAxle1PositionStatus
    delegate VSI.LKS_Enable <-> outer port LKS_Enable
    delegate TSAM.LKSApplicationStatus <-> outer port LKSApplicationStatus
    delegate TSAM.LKSApplicationStatus_BB1_X_D <-> outer port LKSApplicationStatus_BB1_X_D
    delegate TSAM.LKSCorrectiveSteeringStatus <-> outer port LKSCorrectiveSteeringStatus
    delegate VSI.LKSCSEnableSwitch_rqst <-> outer port LKSCSEnableSwitch_rqst
    delegate VSI.LKSEnableSwitch_rqst <-> outer port LKSEnableSwitch_rqst
    delegate VSI.LoadTruck <-> outer port LoadTruck
    delegate TSAM.LPOSBlocked <-> outer port LPOSBlocked
    delegate VSI.NominalFrictionPercentTorque <-> outer port NominalFrictionPercentTorque
    delegate TSAM.ObserveRoadRestriction_OpCap <-> outer port ObserveRoadRestriction_OpCap
    delegate TSAM.ObserveRoadRestrictionStatus <-> outer port ObserveRoadRestrictionStatus
    delegate VSI.ParkBrakeActuationStatus <-> outer port ParkBrakeActuationStatus
    delegate VSI.ParkingBrkSwitch <-> outer port ParkingBrkSwitch
    delegate TSAM.PathDeviationDriverAlert <-> outer port PathDeviationDriverAlert
    delegate TSAM.PathDeviationDriverAlert_BB1_X_D <-> outer port PathDeviationDriverAlert_BB1_X_D
    delegate VSI.PercentageOfBrakeTemperatureWa <-> outer port PercentageOfBrakeTemperatureWa
    delegate VSI.PloughLampModeStatus <-> outer port PloughLampModeStatus
    delegate VSI.PoweredVehicleWeight <-> outer port PoweredVehicleWeight
    delegate VSI.PusherAxleLoad <-> outer port PusherAxleLoad
    delegate VSI.RASstatus <-> outer port RASstatus
    delegate VSI.RCERReferenceRetarderTorque <-> outer port RCERReferenceRetarderTorque
    delegate VSI.RCRReferenceRetarderTorque <-> outer port RCRReferenceRetarderTorque
    delegate VSI.RCRRetarderLocation <-> outer port RCRRetarderLocation
    delegate VSI.RearAxleLeftWheelSpeed <-> outer port RearAxleLeftWheelSpeed
    delegate VSI.RearAxleRightWheelSpeed <-> outer port RearAxleRightWheelSpeed
    delegate VSI.RearAxleSteeringFunctionStatus <-> outer port RearAxleSteeringFunctionStatus
    delegate VSI.RearPropulsionStat <-> outer port RearPropulsionStat
    delegate VSI.ReferenceEngineRetarderTorque <-> outer port ReferenceEngineRetarderTorque
    delegate TrafficSituationActionGate.ReferencePathCurvature <-> outer port ReferencePathCurvature
    delegate VSI.RelativeSpdFrntAxleLeftWheel <-> outer port RelativeSpdFrntAxleLeftWheel
    delegate VSI.RelativeSpdRearAxle1LeftWheel <-> outer port RelativeSpdRearAxle1LeftWheel
    delegate VSI.RequestedACCDistanceMode <-> outer port RequestedACCDistanceMode
    delegate VSI.ResumeRequestForACC <-> outer port ResumeRequestForACC
    delegate VSI.RetarderStalkArmPosition <-> outer port RetarderStalkArmPosition
    delegate VSI.ReverseGearEngaged <-> outer port ReverseGearEngaged
    delegate VSI.ReverseGearStatus <-> outer port ReverseGearStatus
    delegate VSI.RlativeSpdFrntAxleRightWheel <-> outer port RlativeSpdFrntAxleRightWheel
    delegate VSI.RlativeSpdRearAxle1RightWheel <-> outer port RlativeSpdRearAxle1RightWheel
    delegate VSI.RoadInclination <-> outer port RoadInclination
    delegate VSI.RoadInclinationVP15 <-> outer port RoadInclinationVP15
    delegate TSAM.RoadOvertakingRestriction <-> outer port RoadOvertakingRestriction
    delegate TSAM.RoadSpeedRestriction <-> outer port RoadSpeedRestriction
    delegate TSAM.RoadTypeSpeedRestriction <-> outer port RoadTypeSpeedRestriction
    delegate VSI.RollerBenchModeStatus <-> outer port RollerBenchModeStatus
    delegate VSI.ROPBrakeControlActive <-> outer port ROPBrakeControlActive
    delegate VSI.ROPBrakeCtrlActive <-> outer port ROPBrakeCtrlActive
    delegate VSI.RSBBM <-> outer port RSBBM
    delegate VSI.SecondaryDriveAxleLoad <-> outer port SecondaryDriveAxleLoad
    delegate VSI.SecondThrottle <-> outer port SecondThrottle
    delegate VSI.SelectedEcoCruiseLevel <-> outer port SelectedEcoCruiseLevel
    delegate VSI.SetCMOperation_BP <-> outer port SetCMOperation_BP
    delegate VSI.SetFCWOperation <-> outer port SetFCWOperation
    delegate VSI.SetFCWOperation_BP <-> outer port SetFCWOperation_BP
    delegate ESI.SideObjectDetectedT2P <-> outer port SideObjectDetectedT2P
    delegate VSI.SteeringWheelAngle <-> outer port SteeringWheelAngle
    delegate VSI.SteeringWheelAngle1 <-> outer port SteeringWheelAngle1
    delegate VSI.SteeringWheelAngleOffset <-> outer port SteeringWheelAngleOffset
    delegate VSI.TagAxleLoad <-> outer port TagAxleLoad
    delegate TSAM.TrafficSituationCriticality <-> outer port TrafficSituationCriticality
    delegate VSI.TrailerABSStatus <-> outer port TrailerABSStatus
    delegate VSI.TrailerConnected <-> outer port TrailerConnected
    delegate VSI.TrailerWithoutABS <-> outer port TrailerWithoutABS
    delegate VSI.TrailerWoABS <-> outer port TrailerWoABS
    delegate VSI.TransmissionActualGearRatio <-> outer port TransmissionActualGearRatio
    delegate VSI.TransmissionDrivelineEngaged <-> outer port TransmissionDrivelineEngaged
    delegate VSI.TransmissionShiftInProcess <-> outer port TransmissionShiftInProcess
    delegate VSI.TransmOutputShaftSpeedSigned <-> outer port TransmOutputShaftSpeedSigned
    delegate TSAM.TSC1_E_D_sg <-> outer port TSC1_E_D_sg
    delegate TSAM.TSC1EMSDACU <-> outer port TSC1EMSDACU
    delegate VSI.VDCFullyOperational <-> outer port VDCFullyOperational
    delegate VSI.VehicleCalibratedLoad <-> outer port VehicleCalibratedLoad
    delegate ACC.VehicleMode <-> outer port VehicleMode
    delegate CWEB.VehicleMode <-> outer port VehicleMode
    delegate DVE.VehicleMode <-> outer port VehicleMode
    delegate ESI.VehicleMode <-> outer port VehicleMode
    delegate ESO.VehicleMode <-> outer port VehicleMode
    delegate EgoVehicleTrajectoryPlanner.VehicleMode <-> outer port VehicleMode
    delegate LPS.VehicleMode <-> outer port VehicleMode
    delegate MUM.VehicleMode <-> outer port VehicleMode
    delegate NonDrivableRegionSituation.VehicleMode <-> outer port VehicleMode
    delegate SCS.VehicleMode <-> outer port VehicleMode
    delegate SDF.VehicleMode <-> outer port VehicleMode
    delegate TSAM.VehicleMode <-> outer port VehicleMode
    delegate TSM.VehicleMode <-> outer port VehicleMode
    delegate TrafficSituationActionGate.VehicleMode <-> outer port VehicleMode
    delegate VSI.VehicleMode <-> outer port VehicleMode
    delegate VSI.WheelBasedVehicleSpeed <-> outer port WheelBasedVehicleSpeed
    delegate TSAM.VisionLight_stat <-> outer port VisionLight_stat
    delegate VSI.VP40TrailerABSStatus <-> outer port VP40TrailerABSStatus
    delegate VSI.VSI_Dynamic_Out <-> outer port VSI_Dynamic_Out
    delegate VSI.VSI_Out <-> outer port VSI_Out
    delegate VSI.XARActiveControlMode <-> outer port XARActiveControlMode
    delegate TrafficSituationActionGate.XARDACU <-> outer port XARDACU
    delegate VSI.XARSystemState <-> outer port XARSystemState
    delegate TrafficSituationActionGate.XBR_A_D_sg <-> outer port XBR_A_D_sg
    delegate VSI.XBR_A_V_ControlMode <-> outer port XBR_A_V_ControlMode
    delegate VSI.XBRActiveControlMode <-> outer port XBRActiveControlMode
    delegate VSI.XBRBrakingCapacityTemperature <-> outer port XBRBrakingCapacityTemperature
    delegate VSI.XBRBrakingCapacityTime <-> outer port XBRBrakingCapacityTime
    delegate TrafficSituationActionGate.XBRDACU <-> outer port XBRDACU
    delegate VSI.XBRSystemInformation <-> outer port XBRSystemInformation
    delegate VSI.XBRSystemState <-> outer port XBRSystemState
    delegate TSAM.XPRRequest_CM <-> outer port XPRRequest_CM
    delegate VSI.XPRsystemstate <-> outer port XPRsystemstate
    delegate VSI.YawRate <-> outer port YawRate
    delegate VSI.YawRateOffset <-> outer port YawRateOffset
    delegate VSI.YCBrakeControlActive <-> outer port YCBrakeControlActive
    delegate VSI.GPSData <-> outer port GPSData
    delegate TSAM.RoadSpeedUnitType <-> outer port RoadSpeedUnitType
    delegate TSAM.LKS_DriverOverride <-> outer port LKS_DriverOverride
    delegate TSAM.TSAMIntervntionCapabilityLeft <-> outer port TSAMIntervntionCapabilityLeft
    delegate TSAM.PathDeviationSteeringStatus <-> outer port PathDeviationSteeringStatus
    delegate TSAM.TSAMIntervntionCapabilityRight <-> outer port TSAMIntervntionCapabilityRight
    delegate VSI.TransmissionCurrentGear <-> outer port TransmissionCurrentGear
    delegate VSI.TrailersConnected <-> outer port TrailersConnected
    delegate VSI.Trailer1GeometricData <-> outer port Trailer1GeometricData
    delegate VSI.Trailer2GeometricData <-> outer port Trailer2GeometricData
    delegate VSI.Trailer4GeometricData <-> outer port Trailer4GeometricData
    delegate VSI.Trailer5GeometricData <-> outer port Trailer5GeometricData
    delegate VSI.Trailer3GeometricData <-> outer port Trailer3GeometricData
    delegate TSAM.LSMS_LED_IndicationCmd <-> outer port LSMS_LED_IndicationCmd
    delegate MapDataReconstructor.AdasisMapData <-> outer port AdasisMapData
    delegate TSAM.ACC_SGOBrakeAlert <-> outer port ACC_SGOBrakeAlert
    delegate VSI.CACCSuitability <-> outer port CACCSuitability
    delegate VSI.SpeedAdaptationLevelRqst <-> outer port SpeedAdaptationLevelRqst
    delegate VSI.CACCTimeGapRqst <-> outer port CACCTimeGapRqst
    delegate VSI.SpeedAdaptEnableRqst <-> outer port SpeedAdaptEnableRqst
    delegate TSAM.CACCStatus <-> outer port CACCStatus
    connect VSI.VSI_Out -> LongitudinalPathPlanner.VSI_Out
    delegate TSAM.LSMS_RecordedPathLeft1 <-> outer port LSMS_RecordedPathLeft1
    delegate TSAM.LSMS_KnobAngle1 <-> outer port LSMS_KnobAngle1
    delegate TSAM.FrontRoadWheelAngleEstimate1 <-> outer port FrontRoadWheelAngleEstimate1
    delegate TSAM.LSMS_RevDirSupportUASens1 <-> outer port LSMS_RevDirSupportUASens1
    delegate TSAM.LSMS_UndoUASens1 <-> outer port LSMS_UndoUASens1
    delegate TSAM.LSMS_AngleMatch1 <-> outer port LSMS_AngleMatch1
    delegate TSAM.LSMS_RevDirSupportUAPreCon1 <-> outer port LSMS_RevDirSupportUAPreCon1
    delegate TSAM.LSMS_KnbSteerUASens1 <-> outer port LSMS_KnbSteerUASens1
    delegate TSAM.LSMS_SpeedLimit <-> outer port LSMS_SpeedLimit
    delegate TSAM.LSMS_JackKnifeWarning1 <-> outer port LSMS_JackKnifeWarning1
    delegate TSAM.LSMS_KnbSteerUAPreCon1 <-> outer port LSMS_KnbSteerUAPreCon1
    delegate TSAM.LSMS_UndoUAPreCon1 <-> outer port LSMS_UndoUAPreCon1
    connect MUM.MUM_Out -> EgoVehicleTrajectoryPlanner.MUM_Out
    connect MapDataReconstructor.CurvatureBuffer_Out -> LongitudinalPathPlanner.CurvatureBuffer_Out
    connect MapDataReconstructor.SlopeBuffer_Out -> LongitudinalPathPlanner.SlopeBuffer_Out
    delegate LongitudinalPathPlanner.VehicleMode <-> outer port VehicleMode
    connect MapDataReconstructor.EgoPosition_Out -> LongitudinalPathPlanner.EgoPosition_Out
    connect MapDataReconstructor.SpeedLimitBuffer_Out -> LongitudinalPathPlanner.SpeedLimitBuffer_Out
    connect MapDataReconstructor.RoadEventBuffer_Out -> LongitudinalPathPlanner.RoadEventBuffer_Out
    delegate VSI.TransmissionDrivingMode <-> outer port TransmissionDrivingMode
    delegate VSI.ISeeStatus <-> outer port ISeeStatus
    delegate VSI.LKSCSActiveBoxStatus_GUIrqst <-> outer port LKSCSActiveBoxStatus_GUIrqst
    connect MapDataReconstructor.EgoPosition_Out -> ACC.EgoPosition_Out
    connect MapDataReconstructor.RoadEventBuffer_Out -> ACC.RoadEventBuffer_Out
    connect MapDataReconstructor.SpeedLimitBuffer_Out -> ACC.SpeedLimitBuffer_Out
    connect MapDataReconstructor.SlopeBuffer_Out -> ACC.SlopeBuffer_Out
    connect MapDataReconstructor.CurvatureBuffer_Out -> ACC.CurvatureBuffer_Out
    delegate VSI.DebugFrame_1 <-> outer port DebugFrame_1
    delegate VSI.RelativeLevelFrontAxleLeftRaw <-> outer port RelativeLevelFrontAxleLeftRaw
    delegate VSI.RelativeLevelFrontAxleRightRaw <-> outer port RelativeLevelFrontAxleRightRaw
    delegate VSI.TrafficSitPathExecSta <-> outer port TrafficSitPathExecSta
    delegate VSI.EngineActiveStatus <-> outer port EngineActiveStatus
    delegate TSAM.PSC_SetSpeedChangeRqst <-> outer port PSC_SetSpeedChangeRqst
    delegate TSAM.PSC_DriverBrakingAllowed <-> outer port PSC_DriverBrakingAllowed
    delegate TSAM.TrafficSitPathEvent1 <-> outer port TrafficSitPathEvent1
    delegate TSAM.TrafficSitPathEvent2 <-> outer port TrafficSitPathEvent2
    delegate TSAM.PSC_RequestedPresetSpeed <-> outer port PSC_RequestedPresetSpeed
    delegate TSAM.TrafficSitSpdProfile <-> outer port TrafficSitSpdProfile
    connect LongitudinalPathPlanner.LongitudinalPathPlanner_Out -> TSAM.LongitudinalPathPlanner_Out
    delegate VSI.ASRBrakeControlActive <-> outer port ASRBrakeControlActive
    delegate VSI.ActualMaxAvailDrvlnRetPrctTrq <-> outer port ActualMaxAvailDrvlnRetPrctTrq
    delegate VSI.ActualDrvlnRetdrPercentTorque <-> outer port ActualDrvlnRetdrPercentTorque
    delegate VSI.ActualEngineRetarderPercentTrq <-> outer port ActualEngineRetarderPercentTrq
    delegate VSI.AmbientAirTemperature <-> outer port AmbientAirTemperature
    delegate VSI.DriveAssistEnableRqst <-> outer port DriveAssistEnableRqst
    delegate VSI.DriverRetarderRequest <-> outer port DriverRetarderRequest
    delegate VSI.FrAxleLtWhlBrakeApplPrsHiRng <-> outer port FrAxleLtWhlBrakeApplPrsHiRng
    delegate VSI.FrAxleRtWhlBrakeApplPrsHiRng <-> outer port FrAxleRtWhlBrakeApplPrsHiRng
    delegate VSI.FogLight_Front_cmd <-> outer port FogLight_Front_cmd
    delegate VSI.MainBeam_cmd <-> outer port MainBeam_cmd
    delegate VSI.RelativeLevelFrontAxleRight <-> outer port RelativeLevelFrontAxleRight
    delegate VSI.RelativeLevelRearAxleLeft <-> outer port RelativeLevelRearAxleLeft
    delegate VSI.RelativeLevelFrontAxleLeft <-> outer port RelativeLevelFrontAxleLeft
    delegate VSI.RelativeLevelRearAxleRight <-> outer port RelativeLevelRearAxleRight
    delegate VSI.RrAxle1LtWhlBrakeApplPrsHiRng <-> outer port RrAxle1LtWhlBrakeApplPrsHiRng
    delegate VSI.RrAxle1RtWhlBrakeApplPrsHiRng <-> outer port RrAxle1RtWhlBrakeApplPrsHiRng
    delegate VSI.RrAxle2RtWhlBrakeApplPrsHiRng <-> outer port RrAxle2RtWhlBrakeApplPrsHiRng
    delegate VSI.RrAxle2LtWhlBrakeApplPrsHiRng <-> outer port RrAxle2LtWhlBrakeApplPrsHiRng
    delegate VSI.RrAxle3LtWhlBrakeApplPrsHiRng <-> outer port RrAxle3LtWhlBrakeApplPrsHiRng
    delegate VSI.RrAxle3RtWhlBrakeApplPrsHiRng <-> outer port RrAxle3RtWhlBrakeApplPrsHiRng
    delegate VSI.ScndRrDriveAxleRightWheelSpeed <-> outer port ScndRrDriveAxleRightWheelSpeed
    delegate VSI.ScndRrDriveAxleLeftWheelSpeed <-> outer port ScndRrDriveAxleLeftWheelSpeed
    delegate VSI.TachographLocalMinuteOffset <-> outer port TachographLocalMinuteOffset
    delegate VSI.TotalVehicleDistanceHighRes <-> outer port TotalVehicleDistanceHighRes
    delegate VSI.TachographVehicleSpeed <-> outer port TachographVehicleSpeed
    delegate VSI.TachographLocalHourOffset <-> outer port TachographLocalHourOffset
    delegate TSAM.DriveAssistStatus <-> outer port DriveAssistStatus
    delegate TSAM.DriverTakeControlRqst <-> outer port DriverTakeControlRqst
    connect VSI.VSI_Dynamic_Out -> ESO.VSI_Dynamic_Out
    connect ESI.SideSensorObjects -> SDF.SideSensorObjects
    delegate TSAM.TSMEngineOnRecommended <-> outer port TSMEngineOnRecommended
    delegate TSAM.Debug_6_DACU <-> outer port Debug_6_DACU
    delegate TSAM.Debug_11_DACU <-> outer port Debug_11_DACU
    delegate TSAM.Debug_10_DACU <-> outer port Debug_10_DACU
    delegate TSAM.Debug_5_DACU <-> outer port Debug_5_DACU
    delegate TSAM.Debug_2_DACU <-> outer port Debug_2_DACU
    delegate TSAM.Debug_3_DACU <-> outer port Debug_3_DACU
    delegate TSAM.Debug_9_DACU <-> outer port Debug_9_DACU
    delegate TSAM.Debug_4_DACU <-> outer port Debug_4_DACU
    delegate TSAM.Debug_8_DACU <-> outer port Debug_8_DACU
    delegate TSAM.Debug_7_DACU <-> outer port Debug_7_DACU
    connect TSM.TSM_Debug -> TSAM.TSM_Debug
    connect SDF.SDF_Debug -> TSAM.SDF_Debug
    connect LPS.LPS_Debug -> TSAM.LPS_Debug
    connect SCS.SCS_Debug -> TSAM.SCS_Debug
    connect ACC.ACC_Debug -> TSAM.ACC_Debug
    connect DVE.DVE_Debug -> TSAM.DVE_Debug
    connect CWEB.CWEB_Debug -> TSAM.CWEB_Debug
    connect MUM.MUM_Debug -> TSAM.MUM_Debug
    delegate CWEB.CWEB_Debug <-> outer port CWEB_Debug
    delegate ACC.ACC_Debug <-> outer port ACC_Debug
    connect ESI.FrontFLCSensorObjects -> SDF.FrontFLCSensorObjects
    connect ESI.FrontFLRSensorObjects -> SDF.FrontFLRSensorObjects
    connect SDF.NewSDF_Out -> NonDrivableRegionSituation.NewSDF_Out
    connect SDF.NewSDF_Out -> CWEB.NewSDF_Out
    connect SDF.NewSDF_Out -> LPS.NewSDF_Out
    connect SDF.NewSDF_Out -> EgoVehicleTrajectoryPlanner.NewSDF_Out
    delegate VSI.ActualPusherWheelAngle <-> outer port ActualPusherWheelAngle
    delegate VSI.ABSAxle2Active <-> outer port ABSAxle2Active
    delegate VSI.CabLightIntensity_stat <-> outer port CabLightIntensity_stat
    delegate VSI.PusherAxleLeftWheelSpeed <-> outer port PusherAxleLeftWheelSpeed
    delegate VSI.ScndFrAxleRightWheelSpeed <-> outer port ScndFrAxleRightWheelSpeed
    delegate VSI.ABSAxle1Active <-> outer port ABSAxle1Active
    delegate VSI.LongitudinalAcceleration <-> outer port LongitudinalAcceleration
    delegate VSI.TagAxleRightWheelSpeed <-> outer port TagAxleRightWheelSpeed
    delegate VSI.PusherAxleRightWheelSpeed <-> outer port PusherAxleRightWheelSpeed
    delegate VSI.ABSAxle3Active <-> outer port ABSAxle3Active
    delegate VSI.ASREngineControlActive <-> outer port ASREngineControlActive
    delegate VSI.ABSAxle5Active <-> outer port ABSAxle5Active
    delegate VSI.ActualTagWheelAngle <-> outer port ActualTagWheelAngle
    delegate VSI.LiftAxle2PositionStatus <-> outer port LiftAxle2PositionStatus
    delegate VSI.CountryCode <-> outer port CountryCode
    delegate VSI.TagAxleLeftWheelSpeed <-> outer port TagAxleLeftWheelSpeed
    delegate VSI.ABSAxle4Active <-> outer port ABSAxle4Active
    delegate VSI.ScndFrAxleLeftWheelSpeed <-> outer port ScndFrAxleLeftWheelSpeed
    connect SDF.NewSDF_Out -> ACC.NewSDF_Out
    delegate ESI.RRSRSwVersion <-> outer port RRSRSwVersion
    delegate ESI.LRSREgoAssumpt <-> outer port LRSREgoAssumpt
    delegate ESI.LRSRSwVersion <-> outer port LRSRSwVersion
    delegate ESI.RFSREgoAssumpt <-> outer port RFSREgoAssumpt
    delegate ESI.LFSREgoAssumpt <-> outer port LFSREgoAssumpt
    delegate ESI.LFSRSideSensorStatus <-> outer port LFSRSideSensorStatus
    delegate ESI.Clothoid00 <-> outer port Clothoid00
    delegate ESI.FLCSwVersion <-> outer port FLCSwVersion
    delegate ESI.Clothoid05 <-> outer port Clothoid05
    delegate ESI.Clothoid03 <-> outer port Clothoid03
    delegate ESI.RFSRSwVersion <-> outer port RFSRSwVersion
    delegate ESI.FLREgoAssumpt <-> outer port FLREgoAssumpt
    delegate ESI.Clothoid01 <-> outer port Clothoid01
    delegate ESI.Clothoid02 <-> outer port Clothoid02
    delegate ESI.RRSREgoAssumpt <-> outer port RRSREgoAssumpt
    delegate ESI.Clothoid04 <-> outer port Clothoid04
    delegate ESI.FLRSwVersion <-> outer port FLRSwVersion
    delegate ESI.Clothoid06 <-> outer port Clothoid06
    delegate ESI.RFSRSideSensorStatus <-> outer port RFSRSideSensorStatus
    delegate ESI.Clothoid07 <-> outer port Clothoid07
    delegate ESI.RRSRSideSensorStatus <-> outer port RRSRSideSensorStatus
    delegate ESI.LFSRSwVersion <-> outer port LFSRSwVersion
    delegate TSAM.LCS_WarningStatusLeft <-> outer port LCS_WarningStatusLeft
    delegate TSAM.LCS_WarningStatusRight <-> outer port LCS_WarningStatusRight
    delegate ESO.ShadowArea <-> outer port ShadowArea
    delegate ESO.EgoPathPrediction <-> outer port EgoPathPrediction
    connect SDF.NewSDF_Out -> TSAM.NewSDF_Out
    connect SDF.NewSDF_Out -> TSR.NewSDF_Out
    delegate ESI.FLRObj05 <-> outer port FLRObj05
    delegate ESI.LFSideSensorObj05 <-> outer port LFSideSensorObj05
    delegate ESI.FLRObj03 <-> outer port FLRObj03
    delegate ESI.FLCObject06 <-> outer port FLCObject06
    delegate ESI.LFSideSensorObj02 <-> outer port LFSideSensorObj02
    delegate ESI.FLRObj01 <-> outer port FLRObj01
    delegate ESI.RFSideSensorObj08 <-> outer port RFSideSensorObj08
    delegate ESI.RRSideSensorObj06 <-> outer port RRSideSensorObj06
    delegate ESI.RRSideSensorObj09 <-> outer port RRSideSensorObj09
    delegate ESI.LRSideSensorObj02 <-> outer port LRSideSensorObj02
    delegate ESI.LRSRRaisedEdge <-> outer port LRSRRaisedEdge
    delegate ESI.LRSideSensorObj00 <-> outer port LRSideSensorObj00
    delegate ESI.FLCObject00 <-> outer port FLCObject00
    delegate ESI.Brightspot02 <-> outer port Brightspot02
    delegate ESI.LeftRoadBoundary <-> outer port LeftRoadBoundary
    delegate ESI.LRSideSensorObj03 <-> outer port LRSideSensorObj03
    delegate ESI.RFSideSensorObj09 <-> outer port RFSideSensorObj09
    delegate ESI.RFSideSensorObj07 <-> outer port RFSideSensorObj07
    delegate ESI.LFSideSensorObj11 <-> outer port LFSideSensorObj11
    delegate ESI.LFSRRaisedEdge <-> outer port LFSRRaisedEdge
    delegate ESI.RRSideSensorObj05 <-> outer port RRSideSensorObj05
    delegate ESI.LRSideSensorObj08 <-> outer port LRSideSensorObj08
    delegate ESI.RightRoadBoundary <-> outer port RightRoadBoundary
    delegate ESI.FLRObj20 <-> outer port FLRObj20
    delegate ESI.RRSideSensorObj10 <-> outer port RRSideSensorObj10
    delegate ESI.LFSideSensorObj00 <-> outer port LFSideSensorObj00
    delegate ESI.FLRObj02 <-> outer port FLRObj02
    delegate ESI.FLRObj17 <-> outer port FLRObj17
    delegate ESI.RFSRRaisedEdge <-> outer port RFSRRaisedEdge
    delegate ESI.RRSideSensorObj07 <-> outer port RRSideSensorObj07
    delegate ESI.FLCObject08 <-> outer port FLCObject08
    delegate ESI.FLRObj21 <-> outer port FLRObj21
    delegate ESI.RRSideSensorObj04 <-> outer port RRSideSensorObj04
    delegate ESI.LFSideSensorObj03 <-> outer port LFSideSensorObj03
    delegate ESI.LRSideSensorObj10 <-> outer port LRSideSensorObj10
    delegate ESI.FLRObj23 <-> outer port FLRObj23
    delegate ESI.LRSideSensorObj09 <-> outer port LRSideSensorObj09
    delegate ESI.Brightspot06 <-> outer port Brightspot06
    delegate ESI.RFSideSensorObj02 <-> outer port RFSideSensorObj02
    delegate ESI.FLCObject16 <-> outer port FLCObject16
    delegate ESI.FLRObj10 <-> outer port FLRObj10
    delegate ESI.FLRObj16 <-> outer port FLRObj16
    delegate ESI.FLCObject02 <-> outer port FLCObject02
    delegate ESI.FLCObject10 <-> outer port FLCObject10
    delegate ESI.RFSideSensorObj00 <-> outer port RFSideSensorObj00
    delegate ESI.RFSideSensorObj04 <-> outer port RFSideSensorObj04
    delegate ESI.FLRObj00 <-> outer port FLRObj00
    delegate ESI.FLCObject13 <-> outer port FLCObject13
    delegate ESI.FLCObject11 <-> outer port FLCObject11
    delegate ESI.Brightspot05 <-> outer port Brightspot05
    delegate ESI.RRSRRaisedEdge <-> outer port RRSRRaisedEdge
    delegate ESI.FLCObject23 <-> outer port FLCObject23
    delegate ESI.FLCObject03 <-> outer port FLCObject03
    delegate ESI.RRSideSensorObj08 <-> outer port RRSideSensorObj08
    delegate ESI.RFSideSensorObj01 <-> outer port RFSideSensorObj01
    delegate ESI.RFSideSensorObj06 <-> outer port RFSideSensorObj06
    delegate ESI.FLRObj11 <-> outer port FLRObj11
    delegate ESI.FLCObject05 <-> outer port FLCObject05
    delegate ESI.RRSideSensorObj11 <-> outer port RRSideSensorObj11
    delegate ESI.RRSideSensorObj03 <-> outer port RRSideSensorObj03
    delegate ESI.LFSideSensorObj01 <-> outer port LFSideSensorObj01
    delegate ESI.FLCObject09 <-> outer port FLCObject09
    delegate ESI.LFSideSensorObj08 <-> outer port LFSideSensorObj08
    delegate ESI.FLRObj07 <-> outer port FLRObj07
    delegate ESI.LFSideSensorObj04 <-> outer port LFSideSensorObj04
    delegate ESI.FLCObject01 <-> outer port FLCObject01
    delegate ESI.LFSideSensorObj07 <-> outer port LFSideSensorObj07
    delegate ESI.Brightspot08 <-> outer port Brightspot08
    delegate ESI.FLCObject20 <-> outer port FLCObject20
    delegate ESI.FLRObj19 <-> outer port FLRObj19
    delegate ESI.FLRObj12 <-> outer port FLRObj12
    delegate ESI.FLRObj15 <-> outer port FLRObj15
    delegate ESI.RFSideSensorObj10 <-> outer port RFSideSensorObj10
    delegate ESI.FLCObject22 <-> outer port FLCObject22
    delegate ESI.LFSideSensorObj06 <-> outer port LFSideSensorObj06
    delegate ESI.FLRObj22 <-> outer port FLRObj22
    delegate ESI.LRSideSensorObj11 <-> outer port LRSideSensorObj11
    delegate ESI.FLCObject04 <-> outer port FLCObject04
    delegate ESI.FLCObject19 <-> outer port FLCObject19
    delegate ESI.LRSideSensorObj07 <-> outer port LRSideSensorObj07
    delegate ESI.FLCObject18 <-> outer port FLCObject18
    delegate ESI.FLRObj18 <-> outer port FLRObj18
    delegate ESI.LRSideSensorObj06 <-> outer port LRSideSensorObj06
    delegate ESI.FLCObject12 <-> outer port FLCObject12
    delegate ESI.RFSideSensorObj11 <-> outer port RFSideSensorObj11
    delegate ESI.FLCObject21 <-> outer port FLCObject21
    delegate ESI.Brightspot00 <-> outer port Brightspot00
    delegate ESI.Brightspot01 <-> outer port Brightspot01
    delegate ESI.LRSideSensorObj05 <-> outer port LRSideSensorObj05
    delegate ESI.LFSideSensorObj09 <-> outer port LFSideSensorObj09
    delegate ESI.RRSideSensorObj02 <-> outer port RRSideSensorObj02
    delegate ESI.FLRObj04 <-> outer port FLRObj04
    delegate ESI.FLCObject17 <-> outer port FLCObject17
    delegate ESI.Brightspot03 <-> outer port Brightspot03
    delegate ESI.FLCEgoAssumption <-> outer port FLCEgoAssumption
    delegate ESI.RRSideSensorObj00 <-> outer port RRSideSensorObj00
    delegate ESI.FLRObj06 <-> outer port FLRObj06
    delegate ESI.FLRObj14 <-> outer port FLRObj14
    delegate ESI.Brightspot04 <-> outer port Brightspot04
    delegate ESI.LFSideSensorObj10 <-> outer port LFSideSensorObj10
    delegate ESI.FLCObject07 <-> outer port FLCObject07
    delegate ESI.FLRObj09 <-> outer port FLRObj09
    delegate ESI.RFSideSensorObj03 <-> outer port RFSideSensorObj03
    delegate ESI.FLCObject15 <-> outer port FLCObject15
    delegate ESI.RRSideSensorObj01 <-> outer port RRSideSensorObj01
    delegate ESI.FLRObj13 <-> outer port FLRObj13
    delegate ESI.Brightspot07 <-> outer port Brightspot07
    delegate ESI.LRSideSensorObj04 <-> outer port LRSideSensorObj04
    delegate ESI.RFSideSensorObj05 <-> outer port RFSideSensorObj05
    delegate ESI.FLCObject14 <-> outer port FLCObject14
    delegate ESI.LRSideSensorObj01 <-> outer port LRSideSensorObj01
    delegate ESI.FLRObj08 <-> outer port FLRObj08
    delegate VSI.WiperModeStatus <-> outer port WiperModeStatus
    delegate ESO.FrontCameraDynPitch <-> outer port FrontCameraDynPitch
    delegate ESO.Trailer2Data <-> outer port Trailer2Data
    delegate ESO.EgoMotionRaw <-> outer port EgoMotionRaw
    delegate ESO.FrontCameraDynRoll <-> outer port FrontCameraDynRoll
    delegate ESO.Trailer5Data <-> outer port Trailer5Data
    delegate ESO.Trailer1Data <-> outer port Trailer1Data
    delegate ESO.Trailer3Data <-> outer port Trailer3Data
    delegate ESO.Trailer4Data <-> outer port Trailer4Data
    delegate ESO.RegionCode <-> outer port RegionCode
    delegate ESO.VIN_DACU <-> outer port VIN_DACU
    delegate ESO.TimeSynchStat_DACU <-> outer port TimeSynchStat_DACU
    connect ESI.FrontFLCSensorObjects -> TSM.FrontFLCSensorObjects
    connect SDF.NewSDF_Out -> TSM.NewSDF_Out
    connect ESI.FrontFLRSensorObjects -> TSM.FrontFLRSensorObjects
    connect SDF.NewSDF_Out -> SCS.NewSDF_Out
    connect SDF.NewSDF_Out -> DVE.NewSDF_Out
    connect SDF.NewSDF_Out -> HOA.NewSDF_Out
    connect SDF.NewSDF_Out -> LongitudinalPathPlanner.NewSDF_Out
    connect SDF.NewSDF_Out -> MapDataReconstructor.NewSDF_Out
    delegate ESI.SideRadarLR <-> outer port SideRadarLR
    delegate ESI.SideRadarLF <-> outer port SideRadarLF
    delegate ESI.FwdCam <-> outer port FwdCam
    delegate ESI.SideRadarRF <-> outer port SideRadarRF
    delegate ESI.FwdRdr <-> outer port FwdRdr
    delegate ESI.SideRadarRR <-> outer port SideRadarRR
    delegate VSI.PitchAngleRef <-> outer port PitchAngleRef
    delegate VSI.DifferentialLockStateFrAxle2 <-> outer port DifferentialLockStateFrAxle2
    delegate VSI.PitchAngle <-> outer port PitchAngle
    delegate VSI.RearAxle3DiffLock_stat <-> outer port RearAxle3DiffLock_stat
    delegate VSI.WheelCircumference <-> outer port WheelCircumference
    delegate VSI.EHERearAxleSteeringFuncStatus <-> outer port EHERearAxleSteeringFuncStatus
    delegate VSI.RearAxle2DiffLock_stat <-> outer port RearAxle2DiffLock_stat
    delegate VSI.DifferentialLockStateCentral <-> outer port DifferentialLockStateCentral
    delegate VSI.EHRearAxleSteeringFuncStatus <-> outer port EHRearAxleSteeringFuncStatus
    delegate VSI.CentralRearDiffLock_stat <-> outer port CentralRearDiffLock_stat
    delegate VSI.ActualEHTagWheelAngle <-> outer port ActualEHTagWheelAngle
    delegate VSI.DifferentialLockStateFrAxle1 <-> outer port DifferentialLockStateFrAxle1
    delegate VSI.ActualEHPusherWheelAngle <-> outer port ActualEHPusherWheelAngle
    delegate VSI.ExtraAxleSteeringFunctionStat <-> outer port ExtraAxleSteeringFunctionStat
    delegate VSI.EASActualPusherWheelAngle <-> outer port EASActualPusherWheelAngle
    delegate VSI.DifferentialLockStateCentral2 <-> outer port DifferentialLockStateCentral2
    delegate VSI.RearAxle1DiffLock_stat <-> outer port RearAxle1DiffLock_stat
    delegate VSI.EASActualTagWheelAngle <-> outer port EASActualTagWheelAngle
    delegate ESI.TrafficSign00 <-> outer port TrafficSign00
    delegate ESI.RFSideSensorTrlrObj <-> outer port RFSideSensorTrlrObj
    delegate ESI.LRSRSensingRadarStat <-> outer port LRSRSensingRadarStat
    delegate ESI.VisionProperties <-> outer port VisionProperties
    delegate ESI.TrafficSign02 <-> outer port TrafficSign02
    delegate ESI.FwdSensingCamStat <-> outer port FwdSensingCamStat
    delegate ESI.RRSRSensingRadarStat <-> outer port RRSRSensingRadarStat
    delegate ESI.TrafficSign07 <-> outer port TrafficSign07
    delegate ESI.LFSideSensorTrlrObj <-> outer port LFSideSensorTrlrObj
    delegate ESI.RRSideSensorTrlrObj <-> outer port RRSideSensorTrlrObj
    delegate ESI.TrafficSign04 <-> outer port TrafficSign04
    delegate ESI.TrafficSign03 <-> outer port TrafficSign03
    delegate ESI.RFSRSensingRadarStat <-> outer port RFSRSensingRadarStat
    delegate ESI.LRSideSensorTrlrObj <-> outer port LRSideSensorTrlrObj
    delegate ESI.TrafficSign06 <-> outer port TrafficSign06
    delegate ESI.TrafficSign10 <-> outer port TrafficSign10
    delegate ESI.TrafficSign11 <-> outer port TrafficSign11
    delegate ESI.FwdSensingRadarStat <-> outer port FwdSensingRadarStat
    delegate ESI.TrafficSign09 <-> outer port TrafficSign09
    delegate ESI.TrafficSign01 <-> outer port TrafficSign01
    delegate ESI.FLCVideoOutStatus <-> outer port FLCVideoOutStatus
    delegate ESI.TrafficSign05 <-> outer port TrafficSign05
    delegate ESI.TrafficSign08 <-> outer port TrafficSign08
    delegate ESI.FwdRadarStatus <-> outer port FwdRadarStatus
    delegate ESI.LFSRSensingRadarStat <-> outer port LFSRSensingRadarStat
    delegate ESI.LRSRSideSensorStatus <-> outer port LRSRSideSensorStatus
    delegate ESI.ForwardLookingCameraStatus2 <-> outer port ForwardLookingCameraStatus2
    delegate ESO.EgoMotionXYplane <-> outer port EgoMotionXYplane
    delegate ESO.CountryCodeLocal <-> outer port CountryCodeLocal
    delegate ESO.FRadarLoggingTrigger <-> outer port FRadarLoggingTrigger
    delegate ESO.SRadarLoggingTrigger <-> outer port SRadarLoggingTrigger
    delegate ESO.CameraLoggingTrigger <-> outer port CameraLoggingTrigger
    delegate TSAM.RightSideRadarsStatus <-> outer port RightSideRadarsStatus
    delegate TSAM.LeftRadarsCalibProgress <-> outer port LeftRadarsCalibProgress
    delegate TSAM.LeftSideRadarsStatus <-> outer port LeftSideRadarsStatus
    delegate TSAM.RightRadarsCalibStatus <-> outer port RightRadarsCalibStatus
    delegate TSAM.LeftRadarsCalibStatus <-> outer port LeftRadarsCalibStatus
    delegate TSAM.RightRadarsCalibProgress <-> outer port RightRadarsCalibProgress
    connect VSI.VSI_Out -> TSR.VSI_Out
    delegate VSI.ASRBrakeControlActive_BB1_X_EBS <-> outer port ASRBrakeControlActive_BB1_X_EBS
    delegate VSI.BrkApplPressHiRaRearAxle1L <-> outer port BrkApplPressHiRaRearAxle1L
    delegate VSI.AxleWeight <-> outer port AxleWeight
    delegate VSI.BrkApplPressHiRaRearAxle2L <-> outer port BrkApplPressHiRaRearAxle2L
    delegate VSI.BrkApplPressHiRaFrAxleR <-> outer port BrkApplPressHiRaFrAxleR
    delegate VSI.TERoadinclination_BB1_X_V <-> outer port TERoadinclination_BB1_X_V
    delegate VSI.BrkApplPressHiRaRearAxle2R <-> outer port BrkApplPressHiRaRearAxle2R
    delegate VSI.BrkApplPressHiRaRearAxle1R <-> outer port BrkApplPressHiRaRearAxle1R
    delegate VSI.BrkApplPressHiRaFrAxleL <-> outer port BrkApplPressHiRaFrAxleL
    delegate VSI.LiftAxle1Pos <-> outer port LiftAxle1Pos
    delegate VSI.LiftAxle2Pos <-> outer port LiftAxle2Pos
    delegate VSI.BrkApplPressHiRaRearAxle3R <-> outer port BrkApplPressHiRaRearAxle3R
    delegate VSI.BrkApplPressHiRaRearAxle3L <-> outer port BrkApplPressHiRaRearAxle3L
    delegate VSI.AxleLocation <-> outer port AxleLocation
    delegate VSI.RelativeSpeedRearAxle2LeftWheel <-> outer port RelativeSpeedRearAxle2LeftWheel
    delegate VSI.RlativeSpeedRearAxle2RightWheel <-> outer port RlativeSpeedRearAxle2RightWheel
    connect HOA.HOA_Out -> ESO.HOA_Out
    delegate VSI.PEMTimeGapRequest <-> outer port PEMTimeGapRequest
    delegate TSAM.UpcomingRoadSpeedRestriction <-> outer port UpcomingRoadSpeedRestriction
    delegate TSAM.TrafficSitSpeedNotify <-> outer port TrafficSitSpeedNotify
    delegate TSAM.TrafficSitPathInfo2 <-> outer port TrafficSitPathInfo2
    delegate TSAM.TrafficSitPathInfo1 <-> outer port TrafficSitPathInfo1
    delegate TSAM.TrafficSitOverspeedWarn <-> outer port TrafficSitOverspeedWarn
    delegate VSI.FCW_OpticalWarningStatusHUA <-> outer port FCW_OpticalWarningStatusHUA
    delegate VSI.TransOutputShaftSpdSignd_BB1_X_T <-> outer port TransOutputShaftSpdSignd_BB1_X_T
    delegate VSI.SCS_OpticalWarningStatus <-> outer port SCS_OpticalWarningStatus
    connect ESI.SDF_Trigger -> SDF.SDF_Trigger
    delegate VSI.RelativeLevelRearAxleRightRaw <-> outer port RelativeLevelRearAxleRightRaw
    delegate VSI.SideCollSituationEnableRqst <-> outer port SideCollSituationEnableRqst
    delegate VSI.RelativeLevelRearAxleLeftRaw <-> outer port RelativeLevelRearAxleLeftRaw
    delegate ESO.BendingAngle <-> outer port BendingAngle
    delegate TSAM.FrontCameraCalibProgress <-> outer port FrontCameraCalibProgress
    delegate TSAM.FrontRadarCalibStatus <-> outer port FrontRadarCalibStatus
    delegate TSAM.FrontRadarCalibProgress <-> outer port FrontRadarCalibProgress
    delegate TSAM.MOISDriverAlert <-> outer port MOISDriverAlert
    delegate TSAM.FrontCameraCalibStatus <-> outer port FrontCameraCalibStatus
    delegate TSAM.ForwardDistanceAlert <-> outer port ForwardDistanceAlert
    delegate TSAM.LightIntensity <-> outer port LightIntensity
    connect MapDataReconstructor.EgoPosition_Out -> TSR.EgoPosition_Out
    connect MapDataReconstructor.RoadEventBuffer_Out -> TSR.RoadEventBuffer_Out
    connect MapDataReconstructor.SpeedLimitBuffer_Out -> TSR.SpeedLimitBuffer_Out
    connect MapDataReconstructor.FormOfWayBuffer_Out -> TSR.FormOfWayBuffer_Out
    delegate VSI.AccPedal <-> outer port AccPedal
    delegate VSI.DayOfWeek_stat <-> outer port DayOfWeek_stat
    delegate VSI.PSCTimeGapRequest <-> outer port PSCTimeGapRequest
    delegate VSI.MinutesLocal <-> outer port MinutesLocal
    delegate VSI.TertiaryDriveAxleLoad <-> outer port TertiaryDriveAxleLoad
    delegate VSI.CMSLCSWarningRightStatus_stat <-> outer port CMSLCSWarningRightStatus_stat
    delegate VSI.AmbientLight_stat <-> outer port AmbientLight_stat
    delegate VSI.HoursLocal <-> outer port HoursLocal
    delegate VSI.PositionLightRequest_status <-> outer port PositionLightRequest_status
    delegate VSI.CMSLCSWarningLeftStatus_stat <-> outer port CMSLCSWarningLeftStatus_stat
    delegate ESI.RFSideSensorMALElevation <-> outer port RFSideSensorMALElevation
    delegate ESI.LFSideSensorMALAzimuth <-> outer port LFSideSensorMALAzimuth
    delegate ESI.RRSideSensorMALAzimuth <-> outer port RRSideSensorMALAzimuth
    delegate ESI.RRSideSensorMALElevation <-> outer port RRSideSensorMALElevation
    delegate ESI.LRSideSensorMALAzimuth <-> outer port LRSideSensorMALAzimuth
    delegate ESI.LRSideSensorMALElevation <-> outer port LRSideSensorMALElevation
    delegate ESI.RFSideSensorMALAzimuth <-> outer port RFSideSensorMALAzimuth
    delegate ESI.LFSideSensorMALElevation <-> outer port LFSideSensorMALElevation
    delegate TSAM.ForwardLookingRadarStat_BB1_X_D <-> outer port ForwardLookingRadarStat_BB1_X_D
    delegate TSAM.ForwardLookingCameraStat_BB1_X_D <-> outer port ForwardLookingCameraStat_BB1_X_D
    delegate VSI.RightFlash_Truck_BB1_X_LCM <-> outer port RightFlash_Truck_BB1_X_LCM
    delegate VSI.LeftFlash_Truck_BB1_X_LCM <-> outer port LeftFlash_Truck_BB1_X_LCM
    delegate VSI.WiperParkStatusGlobal_BB1_X_LCM <-> outer port WiperParkStatusGlobal_BB1_X_LCM
    delegate VSI.FrontVRU_EnableSwitch_rqst <-> outer port FrontVRU_EnableSwitch_rqst
    delegate VSI.TrailerConnected_BB1_X_LCM <-> outer port TrailerConnected_BB1_X_LCM
    connect VSI.VSI_Dynamic_Out -> TSAM.VSI_Dynamic_Out
    connect TSAM.PerformSafeStop -> ACC.PerformSafeStop
    connect TSAM.DriveAssistStatus -> EgoVehicleTrajectoryPlanner.DriveAssistStatus
    connect TSAM.LatControlFactor_I -> EgoVehicleTrajectoryPlanner.LatControlFactor
    connect TSR.TSR_Out -> ESO.TSR_Out
    delegate ESI.RFSideSensorSafeState <-> outer port RFSideSensorSafeState
    delegate ESI.LFSideSensorSafeState <-> outer port LFSideSensorSafeState
    delegate ESI.FwdLookingCamStat3 <-> outer port FwdLookingCamStat3
    delegate ESI.RRSideSensorSafeState <-> outer port RRSideSensorSafeState
    delegate ESI.LRSideSensorSafeState <-> outer port LRSideSensorSafeState
    delegate ESI.FwdRadarStatus2 <-> outer port FwdRadarStatus2
    delegate VSI.SetFwdDistanceAlert_Rqst <-> outer port SetFwdDistanceAlert_Rqst
    delegate VSI.SetMOISOperation <-> outer port SetMOISOperation
    delegate TSAM.MOIS_Status <-> outer port MOIS_Status
    delegate ESO.VideoOutConfFLC <-> outer port VideoOutConfFLC
    connect MapDataReconstructor.FormOfWayBuffer_Out -> LongitudinalPathPlanner.FormOfWayBuffer_Out
    connect VSI.VSI_Out -> ESI.VSI_Out
    delegate VSI.ACCEnableRqst_BB1_X_D <-> outer port ACCEnableRqst_BB1_X_D
    delegate VSI.SetCMOperation <-> outer port SetCMOperation
    delegate VSI.LongitudinalAcceleration_8b <-> outer port LongitudinalAcceleration_8b
    delegate VSI.IlluminationBrightnessPercent_SLCM08 <-> outer port IlluminationBrightnessPercent_SLCM08
    delegate VSI.NightOrDay_BB1_X_LCM <-> outer port NightOrDay_BB1_X_LCM
    delegate VSI.FuncIndIlluminationLevel <-> outer port FuncIndIlluminationLevel
    delegate SDF.SDF_Debug_Local <-> outer port SDF_Debug_Local
