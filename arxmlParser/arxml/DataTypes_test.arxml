AUTOSAR XML (schema 4-2-2)
package /Test
  ar-package:
    compu method Element1CompuMethod_T: phys=raw*0.5+1
    compu method Element2CompuMethod_T: phys=raw*0.5
    compu method Element3CompuMethod_T: phys=raw*0.25
    compu method ValueCompuMethod_T: phys=raw*5-10
    compu method ArrayElementCompuMethod_T: phys=raw*2
    7 x impl type:
      Array_T: category=ARRAY
        element ArrayElement: array-size=5, array-size-semantics=FIXED-SIZE, implementation-data-type=ArrayElement_T
      ArrayElement_T: category=VALUE, base-type=uint8_BaseType
      Value_T: category=VALUE, base-type=uint8_BaseType
      Element1_T: category=VALUE, base-type=uint16
      Element2_T: category=VALUE, base-type=Value_T
      Element3_T: category=VALUE, base-type=Boolean_T
      Struct_T: category=STRUCTURE
        element element{1..3}: implementation-data-type=Element{1..3}_T
